AUTOSAR XML (schema 00049)
package /Renesas/EcucDefs_GSA
  module config Pwm0: definition=Pwm, implementation-config-variant=VARIANT-POST-BUILD-LOADABLE, module-description=Pwm_Impl
    PwmChannelConfigSet0 (PwmChannelConfigSet)
      3 x PwmChannel, all with PwmChannelClass=PWM_VARIABLE_PERIOD, PwmIdleState=PWM_HIGH, PwmPolarity=PWM_HIGH, PwmChannelClk=CK1, PwmComplexDriverInit=false, PwmIntrPriority=false, PwmSyncStartReq=false, PwmMcuClockReferencePoint=McuClockReferencePoint0:
        PwmChannel0: PwmChannelId=0, PwmDutycycleDefault=0, PwmNotification=Pwm_Notif0, PwmPeriodDefault=65535, PwmTimerChannelSelection=TAUJ1O0, PwmTimerMode=PWM_MASTER_CHANNEL
        PwmChannel1: PwmChannelId=1, PwmDutycycleDefault=8192, PwmNotification=Pwm_Notif1, PwmPeriodDefault=0, PwmTimerChannelSelection=TAUJ1O1, PwmTimerMode=PWM_SLAVE_CHANNEL
        PwmChannel2: PwmChannelId=2, PwmDutycycleDefault=16384, PwmNotification=Pwm_Notif2, PwmPeriodDefault=0, PwmTimerChannelSelection=TAUJ1O2, PwmTimerMode=PWM_SLAVE_CHANNEL
      4 x PwmDiagChannel, all with PwmComplexDriverInit=false, PwmDiagClk=PWMCLK1, PwmDiagLoopCount=10000, PwmIntrPriority=false, PwmNotification=NULL, PwmOffsetDelayAdjust=false, PwmSyncStartReq=false:
        PwmDiagChannel0: PwmDiagChannelId=3, PwmDiagDutycycleDefault=1638, PwmDiagOutputSelection=DIAG_CH00, PwmOffset=50, PwmPolarity=PWM_HIGH, PwmTriggerDelay=75
        PwmDiagChannel1: PwmDiagChannelId=4, PwmDiagDutycycleDefault=3276, PwmDiagOutputSelection=DIAG_CH02, PwmOffset=868, PwmPolarity=PWM_LOW, PwmTriggerDelay=250
        PwmDiagChannel2: PwmDiagChannelId=5, PwmDiagDutycycleDefault=4915, PwmDiagOutputSelection=DIAG_CH04, PwmOffset=150, PwmPolarity=PWM_HIGH, PwmTriggerDelay=175
        PwmDiagChannel3: PwmDiagChannelId=6, PwmDiagDutycycleDefault=6553, PwmDiagOutputSelection=DIAG_CH06, PwmOffset=200, PwmPolarity=PWM_HIGH, PwmTriggerDelay=225
      PwmDiagUnit0 (PwmDiagUnit): PwmDiagBaudRateClk0=10, PwmDiagBaudRateClk1=8, PwmDiagBaudRateClk2=2, PwmDiagBaudRateClk3=1
      PwmTaUnit0 (PwmTaUnit):
        PwmPrescalerCk0 = PCLK_DIVBY_2_POWOF_0
        PwmPrescalerCk1 = PCLK_DIVBY_2_POWOF_4
        PwmPrescalerCk2 = PCLK_DIVBY_2_POWOF_8
        PwmPrescalerCk3BaudRate = 255
        PwmPrescalerCk3Pre = PCLK_DIVBY_2_POWOF_15
        PwmTaUnitSelection = TAUJ1
    PwmConfigurationOfOptApiServices:
      PwmDeInitApi = true
      PwmGetOutputState = true
      PwmSetDutyCycle = true
      PwmSetOutputToIdle = true
      PwmSetPeriodAndDuty = true
      PwmVersionInfoApi = true
      PwmSelectChannelClk = true
      PwmSetChannelOutput = true
      PwmSetTriggerDelay = true
    PwmGeneral0 (PwmGeneral):
      PwmDevErrorDetect = true
      PwmDutycycleUpdatedEndperiod = true
      PwmIndex = 0
      PwmNotificationSupported = true
      PwmPeriodUpdatedEndperiod = true
      PwmAlreadyInitDetCheck = true
      PwmClearPendingInterrupts = true
      PwmCriticalSectionProtection = true
      PwmDeviceName = R7F701583
      PwmDiagnosticSupport = true
      PwmPWGARamMirror = DISABLE
      PwmPWGAWriteVerify = WV_DISABLE
      PwmSyncStartSupport = false
      PwmTAUDBRamMirror = DISABLE
      PwmTAUDBWriteVerify = WV_DISABLE
      PwmTAUJRamMirror = DISABLE
      PwmTAUJWriteVerify = WV_DISABLE
      PwmUseWriteVerifyErrorInterface = false
      PwmVersionCheckExternalModules = true
      PwmWriteVerifyErrorInterface = NULL
      PwmPowerStateConfig: PwmPowerState=0, PwmPowerStateReadyCbkRef=NULL
    PwmDemEventParameterRefs0 (PwmDemEventParameterRefs):
      PWM_E_DIAG_FAILURE = DemEventParameter2
      PWM_E_REG_WRITE_VERIFY = DemEventParameter0
      PWM_E_TIMER_FAILURE = DemEventParameter1
      PWM_E_REWRITE_FAILED = DemEventParameter3
      PWM_E_TIMEOUT_FAILURE = DemEventParameter4
