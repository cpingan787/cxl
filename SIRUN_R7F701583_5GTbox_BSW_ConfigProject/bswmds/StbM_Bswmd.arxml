AUTOSAR XML (schema 00048)
package /AUTOSAR/BswOverviews
  bsw module description StbM: category=BSW_MODULE, implemented-entrys=StbM_MainFunction, module-id=160
    bsw internal behavior StbMBehavior
      exclusive area Context
      bsw schedulable entity StbM_MainFunction: implemented-entry=StbM_MainFunction
      bsw timing event TimingEvent_MainFunction: starts-on-event=StbM_MainFunction, period=0.01
package /AUTOSAR/BswImplementations
  bsw implementation StbMImplementation: programming-language=C, sw-version=1.0.0, vendor-id=62, ar-release-version=1.0.0, behavior=StbMBehavior
package /AUTOSAR/BswInterfaces
  bsw module entry StbM_MainFunction: service-id=4, is-synchronous=true, call-type=SCHEDULED, execution-context=TASK, sw-service-impl-policy=STANDARD
