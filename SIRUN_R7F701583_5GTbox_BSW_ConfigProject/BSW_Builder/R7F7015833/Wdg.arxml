AUTOSAR XML (schema 00048)
package /R7F7015833
  module config Wdg
    WdgGeneral: WdgDevErrorDetect=true, WdgDisableAllowed=true, WdgIndex=0, WdgInitialTimeout=5.0, WdgMaxTimeout=10.0, WdgRunArea=RAM, WdgVersionInfoApi=false
    WdgPublishedInformation: WdgTriggerMode=WDG_WINDOW
    WdgSettingsConfig: WdgDefaultMode=WDGIF_OFF_MODE
      WdgSettingsFast
      WdgSettingsOff
      WdgSettingsSlow
