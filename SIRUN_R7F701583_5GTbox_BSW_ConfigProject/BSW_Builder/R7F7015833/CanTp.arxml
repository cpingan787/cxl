AUTOSAR XML (schema 00048)
package /R7F7015833
  module config CanTp
    CanTpConfig: CanTpMainFunctionPeriod=0.01, CanTpMaxChannelCnt=1
      CanTpChannel_DbcDiag_0 (CanTpChannel): CanTpChannelMode=CANTP_MODE_FULL_DUPLEX
        CanTpRxNSdu_FUNC_RX_0x7DF (CanTpRxNSdu):
          CanTpNbr = 0.0
          CanTpRxAddressingFormat = CANTP_STANDARD
          CanTpRxNSduId = CANTP_CanTp_fun_rx_0x7df
          CanTpRxPaddingActivation = CANTP_ON
          CanTpRxTaType = CANTP_CANFD_FUNCTIONAL
          CanTpNar = 0.025
          CanTpNcr = 0.15
          CanTpRxWftMax = 255
          CanTpSTmin = 0.01
          CanTpBs = 0
          CanTpRxNSduRef = CanTp_fun_rx_0x7df
          CanTpRxNPdu: CanTpRxNPduId=CANTP_CanIf_fun_rx_0x7df, CanTpRxNPduRef=CanIf_fun_rx_0x7df
        CanTpRxNSdu_PHY_RX_0x711 (CanTpRxNSdu):
          CanTpNbr = 0.0
          CanTpRxAddressingFormat = CANTP_STANDARD
          CanTpRxNSduId = CANTP_CanTp_phy_rx_0x711
          CanTpRxPaddingActivation = CANTP_ON
          CanTpRxTaType = CANTP_CANFD_PHYSICAL
          CanTpBs = 0
          CanTpNar = 0.025
          CanTpNcr = 0.15
          CanTpRxWftMax = 255
          CanTpSTmin = 0.01
          CanTpRxNSduRef = CanTp_phy_rx_0x711
          CanTpRxNPdu: CanTpRxNPduId=CANTP_CanIf_phy_rx_0x711, CanTpRxNPduRef=CanIf_phy_rx_0x711
          CanTpTxFcNPdu: CanTpTxFcNPduConfirmationPduId=CANTP_CanIf_phy_tx_0x719, CanTpTxFcNPduRef=CanIf_phy_tx_0x719
        CanTpTxNSdu_TX_0x719 (CanTpTxNSdu):
          CanTpNas = 0.025
          CanTpTc = false
          CanTpTxAddressingFormat = CANTP_STANDARD
          CanTpTxNSduId = CANTP_CanTp_phy_tx_0x719
          CanTpTxPaddingActivation = CANTP_ON
          CanTpTxTaType = CANTP_PHYSICAL
          CanTpNbs = 0.075
          CanTpNcs = 0.025
          CanTpTxNSduRef = CanTp_phy_tx_0x719
          CanTpTxNPdu: CanTpTxNPduConfirmationPduId=CANTP_CanIf_phy_tx_0x719, CanTpTxNPduRef=CanIf_phy_tx_0x719
          CanTpRxFcNPdu: CanTpRxFcNPduId=CANTP_CanIf_phy_rx_0x711, CanTpRxFcNPduRef=CanIf_phy_rx_0x711
    CanTpGeneral:
      CanTpConfigType = PC_CONFIG
      CanTpChangeParameterApi = true
      CanTpDevErrorDetect = true
      CanTpPaddingByte = 170
      CanTpReadParameterApi = false
      CanTpVersionInfoApi = false
      CanTpDiagGWResEnable = false
      CanTpSynchronousRxIndication = false
      CanTpRuntimeErrorDetect = true
      CanTpRxQueue = false
      CanTpTimerType = MainFunction
      CanTpSynchronousTransmission = false
      CanTpFlexibleDataRateSupport = true
