AUTOSAR XML (schema 4-2-2)
# COPYRIGHT
# Copyright(c) 2016-2021 Renesas Electronics Corporation
package /Renesas/ModuleDescription_Mcu
  bsw implementation Mcu_Impl: programming-language=C, sw-version=1.2.6, vendor-id=59, ar-release-version=4.2.2, behavior=BswInternalBehavior_0, preconfigured-configuration=Mcu, vendor-specific-module-def=Mcu
    code-descriptors:
      code Mcu_Code: artifact-descriptors=[{short-label=Mcu.c, category=SWSRC}, {short-label=Mcu.h, category=SWHDR}]
    resource consumption ResourceConsumption
      12 x memory section:
        VAR_NO_INIT_8: sw-addrmethod=VAR
        VAR_NO_INIT_32: sw-addrmethod=VAR
        VAR_NO_INIT_UNSPECIFIED: sw-addrmethod=VAR
        VAR_INIT_BOOLEAN: sw-addrmethod=VAR
        BURAM_VAR_NO_INIT_8: sw-addrmethod=VAR
        BURAM_VAR_NO_INIT_32: sw-addrmethod=VAR
        CONST_UNSPECIFIED: sw-addrmethod=CONST
        CONFIG_DATA_UNSPECIFIED: sw-addrmethod=CONFIG_DATA
        CONFIG_DATA_8: sw-addrmethod=CONFIG_DATA
        CODE_FAST: sw-addrmethod=CODE
        PUBLIC_CODE: sw-addrmethod=CODE
        PRIVATE_CODE: sw-addrmethod=CODE
  module config Mcu_Preconfiguration: definition=Renesas, implementation-config-variant=VARIANT-PRE-COMPILE
    McuResetReason_1 (McuRstRsnConfSwRst): McuResetReason=1
    McuResetReason_2 (McuRstRsnConfWdta0): McuResetReason=2
    McuResetReason_3 (McuRstRsnConfWdta1): McuResetReason=3
    McuResetReason_4 (McuRstRsnConfClm0): McuResetReason=4
    McuResetReason_5 (McuRstRsnConfClm1): McuResetReason=5
    McuResetReason_6 (McuRstRsnConfClm2): McuResetReason=6
    McuResetReason_7 (McuRstRsnConfLvi): McuResetReason=7
    McuResetReason_8 (McuRstRsnConfCvm): McuResetReason=8
    McuResetReason_9 (McuRstRsnConfTer): McuResetReason=9
    McuResetReason_10 (McuRstRsnConfPOR): McuResetReason=10
    McuResetReason_11 (McuRstRsnConfIso): McuResetReason=11
    McuResetReason_12 (McuRstRsnConfResf11): McuResetReason=12
    McuResetReason_13 (McuRstRsnConfResf12): McuResetReason=13
    McuResetReason_14 (McuRstRsnConfResf13): McuResetReason=14
    McuResetReason_15 (McuRstRsnConfClm3): McuResetReason=15
    McuResetReason_16 (McuRstRsnConfUndef): McuResetReason=16
    McuResetReason_17 (McuRstRsnConfMultipleResets): McuResetReason=17
    McuResetReason_18 (McuRstRsnConfUnknown): McuResetReason=18
  bsw module description Mcu: module-id=101
    provided-entrys:
      Mcu_Init
      Mcu_InitClock
      Mcu_DistributePllClock
      Mcu_GetPllStatus
      Mcu_GetResetReason
      Mcu_GetResetRawValue
      Mcu_GetVersionInfo
      Mcu_PerformReset
      Mcu_SetMode
      Mcu_SequencerInit
      Mcu_SequencerStart
      Mcu_SequencerStop
      Mcu_SequencerDiCmpValueSet
      Mcu_GetRamState
      Mcu_WakeUpFactor_Preparation
      Mcu_InitRamSection
      Mcu_CheckHWConsistency
      MCU_FEINT_ISR
      MCU_FEINT_CAT2_ISR
      MCU_INTCWEND_ISR
      MCU_INTCWEND_CAT2_ISR
    bsw internal behavior BswInternalBehavior_0
      exclusive area MCU_REGISTER_PROTECTION
      exclusive area MCU_VARIABLE_PROTECTION
      17 x bsw called entity:
        BswCalledEntity_1: can-enter-exclusive-area=MCU_REGISTER_PROTECTION, implemented-entry=Mcu_Init
        BswCalledEntity_2: implemented-entry=Mcu_InitRamSection
        BswCalledEntity_3: can-enter-exclusive-area=[MCU_VARIABLE_PROTECTION, MCU_REGISTER_PROTECTION], implemented-entry=Mcu_InitClock
        BswCalledEntity_4: can-enter-exclusive-area=[MCU_VARIABLE_PROTECTION, MCU_REGISTER_PROTECTION], implemented-entry=Mcu_DistributePllClock
        BswCalledEntity_5: can-enter-exclusive-area=MCU_VARIABLE_PROTECTION, implemented-entry=Mcu_GetPllStatus
        BswCalledEntity_6: can-enter-exclusive-area=[MCU_VARIABLE_PROTECTION, MCU_REGISTER_PROTECTION], implemented-entry=Mcu_GetResetReason
        BswCalledEntity_7: can-enter-exclusive-area=[MCU_VARIABLE_PROTECTION, MCU_REGISTER_PROTECTION], implemented-entry=Mcu_GetResetRawValue
        BswCalledEntity_8: can-enter-exclusive-area=MCU_REGISTER_PROTECTION, implemented-entry=Mcu_PerformReset
        BswCalledEntity_9: implemented-entry=Mcu_SetMode
        BswCalledEntity_10: implemented-entry=Mcu_GetVersionInfo
        BswCalledEntity_11: implemented-entry=Mcu_GetRamState
        BswCalledEntity_12: can-enter-exclusive-area=[MCU_VARIABLE_PROTECTION, MCU_REGISTER_PROTECTION], implemented-entry=Mcu_SequencerInit
        BswCalledEntity_13: can-enter-exclusive-area=MCU_REGISTER_PROTECTION, implemented-entry=Mcu_SequencerStart
        BswCalledEntity_14: can-enter-exclusive-area=[MCU_VARIABLE_PROTECTION, MCU_REGISTER_PROTECTION], implemented-entry=Mcu_SequencerStop
        BswCalledEntity_16: can-enter-exclusive-area=MCU_REGISTER_PROTECTION, implemented-entry=Mcu_SequencerDiCmpValueSet
        BswCalledEntity_17: implemented-entry=Mcu_CheckHWConsistency
        BswCalledEntity_18: implemented-entry=Mcu_WakeUpFactor_Preparation
      4 x bsw interrupt entity:
        BswInterruptEntity_1: implemented-entry=MCU_FEINT_ISR, interrupt-category=CAT-1, interrupt-source=INTLVI
        BswInterruptEntity_2: implemented-entry=MCU_FEINT_CAT2_ISR, interrupt-category=CAT-2, interrupt-source=INTLVI
        BswInterruptEntity_3: implemented-entry=MCU_INTCWEND_ISR, interrupt-category=CAT-1, interrupt-source=INTCWEND
        BswInterruptEntity_4: implemented-entry=MCU_INTCWEND_CAT2_ISR, interrupt-category=CAT-2, interrupt-source=INTCWEND
  21 x bsw module entry, all with is-synchronous=true, sw-service-impl-policy=STANDARD:
    Mcu_Init: service-id=0, is-reentrant=false, call-type=REGULAR, execution-context=TASK
    Mcu_InitRamSection: service-id=1, is-reentrant=false, call-type=REGULAR, execution-context=TASK
    Mcu_InitClock: service-id=2, is-reentrant=false, call-type=REGULAR, execution-context=TASK
    Mcu_DistributePllClock: service-id=3, is-reentrant=false, call-type=REGULAR, execution-context=TASK
    Mcu_GetPllStatus: service-id=4, is-reentrant=true, call-type=REGULAR, execution-context=TASK
    Mcu_GetResetReason: service-id=5, is-reentrant=true, call-type=REGULAR, execution-context=TASK
    Mcu_GetResetRawValue: service-id=6, is-reentrant=true, call-type=REGULAR, execution-context=TASK
    Mcu_PerformReset: service-id=7, is-reentrant=false, call-type=REGULAR, execution-context=TASK
    Mcu_SetMode: service-id=8, is-reentrant=false, call-type=REGULAR, execution-context=TASK
    Mcu_GetVersionInfo: service-id=9, is-reentrant=true, call-type=REGULAR, execution-context=TASK
    Mcu_GetRamState: service-id=10, is-reentrant=true, call-type=REGULAR, execution-context=TASK
    Mcu_SequencerInit: service-id=11, is-reentrant=false, call-type=REGULAR, execution-context=TASK
    Mcu_SequencerStart: service-id=12, is-reentrant=false, call-type=REGULAR, execution-context=TASK
    Mcu_SequencerStop: service-id=13, is-reentrant=false, call-type=REGULAR, execution-context=TASK
    Mcu_SequencerDiCmpValueSet: service-id=15, is-reentrant=false, call-type=REGULAR, execution-context=TASK
    Mcu_CheckHWConsistency: service-id=16, is-reentrant=false, call-type=REGULAR, execution-context=TASK
    Mcu_WakeUpFactor_Preparation: service-id=17, is-reentrant=true, call-type=REGULAR, execution-context=TASK
    MCU_FEINT_ISR: is-reentrant=true, call-type=INTERRUPT, execution-context=INTERRUPT-CAT-1
    MCU_FEINT_CAT2_ISR: is-reentrant=true, call-type=INTERRUPT, execution-context=INTERRUPT-CAT-2
    MCU_INTCWEND_ISR: is-reentrant=true, call-type=INTERRUPT, execution-context=INTERRUPT-CAT-1
    MCU_INTCWEND_CAT2_ISR: is-reentrant=true, call-type=INTERRUPT, execution-context=INTERRUPT-CAT-2
