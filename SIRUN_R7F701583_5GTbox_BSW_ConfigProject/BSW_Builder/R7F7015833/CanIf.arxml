AUTOSAR XML (schema 00048)
package /R7F7015833
  module config CanIf
    CanIfCtrlDrvCfg: CanIfCtrlDrvInitHohConfigRef=CanIfInitHohCfg, CanIfCtrlDrvNameRef=Can
      CANIF_CONTROLLER_0_IAM (CanIfCtrlCfg): CanIfCtrlId=CANIF_CANDRV_0_CANIF_CONTROLLER_0_IAM, CanIfCtrlWakeupSupport=false, CanIfCtrlCanCtrlRef=CanController
    CanIfDispatchCfg:
      CanIfDispatchUserCheckTrcvWakeFlagIndicationName = User_CheckTransceiverWakeFlagIndication
      CanIfDispatchUserClearTrcvWufFlagIndicationName = User_ClearTrcvWufFlagIndication
      CanIfDispatchUserConfirmPnAvailabilityName = User_ConfirmPnAvailability
      CanIfDispatchUserCtrlBusOffName = CanSM_ControllerBusOff
      CanIfDispatchUserCtrlBusOffUL = CAN_SM
      CanIfDispatchUserCtrlModeIndicationName = CanSM_ControllerModeIndication
      CanIfDispatchUserCtrlModeIndicationUL = CAN_SM
      CanIfDispatchUserTrcvModeIndicationName = User_TrcvModeIndication
      CanIfDispatchUserValidateWakeupEventName = User_ValidateWakeupEvent
    CanIfInitCfg: CanIfInitCfgSet=CanIfInitCfgSet
      CanIfInitHohCfg
        CanifHrh_0 (CanIfHrhCfg): CanIfHrhSoftwareFilter=false, CanIfHrhCanCtrlIdRef=CANIF_CONTROLLER_0_IAM, CanIfHrhIdSymRef=CanHardwareObject_Rx0
        CanIfHth_0 (CanIfHthCfg): CanIfHthCanCtrlIdRef=CANIF_CONTROLLER_0_IAM, CanIfHthIdSymRef=CanHardwareObject_Tx0
        CanIfHth_1 (CanIfHthCfg): CanIfHthCanCtrlIdRef=CANIF_CONTROLLER_0_IAM, CanIfHthIdSymRef=CanHardwareObject_Tx1
      35 x CanIfTxPduCfg, all with CanIfTxPduCanIdType=STANDARD_FD_CAN, CanIfTxPduPnFilterPdu=false, CanIfTxPduReadNotifyStatus=false, CanIfTxPduTriggerTransmit=false, CanIfTxPduTruncation=true, CanIfTxPduType=DYNAMIC:
        TX_PDU_DIAG_DTCInfo_IAM_CONTROLLER_0_IAM: CanIfTxPduCanId=1801, CanIfTxPduId=CANIF_TXPDU_CANIF_DIAG_DTCInfo_IAM_CONTROLLER_0_IAM_Tx, CanIfTxPduUserTriggerTransmitName=PduR_CanIfTriggerTransmit, CanIfTxPduUserTxConfirmationName=PduR_CanIfTxConfirmation, CanIfTxPduUserTxConfirmationUL=PDUR, CanIfTxPduBufferRef=CanIfBufferCfg_0, CanIfTxPduRef=CANIF_DIAG_DTCInfo_IAM_CONTROLLER_0_IAM_Tx
        TX_PDU_IAM_BKPCANFD_1000ms_FrP60_CONTROLLER_0_IAM: CanIfTxPduCanId=1383, CanIfTxPduId=CANIF_TXPDU_CANIF_IAM_BKPCANFD_1000ms_FrP60_CONTROLLER_0_IAM_Tx, CanIfTxPduUserTriggerTransmitName=PduR_CanIfTriggerTransmit, CanIfTxPduUserTxConfirmationName=PduR_CanIfTxConfirmation, CanIfTxPduUserTxConfirmationUL=PDUR, CanIfTxPduBufferRef=CanIfBufferCfg_0, CanIfTxPduRef=CANIF_IAM_BKPCANFD_1000ms_FrP60_CONTROLLER_0_IAM_Tx
        TX_PDU_IAM_BKPCANFD_1000ms_FrP61_CONTROLLER_0_IAM: CanIfTxPduCanId=1384, CanIfTxPduId=CANIF_TXPDU_CANIF_IAM_BKPCANFD_1000ms_FrP61_CONTROLLER_0_IAM_Tx, CanIfTxPduUserTriggerTransmitName=PduR_CanIfTriggerTransmit, CanIfTxPduUserTxConfirmationName=PduR_CanIfTxConfirmation, CanIfTxPduUserTxConfirmationUL=PDUR, CanIfTxPduBufferRef=CanIfBufferCfg_0, CanIfTxPduRef=CANIF_IAM_BKPCANFD_1000ms_FrP61_CONTROLLER_0_IAM_Tx
        TX_PDU_IAM_BKPCANFD_1000ms_FrP62_CONTROLLER_0_IAM: CanIfTxPduCanId=1385, CanIfTxPduId=CANIF_TXPDU_CANIF_IAM_BKPCANFD_1000ms_FrP62_CONTROLLER_0_IAM_Tx, CanIfTxPduUserTriggerTransmitName=PduR_CanIfTriggerTransmit, CanIfTxPduUserTxConfirmationName=PduR_CanIfTxConfirmation, CanIfTxPduUserTxConfirmationUL=PDUR, CanIfTxPduBufferRef=CanIfBufferCfg_0, CanIfTxPduRef=CANIF_IAM_BKPCANFD_1000ms_FrP62_CONTROLLER_0_IAM_Tx
        TX_PDU_IAM_BKPCANFD_1000ms_FrP63_CONTROLLER_0_IAM: CanIfTxPduCanId=1386, CanIfTxPduId=CANIF_TXPDU_CANIF_IAM_BKPCANFD_1000ms_FrP63_CONTROLLER_0_IAM_Tx, CanIfTxPduUserTriggerTransmitName=PduR_CanIfTriggerTransmit, CanIfTxPduUserTxConfirmationName=PduR_CanIfTxConfirmation, CanIfTxPduUserTxConfirmationUL=PDUR, CanIfTxPduBufferRef=CanIfBufferCfg_0, CanIfTxPduRef=CANIF_IAM_BKPCANFD_1000ms_FrP63_CONTROLLER_0_IAM_Tx
        TX_PDU_IAM_BKPCANFD_1000ms_FrP64_CONTROLLER_0_IAM: CanIfTxPduCanId=1387, CanIfTxPduId=CANIF_TXPDU_CANIF_IAM_BKPCANFD_1000ms_FrP64_CONTROLLER_0_IAM_Tx, CanIfTxPduUserTriggerTransmitName=PduR_CanIfTriggerTransmit, CanIfTxPduUserTxConfirmationName=PduR_CanIfTxConfirmation, CanIfTxPduUserTxConfirmationUL=PDUR, CanIfTxPduBufferRef=CanIfBufferCfg_0, CanIfTxPduRef=CANIF_IAM_BKPCANFD_1000ms_FrP64_CONTROLLER_0_IAM_Tx
        TX_PDU_IAM_BKPCANFD_1000ms_FrP65_CONTROLLER_0_IAM: CanIfTxPduCanId=1388, CanIfTxPduId=CANIF_TXPDU_CANIF_IAM_BKPCANFD_1000ms_FrP65_CONTROLLER_0_IAM_Tx, CanIfTxPduUserTriggerTransmitName=PduR_CanIfTriggerTransmit, CanIfTxPduUserTxConfirmationName=PduR_CanIfTxConfirmation, CanIfTxPduUserTxConfirmationUL=PDUR, CanIfTxPduBufferRef=CanIfBufferCfg_0, CanIfTxPduRef=CANIF_IAM_BKPCANFD_1000ms_FrP65_CONTROLLER_0_IAM_Tx
        TX_PDU_IAM_BKPCANFD_1000ms_FrP66_CONTROLLER_0_IAM: CanIfTxPduCanId=1380, CanIfTxPduId=CANIF_TXPDU_CANIF_IAM_BKPCANFD_1000ms_FrP66_CONTROLLER_0_IAM_Tx, CanIfTxPduUserTriggerTransmitName=PduR_CanIfTriggerTransmit, CanIfTxPduUserTxConfirmationName=PduR_CanIfTxConfirmation, CanIfTxPduUserTxConfirmationUL=PDUR, CanIfTxPduBufferRef=CanIfBufferCfg_0, CanIfTxPduRef=CANIF_IAM_BKPCANFD_1000ms_FrP66_CONTROLLER_0_IAM_Tx
        TX_PDU_IAM_CONNCAN_100ms_FrP18_CONTROLLER_0_IAM: CanIfTxPduCanId=811, CanIfTxPduId=CANIF_TXPDU_CANIF_IAM_CONNCAN_100ms_FrP18_CONTROLLER_0_IAM_Tx, CanIfTxPduUserTriggerTransmitName=PduR_CanIfTriggerTransmit, CanIfTxPduUserTxConfirmationName=PduR_CanIfTxConfirmation, CanIfTxPduUserTxConfirmationUL=PDUR, CanIfTxPduBufferRef=CanIfBufferCfg_0, CanIfTxPduRef=CANIF_IAM_CONNCAN_100ms_FrP18_CONTROLLER_0_IAM_Tx
        TX_PDU_IAM_CONNCAN_200ms_FrP01_CONTROLLER_0_IAM: CanIfTxPduCanId=1053, CanIfTxPduId=CANIF_TXPDU_CANIF_IAM_CONNCAN_200ms_FrP01_CONTROLLER_0_IAM_Tx, CanIfTxPduUserTriggerTransmitName=PduR_CanIfTriggerTransmit, CanIfTxPduUserTxConfirmationName=PduR_CanIfTxConfirmation, CanIfTxPduUserTxConfirmationUL=PDUR, CanIfTxPduBufferRef=CanIfBufferCfg_0, CanIfTxPduRef=CANIF_IAM_CONNCAN_200ms_FrP01_CONTROLLER_0_IAM_Tx
        TX_PDU_IAM_CONNCAN_200ms_FrP02_CONTROLLER_0_IAM: CanIfTxPduCanId=1130, CanIfTxPduId=CANIF_TXPDU_CANIF_IAM_CONNCAN_200ms_FrP02_CONTROLLER_0_IAM_Tx, CanIfTxPduUserTriggerTransmitName=PduR_CanIfTriggerTransmit, CanIfTxPduUserTxConfirmationName=PduR_CanIfTxConfirmation, CanIfTxPduUserTxConfirmationUL=PDUR, CanIfTxPduBufferRef=CanIfBufferCfg_0, CanIfTxPduRef=CANIF_IAM_CONNCAN_200ms_FrP02_CONTROLLER_0_IAM_Tx
        TX_PDU_IAM_CONNCAN_Event_FrS20_CONTROLLER_0_IAM: CanIfTxPduCanId=1398, CanIfTxPduId=CANIF_TXPDU_CANIF_IAM_CONNCAN_Event_FrS20_CONTROLLER_0_IAM_Tx, CanIfTxPduUserTriggerTransmitName=PduR_CanIfTriggerTransmit, CanIfTxPduUserTxConfirmationName=PduR_CanIfTxConfirmation, CanIfTxPduUserTxConfirmationUL=PDUR, CanIfTxPduBufferRef=CanIfBufferCfg_0, CanIfTxPduRef=CANIF_IAM_CONNCAN_Event_FrS20_CONTROLLER_0_IAM_Tx
        TX_PDU_IAM_CONNCAN_Event_FrS21_CONTROLLER_0_IAM: CanIfTxPduCanId=1358, CanIfTxPduId=CANIF_TXPDU_CANIF_IAM_CONNCAN_Event_FrS21_CONTROLLER_0_IAM_Tx, CanIfTxPduUserTriggerTransmitName=PduR_CanIfTriggerTransmit, CanIfTxPduUserTxConfirmationName=PduR_CanIfTxConfirmation, CanIfTxPduUserTxConfirmationUL=PDUR, CanIfTxPduBufferRef=CanIfBufferCfg_0, CanIfTxPduRef=CANIF_IAM_CONNCAN_Event_FrS21_CONTROLLER_0_IAM_Tx
        TX_PDU_IAM_CONNCANFD_100ms_FrP19_CONTROLLER_0_IAM: CanIfTxPduCanId=700, CanIfTxPduId=CANIF_TXPDU_CANIF_IAM_CONNCANFD_100ms_FrP19_CONTROLLER_0_IAM_Tx, CanIfTxPduUserTriggerTransmitName=PduR_CanIfTriggerTransmit, CanIfTxPduUserTxConfirmationName=PduR_CanIfTxConfirmation, CanIfTxPduUserTxConfirmationUL=PDUR, CanIfTxPduBufferRef=CanIfBufferCfg_0, CanIfTxPduRef=CANIF_IAM_CONNCANFD_100ms_FrP19_CONTROLLER_0_IAM_Tx
        TX_PDU_IAM_CONNCANFD_Event_FrS04_CONTROLLER_0_IAM: CanIfTxPduCanId=89, CanIfTxPduId=CANIF_TXPDU_CANIF_IAM_CONNCANFD_Event_FrS04_CONTROLLER_0_IAM_Tx, CanIfTxPduUserTriggerTransmitName=PduR_CanIfTriggerTransmit, CanIfTxPduUserTxConfirmationName=PduR_CanIfTxConfirmation, CanIfTxPduUserTxConfirmationUL=PDUR, CanIfTxPduBufferRef=CanIfBufferCfg_0, CanIfTxPduRef=CANIF_IAM_CONNCANFD_Event_FrS04_CONTROLLER_0_IAM_Tx
        TX_PDU_IAM_CONNCANFD_Event_FrS42_CONTROLLER_0_IAM: CanIfTxPduCanId=1281, CanIfTxPduId=CANIF_TXPDU_CANIF_IAM_CONNCANFD_Event_FrS42_CONTROLLER_0_IAM_Tx, CanIfTxPduUserTriggerTransmitName=PduR_CanIfTriggerTransmit, CanIfTxPduUserTxConfirmationName=PduR_CanIfTxConfirmation, CanIfTxPduUserTxConfirmationUL=PDUR, CanIfTxPduBufferRef=CanIfBufferCfg_0, CanIfTxPduRef=CANIF_IAM_CONNCANFD_Event_FrS42_CONTROLLER_0_IAM_Tx
        TX_PDU_IAM_CONNCANFD_Event_FrS43_CONTROLLER_0_IAM: CanIfTxPduCanId=1284, CanIfTxPduId=CANIF_TXPDU_CANIF_IAM_CONNCANFD_Event_FrS43_CONTROLLER_0_IAM_Tx, CanIfTxPduUserTriggerTransmitName=PduR_CanIfTriggerTransmit, CanIfTxPduUserTxConfirmationName=PduR_CanIfTxConfirmation, CanIfTxPduUserTxConfirmationUL=PDUR, CanIfTxPduBufferRef=CanIfBufferCfg_0, CanIfTxPduRef=CANIF_IAM_CONNCANFD_Event_FrS43_CONTROLLER_0_IAM_Tx
        TX_PDU_IAM_CONNCANFD_Event_FrS44_CONTROLLER_0_IAM: CanIfTxPduCanId=1286, CanIfTxPduId=CANIF_TXPDU_CANIF_IAM_CONNCANFD_Event_FrS44_CONTROLLER_0_IAM_Tx, CanIfTxPduUserTriggerTransmitName=PduR_CanIfTriggerTransmit, CanIfTxPduUserTxConfirmationName=PduR_CanIfTxConfirmation, CanIfTxPduUserTxConfirmationUL=PDUR, CanIfTxPduBufferRef=CanIfBufferCfg_0, CanIfTxPduRef=CANIF_IAM_CONNCANFD_Event_FrS44_CONTROLLER_0_IAM_Tx
        TX_PDU_IAM_CONNCANFD_EvtInfo_CONTROLLER_0_IAM: CanIfTxPduCanId=96, CanIfTxPduId=CANIF_TXPDU_CANIF_IAM_CONNCANFD_EvtInfo_CONTROLLER_0_IAM_Tx, CanIfTxPduUserTriggerTransmitName=PduR_CanIfTriggerTransmit, CanIfTxPduUserTxConfirmationName=PduR_CanIfTxConfirmation, CanIfTxPduUserTxConfirmationUL=PDUR, CanIfTxPduBufferRef=CanIfBufferCfg_0, CanIfTxPduRef=CANIF_IAM_CONNCANFD_EvtInfo_CONTROLLER_0_IAM_Tx
        TX_PDU_IAM_SecOC_ComKeyResp_CONTROLLER_0_IAM: CanIfTxPduCanId=152, CanIfTxPduId=CANIF_TXPDU_CANIF_IAM_SecOC_ComKeyResp_CONTROLLER_0_IAM_Tx, CanIfTxPduUserTriggerTransmitName=PduR_CanIfTriggerTransmit, CanIfTxPduUserTxConfirmationName=PduR_CanIfTxConfirmation, CanIfTxPduUserTxConfirmationUL=PDUR, CanIfTxPduBufferRef=CanIfBufferCfg_0, CanIfTxPduRef=CANIF_IAM_SecOC_ComKeyResp_CONTROLLER_0_IAM_Tx
        TX_PDU_IAM_SecOC_Log_CONTROLLER_0_IAM: CanIfTxPduCanId=95, CanIfTxPduId=CANIF_TXPDU_CANIF_IAM_SecOC_Log_CONTROLLER_0_IAM_Tx, CanIfTxPduUserTriggerTransmitName=PduR_CanIfTriggerTransmit, CanIfTxPduUserTxConfirmationName=PduR_CanIfTxConfirmation, CanIfTxPduUserTxConfirmationUL=PDUR, CanIfTxPduBufferRef=CanIfBufferCfg_0, CanIfTxPduRef=CANIF_IAM_SecOC_Log_CONTROLLER_0_IAM_Tx
        TX_PDU_IAM_ZONE_CONNCANFD_100ms_FrP56_CONTROLLER_0_IAM: CanIfTxPduCanId=974, CanIfTxPduId=CANIF_TXPDU_CANIF_IAM_ZONE_CONNCANFD_100ms_FrP56_CONTROLLER_0_IAM_Tx, CanIfTxPduUserTriggerTransmitName=PduR_CanIfTriggerTransmit, CanIfTxPduUserTxConfirmationName=PduR_CanIfTxConfirmation, CanIfTxPduUserTxConfirmationUL=PDUR, CanIfTxPduBufferRef=CanIfBufferCfg_0, CanIfTxPduRef=CANIF_IAM_ZONE_CONNCANFD_100ms_FrP56_CONTROLLER_0_IAM_Tx
        TX_PDU_TBOX_CONNCAN_20ms_FrP02_CONTROLLER_0_IAM: CanIfTxPduCanId=504, CanIfTxPduId=CANIF_TXPDU_CANIF_TBOX_CONNCAN_20ms_FrP02_CONTROLLER_0_IAM_Tx, CanIfTxPduUserTriggerTransmitName=PduR_CanIfTriggerTransmit, CanIfTxPduUserTxConfirmationName=PduR_CanIfTxConfirmation, CanIfTxPduUserTxConfirmationUL=PDUR, CanIfTxPduBufferRef=CanIfBufferCfg_0, CanIfTxPduRef=CANIF_TBOX_CONNCAN_20ms_FrP02_CONTROLLER_0_IAM_Tx
        TX_PDU_IAM_BKPCANFD_1000ms_FrP49_CONTROLLER_0_IAM: CanIfTxPduCanId=1381, CanIfTxPduId=CANIF_TXPDU_CANIF_IAM_BKPCANFD_1000ms_FrP49_CONTROLLER_0_IAM_Tx, CanIfTxPduUserTriggerTransmitName=PduR_CanIfTriggerTransmit, CanIfTxPduUserTxConfirmationName=PduR_CanIfTxConfirmation, CanIfTxPduUserTxConfirmationUL=PDUR, CanIfTxPduBufferRef=CanIfBufferCfg_0, CanIfTxPduRef=CANIF_IAM_BKPCANFD_1000ms_FrP49_CONTROLLER_0_IAM_Tx
        TX_PDU_IAM_BKPCANFD_1000ms_FrP55_CONTROLLER_0_IAM: CanIfTxPduCanId=1374, CanIfTxPduId=CANIF_TXPDU_CANIF_IAM_BKPCANFD_1000ms_FrP55_CONTROLLER_0_IAM_Tx, CanIfTxPduUserTriggerTransmitName=PduR_CanIfTriggerTransmit, CanIfTxPduUserTxConfirmationName=PduR_CanIfTxConfirmation, CanIfTxPduUserTxConfirmationUL=PDUR, CanIfTxPduBufferRef=CanIfBufferCfg_0, CanIfTxPduRef=CANIF_IAM_BKPCANFD_1000ms_FrP55_CONTROLLER_0_IAM_Tx
        TX_PDU_IAM_BKPCANFD_1000ms_FrP58_CONTROLLER_0_IAM: CanIfTxPduCanId=1375, CanIfTxPduId=CANIF_TXPDU_CANIF_IAM_BKPCANFD_1000ms_FrP58_CONTROLLER_0_IAM_Tx, CanIfTxPduUserTriggerTransmitName=PduR_CanIfTriggerTransmit, CanIfTxPduUserTxConfirmationName=PduR_CanIfTxConfirmation, CanIfTxPduUserTxConfirmationUL=PDUR, CanIfTxPduBufferRef=CanIfBufferCfg_0, CanIfTxPduRef=CANIF_IAM_BKPCANFD_1000ms_FrP58_CONTROLLER_0_IAM_Tx
        TX_PDU_IAM_BKPCANFD_1000ms_FrP59_CONTROLLER_0_IAM: CanIfTxPduCanId=1382, CanIfTxPduId=CANIF_TXPDU_CANIF_IAM_BKPCANFD_1000ms_FrP59_CONTROLLER_0_IAM_Tx, CanIfTxPduUserTriggerTransmitName=PduR_CanIfTriggerTransmit, CanIfTxPduUserTxConfirmationName=PduR_CanIfTxConfirmation, CanIfTxPduUserTxConfirmationUL=PDUR, CanIfTxPduBufferRef=CanIfBufferCfg_0, CanIfTxPduRef=CANIF_IAM_BKPCANFD_1000ms_FrP59_CONTROLLER_0_IAM_Tx
        TX_PDU_synthesized_IAM_ZONE_CONNCANFD_E_CONTROLLER_0_IAM: CanIfTxPduCanId=125, CanIfTxPduId=CANIF_TXPDU_CANIF_synthesized_IAM_ZONE_CONNCANFD_E_CONTROLLER_0_IAM_Tx, CanIfTxPduUserTriggerTransmitName=PduR_CanIfTriggerTransmit, CanIfTxPduUserTxConfirmationName=PduR_CanIfTxConfirmation, CanIfTxPduUserTxConfirmationUL=PDUR, CanIfTxPduBufferRef=CanIfBufferCfg_0, CanIfTxPduRef=CANIF_synthesized_IAM_ZONE_CONNCANFD_E_CONTROLLER_0_IAM_Tx
        TX_PDU_synthesized_IAM_ZONE_CONNCA_0000_CONTROLLER_0_IAM: CanIfTxPduCanId=159, CanIfTxPduId=CANIF_TXPDU_CANIF_synthesized_IAM_ZONE_CONNCA_0000_CONTROLLER_0_IAM_Tx, CanIfTxPduUserTriggerTransmitName=PduR_CanIfTriggerTransmit, CanIfTxPduUserTxConfirmationName=PduR_CanIfTxConfirmation, CanIfTxPduUserTxConfirmationUL=PDUR, CanIfTxPduBufferRef=CanIfBufferCfg_0, CanIfTxPduRef=CANIF_synthesized_IAM_ZONE_CONNCA_0000_CONTROLLER_0_IAM_Tx
        TX_PDU_synthesized_IAM_ZONE_CONNCA_0001_CONTROLLER_0_IAM: CanIfTxPduCanId=179, CanIfTxPduId=CANIF_TXPDU_CANIF_synthesized_IAM_ZONE_CONNCA_0001_CONTROLLER_0_IAM_Tx, CanIfTxPduUserTriggerTransmitName=PduR_CanIfTriggerTransmit, CanIfTxPduUserTxConfirmationName=PduR_CanIfTxConfirmation, CanIfTxPduUserTxConfirmationUL=PDUR, CanIfTxPduBufferRef=CanIfBufferCfg_0, CanIfTxPduRef=CANIF_synthesized_IAM_ZONE_CONNCA_0001_CONTROLLER_0_IAM_Tx
        TX_PDU_synthesized_IAM_BKPCANFD_20ms_Fr_CONTROLLER_0_IAM: CanIfTxPduCanId=298, CanIfTxPduId=CANIF_TXPDU_CANIF_synthesized_IAM_BKPCANFD_20ms_Fr_CONTROLLER_0_IAM_Tx, CanIfTxPduUserTriggerTransmitName=PduR_CanIfTriggerTransmit, CanIfTxPduUserTxConfirmationName=PduR_CanIfTxConfirmation, CanIfTxPduUserTxConfirmationUL=PDUR, CanIfTxPduBufferRef=CanIfBufferCfg_0, CanIfTxPduRef=CANIF_synthesized_IAM_BKPCANFD_20ms_Fr_CONTROLLER_0_IAM_Tx
        TX_PDU_IAM_CONNCANFD_100ms_ConFrP03_CONTROLLER_0_IAM: CanIfTxPduCanId=874, CanIfTxPduId=CANIF_TXPDU_CanIf_Contained_Tx_Pdu_0x36A, CanIfTxPduUserTriggerTransmitName=PduR_CanIfTriggerTransmit, CanIfTxPduUserTxConfirmationName=PduR_CanIfTxConfirmation, CanIfTxPduUserTxConfirmationUL=PDUR, CanIfTxPduBufferRef=CanIfBufferCfg_1, CanIfTxPduRef=CanIf_Contained_Tx_Pdu_0x36A
        TX_PDU_IAM_CONNCANFD_100ms_ConFrP02_CONTROLLER_0_IAM: CanIfTxPduCanId=887, CanIfTxPduId=CANIF_TXPDU_CanIf_Contained_Tx_Pdu_0x377, CanIfTxPduUserTriggerTransmitName=PduR_CanIfTriggerTransmit, CanIfTxPduUserTxConfirmationName=PduR_CanIfTxConfirmation, CanIfTxPduUserTxConfirmationUL=PDUR, CanIfTxPduBufferRef=CanIfBufferCfg_1, CanIfTxPduRef=CanIf_Contained_Tx_Pdu_0x377
        TX_PDU_IAM_CONNCANFD_100ms_ConFrP41_CONTROLLER_0_IAM: CanIfTxPduCanId=930, CanIfTxPduId=CANIF_TXPDU_CanIf_Contained_Tx_Pdu_0x3A2, CanIfTxPduUserTriggerTransmitName=PduR_CanIfTriggerTransmit, CanIfTxPduUserTxConfirmationName=PduR_CanIfTxConfirmation, CanIfTxPduUserTxConfirmationUL=PDUR, CanIfTxPduBufferRef=CanIfBufferCfg_1, CanIfTxPduRef=CanIf_Contained_Tx_Pdu_0x3A2
        TX_PDU_Diag_CONNCANFD_PhyResp_IAM_CONTROLLER_0_IAM: CanIfTxPduCanId=1817, CanIfTxPduId=CANIF_TXPDU_CanIf_phy_tx_0x719, CanIfTxPduUserTriggerTransmitName=CanTp_TriggerTransmit, CanIfTxPduUserTxConfirmationName=CanTp_TxConfirmation, CanIfTxPduUserTxConfirmationUL=CAN_TP, CanIfTxPduBufferRef=CanIfBufferCfg_0, CanIfTxPduRef=CanIf_phy_tx_0x719
      120 x CanIfRxPduCfg, all with CanIfRxPduCanIdType=STANDARD_FD_CAN, CanIfRxPduReadData=false, CanIfRxPduReadNotifyStatus=false, CanIfRxPduHrhIdRef=CanifHrh_0:
        RX_PDU_SDM_SFCANFD_Event_FrS14_CONTROLLER_0_IAM: CanIfRxPduDataLength=8, CanIfRxPduDataLengthCheck=true, CanIfRxPduId=CANIF_RXPDU_CANIF_SDM_SFCANFD_Event_FrS14_CONTROLLER_0_IAM_Rx, CanIfRxPduUserRxIndicationName=PduR_CanIfRxIndication, CanIfRxPduUserRxIndicationUL=PDUR, CanIfRxPduCanId=53, CanIfRxPduRef=CANIF_SDM_SFCANFD_Event_FrS14_CONTROLLER_0_IAM_Rx
        RX_PDU_ICBAD_BKPCANFD_Event_FrS04_CONTROLLER_0_IAM: CanIfRxPduDataLength=48, CanIfRxPduDataLengthCheck=true, CanIfRxPduId=CANIF_RXPDU_CANIF_ICBAD_BKPCANFD_Event_FrS04_CONTROLLER_0_IAM_Rx, CanIfRxPduUserRxIndicationName=PduR_CanIfRxIndication, CanIfRxPduUserRxIndicationUL=PDUR, CanIfRxPduCanId=54, CanIfRxPduRef=CANIF_ICBAD_BKPCANFD_Event_FrS04_CONTROLLER_0_IAM_Rx
        RX_PDU_ICBAD_BKPCANFD_Event_FrS05_CONTROLLER_0_IAM: CanIfRxPduDataLength=48, CanIfRxPduDataLengthCheck=true, CanIfRxPduId=CANIF_RXPDU_CANIF_ICBAD_BKPCANFD_Event_FrS05_CONTROLLER_0_IAM_Rx, CanIfRxPduUserRxIndicationName=PduR_CanIfRxIndication, CanIfRxPduUserRxIndicationUL=PDUR, CanIfRxPduCanId=59, CanIfRxPduRef=CANIF_ICBAD_BKPCANFD_Event_FrS05_CONTROLLER_0_IAM_Rx
        RX_PDU_ICBVC_SecOC_ComKeyReq_CONTROLLER_0_IAM: CanIfRxPduDataLength=8, CanIfRxPduDataLengthCheck=true, CanIfRxPduId=CANIF_RXPDU_CANIF_ICBVC_SecOC_ComKeyReq_CONTROLLER_0_IAM_Rx, CanIfRxPduUserRxIndicationName=PduR_CanIfRxIndication, CanIfRxPduUserRxIndicationUL=PDUR, CanIfRxPduCanId=60, CanIfRxPduRef=CANIF_ICBVC_SecOC_ComKeyReq_CONTROLLER_0_IAM_Rx
        RX_PDU_ICBAD_ZONE_CHCANFD_20ms_FrP13_CONTROLLER_0_IAM: CanIfRxPduDataLength=8, CanIfRxPduDataLengthCheck=true, CanIfRxPduId=CANIF_RXPDU_CANIF_ICBAD_ZONE_CHCANFD_20ms_FrP13_CONTROLLER_0_IAM_Rx, CanIfRxPduUserRxIndicationName=PduR_CanIfRxIndication, CanIfRxPduUserRxIndicationUL=PDUR, CanIfRxPduCanId=81, CanIfRxPduRef=CANIF_ICBAD_ZONE_CHCANFD_20ms_FrP13_CONTROLLER_0_IAM_Rx
        RX_PDU_TC_ZONE_PTCANFD_10ms_FrP01_CONTROLLER_0_IAM: CanIfRxPduDataLength=8, CanIfRxPduDataLengthCheck=true, CanIfRxPduId=CANIF_RXPDU_CANIF_TC_ZONE_PTCANFD_10ms_FrP01_CONTROLLER_0_IAM_Rx, CanIfRxPduUserRxIndicationName=PduR_CanIfRxIndication, CanIfRxPduUserRxIndicationUL=PDUR, CanIfRxPduCanId=87, CanIfRxPduRef=CANIF_TC_ZONE_PTCANFD_10ms_FrP01_CONTROLLER_0_IAM_Rx
        RX_PDU_ICM_INFOCANFD_EvtInfo_CONTROLLER_0_IAM: CanIfRxPduDataLength=8, CanIfRxPduDataLengthCheck=true, CanIfRxPduId=CANIF_RXPDU_CANIF_ICM_INFOCANFD_EvtInfo_CONTROLLER_0_IAM_Rx, CanIfRxPduUserRxIndicationName=PduR_CanIfRxIndication, CanIfRxPduUserRxIndicationUL=PDUR, CanIfRxPduCanId=90, CanIfRxPduRef=CANIF_ICM_INFOCANFD_EvtInfo_CONTROLLER_0_IAM_Rx
        RX_PDU_AMP_INFOCAN_EvtInfo_CONTROLLER_0_IAM: CanIfRxPduDataLength=8, CanIfRxPduDataLengthCheck=true, CanIfRxPduId=CANIF_RXPDU_CANIF_AMP_INFOCAN_EvtInfo_CONTROLLER_0_IAM_Rx, CanIfRxPduUserRxIndicationName=PduR_CanIfRxIndication, CanIfRxPduUserRxIndicationUL=PDUR, CanIfRxPduCanId=106, CanIfRxPduRef=CANIF_AMP_INFOCAN_EvtInfo_CONTROLLER_0_IAM_Rx
        RX_PDU_ECM_ERCANFD_10ms_FrP00_CONTROLLER_0_IAM: CanIfRxPduDataLength=8, CanIfRxPduDataLengthCheck=true, CanIfRxPduId=CANIF_RXPDU_CANIF_ECM_ERCANFD_10ms_FrP00_CONTROLLER_0_IAM_Rx, CanIfRxPduUserRxIndicationName=PduR_CanIfRxIndication, CanIfRxPduUserRxIndicationUL=PDUR, CanIfRxPduCanId=132, CanIfRxPduRef=CANIF_ECM_ERCANFD_10ms_FrP00_CONTROLLER_0_IAM_Rx
        RX_PDU_LHZCU_LHBKBCANFD_10ms_FrP01_CONTROLLER_0_IAM: CanIfRxPduDataLength=8, CanIfRxPduDataLengthCheck=true, CanIfRxPduId=CANIF_RXPDU_CANIF_LHZCU_LHBKBCANFD_10ms_FrP01_CONTROLLER_0_IAM_Rx, CanIfRxPduUserRxIndicationName=PduR_CanIfRxIndication, CanIfRxPduUserRxIndicationUL=PDUR, CanIfRxPduCanId=157, CanIfRxPduRef=CANIF_LHZCU_LHBKBCANFD_10ms_FrP01_CONTROLLER_0_IAM_Rx
        RX_PDU_RZCU_PTCANFD_10ms_FrP01_CONTROLLER_0_IAM: CanIfRxPduDataLength=8, CanIfRxPduDataLengthCheck=true, CanIfRxPduId=CANIF_RXPDU_CANIF_RZCU_PTCANFD_10ms_FrP01_CONTROLLER_0_IAM_Rx, CanIfRxPduUserRxIndicationName=PduR_CanIfRxIndication, CanIfRxPduUserRxIndicationUL=PDUR, CanIfRxPduCanId=180, CanIfRxPduRef=CANIF_RZCU_PTCANFD_10ms_FrP01_CONTROLLER_0_IAM_Rx
        RX_PDU_IBS_CHCANFD_10ms_FrP04_CONTROLLER_0_IAM: CanIfRxPduDataLength=8, CanIfRxPduDataLengthCheck=true, CanIfRxPduId=CANIF_RXPDU_CANIF_IBS_CHCANFD_10ms_FrP04_CONTROLLER_0_IAM_Rx, CanIfRxPduUserRxIndicationName=PduR_CanIfRxIndication, CanIfRxPduUserRxIndicationUL=PDUR, CanIfRxPduCanId=184, CanIfRxPduRef=CANIF_IBS_CHCANFD_10ms_FrP04_CONTROLLER_0_IAM_Rx
        RX_PDU_PEU_PTCANFD_10ms_FrP04_SigGWtoCO_CONTROLLER_0_IAM: CanIfRxPduDataLength=16, CanIfRxPduDataLengthCheck=true, CanIfRxPduId=CANIF_RXPDU_CANIF_PEU_PTCANFD_10ms_FrP04_SigGWtoCO_CONTROLLER_0_IAM_Rx, CanIfRxPduUserRxIndicationName=PduR_CanIfRxIndication, CanIfRxPduUserRxIndicationUL=PDUR, CanIfRxPduCanId=212, CanIfRxPduRef=CANIF_PEU_PTCANFD_10ms_FrP04_SigGWtoCO_CONTROLLER_0_IAM_Rx
        RX_PDU_DLP_BDCAN_EvtInfo_CONTROLLER_0_IAM: CanIfRxPduDataLength=8, CanIfRxPduDataLengthCheck=true, CanIfRxPduId=CANIF_RXPDU_CANIF_DLP_BDCAN_EvtInfo_CONTROLLER_0_IAM_Rx, CanIfRxPduUserRxIndicationName=PduR_CanIfRxIndication, CanIfRxPduUserRxIndicationUL=PDUR, CanIfRxPduCanId=214, CanIfRxPduRef=CANIF_DLP_BDCAN_EvtInfo_CONTROLLER_0_IAM_Rx
        RX_PDU_PEU_PTCANFD_5ms_FrP02_SigGwTOCON_CONTROLLER_0_IAM: CanIfRxPduDataLength=8, CanIfRxPduDataLengthCheck=true, CanIfRxPduId=CANIF_RXPDU_CANIF_PEU_PTCANFD_5ms_FrP02_SigGwTOCON_CONTROLLER_0_IAM_Rx, CanIfRxPduUserRxIndicationName=PduR_CanIfRxIndication, CanIfRxPduUserRxIndicationUL=PDUR, CanIfRxPduCanId=226, CanIfRxPduRef=CANIF_PEU_PTCANFD_5ms_FrP02_SigGwTOCON_CONTROLLER_0_IAM_Rx
        RX_PDU_TC_PTCANFD_10ms_FrP01_SigGWTORZC_CONTROLLER_0_IAM: CanIfRxPduDataLength=16, CanIfRxPduDataLengthCheck=true, CanIfRxPduId=CANIF_RXPDU_CANIF_TC_PTCANFD_10ms_FrP01_SigGWTORZC_CONTROLLER_0_IAM_Rx, CanIfRxPduUserRxIndicationName=PduR_CanIfRxIndication, CanIfRxPduUserRxIndicationUL=PDUR, CanIfRxPduCanId=237, CanIfRxPduRef=CANIF_TC_PTCANFD_10ms_FrP01_SigGWTORZC_CONTROLLER_0_IAM_Rx
        RX_PDU_RZCU_RZCUCANFD_10ms_FrP22_NoSecO_CONTROLLER_0_IAM: CanIfRxPduDataLength=12, CanIfRxPduDataLengthCheck=true, CanIfRxPduId=CANIF_RXPDU_CANIF_RZCU_RZCUCANFD_10ms_FrP22_NoSecO_CONTROLLER_0_IAM_Rx, CanIfRxPduUserRxIndicationName=PduR_CanIfRxIndication, CanIfRxPduUserRxIndicationUL=PDUR, CanIfRxPduCanId=247, CanIfRxPduRef=CANIF_RZCU_RZCUCANFD_10ms_FrP22_NoSecO_CONTROLLER_0_IAM_Rx
        RX_PDU_ESS_PTCANFD_20ms_FrP01_CONTROLLER_0_IAM: CanIfRxPduDataLength=8, CanIfRxPduDataLengthCheck=true, CanIfRxPduId=CANIF_RXPDU_CANIF_ESS_PTCANFD_20ms_FrP01_CONTROLLER_0_IAM_Rx, CanIfRxPduUserRxIndicationName=PduR_CanIfRxIndication, CanIfRxPduUserRxIndicationUL=PDUR, CanIfRxPduCanId=300, CanIfRxPduRef=CANIF_ESS_PTCANFD_20ms_FrP01_CONTROLLER_0_IAM_Rx
        RX_PDU_ESS_PTCANFD_20ms_FrP02_CONTROLLER_0_IAM: CanIfRxPduDataLength=8, CanIfRxPduDataLengthCheck=true, CanIfRxPduId=CANIF_RXPDU_CANIF_ESS_PTCANFD_20ms_FrP02_CONTROLLER_0_IAM_Rx, CanIfRxPduUserRxIndicationName=PduR_CanIfRxIndication, CanIfRxPduUserRxIndicationUL=PDUR, CanIfRxPduCanId=304, CanIfRxPduRef=CANIF_ESS_PTCANFD_20ms_FrP02_CONTROLLER_0_IAM_Rx
        RX_PDU_ICBAD_CHCANFD_20ms_FrP08_CONTROLLER_0_IAM: CanIfRxPduDataLength=8, CanIfRxPduDataLengthCheck=true, CanIfRxPduId=CANIF_RXPDU_CANIF_ICBAD_CHCANFD_20ms_FrP08_CONTROLLER_0_IAM_Rx, CanIfRxPduUserRxIndicationName=PduR_CanIfRxIndication, CanIfRxPduUserRxIndicationUL=PDUR, CanIfRxPduCanId=314, CanIfRxPduRef=CANIF_ICBAD_CHCANFD_20ms_FrP08_CONTROLLER_0_IAM_Rx
        RX_PDU_PEU_ERCANFD_20ms_FrP33_CONTROLLER_0_IAM: CanIfRxPduDataLength=12, CanIfRxPduDataLengthCheck=true, CanIfRxPduId=CANIF_RXPDU_CANIF_PEU_ERCANFD_20ms_FrP33_CONTROLLER_0_IAM_Rx, CanIfRxPduUserRxIndicationName=PduR_CanIfRxIndication, CanIfRxPduUserRxIndicationUL=PDUR, CanIfRxPduCanId=344, CanIfRxPduRef=CANIF_PEU_ERCANFD_20ms_FrP33_CONTROLLER_0_IAM_Rx
        RX_PDU_SDM_CHCANFD_20ms_FrP01_CONTROLLER_0_IAM: CanIfRxPduDataLength=8, CanIfRxPduDataLengthCheck=true, CanIfRxPduId=CANIF_RXPDU_CANIF_SDM_CHCANFD_20ms_FrP01_CONTROLLER_0_IAM_Rx, CanIfRxPduUserRxIndicationName=PduR_CanIfRxIndication, CanIfRxPduUserRxIndicationUL=PDUR, CanIfRxPduCanId=355, CanIfRxPduRef=CANIF_SDM_CHCANFD_20ms_FrP01_CONTROLLER_0_IAM_Rx
        RX_PDU_ICBVC_RZCUCANFD_20ms_FrP00_CONTROLLER_0_IAM: CanIfRxPduDataLength=8, CanIfRxPduDataLengthCheck=true, CanIfRxPduId=CANIF_RXPDU_CANIF_ICBVC_RZCUCANFD_20ms_FrP00_CONTROLLER_0_IAM_Rx, CanIfRxPduUserRxIndicationName=PduR_CanIfRxIndication, CanIfRxPduUserRxIndicationUL=PDUR, CanIfRxPduCanId=361, CanIfRxPduRef=CANIF_ICBVC_RZCUCANFD_20ms_FrP00_CONTROLLER_0_IAM_Rx
        RX_PDU_PEU_PTCANFD_100ms_FrP03_CONTROLLER_0_IAM: CanIfRxPduDataLength=8, CanIfRxPduDataLengthCheck=true, CanIfRxPduId=CANIF_RXPDU_CANIF_PEU_PTCANFD_100ms_FrP03_CONTROLLER_0_IAM_Rx, CanIfRxPduUserRxIndicationName=PduR_CanIfRxIndication, CanIfRxPduUserRxIndicationUL=PDUR, CanIfRxPduCanId=380, CanIfRxPduRef=CANIF_PEU_PTCANFD_100ms_FrP03_CONTROLLER_0_IAM_Rx
        RX_PDU_ICBAD_BKPCANFD_20ms_FrP07_CONTROLLER_0_IAM: CanIfRxPduDataLength=8, CanIfRxPduDataLengthCheck=true, CanIfRxPduId=CANIF_RXPDU_CANIF_ICBAD_BKPCANFD_20ms_FrP07_CONTROLLER_0_IAM_Rx, CanIfRxPduUserRxIndicationName=PduR_CanIfRxIndication, CanIfRxPduUserRxIndicationUL=PDUR, CanIfRxPduCanId=382, CanIfRxPduRef=CANIF_ICBAD_BKPCANFD_20ms_FrP07_CONTROLLER_0_IAM_Rx
        RX_PDU_SDM_CHCANFD_20ms_FrP02_CONTROLLER_0_IAM: CanIfRxPduDataLength=8, CanIfRxPduDataLengthCheck=true, CanIfRxPduId=CANIF_RXPDU_CANIF_SDM_CHCANFD_20ms_FrP02_CONTROLLER_0_IAM_Rx, CanIfRxPduUserRxIndicationName=PduR_CanIfRxIndication, CanIfRxPduUserRxIndicationUL=PDUR, CanIfRxPduCanId=391, CanIfRxPduRef=CANIF_SDM_CHCANFD_20ms_FrP02_CONTROLLER_0_IAM_Rx
        RX_PDU_RZCU_PTCANFD_20ms_FrP06_CONTROLLER_0_IAM: CanIfRxPduDataLength=8, CanIfRxPduDataLengthCheck=true, CanIfRxPduId=CANIF_RXPDU_CANIF_RZCU_PTCANFD_20ms_FrP06_CONTROLLER_0_IAM_Rx, CanIfRxPduUserRxIndicationName=PduR_CanIfRxIndication, CanIfRxPduUserRxIndicationUL=PDUR, CanIfRxPduCanId=404, CanIfRxPduRef=CANIF_RZCU_PTCANFD_20ms_FrP06_CONTROLLER_0_IAM_Rx
        RX_PDU_IBS_CHCANFD_20ms_FrP07_CONTROLLER_0_IAM: CanIfRxPduDataLength=8, CanIfRxPduDataLengthCheck=true, CanIfRxPduId=CANIF_RXPDU_CANIF_IBS_CHCANFD_20ms_FrP07_CONTROLLER_0_IAM_Rx, CanIfRxPduUserRxIndicationName=PduR_CanIfRxIndication, CanIfRxPduUserRxIndicationUL=PDUR, CanIfRxPduCanId=423, CanIfRxPduRef=CANIF_IBS_CHCANFD_20ms_FrP07_CONTROLLER_0_IAM_Rx
        RX_PDU_ICBAD_RZCUCANFD_20ms_FrP12_CONTROLLER_0_IAM: CanIfRxPduDataLength=8, CanIfRxPduDataLengthCheck=true, CanIfRxPduId=CANIF_RXPDU_CANIF_ICBAD_RZCUCANFD_20ms_FrP12_CONTROLLER_0_IAM_Rx, CanIfRxPduUserRxIndicationName=PduR_CanIfRxIndication, CanIfRxPduUserRxIndicationUL=PDUR, CanIfRxPduCanId=424, CanIfRxPduRef=CANIF_ICBAD_RZCUCANFD_20ms_FrP12_CONTROLLER_0_IAM_Rx
        RX_PDU_IBS_CHCANFD_20ms_FrP11_CONTROLLER_0_IAM: CanIfRxPduDataLength=8, CanIfRxPduDataLengthCheck=true, CanIfRxPduId=CANIF_RXPDU_CANIF_IBS_CHCANFD_20ms_FrP11_CONTROLLER_0_IAM_Rx, CanIfRxPduUserRxIndicationName=PduR_CanIfRxIndication, CanIfRxPduUserRxIndicationUL=PDUR, CanIfRxPduCanId=425, CanIfRxPduRef=CANIF_IBS_CHCANFD_20ms_FrP11_CONTROLLER_0_IAM_Rx
        RX_PDU_ESS_PTCANFD_20ms_FrP04_CONTROLLER_0_IAM: CanIfRxPduDataLength=8, CanIfRxPduDataLengthCheck=true, CanIfRxPduId=CANIF_RXPDU_CANIF_ESS_PTCANFD_20ms_FrP04_CONTROLLER_0_IAM_Rx, CanIfRxPduUserRxIndicationName=PduR_CanIfRxIndication, CanIfRxPduUserRxIndicationUL=PDUR, CanIfRxPduCanId=457, CanIfRxPduRef=CANIF_ESS_PTCANFD_20ms_FrP04_CONTROLLER_0_IAM_Rx
        RX_PDU_ICBVC_RZCUCANFD_20ms_FrP03_CONTROLLER_0_IAM: CanIfRxPduDataLength=8, CanIfRxPduDataLengthCheck=true, CanIfRxPduId=CANIF_RXPDU_CANIF_ICBVC_RZCUCANFD_20ms_FrP03_CONTROLLER_0_IAM_Rx, CanIfRxPduUserRxIndicationName=PduR_CanIfRxIndication, CanIfRxPduUserRxIndicationUL=PDUR, CanIfRxPduCanId=497, CanIfRxPduRef=CANIF_ICBVC_RZCUCANFD_20ms_FrP03_CONTROLLER_0_IAM_Rx
        RX_PDU_PEU_PTCANFD_50ms_FrP05_CONTROLLER_0_IAM: CanIfRxPduDataLength=16, CanIfRxPduDataLengthCheck=true, CanIfRxPduId=CANIF_RXPDU_CANIF_PEU_PTCANFD_50ms_FrP05_CONTROLLER_0_IAM_Rx, CanIfRxPduUserRxIndicationName=PduR_CanIfRxIndication, CanIfRxPduUserRxIndicationUL=PDUR, CanIfRxPduCanId=512, CanIfRxPduRef=CANIF_PEU_PTCANFD_50ms_FrP05_CONTROLLER_0_IAM_Rx
        RX_PDU_ESS_PTCANFD_50ms_FrP14_CONTROLLER_0_IAM: CanIfRxPduDataLength=8, CanIfRxPduDataLengthCheck=true, CanIfRxPduId=CANIF_RXPDU_CANIF_ESS_PTCANFD_50ms_FrP14_CONTROLLER_0_IAM_Rx, CanIfRxPduUserRxIndicationName=PduR_CanIfRxIndication, CanIfRxPduUserRxIndicationUL=PDUR, CanIfRxPduCanId=529, CanIfRxPduRef=CANIF_ESS_PTCANFD_50ms_FrP14_CONTROLLER_0_IAM_Rx
        RX_PDU_ESS_PTCANFD_100ms_FrP29_CONTROLLER_0_IAM: CanIfRxPduDataLength=8, CanIfRxPduDataLengthCheck=true, CanIfRxPduId=CANIF_RXPDU_CANIF_ESS_PTCANFD_100ms_FrP29_CONTROLLER_0_IAM_Rx, CanIfRxPduUserRxIndicationName=PduR_CanIfRxIndication, CanIfRxPduUserRxIndicationUL=PDUR, CanIfRxPduCanId=536, CanIfRxPduRef=CANIF_ESS_PTCANFD_100ms_FrP29_CONTROLLER_0_IAM_Rx
        RX_PDU_ESS_PTCANFD_100ms_FrP26_CONTROLLER_0_IAM: CanIfRxPduDataLength=8, CanIfRxPduDataLengthCheck=true, CanIfRxPduId=CANIF_RXPDU_CANIF_ESS_PTCANFD_100ms_FrP26_CONTROLLER_0_IAM_Rx, CanIfRxPduUserRxIndicationName=PduR_CanIfRxIndication, CanIfRxPduUserRxIndicationUL=PDUR, CanIfRxPduCanId=548, CanIfRxPduRef=CANIF_ESS_PTCANFD_100ms_FrP26_CONTROLLER_0_IAM_Rx
        RX_PDU_ESS_PTCANFD_50ms_FrP06_CONTROLLER_0_IAM: CanIfRxPduDataLength=8, CanIfRxPduDataLengthCheck=true, CanIfRxPduId=CANIF_RXPDU_CANIF_ESS_PTCANFD_50ms_FrP06_CONTROLLER_0_IAM_Rx, CanIfRxPduUserRxIndicationName=PduR_CanIfRxIndication, CanIfRxPduUserRxIndicationUL=PDUR, CanIfRxPduCanId=549, CanIfRxPduRef=CANIF_ESS_PTCANFD_50ms_FrP06_CONTROLLER_0_IAM_Rx
        RX_PDU_ESS_PTCANFD_50ms_FrP07_CONTROLLER_0_IAM: CanIfRxPduDataLength=8, CanIfRxPduDataLengthCheck=true, CanIfRxPduId=CANIF_RXPDU_CANIF_ESS_PTCANFD_50ms_FrP07_CONTROLLER_0_IAM_Rx, CanIfRxPduUserRxIndicationName=PduR_CanIfRxIndication, CanIfRxPduUserRxIndicationUL=PDUR, CanIfRxPduCanId=551, CanIfRxPduRef=CANIF_ESS_PTCANFD_50ms_FrP07_CONTROLLER_0_IAM_Rx
        RX_PDU_ESS_PTCANFD_50ms_FrP09_CONTROLLER_0_IAM: CanIfRxPduDataLength=8, CanIfRxPduDataLengthCheck=true, CanIfRxPduId=CANIF_RXPDU_CANIF_ESS_PTCANFD_50ms_FrP09_CONTROLLER_0_IAM_Rx, CanIfRxPduUserRxIndicationName=PduR_CanIfRxIndication, CanIfRxPduUserRxIndicationUL=PDUR, CanIfRxPduCanId=552, CanIfRxPduRef=CANIF_ESS_PTCANFD_50ms_FrP09_CONTROLLER_0_IAM_Rx
        RX_PDU_ESS_PTCANFD_50ms_FrP13_CONTROLLER_0_IAM: CanIfRxPduDataLength=8, CanIfRxPduDataLengthCheck=true, CanIfRxPduId=CANIF_RXPDU_CANIF_ESS_PTCANFD_50ms_FrP13_CONTROLLER_0_IAM_Rx, CanIfRxPduUserRxIndicationName=PduR_CanIfRxIndication, CanIfRxPduUserRxIndicationUL=PDUR, CanIfRxPduCanId=553, CanIfRxPduRef=CANIF_ESS_PTCANFD_50ms_FrP13_CONTROLLER_0_IAM_Rx
        RX_PDU_ESS_PTCANFD_50ms_FrP08_CONTROLLER_0_IAM: CanIfRxPduDataLength=8, CanIfRxPduDataLengthCheck=true, CanIfRxPduId=CANIF_RXPDU_CANIF_ESS_PTCANFD_50ms_FrP08_CONTROLLER_0_IAM_Rx, CanIfRxPduUserRxIndicationName=PduR_CanIfRxIndication, CanIfRxPduUserRxIndicationUL=PDUR, CanIfRxPduCanId=554, CanIfRxPduRef=CANIF_ESS_PTCANFD_50ms_FrP08_CONTROLLER_0_IAM_Rx
        RX_PDU_ESS_PTCANFD_100ms_FrP21_CONTROLLER_0_IAM: CanIfRxPduDataLength=8, CanIfRxPduDataLengthCheck=true, CanIfRxPduId=CANIF_RXPDU_CANIF_ESS_PTCANFD_100ms_FrP21_CONTROLLER_0_IAM_Rx, CanIfRxPduUserRxIndicationName=PduR_CanIfRxIndication, CanIfRxPduUserRxIndicationUL=PDUR, CanIfRxPduCanId=559, CanIfRxPduRef=CANIF_ESS_PTCANFD_100ms_FrP21_CONTROLLER_0_IAM_Rx
        RX_PDU_RZCU_LHBKBCANFD_50ms_FrP37_CONTROLLER_0_IAM: CanIfRxPduDataLength=8, CanIfRxPduDataLengthCheck=true, CanIfRxPduId=CANIF_RXPDU_CANIF_RZCU_LHBKBCANFD_50ms_FrP37_CONTROLLER_0_IAM_Rx, CanIfRxPduUserRxIndicationName=PduR_CanIfRxIndication, CanIfRxPduUserRxIndicationUL=PDUR, CanIfRxPduCanId=564, CanIfRxPduRef=CANIF_RZCU_LHBKBCANFD_50ms_FrP37_CONTROLLER_0_IAM_Rx
        RX_PDU_LHZCU_LHBKBCANFD_50ms_FrP04_CONTROLLER_0_IAM: CanIfRxPduDataLength=8, CanIfRxPduDataLengthCheck=true, CanIfRxPduId=CANIF_RXPDU_CANIF_LHZCU_LHBKBCANFD_50ms_FrP04_CONTROLLER_0_IAM_Rx, CanIfRxPduUserRxIndicationName=PduR_CanIfRxIndication, CanIfRxPduUserRxIndicationUL=PDUR, CanIfRxPduCanId=566, CanIfRxPduRef=CANIF_LHZCU_LHBKBCANFD_50ms_FrP04_CONTROLLER_0_IAM_Rx
        RX_PDU_LHZCU_BKBCANFD_50ms_FrP24_CONTROLLER_0_IAM: CanIfRxPduDataLength=20, CanIfRxPduDataLengthCheck=true, CanIfRxPduId=CANIF_RXPDU_CANIF_LHZCU_BKBCANFD_50ms_FrP24_CONTROLLER_0_IAM_Rx, CanIfRxPduUserRxIndicationName=PduR_CanIfRxIndication, CanIfRxPduUserRxIndicationUL=PDUR, CanIfRxPduCanId=638, CanIfRxPduRef=CANIF_LHZCU_BKBCANFD_50ms_FrP24_CONTROLLER_0_IAM_Rx
        RX_PDU_LHZCU_LHBKBCANFD_50ms_FrP06_CONTROLLER_0_IAM: CanIfRxPduDataLength=8, CanIfRxPduDataLengthCheck=true, CanIfRxPduId=CANIF_RXPDU_CANIF_LHZCU_LHBKBCANFD_50ms_FrP06_CONTROLLER_0_IAM_Rx, CanIfRxPduUserRxIndicationName=PduR_CanIfRxIndication, CanIfRxPduUserRxIndicationUL=PDUR, CanIfRxPduCanId=652, CanIfRxPduRef=CANIF_LHZCU_LHBKBCANFD_50ms_FrP06_CONTROLLER_0_IAM_Rx
        RX_PDU_ESS_PTEXTDCAN_100ms_FrP33_CONTROLLER_0_IAM: CanIfRxPduDataLength=8, CanIfRxPduDataLengthCheck=true, CanIfRxPduId=CANIF_RXPDU_CANIF_ESS_PTEXTDCAN_100ms_FrP33_CONTROLLER_0_IAM_Rx, CanIfRxPduUserRxIndicationName=PduR_CanIfRxIndication, CanIfRxPduUserRxIndicationUL=PDUR, CanIfRxPduCanId=726, CanIfRxPduRef=CANIF_ESS_PTEXTDCAN_100ms_FrP33_CONTROLLER_0_IAM_Rx
        RX_PDU_PEU_ERCANFD_50ms_FrP10_CONTROLLER_0_IAM: CanIfRxPduDataLength=16, CanIfRxPduDataLengthCheck=true, CanIfRxPduId=CANIF_RXPDU_CANIF_PEU_ERCANFD_50ms_FrP10_CONTROLLER_0_IAM_Rx, CanIfRxPduUserRxIndicationName=PduR_CanIfRxIndication, CanIfRxPduUserRxIndicationUL=PDUR, CanIfRxPduCanId=735, CanIfRxPduRef=CANIF_PEU_ERCANFD_50ms_FrP10_CONTROLLER_0_IAM_Rx
        RX_PDU_LVBM_PTEXTDCAN_100ms_FrP01_CONTROLLER_0_IAM: CanIfRxPduDataLength=8, CanIfRxPduDataLengthCheck=true, CanIfRxPduId=CANIF_RXPDU_CANIF_LVBM_PTEXTDCAN_100ms_FrP01_CONTROLLER_0_IAM_Rx, CanIfRxPduUserRxIndicationName=PduR_CanIfRxIndication, CanIfRxPduUserRxIndicationUL=PDUR, CanIfRxPduCanId=738, CanIfRxPduRef=CANIF_LVBM_PTEXTDCAN_100ms_FrP01_CONTROLLER_0_IAM_Rx
        RX_PDU_ICBAD_BKPCANFD_100ms_FrP42_CONTROLLER_0_IAM: CanIfRxPduDataLength=8, CanIfRxPduDataLengthCheck=true, CanIfRxPduId=CANIF_RXPDU_CANIF_ICBAD_BKPCANFD_100ms_FrP42_CONTROLLER_0_IAM_Rx, CanIfRxPduUserRxIndicationName=PduR_CanIfRxIndication, CanIfRxPduUserRxIndicationUL=PDUR, CanIfRxPduCanId=758, CanIfRxPduRef=CANIF_ICBAD_BKPCANFD_100ms_FrP42_CONTROLLER_0_IAM_Rx
        RX_PDU_PEU_ERCANFD_100ms_FrP15_CONTROLLER_0_IAM: CanIfRxPduDataLength=32, CanIfRxPduDataLengthCheck=true, CanIfRxPduId=CANIF_RXPDU_CANIF_PEU_ERCANFD_100ms_FrP15_CONTROLLER_0_IAM_Rx, CanIfRxPduUserRxIndicationName=PduR_CanIfRxIndication, CanIfRxPduUserRxIndicationUL=PDUR, CanIfRxPduCanId=760, CanIfRxPduRef=CANIF_PEU_ERCANFD_100ms_FrP15_CONTROLLER_0_IAM_Rx
        RX_PDU_IPD_BKPCANFD_100ms_FrP50_CONTROLLER_0_IAM: CanIfRxPduDataLength=32, CanIfRxPduDataLengthCheck=true, CanIfRxPduId=CANIF_RXPDU_CANIF_IPD_BKPCANFD_100ms_FrP50_CONTROLLER_0_IAM_Rx, CanIfRxPduUserRxIndicationName=PduR_CanIfRxIndication, CanIfRxPduUserRxIndicationUL=PDUR, CanIfRxPduCanId=765, CanIfRxPduRef=CANIF_IPD_BKPCANFD_100ms_FrP50_CONTROLLER_0_IAM_Rx
        RX_PDU_ESS_PTCANFD_100ms_FrP28_CONTROLLER_0_IAM: CanIfRxPduDataLength=8, CanIfRxPduDataLengthCheck=true, CanIfRxPduId=CANIF_RXPDU_CANIF_ESS_PTCANFD_100ms_FrP28_CONTROLLER_0_IAM_Rx, CanIfRxPduUserRxIndicationName=PduR_CanIfRxIndication, CanIfRxPduUserRxIndicationUL=PDUR, CanIfRxPduCanId=770, CanIfRxPduRef=CANIF_ESS_PTCANFD_100ms_FrP28_CONTROLLER_0_IAM_Rx
        RX_PDU_ESS_ZONE_PTCANFD_100ms_FrP16_CONTROLLER_0_IAM: CanIfRxPduDataLength=8, CanIfRxPduDataLengthCheck=true, CanIfRxPduId=CANIF_RXPDU_CANIF_ESS_ZONE_PTCANFD_100ms_FrP16_CONTROLLER_0_IAM_Rx, CanIfRxPduUserRxIndicationName=PduR_CanIfRxIndication, CanIfRxPduUserRxIndicationUL=PDUR, CanIfRxPduCanId=771, CanIfRxPduRef=CANIF_ESS_ZONE_PTCANFD_100ms_FrP16_CONTROLLER_0_IAM_Rx
        RX_PDU_ESS_PTCANFD_100ms_FrP22_CONTROLLER_0_IAM: CanIfRxPduDataLength=8, CanIfRxPduDataLengthCheck=true, CanIfRxPduId=CANIF_RXPDU_CANIF_ESS_PTCANFD_100ms_FrP22_CONTROLLER_0_IAM_Rx, CanIfRxPduUserRxIndicationName=PduR_CanIfRxIndication, CanIfRxPduUserRxIndicationUL=PDUR, CanIfRxPduCanId=775, CanIfRxPduRef=CANIF_ESS_PTCANFD_100ms_FrP22_CONTROLLER_0_IAM_Rx
        RX_PDU_ESS_PTCANFD_100ms_FrP20_CONTROLLER_0_IAM: CanIfRxPduDataLength=8, CanIfRxPduDataLengthCheck=true, CanIfRxPduId=CANIF_RXPDU_CANIF_ESS_PTCANFD_100ms_FrP20_CONTROLLER_0_IAM_Rx, CanIfRxPduUserRxIndicationName=PduR_CanIfRxIndication, CanIfRxPduUserRxIndicationUL=PDUR, CanIfRxPduCanId=776, CanIfRxPduRef=CANIF_ESS_PTCANFD_100ms_FrP20_CONTROLLER_0_IAM_Rx
        RX_PDU_RZCU_PTCANFD_100ms_FrP10_CONTROLLER_0_IAM: CanIfRxPduDataLength=8, CanIfRxPduDataLengthCheck=true, CanIfRxPduId=CANIF_RXPDU_CANIF_RZCU_PTCANFD_100ms_FrP10_CONTROLLER_0_IAM_Rx, CanIfRxPduUserRxIndicationName=PduR_CanIfRxIndication, CanIfRxPduUserRxIndicationUL=PDUR, CanIfRxPduCanId=777, CanIfRxPduRef=CANIF_RZCU_PTCANFD_100ms_FrP10_CONTROLLER_0_IAM_Rx
        RX_PDU_ESS_PTCANFD_100ms_FrP35_CONTROLLER_0_IAM: CanIfRxPduDataLength=8, CanIfRxPduDataLengthCheck=true, CanIfRxPduId=CANIF_RXPDU_CANIF_ESS_PTCANFD_100ms_FrP35_CONTROLLER_0_IAM_Rx, CanIfRxPduUserRxIndicationName=PduR_CanIfRxIndication, CanIfRxPduUserRxIndicationUL=PDUR, CanIfRxPduCanId=782, CanIfRxPduRef=CANIF_ESS_PTCANFD_100ms_FrP35_CONTROLLER_0_IAM_Rx
        RX_PDU_LHZCU_LHBKBCANFD_100ms_FrP12_CONTROLLER_0_IAM: CanIfRxPduDataLength=20, CanIfRxPduDataLengthCheck=true, CanIfRxPduId=CANIF_RXPDU_CANIF_LHZCU_LHBKBCANFD_100ms_FrP12_CONTROLLER_0_IAM_Rx, CanIfRxPduUserRxIndicationName=PduR_CanIfRxIndication, CanIfRxPduUserRxIndicationUL=PDUR, CanIfRxPduCanId=785, CanIfRxPduRef=CANIF_LHZCU_LHBKBCANFD_100ms_FrP12_CONTROLLER_0_IAM_Rx
        RX_PDU_ESS_PTEXTDCAN_100ms_FrP23_CONTROLLER_0_IAM: CanIfRxPduDataLength=8, CanIfRxPduDataLengthCheck=true, CanIfRxPduId=CANIF_RXPDU_CANIF_ESS_PTEXTDCAN_100ms_FrP23_CONTROLLER_0_IAM_Rx, CanIfRxPduUserRxIndicationName=PduR_CanIfRxIndication, CanIfRxPduUserRxIndicationUL=PDUR, CanIfRxPduCanId=786, CanIfRxPduRef=CANIF_ESS_PTEXTDCAN_100ms_FrP23_CONTROLLER_0_IAM_Rx
        RX_PDU_ESS_PTCANFD_100ms_FrP36_CONTROLLER_0_IAM: CanIfRxPduDataLength=8, CanIfRxPduDataLengthCheck=true, CanIfRxPduId=CANIF_RXPDU_CANIF_ESS_PTCANFD_100ms_FrP36_CONTROLLER_0_IAM_Rx, CanIfRxPduUserRxIndicationName=PduR_CanIfRxIndication, CanIfRxPduUserRxIndicationUL=PDUR, CanIfRxPduCanId=788, CanIfRxPduRef=CANIF_ESS_PTCANFD_100ms_FrP36_CONTROLLER_0_IAM_Rx
        RX_PDU_ICBVC_FOTASts_100ms_FrP47_CONTROLLER_0_IAM: CanIfRxPduDataLength=8, CanIfRxPduDataLengthCheck=true, CanIfRxPduId=CANIF_RXPDU_CANIF_ICBVC_FOTASts_100ms_FrP47_CONTROLLER_0_IAM_Rx, CanIfRxPduUserRxIndicationName=PduR_CanIfRxIndication, CanIfRxPduUserRxIndicationUL=PDUR, CanIfRxPduCanId=790, CanIfRxPduRef=CANIF_ICBVC_FOTASts_100ms_FrP47_CONTROLLER_0_IAM_Rx
        RX_PDU_CCU_PTCANFD_100ms_FrP02_CONTROLLER_0_IAM: CanIfRxPduDataLength=8, CanIfRxPduDataLengthCheck=true, CanIfRxPduId=CANIF_RXPDU_CANIF_CCU_PTCANFD_100ms_FrP02_CONTROLLER_0_IAM_Rx, CanIfRxPduUserRxIndicationName=PduR_CanIfRxIndication, CanIfRxPduUserRxIndicationUL=PDUR, CanIfRxPduCanId=791, CanIfRxPduRef=CANIF_CCU_PTCANFD_100ms_FrP02_CONTROLLER_0_IAM_Rx
        RX_PDU_ICBVC_RZCUCANFD_100ms_FrP45_CONTROLLER_0_IAM: CanIfRxPduDataLength=8, CanIfRxPduDataLengthCheck=true, CanIfRxPduId=CANIF_RXPDU_CANIF_ICBVC_RZCUCANFD_100ms_FrP45_CONTROLLER_0_IAM_Rx, CanIfRxPduUserRxIndicationName=PduR_CanIfRxIndication, CanIfRxPduUserRxIndicationUL=PDUR, CanIfRxPduCanId=812, CanIfRxPduRef=CANIF_ICBVC_RZCUCANFD_100ms_FrP45_CONTROLLER_0_IAM_Rx
        RX_PDU_ESS_PTCANFD_100ms_FrP15_CONTROLLER_0_IAM: CanIfRxPduDataLength=8, CanIfRxPduDataLengthCheck=true, CanIfRxPduId=CANIF_RXPDU_CANIF_ESS_PTCANFD_100ms_FrP15_CONTROLLER_0_IAM_Rx, CanIfRxPduUserRxIndicationName=PduR_CanIfRxIndication, CanIfRxPduUserRxIndicationUL=PDUR, CanIfRxPduCanId=814, CanIfRxPduRef=CANIF_ESS_PTCANFD_100ms_FrP15_CONTROLLER_0_IAM_Rx
        RX_PDU_ESS_PTCANFD_100ms_FrP32_CONTROLLER_0_IAM: CanIfRxPduDataLength=8, CanIfRxPduDataLengthCheck=true, CanIfRxPduId=CANIF_RXPDU_CANIF_ESS_PTCANFD_100ms_FrP32_CONTROLLER_0_IAM_Rx, CanIfRxPduUserRxIndicationName=PduR_CanIfRxIndication, CanIfRxPduUserRxIndicationUL=PDUR, CanIfRxPduCanId=817, CanIfRxPduRef=CANIF_ESS_PTCANFD_100ms_FrP32_CONTROLLER_0_IAM_Rx
        RX_PDU_RHZCU_RHBKBCANFD_100ms_FrP12_CONTROLLER_0_IAM: CanIfRxPduDataLength=8, CanIfRxPduDataLengthCheck=true, CanIfRxPduId=CANIF_RXPDU_CANIF_RHZCU_RHBKBCANFD_100ms_FrP12_CONTROLLER_0_IAM_Rx, CanIfRxPduUserRxIndicationName=PduR_CanIfRxIndication, CanIfRxPduUserRxIndicationUL=PDUR, CanIfRxPduCanId=855, CanIfRxPduRef=CANIF_RHZCU_RHBKBCANFD_100ms_FrP12_CONTROLLER_0_IAM_Rx
        RX_PDU_RHZCU_RHBKBCANFD_100ms_FrP15_CONTROLLER_0_IAM: CanIfRxPduDataLength=8, CanIfRxPduDataLengthCheck=true, CanIfRxPduId=CANIF_RXPDU_CANIF_RHZCU_RHBKBCANFD_100ms_FrP15_CONTROLLER_0_IAM_Rx, CanIfRxPduUserRxIndicationName=PduR_CanIfRxIndication, CanIfRxPduUserRxIndicationUL=PDUR, CanIfRxPduCanId=857, CanIfRxPduRef=CANIF_RHZCU_RHBKBCANFD_100ms_FrP15_CONTROLLER_0_IAM_Rx
        RX_PDU_ICBVC_RZCUCANFD_100ms_FrP39_CONTROLLER_0_IAM: CanIfRxPduDataLength=8, CanIfRxPduDataLengthCheck=true, CanIfRxPduId=CANIF_RXPDU_CANIF_ICBVC_RZCUCANFD_100ms_FrP39_CONTROLLER_0_IAM_Rx, CanIfRxPduUserRxIndicationName=PduR_CanIfRxIndication, CanIfRxPduUserRxIndicationUL=PDUR, CanIfRxPduCanId=872, CanIfRxPduRef=CANIF_ICBVC_RZCUCANFD_100ms_FrP39_CONTROLLER_0_IAM_Rx
        RX_PDU_RZCU_LHBKBCANFD_100ms_FrP32_CONTROLLER_0_IAM: CanIfRxPduDataLength=8, CanIfRxPduDataLengthCheck=true, CanIfRxPduId=CANIF_RXPDU_CANIF_RZCU_LHBKBCANFD_100ms_FrP32_CONTROLLER_0_IAM_Rx, CanIfRxPduUserRxIndicationName=PduR_CanIfRxIndication, CanIfRxPduUserRxIndicationUL=PDUR, CanIfRxPduCanId=879, CanIfRxPduRef=CANIF_RZCU_LHBKBCANFD_100ms_FrP32_CONTROLLER_0_IAM_Rx
        RX_PDU_RHZCU_RHBKBCANFD_100ms_FrP14_CONTROLLER_0_IAM: CanIfRxPduDataLength=8, CanIfRxPduDataLengthCheck=true, CanIfRxPduId=CANIF_RXPDU_CANIF_RHZCU_RHBKBCANFD_100ms_FrP14_CONTROLLER_0_IAM_Rx, CanIfRxPduUserRxIndicationName=PduR_CanIfRxIndication, CanIfRxPduUserRxIndicationUL=PDUR, CanIfRxPduCanId=892, CanIfRxPduRef=CANIF_RHZCU_RHBKBCANFD_100ms_FrP14_CONTROLLER_0_IAM_Rx
        RX_PDU_ESS_PTEXTDCAN_100ms_FrP27_CONTROLLER_0_IAM: CanIfRxPduDataLength=8, CanIfRxPduDataLengthCheck=true, CanIfRxPduId=CANIF_RXPDU_CANIF_ESS_PTEXTDCAN_100ms_FrP27_CONTROLLER_0_IAM_Rx, CanIfRxPduUserRxIndicationName=PduR_CanIfRxIndication, CanIfRxPduUserRxIndicationUL=PDUR, CanIfRxPduCanId=894, CanIfRxPduRef=CANIF_ESS_PTEXTDCAN_100ms_FrP27_CONTROLLER_0_IAM_Rx
        RX_PDU_ICBAD_BKPCANFD_100ms_FrP36_CONTROLLER_0_IAM: CanIfRxPduDataLength=16, CanIfRxPduDataLengthCheck=true, CanIfRxPduId=CANIF_RXPDU_CANIF_ICBAD_BKPCANFD_100ms_FrP36_CONTROLLER_0_IAM_Rx, CanIfRxPduUserRxIndicationName=PduR_CanIfRxIndication, CanIfRxPduUserRxIndicationUL=PDUR, CanIfRxPduCanId=895, CanIfRxPduRef=CANIF_ICBAD_BKPCANFD_100ms_FrP36_CONTROLLER_0_IAM_Rx
        RX_PDU_PEU_ERCANFD_100ms_FrP11_CONTROLLER_0_IAM: CanIfRxPduDataLength=16, CanIfRxPduDataLengthCheck=true, CanIfRxPduId=CANIF_RXPDU_CANIF_PEU_ERCANFD_100ms_FrP11_CONTROLLER_0_IAM_Rx, CanIfRxPduUserRxIndicationName=PduR_CanIfRxIndication, CanIfRxPduUserRxIndicationUL=PDUR, CanIfRxPduCanId=900, CanIfRxPduRef=CANIF_PEU_ERCANFD_100ms_FrP11_CONTROLLER_0_IAM_Rx
        RX_PDU_ICB_BKBCANFD_100ms_FrP221_CONTROLLER_0_IAM: CanIfRxPduDataLength=24, CanIfRxPduDataLengthCheck=true, CanIfRxPduId=CANIF_RXPDU_CANIF_ICB_BKBCANFD_100ms_FrP221_CONTROLLER_0_IAM_Rx, CanIfRxPduUserRxIndicationName=PduR_CanIfRxIndication, CanIfRxPduUserRxIndicationUL=PDUR, CanIfRxPduCanId=902, CanIfRxPduRef=CANIF_ICB_BKBCANFD_100ms_FrP221_CONTROLLER_0_IAM_Rx
        RX_PDU_RHZCU_RHBKBCANFD_100ms_FrP13_CONTROLLER_0_IAM: CanIfRxPduDataLength=8, CanIfRxPduDataLengthCheck=true, CanIfRxPduId=CANIF_RXPDU_CANIF_RHZCU_RHBKBCANFD_100ms_FrP13_CONTROLLER_0_IAM_Rx, CanIfRxPduUserRxIndicationName=PduR_CanIfRxIndication, CanIfRxPduUserRxIndicationUL=PDUR, CanIfRxPduCanId=904, CanIfRxPduRef=CANIF_RHZCU_RHBKBCANFD_100ms_FrP13_CONTROLLER_0_IAM_Rx
        RX_PDU_ICBVC_RZCUCANFD_100ms_FrP80_CONTROLLER_0_IAM: CanIfRxPduDataLength=8, CanIfRxPduDataLengthCheck=true, CanIfRxPduId=CANIF_RXPDU_CANIF_ICBVC_RZCUCANFD_100ms_FrP80_CONTROLLER_0_IAM_Rx, CanIfRxPduUserRxIndicationName=PduR_CanIfRxIndication, CanIfRxPduUserRxIndicationUL=PDUR, CanIfRxPduCanId=907, CanIfRxPduRef=CANIF_ICBVC_RZCUCANFD_100ms_FrP80_CONTROLLER_0_IAM_Rx
        RX_PDU_ESS_PTEXTDCAN_100ms_FrP24_CONTROLLER_0_IAM: CanIfRxPduDataLength=8, CanIfRxPduDataLengthCheck=true, CanIfRxPduId=CANIF_RXPDU_CANIF_ESS_PTEXTDCAN_100ms_FrP24_CONTROLLER_0_IAM_Rx, CanIfRxPduUserRxIndicationName=PduR_CanIfRxIndication, CanIfRxPduUserRxIndicationUL=PDUR, CanIfRxPduCanId=919, CanIfRxPduRef=CANIF_ESS_PTEXTDCAN_100ms_FrP24_CONTROLLER_0_IAM_Rx
        RX_PDU_RZCU_RZCUCANFD_100ms_FrP82_CONTROLLER_0_IAM: CanIfRxPduDataLength=20, CanIfRxPduDataLengthCheck=true, CanIfRxPduId=CANIF_RXPDU_CANIF_RZCU_RZCUCANFD_100ms_FrP82_CONTROLLER_0_IAM_Rx, CanIfRxPduUserRxIndicationName=PduR_CanIfRxIndication, CanIfRxPduUserRxIndicationUL=PDUR, CanIfRxPduCanId=921, CanIfRxPduRef=CANIF_RZCU_RZCUCANFD_100ms_FrP82_CONTROLLER_0_IAM_Rx
        RX_PDU_RHZCU_RHBKBCANFD_100ms_FrP19_CONTROLLER_0_IAM: CanIfRxPduDataLength=8, CanIfRxPduDataLengthCheck=true, CanIfRxPduId=CANIF_RXPDU_CANIF_RHZCU_RHBKBCANFD_100ms_FrP19_CONTROLLER_0_IAM_Rx, CanIfRxPduUserRxIndicationName=PduR_CanIfRxIndication, CanIfRxPduUserRxIndicationUL=PDUR, CanIfRxPduCanId=962, CanIfRxPduRef=CANIF_RHZCU_RHBKBCANFD_100ms_FrP19_CONTROLLER_0_IAM_Rx
        RX_PDU_LVBM_PTEXTDCAN_100ms_FrP04_CONTROLLER_0_IAM: CanIfRxPduDataLength=8, CanIfRxPduDataLengthCheck=true, CanIfRxPduId=CANIF_RXPDU_CANIF_LVBM_PTEXTDCAN_100ms_FrP04_CONTROLLER_0_IAM_Rx, CanIfRxPduUserRxIndicationName=PduR_CanIfRxIndication, CanIfRxPduUserRxIndicationUL=PDUR, CanIfRxPduCanId=963, CanIfRxPduRef=CANIF_LVBM_PTEXTDCAN_100ms_FrP04_CONTROLLER_0_IAM_Rx
        RX_PDU_TC_PTCANFD_100ms_FrP05_CONTROLLER_0_IAM: CanIfRxPduDataLength=8, CanIfRxPduDataLengthCheck=true, CanIfRxPduId=CANIF_RXPDU_CANIF_TC_PTCANFD_100ms_FrP05_CONTROLLER_0_IAM_Rx, CanIfRxPduUserRxIndicationName=PduR_CanIfRxIndication, CanIfRxPduUserRxIndicationUL=PDUR, CanIfRxPduCanId=971, CanIfRxPduRef=CANIF_TC_PTCANFD_100ms_FrP05_CONTROLLER_0_IAM_Rx
        RX_PDU_RZCU_PTCANFD_100ms_FrP12_CONTROLLER_0_IAM: CanIfRxPduDataLength=8, CanIfRxPduDataLengthCheck=true, CanIfRxPduId=CANIF_RXPDU_CANIF_RZCU_PTCANFD_100ms_FrP12_CONTROLLER_0_IAM_Rx, CanIfRxPduUserRxIndicationName=PduR_CanIfRxIndication, CanIfRxPduUserRxIndicationUL=PDUR, CanIfRxPduCanId=980, CanIfRxPduRef=CANIF_RZCU_PTCANFD_100ms_FrP12_CONTROLLER_0_IAM_Rx
        RX_PDU_ICBVC_INFOCANFD_250ms_FrP52_CONTROLLER_0_IAM: CanIfRxPduDataLength=8, CanIfRxPduDataLengthCheck=true, CanIfRxPduId=CANIF_RXPDU_CANIF_ICBVC_INFOCANFD_250ms_FrP52_CONTROLLER_0_IAM_Rx, CanIfRxPduUserRxIndicationName=PduR_CanIfRxIndication, CanIfRxPduUserRxIndicationUL=PDUR, CanIfRxPduCanId=1008, CanIfRxPduRef=CANIF_ICBVC_INFOCANFD_250ms_FrP52_CONTROLLER_0_IAM_Rx
        RX_PDU_ICB_RZCUCANFD_100ms_FrP144_CONTROLLER_0_IAM: CanIfRxPduDataLength=32, CanIfRxPduDataLengthCheck=true, CanIfRxPduId=CANIF_RXPDU_CANIF_ICB_RZCUCANFD_100ms_FrP144_CONTROLLER_0_IAM_Rx, CanIfRxPduUserRxIndicationName=PduR_CanIfRxIndication, CanIfRxPduUserRxIndicationUL=PDUR, CanIfRxPduCanId=1009, CanIfRxPduRef=CANIF_ICB_RZCUCANFD_100ms_FrP144_CONTROLLER_0_IAM_Rx
        RX_PDU_SDM_CHCANFD_100ms_FrP03_CONTROLLER_0_IAM: CanIfRxPduDataLength=8, CanIfRxPduDataLengthCheck=true, CanIfRxPduId=CANIF_RXPDU_CANIF_SDM_CHCANFD_100ms_FrP03_CONTROLLER_0_IAM_Rx, CanIfRxPduUserRxIndicationName=PduR_CanIfRxIndication, CanIfRxPduUserRxIndicationUL=PDUR, CanIfRxPduCanId=1013, CanIfRxPduRef=CANIF_SDM_CHCANFD_100ms_FrP03_CONTROLLER_0_IAM_Rx
        RX_PDU_RZCU_IMCU_SFCANFD_100ms_FrP26_CONTROLLER_0_IAM: CanIfRxPduDataLength=8, CanIfRxPduDataLengthCheck=true, CanIfRxPduId=CANIF_RXPDU_CANIF_RZCU_IMCU_SFCANFD_100ms_FrP26_CONTROLLER_0_IAM_Rx, CanIfRxPduUserRxIndicationName=PduR_CanIfRxIndication, CanIfRxPduUserRxIndicationUL=PDUR, CanIfRxPduCanId=1015, CanIfRxPduRef=CANIF_RZCU_IMCU_SFCANFD_100ms_FrP26_CONTROLLER_0_IAM_Rx
        RX_PDU_ICBVC_CONNCANFD_200ms_FrP157_CONTROLLER_0_IAM: CanIfRxPduDataLength=20, CanIfRxPduDataLengthCheck=true, CanIfRxPduId=CANIF_RXPDU_CANIF_ICBVC_CONNCANFD_200ms_FrP157_CONTROLLER_0_IAM_Rx, CanIfRxPduUserRxIndicationName=PduR_CanIfRxIndication, CanIfRxPduUserRxIndicationUL=PDUR, CanIfRxPduCanId=1040, CanIfRxPduRef=CANIF_ICBVC_CONNCANFD_200ms_FrP157_CONTROLLER_0_IAM_Rx
        RX_PDU_ESS_PTCANFD_200ms_FrP42_CONTROLLER_0_IAM: CanIfRxPduDataLength=8, CanIfRxPduDataLengthCheck=true, CanIfRxPduId=CANIF_RXPDU_CANIF_ESS_PTCANFD_200ms_FrP42_CONTROLLER_0_IAM_Rx, CanIfRxPduUserRxIndicationName=PduR_CanIfRxIndication, CanIfRxPduUserRxIndicationUL=PDUR, CanIfRxPduCanId=1045, CanIfRxPduRef=CANIF_ESS_PTCANFD_200ms_FrP42_CONTROLLER_0_IAM_Rx
        RX_PDU_ESS_PTCANFD_200ms_FrP39_CONTROLLER_0_IAM: CanIfRxPduDataLength=8, CanIfRxPduDataLengthCheck=true, CanIfRxPduId=CANIF_RXPDU_CANIF_ESS_PTCANFD_200ms_FrP39_CONTROLLER_0_IAM_Rx, CanIfRxPduUserRxIndicationName=PduR_CanIfRxIndication, CanIfRxPduUserRxIndicationUL=PDUR, CanIfRxPduCanId=1046, CanIfRxPduRef=CANIF_ESS_PTCANFD_200ms_FrP39_CONTROLLER_0_IAM_Rx
        RX_PDU_ICBAD_BKPCANFD_100ms_FrP38_CONTROLLER_0_IAM: CanIfRxPduDataLength=32, CanIfRxPduDataLengthCheck=true, CanIfRxPduId=CANIF_RXPDU_CANIF_ICBAD_BKPCANFD_100ms_FrP38_CONTROLLER_0_IAM_Rx, CanIfRxPduUserRxIndicationName=PduR_CanIfRxIndication, CanIfRxPduUserRxIndicationUL=PDUR, CanIfRxPduCanId=1105, CanIfRxPduRef=CANIF_ICBAD_BKPCANFD_100ms_FrP38_CONTROLLER_0_IAM_Rx
        RX_PDU_CCU_PTEXTDCAN_100ms_FrP06_CONTROLLER_0_IAM: CanIfRxPduDataLength=8, CanIfRxPduDataLengthCheck=true, CanIfRxPduId=CANIF_RXPDU_CANIF_CCU_PTEXTDCAN_100ms_FrP06_CONTROLLER_0_IAM_Rx, CanIfRxPduUserRxIndicationName=PduR_CanIfRxIndication, CanIfRxPduUserRxIndicationUL=PDUR, CanIfRxPduCanId=1108, CanIfRxPduRef=CANIF_CCU_PTEXTDCAN_100ms_FrP06_CONTROLLER_0_IAM_Rx
        RX_PDU_RZCU_PTEXTDCAN_100ms_FrP21_CONTROLLER_0_IAM: CanIfRxPduDataLength=8, CanIfRxPduDataLengthCheck=true, CanIfRxPduId=CANIF_RXPDU_CANIF_RZCU_PTEXTDCAN_100ms_FrP21_CONTROLLER_0_IAM_Rx, CanIfRxPduUserRxIndicationName=PduR_CanIfRxIndication, CanIfRxPduUserRxIndicationUL=PDUR, CanIfRxPduCanId=1109, CanIfRxPduRef=CANIF_RZCU_PTEXTDCAN_100ms_FrP21_CONTROLLER_0_IAM_Rx
        RX_PDU_TC_PTCANFD_20ms_FrP08_CONTROLLER_0_IAM: CanIfRxPduDataLength=12, CanIfRxPduDataLengthCheck=true, CanIfRxPduId=CANIF_RXPDU_CANIF_TC_PTCANFD_20ms_FrP08_CONTROLLER_0_IAM_Rx, CanIfRxPduUserRxIndicationName=PduR_CanIfRxIndication, CanIfRxPduUserRxIndicationUL=PDUR, CanIfRxPduCanId=1112, CanIfRxPduRef=CANIF_TC_PTCANFD_20ms_FrP08_CONTROLLER_0_IAM_Rx
        RX_PDU_LHZCU_LHBKBCANFDF_400ms_FrP18_CONTROLLER_0_IAM: CanIfRxPduDataLength=8, CanIfRxPduDataLengthCheck=true, CanIfRxPduId=CANIF_RXPDU_CANIF_LHZCU_LHBKBCANFDF_400ms_FrP18_CONTROLLER_0_IAM_Rx, CanIfRxPduUserRxIndicationName=PduR_CanIfRxIndication, CanIfRxPduUserRxIndicationUL=PDUR, CanIfRxPduCanId=1150, CanIfRxPduRef=CANIF_LHZCU_LHBKBCANFDF_400ms_FrP18_CONTROLLER_0_IAM_Rx
        RX_PDU_ICBVC_RZCUCANFD_200ms_FrP79_CONTROLLER_0_IAM: CanIfRxPduDataLength=8, CanIfRxPduDataLengthCheck=true, CanIfRxPduId=CANIF_RXPDU_CANIF_ICBVC_RZCUCANFD_200ms_FrP79_CONTROLLER_0_IAM_Rx, CanIfRxPduUserRxIndicationName=PduR_CanIfRxIndication, CanIfRxPduUserRxIndicationUL=PDUR, CanIfRxPduCanId=1151, CanIfRxPduRef=CANIF_ICBVC_RZCUCANFD_200ms_FrP79_CONTROLLER_0_IAM_Rx
        RX_PDU_ICBVC_CONNCANFD_Event_FrS145_CONTROLLER_0_IAM: CanIfRxPduDataLength=20, CanIfRxPduDataLengthCheck=true, CanIfRxPduId=CANIF_RXPDU_CANIF_ICBVC_CONNCANFD_Event_FrS145_CONTROLLER_0_IAM_Rx, CanIfRxPduUserRxIndicationName=PduR_CanIfRxIndication, CanIfRxPduUserRxIndicationUL=PDUR, CanIfRxPduCanId=1287, CanIfRxPduRef=CANIF_ICBVC_CONNCANFD_Event_FrS145_CONTROLLER_0_IAM_Rx
        RX_PDU_LHZCU_LHBDCANFD_Event_FrS48_CONTROLLER_0_IAM: CanIfRxPduDataLength=8, CanIfRxPduDataLengthCheck=true, CanIfRxPduId=CANIF_RXPDU_CANIF_LHZCU_LHBDCANFD_Event_FrS48_CONTROLLER_0_IAM_Rx, CanIfRxPduUserRxIndicationName=PduR_CanIfRxIndication, CanIfRxPduUserRxIndicationUL=PDUR, CanIfRxPduCanId=1288, CanIfRxPduRef=CANIF_LHZCU_LHBDCANFD_Event_FrS48_CONTROLLER_0_IAM_Rx
        RX_PDU_LHZCU_LHBDCANFD_Event_FrS49_CONTROLLER_0_IAM: CanIfRxPduDataLength=8, CanIfRxPduDataLengthCheck=true, CanIfRxPduId=CANIF_RXPDU_CANIF_LHZCU_LHBDCANFD_Event_FrS49_CONTROLLER_0_IAM_Rx, CanIfRxPduUserRxIndicationName=PduR_CanIfRxIndication, CanIfRxPduUserRxIndicationUL=PDUR, CanIfRxPduCanId=1289, CanIfRxPduRef=CANIF_LHZCU_LHBDCANFD_Event_FrS49_CONTROLLER_0_IAM_Rx
        RX_PDU_ICBVC_RHBKBCANFD_500ms_FrP67_CONTROLLER_0_IAM: CanIfRxPduDataLength=8, CanIfRxPduDataLengthCheck=true, CanIfRxPduId=CANIF_RXPDU_CANIF_ICBVC_RHBKBCANFD_500ms_FrP67_CONTROLLER_0_IAM_Rx, CanIfRxPduUserRxIndicationName=PduR_CanIfRxIndication, CanIfRxPduUserRxIndicationUL=PDUR, CanIfRxPduCanId=1329, CanIfRxPduRef=CANIF_ICBVC_RHBKBCANFD_500ms_FrP67_CONTROLLER_0_IAM_Rx
        RX_PDU_ZXD_CONNCANFD_Event_FrS220_CONTROLLER_0_IAM: CanIfRxPduDataLength=8, CanIfRxPduDataLengthCheck=true, CanIfRxPduId=CANIF_RXPDU_CANIF_ZXD_CONNCANFD_Event_FrS220_CONTROLLER_0_IAM_Rx, CanIfRxPduUserRxIndicationName=PduR_CanIfRxIndication, CanIfRxPduUserRxIndicationUL=PDUR, CanIfRxPduCanId=1340, CanIfRxPduRef=CANIF_ZXD_CONNCANFD_Event_FrS220_CONTROLLER_0_IAM_Rx
        RX_PDU_ICBVC_RZCUCANFD_200ms_FrP50_CONTROLLER_0_IAM: CanIfRxPduDataLength=8, CanIfRxPduDataLengthCheck=true, CanIfRxPduId=CANIF_RXPDU_CANIF_ICBVC_RZCUCANFD_200ms_FrP50_CONTROLLER_0_IAM_Rx, CanIfRxPduUserRxIndicationName=PduR_CanIfRxIndication, CanIfRxPduUserRxIndicationUL=PDUR, CanIfRxPduCanId=1345, CanIfRxPduRef=CANIF_ICBVC_RZCUCANFD_200ms_FrP50_CONTROLLER_0_IAM_Rx
        RX_PDU_ICB_CONNCANFD_Event_FrS67_CONTROLLER_0_IAM: CanIfRxPduDataLength=16, CanIfRxPduDataLengthCheck=true, CanIfRxPduId=CANIF_RXPDU_CANIF_ICB_CONNCANFD_Event_FrS67_CONTROLLER_0_IAM_Rx, CanIfRxPduUserRxIndicationName=PduR_CanIfRxIndication, CanIfRxPduUserRxIndicationUL=PDUR, CanIfRxPduCanId=1389, CanIfRxPduRef=CANIF_ICB_CONNCANFD_Event_FrS67_CONTROLLER_0_IAM_Rx
        RX_PDU_synthesized_ICBVC_SecOC_SyncMsg__CONTROLLER_0_IAM: CanIfRxPduDataLength=8, CanIfRxPduDataLengthCheck=true, CanIfRxPduId=CANIF_RXPDU_CANIF_synthesized_ICBVC_SecOC_SyncMsg__CONTROLLER_0_IAM_Rx, CanIfRxPduUserRxIndicationName=PduR_CanIfRxIndication, CanIfRxPduUserRxIndicationUL=PDUR, CanIfRxPduCanId=1391, CanIfRxPduRef=CANIF_synthesized_ICBVC_SecOC_SyncMsg__CONTROLLER_0_IAM_Rx
        RX_PDU_RHZCU_BKBCANFD_Event_FrS37_CONTROLLER_0_IAM: CanIfRxPduDataLength=16, CanIfRxPduDataLengthCheck=true, CanIfRxPduId=CANIF_RXPDU_CANIF_RHZCU_BKBCANFD_Event_FrS37_CONTROLLER_0_IAM_Rx, CanIfRxPduUserRxIndicationName=PduR_CanIfRxIndication, CanIfRxPduUserRxIndicationUL=PDUR, CanIfRxPduCanId=1393, CanIfRxPduRef=CANIF_RHZCU_BKBCANFD_Event_FrS37_CONTROLLER_0_IAM_Rx
        RX_PDU_ESS_PTCANFD_Event_FrS452_CONTROLLER_0_IAM: CanIfRxPduDataLength=8, CanIfRxPduDataLengthCheck=true, CanIfRxPduId=CANIF_RXPDU_CANIF_ESS_PTCANFD_Event_FrS452_CONTROLLER_0_IAM_Rx, CanIfRxPduUserRxIndicationName=PduR_CanIfRxIndication, CanIfRxPduUserRxIndicationUL=PDUR, CanIfRxPduCanId=1424, CanIfRxPduRef=CANIF_ESS_PTCANFD_Event_FrS452_CONTROLLER_0_IAM_Rx
        RX_PDU_IPD_BKPCANFD_Event_FrS35_CONTROLLER_0_IAM: CanIfRxPduDataLength=8, CanIfRxPduDataLengthCheck=true, CanIfRxPduId=CANIF_RXPDU_CANIF_IPD_BKPCANFD_Event_FrS35_CONTROLLER_0_IAM_Rx, CanIfRxPduUserRxIndicationName=PduR_CanIfRxIndication, CanIfRxPduUserRxIndicationUL=PDUR, CanIfRxPduCanId=1526, CanIfRxPduRef=CANIF_IPD_BKPCANFD_Event_FrS35_CONTROLLER_0_IAM_Rx
        RX_PDU_CCU_PTCANFD_500ms_FrP13_CONTROLLER_0_IAM: CanIfRxPduDataLength=16, CanIfRxPduDataLengthCheck=true, CanIfRxPduId=CANIF_RXPDU_CANIF_CCU_PTCANFD_500ms_FrP13_CONTROLLER_0_IAM_Rx, CanIfRxPduUserRxIndicationName=PduR_CanIfRxIndication, CanIfRxPduUserRxIndicationUL=PDUR, CanIfRxPduCanId=1530, CanIfRxPduRef=CANIF_CCU_PTCANFD_500ms_FrP13_CONTROLLER_0_IAM_Rx
        RX_PDU_ESS_PTCANFD_500ms_FrP60_CONTROLLER_0_IAM: CanIfRxPduDataLength=16, CanIfRxPduDataLengthCheck=true, CanIfRxPduId=CANIF_RXPDU_CANIF_ESS_PTCANFD_500ms_FrP60_CONTROLLER_0_IAM_Rx, CanIfRxPduUserRxIndicationName=PduR_CanIfRxIndication, CanIfRxPduUserRxIndicationUL=PDUR, CanIfRxPduCanId=1531, CanIfRxPduRef=CANIF_ESS_PTCANFD_500ms_FrP60_CONTROLLER_0_IAM_Rx
        RX_PDU_ICBVC_CONNCANFD_Event_FrS139_CONTROLLER_0_IAM: CanIfRxPduDataLength=20, CanIfRxPduDataLengthCheck=true, CanIfRxPduId=CANIF_RXPDU_CANIF_ICBVC_CONNCANFD_Event_FrS139_CONTROLLER_0_IAM_Rx, CanIfRxPduUserRxIndicationName=PduR_CanIfRxIndication, CanIfRxPduUserRxIndicationUL=PDUR, CanIfRxPduCanId=1558, CanIfRxPduRef=CANIF_ICBVC_CONNCANFD_Event_FrS139_CONTROLLER_0_IAM_Rx
        RX_PDU_SDM_SFCANFD_Event_FrS13_CONTROLLER_0_IAM: CanIfRxPduDataLength=8, CanIfRxPduDataLengthCheck=true, CanIfRxPduId=CANIF_RXPDU_CANIF_SDM_SFCANFD_Event_FrS13_CONTROLLER_0_IAM_Rx, CanIfRxPduUserRxIndicationName=PduR_CanIfRxIndication, CanIfRxPduUserRxIndicationUL=PDUR, CanIfRxPduCanId=1585, CanIfRxPduRef=CANIF_SDM_SFCANFD_Event_FrS13_CONTROLLER_0_IAM_Rx
        RX_PDU_SDM_SFCANFD_Event_FrS12_CONTROLLER_0_IAM: CanIfRxPduDataLength=20, CanIfRxPduDataLengthCheck=true, CanIfRxPduId=CANIF_RXPDU_CANIF_SDM_SFCANFD_Event_FrS12_CONTROLLER_0_IAM_Rx, CanIfRxPduUserRxIndicationName=PduR_CanIfRxIndication, CanIfRxPduUserRxIndicationUL=PDUR, CanIfRxPduCanId=1592, CanIfRxPduRef=CANIF_SDM_SFCANFD_Event_FrS12_CONTROLLER_0_IAM_Rx
        RX_PDU_ICB_CONNCANFD_EvtInfo_CONTROLLER_0_IAM: CanIfRxPduDataLength=8, CanIfRxPduDataLengthCheck=true, CanIfRxPduId=CANIF_RXPDU_CANIF_ICB_CONNCANFD_EvtInfo_CONTROLLER_0_IAM_Rx, CanIfRxPduUserRxIndicationName=PduR_CanIfRxIndication, CanIfRxPduUserRxIndicationUL=PDUR, CanIfRxPduCanId=1643, CanIfRxPduRef=CANIF_ICB_CONNCANFD_EvtInfo_CONTROLLER_0_IAM_Rx
        RX_PDU_ESS_PTCANFD_EvtInfo_CONTROLLER_0_IAM: CanIfRxPduDataLength=64, CanIfRxPduDataLengthCheck=true, CanIfRxPduId=CANIF_RXPDU_CANIF_ESS_PTCANFD_EvtInfo_CONTROLLER_0_IAM_Rx, CanIfRxPduUserRxIndicationName=PduR_CanIfRxIndication, CanIfRxPduUserRxIndicationUL=PDUR, CanIfRxPduCanId=1721, CanIfRxPduRef=CANIF_ESS_PTCANFD_EvtInfo_CONTROLLER_0_IAM_Rx
        RX_PDU_DIAG_DTCInfo_ECM_CONTROLLER_0_IAM: CanIfRxPduDataLength=8, CanIfRxPduDataLengthCheck=true, CanIfRxPduId=CANIF_RXPDU_CANIF_DIAG_DTCInfo_ECM_CONTROLLER_0_IAM_Rx, CanIfRxPduUserRxIndicationName=PduR_CanIfRxIndication, CanIfRxPduUserRxIndicationUL=PDUR, CanIfRxPduCanId=1792, CanIfRxPduRef=CANIF_DIAG_DTCInfo_ECM_CONTROLLER_0_IAM_Rx
        RX_PDU_DIAG_DTCInfo_PEU_CONTROLLER_0_IAM: CanIfRxPduDataLength=8, CanIfRxPduDataLengthCheck=true, CanIfRxPduId=CANIF_RXPDU_CANIF_DIAG_DTCInfo_PEU_CONTROLLER_0_IAM_Rx, CanIfRxPduUserRxIndicationName=PduR_CanIfRxIndication, CanIfRxPduUserRxIndicationUL=PDUR, CanIfRxPduCanId=1795, CanIfRxPduRef=CANIF_DIAG_DTCInfo_PEU_CONTROLLER_0_IAM_Rx
        RX_PDU_DIAG_DTCInfo_ESS_CONTROLLER_0_IAM: CanIfRxPduDataLength=8, CanIfRxPduDataLengthCheck=true, CanIfRxPduId=CANIF_RXPDU_CANIF_DIAG_DTCInfo_ESS_CONTROLLER_0_IAM_Rx, CanIfRxPduUserRxIndicationName=PduR_CanIfRxIndication, CanIfRxPduUserRxIndicationUL=PDUR, CanIfRxPduCanId=1803, CanIfRxPduRef=CANIF_DIAG_DTCInfo_ESS_CONTROLLER_0_IAM_Rx
        RX_PDU_DIAG_DTCInfo_TC_CONTROLLER_0_IAM: CanIfRxPduDataLength=8, CanIfRxPduDataLengthCheck=true, CanIfRxPduId=CANIF_RXPDU_CANIF_DIAG_DTCInfo_TC_CONTROLLER_0_IAM_Rx, CanIfRxPduUserRxIndicationName=PduR_CanIfRxIndication, CanIfRxPduUserRxIndicationUL=PDUR, CanIfRxPduCanId=1804, CanIfRxPduRef=CANIF_DIAG_DTCInfo_TC_CONTROLLER_0_IAM_Rx
        RX_PDU_Diag_CONNCANFD_PhyReq_IAM_CONTROLLER_0_IAM: CanIfRxPduDataLength=64, CanIfRxPduDataLengthCheck=false, CanIfRxPduId=CANIF_RXPDU_CanIf_phy_rx_0x711, CanIfRxPduUserRxIndicationName=CanTp_RxIndication, CanIfRxPduUserRxIndicationUL=CAN_TP, CanIfRxPduCanId=1809, CanIfRxPduRef=CanIf_phy_rx_0x711
        RX_PDU_Diag_CONNCANFD_FuncReq_CONTROLLER_0_IAM: CanIfRxPduDataLength=64, CanIfRxPduDataLengthCheck=false, CanIfRxPduId=CANIF_RXPDU_CanIf_fun_rx_0x7df, CanIfRxPduUserRxIndicationName=CanTp_RxIndication, CanIfRxPduUserRxIndicationUL=CAN_TP, CanIfRxPduCanId=2015, CanIfRxPduRef=CanIf_fun_rx_0x7df
      TX_PDU_IAM_CONNCANFD_NM_CONTROLLER_0_IAM (CanIfTxPduCfg):
        CanIfTxPduCanId = 1155
        CanIfTxPduCanIdType = STANDARD_FD_CAN
        CanIfTxPduId = CANIF_TXPDU_CANIF_IAM_CONNCANFD_NM_IAM_NM_TxPdu
        CanIfTxPduPnFilterPdu = false
        CanIfTxPduReadNotifyStatus = false
        CanIfTxPduTriggerTransmit = false
        CanIfTxPduTruncation = true
        CanIfTxPduType = DYNAMIC
        CanIfTxPduUserTriggerTransmitName = CanNm_TriggerTransmit
        CanIfTxPduUserTxConfirmationName = CanNm_TxConfirmation
        CanIfTxPduUserTxConfirmationUL = CAN_NM
        CanIfTxPduBufferRef = CanIfBufferCfg_0
        CanIfTxPduRef = CANIF_IAM_CONNCANFD_NM_IAM_NM_TxPdu
      RX_PDU_IAM_NM_RxPdu_CONTROLLER_0_IAM (CanIfRxPduCfg):
        CanIfRxPduCanIdType = STANDARD_FD_CAN
        CanIfRxPduDataLength = 8
        CanIfRxPduDataLengthCheck = true
        CanIfRxPduId = CANIF_RXPDU_CANIF_IAM_NM_RxPdu_IAM_NM_RxPdu
        CanIfRxPduReadData = false
        CanIfRxPduReadNotifyStatus = false
        CanIfRxPduUserRxIndicationName = CanNm_RxIndication
        CanIfRxPduUserRxIndicationUL = CAN_NM
        CanIfRxPduHrhIdRef = CanifHrh_0
        CanIfRxPduRef = CANIF_IAM_NM_RxPdu_IAM_NM_RxPdu
        CanIfRxPduCanIdRange: CanIfRxPduCanIdRangeLowerCanId=1152, CanIfRxPduCanIdRangeUpperCanId=1279
      CanIfBufferCfg_0 (CanIfBufferCfg): CanIfBufferSize=0, CanIfBufferHthRef=CanIfHth_0
      CanIfBufferCfg_1 (CanIfBufferCfg): CanIfBufferSize=10, CanIfBufferHthRef=CanIfHth_1
      RX_PDU_CANTSYNC (CanIfRxPduCfg):
        CanIfRxPduCanIdType = STANDARD_FD_CAN
        CanIfRxPduDataLength = 8
        CanIfRxPduDataLengthCheck = true
        CanIfRxPduId = CANIF_RXPDU_RX_PDU_CANTSYNC
        CanIfRxPduReadData = false
        CanIfRxPduReadNotifyStatus = false
        CanIfRxPduUserRxIndicationName = CanTSyn_RxIndication
        CanIfRxPduUserRxIndicationUL = CAN_TSYN
        CanIfRxPduCanId = 1536
        CanIfRxPduHrhIdRef = CanifHrh_0
        CanIfRxPduRef = RX_PDU_CANTSYNC
    CanIfPrivateCfg: CanIfPrivateDataLengthCheck=true, CanIfPrivateSoftwareFilterType=LINEAR, CanIfSupportTTCAN=false
    CanIfPublicCfg:
      CanIfConfigType = PC_CONFIG
      CanIfPublicCtrlDrvVersion = AUTOSAR422
      CanIfBusMirroringSupport = false
      CanIfDevErrorDetect = false
      CanIfMetaDataSupport = false
      CanIfPublicCancelTransmitSupport = false
      CanIfPublicHandleTypeEnum = UINT16
      CanIfPublicCanIdTypeEnum = UINT32
      CanIfPublicIcomSupport = false
      CanIfPublicMultipleDrvSupport = true
      CanIfPublicPnSupport = false
      CanIfPublicReadRxPduDataApi = false
      CanIfPublicReadRxPduNotifyStatusApi = false
      CanIfPublicReadTxPduNotifyStatusApi = false
      CanIfPublicSetDynamicTxIdApi = false
      CanIfPublicTxBuffering = true
      CanIfPublicTxConfirmPollingSupport = true
      CanIfPublicWakeupCheckValidByNM = false
      CanIfPublicWakeupCheckValidSupport = false
      CanIfSetBaudrateApi = false
      CanIfTriggerTransmitSupport = false
      CanIfTxOfflineActiveSupport = false
      CanIfVersionInfoApi = false
      CanIfWakeupSupport = true
