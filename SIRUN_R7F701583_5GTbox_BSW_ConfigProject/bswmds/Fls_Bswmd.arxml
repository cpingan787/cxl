AUTOSAR XML (schema 00048)
package /AUTOSAR/BswOverviews
  bsw module description Fls: implemented-entrys=Fls_MainFunction
    bsw internal behavior IB_Fls
      bsw schedulable entity SE_Fls_MainFunction: reentrancy-level=NON-REENTRANT, implemented-entry=Fls_MainFunction
      bsw timing event TE_Fls_MainFunction: category=Memory, starts-on-event=SE_Fls_MainFunction, period=1.0E-6
      bsw distinguished partition Fls_EcucPartition
package /AUTOSAR/BswImplementations
  bsw implementation Imp_Fls: category=NO_CODE, programming-language=C, sw-version=2.0.2, vendor-id=62, ar-release-version=4.5.0, behavior=IB_Fls
package /AUTOSAR/BswInterfaces
  bsw module entry Fls_MainFunction: is-synchronous=true, call-type=SCHEDULED, execution-context=TASK, sw-service-impl-policy=STANDARD
