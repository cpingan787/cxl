AUTOSAR XML (schema 00048)
package /R7F7015833
  module config CanNm
    CanNmGlobalConfig:
      CanNmBusLoadReductionEnabled = false
      CanNmBusSynchronizationEnabled = false
      CanNmComControlEnabled = true
      CanNmComUserDataSupport = true
      CanNmCoordinatorSyncSupport = false
      CanNmDevErrorDetect = false
      CanNmGlobalPnSupport = false
      CanNmImmediateRestartEnabled = false
      CanNmImmediateTxconfEnabled = false
      CanNmMainFunctionPeriod = 0.005
      CanNmPassiveModeEnabled = false
      CanNmPduRxIndicationEnabled = true
      CanNmRemoteSleepIndEnabled = false
      CanNmStateChangeIndEnabled = false
      CanNmUserDataEnabled = true
      CanNmVersionInfoApi = false
      CanNmChCfg_IAM (CanNmChannelConfig):
        CanNmBusLoadReductionActive = false
        CanNmCarWakeUpRxEnabled = false
        CanNmImmediateNmTransmissions = 5
        CanNmMsgCycleOffset = 0.0
        CanNmMsgCycleTime = 0.1
        CanNmMsgReducedTime = 0.001
        CanNmNodeDetectionEnabled = true
        CanNmNodeId = 131
        CanNmNodeIdEnabled = true
        CanNmPduCbvPosition = CANNM_PDU_BYTE_1
        CanNmPduNidPosition = CANNM_PDU_BYTE_0
        CanNmRepeatMessageTime = 1.0
        CanNmRepeatMsgIndEnabled = true
        CanNmStayInPbsEnabled = false
        CanNmTimeoutTime = 5.0
        CanNmWaitBusSleepTime = 1.0
        CanNmActiveWakeupBitEnabled = true
        CanNmRetryFirstMessageRequest = false
        CanNmImmediateNmCycleTime = 0.01
        CanNmComMNetworkHandleRef = ComMChannel_0
        CanNmTx_IAM_CONNCANFD_NM (CanNmTxPdu): CanNmTxConfirmationPduId=0, CanNmTxPduRef=CANIF_IAM_CONNCANFD_NM_IAM_NM_TxPdu
        CanNmUserDataTxPdu: CanNmTxUserDataPduId=0, CanNmTxUserDataPduRef=CanNm_UserDataPdu_IAM
        CanNmRx_IAM_NM_RxPdu (CanNmRxPdu): CanNmRxPduId=0, CanNmRxPduRef=CANIF_IAM_NM_RxPdu_IAM_NM_RxPdu
