AUTOSAR XML (schema 00048)
package /AUTOSAR/BswOverviews
  bsw module description WdgM: implemented-entrys=WdgM_MainFunction
    bsw internal behavior IB_WdgM
      exclusive area Exclusive
      bsw schedulable entity WdgM_MainFunction: reentrancy-level=NON-REENTRANT, implemented-entry=WdgM_MainFunction
      bsw timing event TE_WdgM_MainFunction: starts-on-event=WdgM_MainFunction, period=0.1
package /AUTOSAR/BswImplementations
  bsw implementation Imp_WdgM: programming-language=C, sw-version=2.0.6, vendor-id=62, ar-release-version=4.5.0, behavior=IB_WdgM
package /AUTOSAR/BswInterfaces
  bsw module entry WdgM_MainFunction: is-synchronous=true, call-type=SCHEDULED, execution-context=TASK, sw-service-impl-policy=STANDARD
