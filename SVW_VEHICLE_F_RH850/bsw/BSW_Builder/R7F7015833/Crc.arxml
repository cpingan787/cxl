AUTOSAR XML (schema 00048)
package /R7F7015833
  module config Crc
    CrcGeneral:
      AlgorithmCrc8 = true
      AlgorithmCrc8H2F = true
      AlgorithmCrc16 = true
      AlgorithmCrc32 = true
      AlgorithmCrc32P4 = true
      AlgorithmCrc64 = true
      Crc8Mode = CRC_8_RUNTIME
      Crc8H2FMode = CRC_8H2F_TABLE
      Crc16Mode = CRC_16_TABLE
      Crc32Mode = CRC_32_TABLE
      Crc32P4Mode = CRC_32P4_TABLE
      Crc64Mode = CRC_64_TABLE
