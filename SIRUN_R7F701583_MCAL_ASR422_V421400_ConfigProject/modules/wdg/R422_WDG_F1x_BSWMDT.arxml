AUTOSAR XML (schema 4-2-2)
# COPYRIGHT
# Copyright(c) 2016-2021 Renesas Electronics Corporation
package /Renesas/ModuleDescription_Wdg0
  bsw implementation Wdg_Impl: programming-language=C, sw-version=1.0.10, vendor-id=59, ar-release-version=4.2.2, behavior=BswInternalBehavior_0, vendor-api-infix=DRIVERA, vendor-specific-module-def=Wdg
    code-descriptors:
      code Wdg_Code: artifact-descriptors=[{short-label=Wdg_59_DriverA.c, category=SWSRC}, {short-label=Wdg_59_DriverA.h, category=SWHDR}]
    resource consumption ResourceConsumption
      8 x memory section:
        VAR_NO_INIT_8: sw-addrmethod=VAR_NO_INIT
        VAR_INIT_8: sw-addrmethod=VAR_INIT
        VAR_NO_INIT_UNSPECIFIED: sw-addrmethod=VAR_NO_INIT
        VAR_NO_INIT_16: sw-addrmethod=VAR_NO_INIT
        CONFIG_DATA_UNSPECIFIED: sw-addrmethod=CONFIG_DATA
        PUBLIC_CODE: sw-addrmethod=CODE
        APPL_CODE: sw-addrmethod=CODE
        CODE_FAST: sw-addrmethod=CODE
  bsw module description Wdg: module-id=102
    provided-entrys:
      Wdg_59_DriverA_Init
      Wdg_59_DriverA_SetMode
      Wdg_59_DriverA_SetTriggerCondition
      Wdg_59_DriverA_GetVersionInfo
      Wdg_59_DriverA_CheckHWConsistency
      WDG_59_DRIVERA_ERROR_ISR
      WDG_59_DRIVERA_TRIGGERFUNCTION_ISR
      WDG_59_DRIVERA_ERROR_CAT2_ISR
      WDG_59_DRIVERA_TRIGGERFUNCTION_CAT2_ISR
    bsw internal behavior BswInternalBehavior_0
      exclusive area WDG_59_DRIVERA_TRIGG_PROTECTION
      exclusive area WDG_59_DRIVERA_MODE_SWITCH_PROTECTION
      4 x bsw interrupt entity:
        BswInterruptEntity_0: can-enter-exclusive-area=WDG_59_DRIVERA_TRIGG_PROTECTION, implemented-entry=WDG_59_DRIVERA_TRIGGERFUNCTION_ISR, interrupt-category=CAT-1, interrupt-source=INTWDTA0
        BswInterruptEntity_1: implemented-entry=WDG_59_DRIVERA_ERROR_ISR, interrupt-category=CAT-1, interrupt-source=WDTA0TNMI
        BswInterruptEntity_2: can-enter-exclusive-area=WDG_59_DRIVERA_TRIGG_PROTECTION, implemented-entry=WDG_59_DRIVERA_TRIGGERFUNCTION_CAT2_ISR, interrupt-category=CAT-2, interrupt-source=INTWDTA0
        BswInterruptEntity_3: implemented-entry=WDG_59_DRIVERA_ERROR_CAT2_ISR, interrupt-category=CAT-2, interrupt-source=WDTA0TNMI
      5 x bsw called entity:
        BswCalledEntity_0: implemented-entry=Wdg_59_DriverA_GetVersionInfo
        BswCalledEntity_1: implemented-entry=Wdg_59_DriverA_Init
        BswCalledEntity_2: can-enter-exclusive-area=[WDG_59_DRIVERA_TRIGG_PROTECTION, WDG_59_DRIVERA_MODE_SWITCH_PROTECTION], implemented-entry=Wdg_59_DriverA_SetMode
        BswCalledEntity_4: can-enter-exclusive-area=WDG_59_DRIVERA_TRIGG_PROTECTION, implemented-entry=Wdg_59_DriverA_SetTriggerCondition
        BswCalledEntity_5: implemented-entry=Wdg_59_DriverA_CheckHWConsistency
  9 x bsw module entry, all with is-synchronous=true, sw-service-impl-policy=STANDARD:
    WDG_59_DRIVERA_TRIGGERFUNCTION_ISR: is-reentrant=true, call-type=INTERRUPT, execution-context=INTERRUPT-CAT-1
    WDG_59_DRIVERA_ERROR_ISR: is-reentrant=true, call-type=INTERRUPT, execution-context=INTERRUPT-CAT-1
    WDG_59_DRIVERA_TRIGGERFUNCTION_CAT2_ISR: is-reentrant=true, call-type=INTERRUPT, execution-context=INTERRUPT-CAT-2
    WDG_59_DRIVERA_ERROR_CAT2_ISR: is-reentrant=true, call-type=INTERRUPT, execution-context=INTERRUPT-CAT-2
    Wdg_59_DriverA_GetVersionInfo: service-id=4, is-reentrant=true, call-type=REGULAR, execution-context=TASK
    Wdg_59_DriverA_Init: service-id=0, is-reentrant=false, call-type=REGULAR, execution-context=TASK
    Wdg_59_DriverA_SetMode: service-id=1, is-reentrant=false, call-type=REGULAR, execution-context=TASK
    Wdg_59_DriverA_SetTriggerCondition: service-id=3, is-reentrant=false, call-type=REGULAR, execution-context=TASK
    Wdg_59_DriverA_CheckHWConsistency: service-id=5, is-reentrant=false, call-type=REGULAR, execution-context=TASK
package /Renesas/ModuleDescription_Wdg1
  bsw implementation Wdg_Impl: programming-language=C, sw-version=1.0.9, vendor-id=59, ar-release-version=4.2.2, behavior=BswInternalBehavior_1, vendor-api-infix=DRIVERB, vendor-specific-module-def=Wdg
    code-descriptors:
      code Wdg_Code: artifact-descriptors=[{short-label=Wdg_59_DriverB.c, category=SWSRC}, {short-label=Wdg_59_DriverB.h, category=SWHDR}]
    resource consumption ResourceConsumption
      8 x memory section:
        VAR_NO_INIT_8: sw-addrmethod=VAR_NO_INIT
        VAR_INIT_8: sw-addrmethod=VAR_INIT
        VAR_NO_INIT_UNSPECIFIED: sw-addrmethod=VAR_NO_INIT
        VAR_NO_INIT_16: sw-addrmethod=VAR_NO_INIT
        CONFIG_DATA_UNSPECIFIED: sw-addrmethod=CONFIG_DATA
        PUBLIC_CODE: sw-addrmethod=CODE
        APPL_CODE: sw-addrmethod=CODE
        CODE_FAST: sw-addrmethod=CODE
  bsw module description Wdg: module-id=102
    provided-entrys:
      Wdg_59_DriverB_Init
      Wdg_59_DriverB_SetMode
      Wdg_59_DriverB_SetTriggerCondition
      Wdg_59_DriverB_GetVersionInfo
      Wdg_59_DriverB_CheckHWConsistency
      WDG_59_DRIVERB_ERROR_ISR
      WDG_59_DRIVERB_TRIGGERFUNCTION_ISR
      WDG_59_DRIVERB_ERROR_CAT2_ISR
      WDG_59_DRIVERB_TRIGGERFUNCTION_CAT2_ISR
    bsw internal behavior BswInternalBehavior_1
      exclusive area WDG_59_DRIVERB_TRIGG_PROTECTION
      exclusive area WDG_59_DRIVERB_MODE_SWITCH_PROTECTION
      4 x bsw interrupt entity:
        BswInterruptEntity_0: can-enter-exclusive-area=WDG_59_DRIVERB_TRIGG_PROTECTION, implemented-entry=WDG_59_DRIVERB_TRIGGERFUNCTION_ISR, interrupt-category=CAT-1, interrupt-source=INTWDTA1
        BswInterruptEntity_1: implemented-entry=WDG_59_DRIVERB_ERROR_ISR, interrupt-category=CAT-1, interrupt-source=WDTA1TNMI
        BswInterruptEntity_2: can-enter-exclusive-area=WDG_59_DRIVERB_TRIGG_PROTECTION, implemented-entry=WDG_59_DRIVERB_TRIGGERFUNCTION_CAT2_ISR, interrupt-category=CAT-2, interrupt-source=INTWDTA1
        BswInterruptEntity_3: implemented-entry=WDG_59_DRIVERB_ERROR_CAT2_ISR, interrupt-category=CAT-2, interrupt-source=WDTA1TNMI
      5 x bsw called entity:
        BswCalledEntity_0: implemented-entry=Wdg_59_DriverB_GetVersionInfo
        BswCalledEntity_1: implemented-entry=Wdg_59_DriverB_Init
        BswCalledEntity_2: can-enter-exclusive-area=[WDG_59_DRIVERB_TRIGG_PROTECTION, WDG_59_DRIVERB_MODE_SWITCH_PROTECTION], implemented-entry=Wdg_59_DriverB_SetMode
        BswCalledEntity_4: can-enter-exclusive-area=WDG_59_DRIVERB_TRIGG_PROTECTION, implemented-entry=Wdg_59_DriverB_SetTriggerCondition
        BswCalledEntity_5: implemented-entry=Wdg_59_DriverB_CheckHWConsistency
  9 x bsw module entry, all with is-synchronous=true, sw-service-impl-policy=STANDARD:
    WDG_59_DRIVERB_TRIGGERFUNCTION_ISR: is-reentrant=true, call-type=INTERRUPT, execution-context=INTERRUPT-CAT-1
    WDG_59_DRIVERB_ERROR_ISR: is-reentrant=true, call-type=INTERRUPT, execution-context=INTERRUPT-CAT-1
    WDG_59_DRIVERB_TRIGGERFUNCTION_CAT2_ISR: is-reentrant=true, call-type=INTERRUPT, execution-context=INTERRUPT-CAT-2
    WDG_59_DRIVERB_ERROR_CAT2_ISR: is-reentrant=true, call-type=INTERRUPT, execution-context=INTERRUPT-CAT-2
    Wdg_59_DriverB_GetVersionInfo: service-id=4, is-reentrant=true, call-type=REGULAR, execution-context=TASK
    Wdg_59_DriverB_Init: service-id=0, is-reentrant=false, call-type=REGULAR, execution-context=TASK
    Wdg_59_DriverB_SetMode: service-id=1, is-reentrant=false, call-type=REGULAR, execution-context=TASK
    Wdg_59_DriverB_SetTriggerCondition: service-id=3, is-reentrant=false, call-type=REGULAR, execution-context=TASK
    Wdg_59_DriverB_CheckHWConsistency: service-id=5, is-reentrant=false, call-type=REGULAR, execution-context=TASK
package /Renesas/ModuleDescription_Wdg2
  bsw implementation Wdg_Impl: programming-language=C, sw-version=1.0.7, vendor-id=59, ar-release-version=4.2.2, behavior=BswInternalBehavior_2, vendor-api-infix=DRIVERC, vendor-specific-module-def=Wdg
    code-descriptors:
      code Wdg_Code: artifact-descriptors=[{short-label=Wdg_59_DriverC.c, category=SWSRC}, {short-label=Wdg_59_DriverC.h, category=SWHDR}]
    resource consumption ResourceConsumption
      8 x memory section:
        VAR_NO_INIT_8: sw-addrmethod=VAR_NO_INIT
        VAR_INIT_8: sw-addrmethod=VAR_INIT
        VAR_NO_INIT_UNSPECIFIED: sw-addrmethod=VAR_NO_INIT
        VAR_NO_INIT_16: sw-addrmethod=VAR_NO_INIT
        CONFIG_DATA_UNSPECIFIED: sw-addrmethod=CONFIG_DATA
        PUBLIC_CODE: sw-addrmethod=CODE
        APPL_CODE: sw-addrmethod=CODE
        CODE_FAST: sw-addrmethod=CODE
  bsw module description Wdg: module-id=102
    provided-entrys:
      Wdg_59_DriverC_Init
      Wdg_59_DriverC_SetMode
      Wdg_59_DriverC_SetTriggerCondition
      Wdg_59_DriverC_GetVersionInfo
      Wdg_59_DriverC_CheckHWConsistency
      WDG_59_DRIVERC_ERROR_ISR
      WDG_59_DRIVERC_TRIGGERFUNCTION_ISR
      WDG_59_DRIVERC_ERROR_CAT2_ISR
      WDG_59_DRIVERC_TRIGGERFUNCTION_CAT2_ISR
    bsw internal behavior BswInternalBehavior_2
      exclusive area WDG_59_DRIVERC_TRIGG_PROTECTION
      exclusive area WDG_59_DRIVERC_MODE_SWITCH_PROTECTION
      4 x bsw interrupt entity:
        BswInterruptEntity_0: can-enter-exclusive-area=WDG_59_DRIVERC_TRIGG_PROTECTION, implemented-entry=WDG_59_DRIVERC_TRIGGERFUNCTION_ISR, interrupt-category=CAT-1, interrupt-source=INTWDTA2
        BswInterruptEntity_1: implemented-entry=WDG_59_DRIVERC_ERROR_ISR, interrupt-category=CAT-1, interrupt-source=WDTA2TNMI
        BswInterruptEntity_2: can-enter-exclusive-area=WDG_59_DRIVERC_TRIGG_PROTECTION, implemented-entry=WDG_59_DRIVERC_TRIGGERFUNCTION_CAT2_ISR, interrupt-category=CAT-2, interrupt-source=INTWDTA2
        BswInterruptEntity_3: implemented-entry=WDG_59_DRIVERC_ERROR_CAT2_ISR, interrupt-category=CAT-2, interrupt-source=WDTA2TNMI
      5 x bsw called entity:
        BswCalledEntity_0: implemented-entry=Wdg_59_DriverC_GetVersionInfo
        BswCalledEntity_1: implemented-entry=Wdg_59_DriverC_Init
        BswCalledEntity_2: can-enter-exclusive-area=[WDG_59_DRIVERC_TRIGG_PROTECTION, WDG_59_DRIVERC_MODE_SWITCH_PROTECTION], implemented-entry=Wdg_59_DriverC_SetMode
        BswCalledEntity_4: can-enter-exclusive-area=WDG_59_DRIVERC_TRIGG_PROTECTION, implemented-entry=Wdg_59_DriverC_SetTriggerCondition
        BswCalledEntity_5: implemented-entry=Wdg_59_DriverC_CheckHWConsistency
  9 x bsw module entry, all with is-synchronous=true, sw-service-impl-policy=STANDARD:
    WDG_59_DRIVERC_TRIGGERFUNCTION_ISR: is-reentrant=true, call-type=INTERRUPT, execution-context=INTERRUPT-CAT-1
    WDG_59_DRIVERC_ERROR_ISR: is-reentrant=true, call-type=INTERRUPT, execution-context=INTERRUPT-CAT-1
    WDG_59_DRIVERC_TRIGGERFUNCTION_CAT2_ISR: is-reentrant=true, call-type=INTERRUPT, execution-context=INTERRUPT-CAT-2
    WDG_59_DRIVERC_ERROR_CAT2_ISR: is-reentrant=true, call-type=INTERRUPT, execution-context=INTERRUPT-CAT-2
    Wdg_59_DriverC_GetVersionInfo: service-id=4, is-reentrant=true, call-type=REGULAR, execution-context=TASK
    Wdg_59_DriverC_Init: service-id=0, is-reentrant=false, call-type=REGULAR, execution-context=TASK
    Wdg_59_DriverC_SetMode: service-id=1, is-reentrant=false, call-type=REGULAR, execution-context=TASK
    Wdg_59_DriverC_SetTriggerCondition: service-id=3, is-reentrant=false, call-type=REGULAR, execution-context=TASK
    Wdg_59_DriverC_CheckHWConsistency: service-id=5, is-reentrant=false, call-type=REGULAR, execution-context=TASK
