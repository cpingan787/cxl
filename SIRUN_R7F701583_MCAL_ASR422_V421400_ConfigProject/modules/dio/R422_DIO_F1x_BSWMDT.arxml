AUTOSAR XML (schema 4-2-2)
# COPYRIGHT
# Copyright(c) 2016-2021 Renesas Electronics Corporation
package /Renesas/ModuleDescription_Dio
  bsw implementation Dio_Impl: programming-language=C, sw-version=2.0.7, vendor-id=59, ar-release-version=4.2.2, behavior=BswInternalBehavior_0, vendor-specific-module-def=Dio
    code-descriptors:
      code Dio_Code: artifact-descriptors=[{short-label=Dio.c, category=SWSRC}, {short-label=Dio.h, category=SWHDR}]
    resource consumption ResourceConsumption
      5 x memory section:
        CODE: sw-addrmethod=CODE
        CONFIG_DATA_UNSPECIFIED: sw-addrmethod=CONFIG_DATA
        CONST_32: sw-addrmethod=CONST
        VAR_INIT_16: sw-addrmethod=VAR_NO_INIT
        VAR_NO_INIT_UNSPECIFIED: sw-addrmethod=VAR_NO_INIT
  bsw module description Dio: module-id=120
    provided-entrys:
      Dio_ReadPort
      Dio_WritePort
      Dio_ReadChannel
      Dio_ReadChannelOutputValue
      Dio_WriteChannel
      Dio_FlipChannel
      Dio_MaskedWritePort
      Dio_ReadChannelGroup
      Dio_ReadChannelGroupOutputValue
      Dio_WriteChannelGroup
      Dio_CheckHWConsistency
      Dio_GetVersionInfo
    bsw internal behavior BswInternalBehavior_0
      exclusive area DIO_REGISTER_PROTECTION
      12 x bsw called entity:
        BswCalledEntity_0: implemented-entry=Dio_ReadChannel
        BswCalledEntity_1: can-enter-exclusive-area=DIO_REGISTER_PROTECTION, implemented-entry=Dio_WriteChannel
        BswCalledEntity_2: implemented-entry=Dio_ReadPort
        BswCalledEntity_3: can-enter-exclusive-area=DIO_REGISTER_PROTECTION, implemented-entry=Dio_WritePort
        BswCalledEntity_4: implemented-entry=Dio_ReadChannelGroup
        BswCalledEntity_5: can-enter-exclusive-area=DIO_REGISTER_PROTECTION, implemented-entry=Dio_WriteChannelGroup
        BswCalledEntity_6: can-enter-exclusive-area=DIO_REGISTER_PROTECTION, implemented-entry=Dio_FlipChannel
        BswCalledEntity_7: implemented-entry=Dio_GetVersionInfo
        BswCalledEntity_8: implemented-entry=Dio_ReadChannelOutputValue
        BswCalledEntity_9: implemented-entry=Dio_ReadChannelGroupOutputValue
        BswCalledEntity_10: can-enter-exclusive-area=DIO_REGISTER_PROTECTION, implemented-entry=Dio_MaskedWritePort
        BswCalledEntity_11: implemented-entry=Dio_CheckHWConsistency
  12 x bsw module entry, all with is-synchronous=true, call-type=REGULAR, execution-context=TASK, sw-service-impl-policy=STANDARD:
    Dio_ReadChannel: service-id=0, is-reentrant=true
    Dio_WriteChannel: service-id=1, is-reentrant=true
    Dio_ReadPort: service-id=2, is-reentrant=true
    Dio_WritePort: service-id=3, is-reentrant=true
    Dio_ReadChannelGroup: service-id=4, is-reentrant=true
    Dio_WriteChannelGroup: service-id=5, is-reentrant=true
    Dio_FlipChannel: service-id=17, is-reentrant=true
    Dio_MaskedWritePort: service-id=23, is-reentrant=true
    Dio_ReadChannelOutputValue: service-id=21, is-reentrant=true
    Dio_ReadChannelGroupOutputValue: service-id=22, is-reentrant=true
    Dio_GetVersionInfo: service-id=18, is-reentrant=true
    Dio_CheckHWConsistency: service-id=19, is-reentrant=false
