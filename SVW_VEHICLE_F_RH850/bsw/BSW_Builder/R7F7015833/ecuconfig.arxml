AUTOSAR XML (schema 00048)
package /R7F7015833
  ecuc value collection R7F7015833: ecuc-values=[Os, CanSM, ComM, EcuC, CanIf, Com, PduR, EcuM, Xfrm, Crc, Nm, CanNm, CanTp, Dem, Dcm, BswM, Can, IpduM]
