AUTOSAR XML (schema 4-2-2)
package /AUTOSAR/EcucDefs
  ecuc value collection ECUConfiguration: ecuc-values=Dem0
  module config Dem0: definition=Dem, implementation-config-variant=VARIANT-PRE-COMPILE
    DemConfigSet0 (DemConfigSet)
      5 x DemEventParameter, all with DemEventKind=, DemMaxNumberFreezeFrameRecords=, DemDTCClassRef=, DemExtendedDataClassRef=, DemFreezeFrameClassRef=, DemFreezeFrameRecNumClassRef=:
        DemEventParameter0: DemEventId=1
          DemEventClass0 (DemEventClass):
            DemAgingAllowed = 
            DemAgingCycleCounterThreshold = 
            DemConsiderPtoStatus = 
            DemEventDestination = 
            DemEventFailureCycleCounterThreshold = 
            DemEventOBDReadinessGroup = 
            DemEventPriority = 
            DemEventSignificance = 
            DemFFPrestorageSupported = 
            DemAgingCycleRef = 
            DemEnableConditionGroupRef = 
            DemEventFailureCycleRef = 
            DemOperationCycleRef = 
            DemStorageConditionGroupRef = 
            DemDebounceAlgorithmClass0 (DemDebounceAlgorithmClass)
        DemEventParameter2: DemEventId=2
          DemEventClass0 (DemEventClass):
            DemAgingAllowed = 
            DemAgingCycleCounterThreshold = 
            DemConsiderPtoStatus = 
            DemEventDestination = 
            DemEventFailureCycleCounterThreshold = 
            DemEventOBDReadinessGroup = 
            DemEventPriority = 
            DemEventSignificance = 
            DemFFPrestorageSupported = 
            DemAgingCycleRef = 
            DemEnableConditionGroupRef = 
            DemEventFailureCycleRef = 
            DemOperationCycleRef = 
            DemStorageConditionGroupRef = 
            DemDebounceAlgorithmClass0 (DemDebounceAlgorithmClass)
        DemEventParameter1: DemEventId=3
          DemEventClass0 (DemEventClass):
            DemAgingAllowed = 
            DemAgingCycleCounterThreshold = 
            DemConsiderPtoStatus = 
            DemEventDestination = 
            DemEventFailureCycleCounterThreshold = 
            DemEventOBDReadinessGroup = 
            DemEventPriority = 
            DemEventSignificance = 
            DemFFPrestorageSupported = 
            DemAgingCycleRef = 
            DemEnableConditionGroupRef = 
            DemEventFailureCycleRef = 
            DemOperationCycleRef = 
            DemStorageConditionGroupRef = 
            DemDebounceAlgorithmClass0 (DemDebounceAlgorithmClass)
        DemEventParameter3: DemEventId=4
          DemEventClass0 (DemEventClass):
            DemAgingAllowed = 
            DemAgingCycleCounterThreshold = 
            DemConsiderPtoStatus = 
            DemEventDestination = 
            DemEventFailureCycleCounterThreshold = 
            DemEventOBDReadinessGroup = 
            DemEventPriority = 
            DemEventSignificance = 
            DemFFPrestorageSupported = 
            DemAgingCycleRef = 
            DemEnableConditionGroupRef = 
            DemEventFailureCycleRef = 
            DemOperationCycleRef = 
            DemStorageConditionGroupRef = 
            DemDebounceAlgorithmClass0 (DemDebounceAlgorithmClass)
        DemEventParameter4: DemEventId=5
          DemEventClass0 (DemEventClass):
            DemAgingAllowed = 
            DemAgingCycleCounterThreshold = 
            DemConsiderPtoStatus = 
            DemEventDestination = 
            DemEventFailureCycleCounterThreshold = 
            DemEventOBDReadinessGroup = 
            DemEventPriority = 
            DemEventSignificance = 
            DemFFPrestorageSupported = 
            DemAgingCycleRef = 
            DemEnableConditionGroupRef = 
            DemEventFailureCycleRef = 
            DemOperationCycleRef = 
            DemStorageConditionGroupRef = 
            DemDebounceAlgorithmClass0 (DemDebounceAlgorithmClass)
    DemGeneral0 (DemGeneral):
      DemAgingCycleCounterProcessing = 
      DemBswErrorBufferSize = 
      DemClearDTCBehavior = 
      DemDTCSuppressionSupport = 
      DemDebounceCounterBasedSupport = 
      DemDebounceTimeBasedSupport = 
      DemDevErrorDetect = 0
      DemDtcStatusAvailabilityMask = 
      DemEnableConditionSupport = 
      DemEventCombinationSupport = 
      DemEventDisplacementSupport = 
      DemExtendedDataCapture = 
      DemFreezeFrameCapture = 
      DemHeaderFileInclusion = 
      DemImmediateNvStorageLimit = 
      DemMaxNumberEventEntryMirror = 
      DemMaxNumberEventEntryPermanent = 
      DemMaxNumberEventEntryPrimary = 
      DemMaxNumberEventEntrySecondary = 
      DemMaxNumberPrestoredFF = 
      DemOBDSupport = 
      DemOccurrenceCounterProcessing = 
      DemOperationCycleStatusStorage = 
      DemPTOSupport = 
      DemStatusBitStorageTestFailed = 
      DemStorageConditionSupport = 
      DemTaskTime = 
      DemTriggerDcmReports = 
      DemTriggerDltReports = 
      DemTriggerFiMReports = 
      DemTriggerMonitorInitBeforeClearOk = 
      DemTypeOfDTCSupported = 
      DemTypeOfFreezeFrameRecordNumeration = 
      DemVersionInfoApi = 
      DemMILIndicatorRef = 
      DemOperationCycle0 (DemOperationCycle): DemOperationCycleType=
