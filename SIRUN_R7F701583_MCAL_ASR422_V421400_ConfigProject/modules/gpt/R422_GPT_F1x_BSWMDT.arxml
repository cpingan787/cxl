AUTOSAR XML (schema 4-2-2)
# COPYRIGHT
# Copyright(c) 2015-2021 Renesas Electronics Corporation
package /Renesas/ModuleDescription_Gpt
  bsw implementation Gpt_Impl: programming-language=C, sw-version=1.0.10, vendor-id=59, ar-release-version=4.2.2, behavior=BswInternalBehavior_0, vendor-specific-module-def=Gpt
    code-descriptors:
      code Gpt_Code: artifact-descriptors=[{short-label=Gpt.c, category=SWSRC}, {short-label=Gpt.h, category=SWHDR}]
    resource consumption ResourceConsumption
      9 x memory section:
        CONST_UNSPECIFIED: sw-addrmethod=CONST
        CONFIG_DATA_UNSPECIFIED: sw-addrmethod=CONFIG_DATA
        VAR_INIT_BOOLEAN: sw-addrmethod=VAR
        VAR_NO_INIT_16: sw-addrmethod=VAR
        VAR_NO_INIT_8: sw-addrmethod=VAR
        VAR_NO_INIT_UNSPECIFIED: sw-addrmethod=VAR
        CODE: sw-addrmethod=CODE
        CODE_FAST: sw-addrmethod=CODE
        CALLOUT_CODE: sw-addrmethod=CODE
  bsw module description Gpt: module-id=100
    provided-entrys:
      Gpt_Init
      Gpt_DeInit
      Gpt_GetTimeElapsed
      Gpt_GetTimeRemaining
      Gpt_StartTimer
      Gpt_StopTimer
      Gpt_EnableNotification
      Gpt_DisableNotification
      Gpt_SetMode
      Gpt_DisableWakeup
      Gpt_EnableWakeup
      Gpt_CheckWakeup
      Gpt_GetVersionInfo
      Gpt_HWCheckConsistency
      Gpt_GetPredefTimerValue
      TAUB0_CH00_ISR
      TAUB0_CH00_CAT2_ISR
      TAUB0_CH01_ISR
      TAUB0_CH01_CAT2_ISR
      TAUB0_CH02_ISR
      TAUB0_CH02_CAT2_ISR
      TAUB0_CH03_ISR
      TAUB0_CH03_CAT2_ISR
      TAUB0_CH04_ISR
      TAUB0_CH04_CAT2_ISR
      TAUB0_CH05_ISR
      TAUB0_CH05_CAT2_ISR
      TAUB0_CH06_ISR
      TAUB0_CH06_CAT2_ISR
      TAUB0_CH07_ISR
      TAUB0_CH07_CAT2_ISR
      TAUB0_CH08_ISR
      TAUB0_CH08_CAT2_ISR
      TAUB0_CH09_ISR
      TAUB0_CH09_CAT2_ISR
      TAUB0_CH10_ISR
      TAUB0_CH10_CAT2_ISR
      TAUB0_CH11_ISR
      TAUB0_CH11_CAT2_ISR
      TAUB0_CH12_ISR
      TAUB0_CH12_CAT2_ISR
      TAUB0_CH13_ISR
      TAUB0_CH13_CAT2_ISR
      TAUB0_CH14_ISR
      TAUB0_CH14_CAT2_ISR
      TAUB0_CH15_ISR
      TAUB0_CH15_CAT2_ISR
      TAUB1_CH00_ISR
      TAUB1_CH00_CAT2_ISR
      TAUB1_CH01_ISR
      TAUB1_CH01_CAT2_ISR
      TAUB1_CH02_ISR
      TAUB1_CH02_CAT2_ISR
      TAUB1_CH03_ISR
      TAUB1_CH03_CAT2_ISR
      TAUB1_CH04_ISR
      TAUB1_CH04_CAT2_ISR
      TAUB1_CH05_ISR
      TAUB1_CH05_CAT2_ISR
      TAUB1_CH06_ISR
      TAUB1_CH06_CAT2_ISR
      TAUB1_CH07_ISR
      TAUB1_CH07_CAT2_ISR
      TAUB1_CH08_ISR
      TAUB1_CH08_CAT2_ISR
      TAUB1_CH09_ISR
      TAUB1_CH09_CAT2_ISR
      TAUB1_CH10_ISR
      TAUB1_CH10_CAT2_ISR
      TAUB1_CH11_ISR
      TAUB1_CH11_CAT2_ISR
      TAUB1_CH12_ISR
      TAUB1_CH12_CAT2_ISR
      TAUB1_CH13_ISR
      TAUB1_CH13_CAT2_ISR
      TAUB1_CH14_ISR
      TAUB1_CH14_CAT2_ISR
      TAUB1_CH15_ISR
      TAUB1_CH15_CAT2_ISR
      TAUD0_CH00_ISR
      TAUD0_CH00_CAT2_ISR
      TAUD0_CH01_ISR
      TAUD0_CH01_CAT2_ISR
      TAUD0_CH02_ISR
      TAUD0_CH02_CAT2_ISR
      TAUD0_CH03_ISR
      TAUD0_CH03_CAT2_ISR
      TAUD0_CH04_ISR
      TAUD0_CH04_CAT2_ISR
      TAUD0_CH05_ISR
      TAUD0_CH05_CAT2_ISR
      TAUD0_CH06_ISR
      TAUD0_CH06_CAT2_ISR
      TAUD0_CH07_ISR
      TAUD0_CH07_CAT2_ISR
      TAUD0_CH08_ISR
      TAUD0_CH08_CAT2_ISR
      TAUD0_CH09_ISR
      TAUD0_CH09_CAT2_ISR
      TAUD0_CH10_ISR
      TAUD0_CH10_CAT2_ISR
      TAUD0_CH11_ISR
      TAUD0_CH11_CAT2_ISR
      TAUD0_CH12_ISR
      TAUD0_CH12_CAT2_ISR
      TAUD0_CH13_ISR
      TAUD0_CH13_CAT2_ISR
      TAUD0_CH14_ISR
      TAUD0_CH14_CAT2_ISR
      TAUD0_CH15_ISR
      TAUD0_CH15_CAT2_ISR
      TAUJ0_CH00_ISR
      TAUJ0_CH00_CAT2_ISR
      TAUJ0_CH01_ISR
      TAUJ0_CH01_CAT2_ISR
      TAUJ0_CH02_ISR
      TAUJ0_CH02_CAT2_ISR
      TAUJ0_CH03_ISR
      TAUJ0_CH03_CAT2_ISR
      TAUJ1_CH00_ISR
      TAUJ1_CH00_CAT2_ISR
      TAUJ1_CH01_ISR
      TAUJ1_CH01_CAT2_ISR
      TAUJ1_CH02_ISR
      TAUJ1_CH02_CAT2_ISR
      TAUJ1_CH03_ISR
      TAUJ1_CH03_CAT2_ISR
      TAUJ2_CH00_ISR
      TAUJ2_CH00_CAT2_ISR
      TAUJ2_CH01_ISR
      TAUJ2_CH01_CAT2_ISR
      TAUJ2_CH02_ISR
      TAUJ2_CH02_CAT2_ISR
      TAUJ2_CH03_ISR
      TAUJ2_CH03_CAT2_ISR
      TAUJ3_CH00_ISR
      TAUJ3_CH00_CAT2_ISR
      TAUJ3_CH01_ISR
      TAUJ3_CH01_CAT2_ISR
      TAUJ3_CH02_ISR
      TAUJ3_CH02_CAT2_ISR
      TAUJ3_CH03_ISR
      TAUJ3_CH03_CAT2_ISR
      OSTM0_CH00_ISR
      OSTM0_CH00_CAT2_ISR
      OSTM5_CH00_ISR
      OSTM5_CH00_CAT2_ISR
      GPT_FEINT_ISR
      GPT_FEINT_CAT2_ISR
    bsw internal behavior BswInternalBehavior_0
      exclusive area GPT_TIMERREG_PROTECTION
      exclusive area GPT_TIMERINT_PROTECTION
      134 x bsw interrupt entity, all with can-enter-exclusive-area=[GPT_TIMERREG_PROTECTION, GPT_TIMERINT_PROTECTION]:
        BswInterruptEntity_0: implemented-entry=TAUB0_CH00_ISR, interrupt-category=CAT-1, interrupt-source=INTTAUB0I0
        BswInterruptEntity_1: implemented-entry=TAUB0_CH00_CAT2_ISR, interrupt-category=CAT-2, interrupt-source=INTTAUB0I0
        BswInterruptEntity_2: implemented-entry=TAUB0_CH01_ISR, interrupt-category=CAT-1, interrupt-source=INTTAUB0I1
        BswInterruptEntity_3: implemented-entry=TAUB0_CH01_CAT2_ISR, interrupt-category=CAT-2, interrupt-source=INTTAUB0I1
        BswInterruptEntity_4: implemented-entry=TAUB0_CH02_ISR, interrupt-category=CAT-1, interrupt-source=INTTAUB0I2
        BswInterruptEntity_5: implemented-entry=TAUB0_CH02_CAT2_ISR, interrupt-category=CAT-2, interrupt-source=INTTAUB0I2
        BswInterruptEntity_6: implemented-entry=TAUB0_CH03_ISR, interrupt-category=CAT-1, interrupt-source=INTTAUB0I3
        BswInterruptEntity_7: implemented-entry=TAUB0_CH03_CAT2_ISR, interrupt-category=CAT-2, interrupt-source=INTTAUB0I3
        BswInterruptEntity_8: implemented-entry=TAUB0_CH04_ISR, interrupt-category=CAT-1, interrupt-source=INTTAUB0I4
        BswInterruptEntity_9: implemented-entry=TAUB0_CH04_CAT2_ISR, interrupt-category=CAT-2, interrupt-source=INTTAUB0I4
        BswInterruptEntity_10: implemented-entry=TAUB0_CH05_ISR, interrupt-category=CAT-1, interrupt-source=INTTAUB0I5
        BswInterruptEntity_11: implemented-entry=TAUB0_CH05_CAT2_ISR, interrupt-category=CAT-2, interrupt-source=INTTAUB0I5
        BswInterruptEntity_12: implemented-entry=TAUB0_CH06_ISR, interrupt-category=CAT-1, interrupt-source=INTTAUB0I6
        BswInterruptEntity_13: implemented-entry=TAUB0_CH06_CAT2_ISR, interrupt-category=CAT-2, interrupt-source=INTTAUB0I6
        BswInterruptEntity_14: implemented-entry=TAUB0_CH07_ISR, interrupt-category=CAT-1, interrupt-source=INTTAUB0I7
        BswInterruptEntity_15: implemented-entry=TAUB0_CH07_CAT2_ISR, interrupt-category=CAT-2, interrupt-source=INTTAUB0I7
        BswInterruptEntity_16: implemented-entry=TAUB0_CH08_ISR, interrupt-category=CAT-1, interrupt-source=INTTAUB0I8
        BswInterruptEntity_17: implemented-entry=TAUB0_CH08_CAT2_ISR, interrupt-category=CAT-2, interrupt-source=INTTAUB0I8
        BswInterruptEntity_18: implemented-entry=TAUB0_CH09_ISR, interrupt-category=CAT-1, interrupt-source=INTTAUB0I9
        BswInterruptEntity_19: implemented-entry=TAUB0_CH09_CAT2_ISR, interrupt-category=CAT-2, interrupt-source=INTTAUB0I9
        BswInterruptEntity_20: implemented-entry=TAUB0_CH10_ISR, interrupt-category=CAT-1, interrupt-source=INTTAUB0I10
        BswInterruptEntity_21: implemented-entry=TAUB0_CH10_CAT2_ISR, interrupt-category=CAT-2, interrupt-source=INTTAUB0I10
        BswInterruptEntity_22: implemented-entry=TAUB0_CH11_ISR, interrupt-category=CAT-1, interrupt-source=INTTAUB0I11
        BswInterruptEntity_23: implemented-entry=TAUB0_CH11_CAT2_ISR, interrupt-category=CAT-2, interrupt-source=INTTAUB0I11
        BswInterruptEntity_24: implemented-entry=TAUB0_CH12_ISR, interrupt-category=CAT-1, interrupt-source=INTTAUB0I12
        BswInterruptEntity_25: implemented-entry=TAUB0_CH12_CAT2_ISR, interrupt-category=CAT-2, interrupt-source=INTTAUB0I12
        BswInterruptEntity_26: implemented-entry=TAUB0_CH13_ISR, interrupt-category=CAT-1, interrupt-source=INTTAUB0I13
        BswInterruptEntity_27: implemented-entry=TAUB0_CH13_CAT2_ISR, interrupt-category=CAT-2, interrupt-source=INTTAUB0I13
        BswInterruptEntity_28: implemented-entry=TAUB0_CH14_ISR, interrupt-category=CAT-1, interrupt-source=INTTAUB0I14
        BswInterruptEntity_29: implemented-entry=TAUB0_CH14_CAT2_ISR, interrupt-category=CAT-2, interrupt-source=INTTAUB0I14
        BswInterruptEntity_30: implemented-entry=TAUB0_CH15_ISR, interrupt-category=CAT-1, interrupt-source=INTTAUB0I15
        BswInterruptEntity_31: implemented-entry=TAUB0_CH15_CAT2_ISR, interrupt-category=CAT-2, interrupt-source=INTTAUB0I15
        BswInterruptEntity_32: implemented-entry=TAUB1_CH00_ISR, interrupt-category=CAT-1, interrupt-source=INTTAUB1I0
        BswInterruptEntity_33: implemented-entry=TAUB1_CH00_CAT2_ISR, interrupt-category=CAT-2, interrupt-source=INTTAUB1I0
        BswInterruptEntity_34: implemented-entry=TAUB1_CH01_ISR, interrupt-category=CAT-1, interrupt-source=INTTAUB1I1
        BswInterruptEntity_35: implemented-entry=TAUB1_CH01_CAT2_ISR, interrupt-category=CAT-2, interrupt-source=INTTAUB1I1
        BswInterruptEntity_36: implemented-entry=TAUB1_CH02_ISR, interrupt-category=CAT-1, interrupt-source=INTTAUB1I2
        BswInterruptEntity_37: implemented-entry=TAUB1_CH02_CAT2_ISR, interrupt-category=CAT-2, interrupt-source=INTTAUB1I2
        BswInterruptEntity_38: implemented-entry=TAUB1_CH03_ISR, interrupt-category=CAT-1, interrupt-source=INTTAUB1I3
        BswInterruptEntity_39: implemented-entry=TAUB1_CH03_CAT2_ISR, interrupt-category=CAT-2, interrupt-source=INTTAUB1I3
        BswInterruptEntity_40: implemented-entry=TAUB1_CH04_ISR, interrupt-category=CAT-1, interrupt-source=INTTAUB1I4
        BswInterruptEntity_41: implemented-entry=TAUB1_CH04_CAT2_ISR, interrupt-category=CAT-2, interrupt-source=INTTAUB1I4
        BswInterruptEntity_42: implemented-entry=TAUB1_CH05_ISR, interrupt-category=CAT-1, interrupt-source=INTTAUB1I5
        BswInterruptEntity_43: implemented-entry=TAUB1_CH05_CAT2_ISR, interrupt-category=CAT-2, interrupt-source=INTTAUB1I5
        BswInterruptEntity_44: implemented-entry=TAUB1_CH06_ISR, interrupt-category=CAT-1, interrupt-source=INTTAUB1I6
        BswInterruptEntity_45: implemented-entry=TAUB1_CH06_CAT2_ISR, interrupt-category=CAT-2, interrupt-source=INTTAUB1I6
        BswInterruptEntity_46: implemented-entry=TAUB1_CH07_ISR, interrupt-category=CAT-1, interrupt-source=INTTAUB1I7
        BswInterruptEntity_47: implemented-entry=TAUB1_CH07_CAT2_ISR, interrupt-category=CAT-2, interrupt-source=INTTAUB1I7
        BswInterruptEntity_48: implemented-entry=TAUB1_CH08_ISR, interrupt-category=CAT-1, interrupt-source=INTTAUB1I8
        BswInterruptEntity_49: implemented-entry=TAUB1_CH08_CAT2_ISR, interrupt-category=CAT-2, interrupt-source=INTTAUB1I8
        BswInterruptEntity_50: implemented-entry=TAUB1_CH09_ISR, interrupt-category=CAT-1, interrupt-source=INTTAUB1I9
        BswInterruptEntity_51: implemented-entry=TAUB1_CH09_CAT2_ISR, interrupt-category=CAT-2, interrupt-source=INTTAUB1I9
        BswInterruptEntity_52: implemented-entry=TAUB1_CH10_ISR, interrupt-category=CAT-1, interrupt-source=INTTAUB1I10
        BswInterruptEntity_53: implemented-entry=TAUB1_CH10_CAT2_ISR, interrupt-category=CAT-2, interrupt-source=INTTAUB1I10
        BswInterruptEntity_54: implemented-entry=TAUB1_CH11_ISR, interrupt-category=CAT-1, interrupt-source=INTTAUB1I11
        BswInterruptEntity_55: implemented-entry=TAUB1_CH11_CAT2_ISR, interrupt-category=CAT-2, interrupt-source=INTTAUB1I11
        BswInterruptEntity_56: implemented-entry=TAUB1_CH12_ISR, interrupt-category=CAT-1, interrupt-source=INTTAUB1I12
        BswInterruptEntity_57: implemented-entry=TAUB1_CH12_CAT2_ISR, interrupt-category=CAT-2, interrupt-source=INTTAUB1I12
        BswInterruptEntity_58: implemented-entry=TAUB1_CH13_ISR, interrupt-category=CAT-1, interrupt-source=INTTAUB1I13
        BswInterruptEntity_59: implemented-entry=TAUB1_CH13_CAT2_ISR, interrupt-category=CAT-2, interrupt-source=INTTAUB1I13
        BswInterruptEntity_60: implemented-entry=TAUB1_CH14_ISR, interrupt-category=CAT-1, interrupt-source=INTTAUB1I14
        BswInterruptEntity_61: implemented-entry=TAUB1_CH14_CAT2_ISR, interrupt-category=CAT-2, interrupt-source=INTTAUB1I14
        BswInterruptEntity_62: implemented-entry=TAUB1_CH15_ISR, interrupt-category=CAT-1, interrupt-source=INTTAUB1I15
        BswInterruptEntity_63: implemented-entry=TAUB1_CH15_CAT2_ISR, interrupt-category=CAT-2, interrupt-source=INTTAUB1I15
        BswInterruptEntity_64: implemented-entry=TAUD0_CH00_ISR, interrupt-category=CAT-1, interrupt-source=INTTAUD0I0
        BswInterruptEntity_65: implemented-entry=TAUD0_CH00_CAT2_ISR, interrupt-category=CAT-2, interrupt-source=INTTAUD0I0
        BswInterruptEntity_66: implemented-entry=TAUD0_CH01_ISR, interrupt-category=CAT-1, interrupt-source=INTTAUD0I1
        BswInterruptEntity_67: implemented-entry=TAUD0_CH01_CAT2_ISR, interrupt-category=CAT-2, interrupt-source=INTTAUD0I1
        BswInterruptEntity_68: implemented-entry=TAUD0_CH02_ISR, interrupt-category=CAT-1, interrupt-source=INTTAUD0I2
        BswInterruptEntity_69: implemented-entry=TAUD0_CH02_CAT2_ISR, interrupt-category=CAT-2, interrupt-source=INTTAUD0I2
        BswInterruptEntity_70: implemented-entry=TAUD0_CH03_ISR, interrupt-category=CAT-1, interrupt-source=INTTAUD0I3
        BswInterruptEntity_71: implemented-entry=TAUD0_CH03_CAT2_ISR, interrupt-category=CAT-2, interrupt-source=INTTAUD0I3
        BswInterruptEntity_72: implemented-entry=TAUD0_CH04_ISR, interrupt-category=CAT-1, interrupt-source=INTTAUD0I4
        BswInterruptEntity_73: implemented-entry=TAUD0_CH04_CAT2_ISR, interrupt-category=CAT-2, interrupt-source=INTTAUD0I4
        BswInterruptEntity_74: implemented-entry=TAUD0_CH05_ISR, interrupt-category=CAT-1, interrupt-source=INTTAUD0I5
        BswInterruptEntity_75: implemented-entry=TAUD0_CH05_CAT2_ISR, interrupt-category=CAT-2, interrupt-source=INTTAUD0I5
        BswInterruptEntity_76: implemented-entry=TAUD0_CH06_ISR, interrupt-category=CAT-1, interrupt-source=INTTAUD0I6
        BswInterruptEntity_77: implemented-entry=TAUD0_CH06_CAT2_ISR, interrupt-category=CAT-2, interrupt-source=INTTAUD0I6
        BswInterruptEntity_78: implemented-entry=TAUD0_CH07_ISR, interrupt-category=CAT-1, interrupt-source=INTTAUD0I7
        BswInterruptEntity_79: implemented-entry=TAUD0_CH07_CAT2_ISR, interrupt-category=CAT-2, interrupt-source=INTTAUD0I7
        BswInterruptEntity_80: implemented-entry=TAUD0_CH08_ISR, interrupt-category=CAT-1, interrupt-source=INTTAUD0I8
        BswInterruptEntity_81: implemented-entry=TAUD0_CH08_CAT2_ISR, interrupt-category=CAT-2, interrupt-source=INTTAUD0I8
        BswInterruptEntity_82: implemented-entry=TAUD0_CH09_ISR, interrupt-category=CAT-1, interrupt-source=INTTAUD0I9
        BswInterruptEntity_83: implemented-entry=TAUD0_CH09_CAT2_ISR, interrupt-category=CAT-2, interrupt-source=INTTAUD0I9
        BswInterruptEntity_84: implemented-entry=TAUD0_CH10_ISR, interrupt-category=CAT-1, interrupt-source=INTTAUD0I10
        BswInterruptEntity_85: implemented-entry=TAUD0_CH10_CAT2_ISR, interrupt-category=CAT-2, interrupt-source=INTTAUD0I10
        BswInterruptEntity_86: implemented-entry=TAUD0_CH11_ISR, interrupt-category=CAT-1, interrupt-source=INTTAUD0I11
        BswInterruptEntity_87: implemented-entry=TAUD0_CH11_CAT2_ISR, interrupt-category=CAT-2, interrupt-source=INTTAUD0I11
        BswInterruptEntity_88: implemented-entry=TAUD0_CH12_ISR, interrupt-category=CAT-1, interrupt-source=INTTAUD0I12
        BswInterruptEntity_89: implemented-entry=TAUD0_CH12_CAT2_ISR, interrupt-category=CAT-2, interrupt-source=INTTAUD0I12
        BswInterruptEntity_90: implemented-entry=TAUD0_CH13_ISR, interrupt-category=CAT-1, interrupt-source=INTTAUD0I13
        BswInterruptEntity_91: implemented-entry=TAUD0_CH13_CAT2_ISR, interrupt-category=CAT-2, interrupt-source=INTTAUD0I13
        BswInterruptEntity_92: implemented-entry=TAUD0_CH14_ISR, interrupt-category=CAT-1, interrupt-source=INTTAUD0I14
        BswInterruptEntity_93: implemented-entry=TAUD0_CH14_CAT2_ISR, interrupt-category=CAT-2, interrupt-source=INTTAUD0I14
        BswInterruptEntity_94: implemented-entry=TAUD0_CH15_ISR, interrupt-category=CAT-1, interrupt-source=INTTAUD0I15
        BswInterruptEntity_95: implemented-entry=TAUD0_CH15_CAT2_ISR, interrupt-category=CAT-2, interrupt-source=INTTAUD0I15
        BswInterruptEntity_96: implemented-entry=TAUJ0_CH00_ISR, interrupt-category=CAT-1, interrupt-source=INTTAUJ0I0
        BswInterruptEntity_97: implemented-entry=TAUJ0_CH00_CAT2_ISR, interrupt-category=CAT-2, interrupt-source=INTTAUJ0I0
        BswInterruptEntity_98: implemented-entry=TAUJ0_CH01_ISR, interrupt-category=CAT-1, interrupt-source=INTTAUJ0I1
        BswInterruptEntity_99: implemented-entry=TAUJ0_CH01_CAT2_ISR, interrupt-category=CAT-2, interrupt-source=INTTAUJ0I1
        BswInterruptEntity_100: implemented-entry=TAUJ0_CH02_ISR, interrupt-category=CAT-1, interrupt-source=INTTAUJ0I2
        BswInterruptEntity_101: implemented-entry=TAUJ0_CH02_CAT2_ISR, interrupt-category=CAT-2, interrupt-source=INTTAUJ0I2
        BswInterruptEntity_102: implemented-entry=TAUJ0_CH03_ISR, interrupt-category=CAT-1, interrupt-source=INTTAUJ0I3
        BswInterruptEntity_103: implemented-entry=TAUJ0_CH03_CAT2_ISR, interrupt-category=CAT-2, interrupt-source=INTTAUJ0I3
        BswInterruptEntity_104: implemented-entry=TAUJ1_CH00_ISR, interrupt-category=CAT-1, interrupt-source=INTTAUJ1I0
        BswInterruptEntity_105: implemented-entry=TAUJ1_CH00_CAT2_ISR, interrupt-category=CAT-2, interrupt-source=INTTAUJ1I0
        BswInterruptEntity_106: implemented-entry=TAUJ1_CH01_ISR, interrupt-category=CAT-1, interrupt-source=INTTAUJ1I1
        BswInterruptEntity_107: implemented-entry=TAUJ1_CH01_CAT2_ISR, interrupt-category=CAT-2, interrupt-source=INTTAUJ1I1
        BswInterruptEntity_108: implemented-entry=TAUJ1_CH02_ISR, interrupt-category=CAT-1, interrupt-source=INTTAUJ1I2
        BswInterruptEntity_109: implemented-entry=TAUJ1_CH02_CAT2_ISR, interrupt-category=CAT-2, interrupt-source=INTTAUJ1I2
        BswInterruptEntity_110: implemented-entry=TAUJ1_CH03_ISR, interrupt-category=CAT-1, interrupt-source=INTTAUJ1I3
        BswInterruptEntity_111: implemented-entry=TAUJ1_CH03_CAT2_ISR, interrupt-category=CAT-2, interrupt-source=INTTAUJ1I3
        BswInterruptEntity_112: implemented-entry=TAUJ2_CH00_ISR, interrupt-category=CAT-1, interrupt-source=INTTAUJ2I0
        BswInterruptEntity_113: implemented-entry=TAUJ2_CH00_CAT2_ISR, interrupt-category=CAT-2, interrupt-source=INTTAUJ2I0
        BswInterruptEntity_114: implemented-entry=TAUJ2_CH01_ISR, interrupt-category=CAT-1, interrupt-source=INTTAUJ2I1
        BswInterruptEntity_115: implemented-entry=TAUJ2_CH01_CAT2_ISR, interrupt-category=CAT-2, interrupt-source=INTTAUJ2I1
        BswInterruptEntity_116: implemented-entry=TAUJ2_CH02_ISR, interrupt-category=CAT-1, interrupt-source=INTTAUJ2I2
        BswInterruptEntity_117: implemented-entry=TAUJ2_CH02_CAT2_ISR, interrupt-category=CAT-2, interrupt-source=INTTAUJ2I2
        BswInterruptEntity_118: implemented-entry=TAUJ2_CH03_ISR, interrupt-category=CAT-1, interrupt-source=INTTAUJ2I3
        BswInterruptEntity_119: implemented-entry=TAUJ2_CH03_CAT2_ISR, interrupt-category=CAT-2, interrupt-source=INTTAUJ2I3
        BswInterruptEntity_120: implemented-entry=TAUJ3_CH00_ISR, interrupt-category=CAT-1, interrupt-source=INTTAUJ3I0
        BswInterruptEntity_121: implemented-entry=TAUJ3_CH00_CAT2_ISR, interrupt-category=CAT-2, interrupt-source=INTTAUJ3I0
        BswInterruptEntity_122: implemented-entry=TAUJ3_CH01_ISR, interrupt-category=CAT-1, interrupt-source=INTTAUJ3I1
        BswInterruptEntity_123: implemented-entry=TAUJ3_CH01_CAT2_ISR, interrupt-category=CAT-2, interrupt-source=INTTAUJ3I1
        BswInterruptEntity_124: implemented-entry=TAUJ3_CH02_ISR, interrupt-category=CAT-1, interrupt-source=INTTAUJ3I2
        BswInterruptEntity_125: implemented-entry=TAUJ3_CH02_CAT2_ISR, interrupt-category=CAT-2, interrupt-source=INTTAUJ3I2
        BswInterruptEntity_126: implemented-entry=TAUJ3_CH03_ISR, interrupt-category=CAT-1, interrupt-source=INTTAUJ3I3
        BswInterruptEntity_127: implemented-entry=TAUJ3_CH03_CAT2_ISR, interrupt-category=CAT-2, interrupt-source=INTTAUJ3I3
        BswInterruptEntity_128: implemented-entry=OSTM0_CH00_ISR, interrupt-category=CAT-1, interrupt-source=INTOSTM0
        BswInterruptEntity_129: implemented-entry=OSTM0_CH00_CAT2_ISR, interrupt-category=CAT-2, interrupt-source=INTOSTM0
        BswInterruptEntity_130: implemented-entry=OSTM5_CH00_ISR, interrupt-category=CAT-1, interrupt-source=INTOSTM5
        BswInterruptEntity_131: implemented-entry=OSTM5_CH00_CAT2_ISR, interrupt-category=CAT-2, interrupt-source=INTOSTM5
        BswInterruptEntity_132: implemented-entry=GPT_FEINT_ISR, interrupt-category=CAT-1, interrupt-source=INTOSTM1_FE,INTOSTM2_FE,INTOSTM3_FE,INTOSTM4_FE,INTOSTM6_FE,INTOSTM7_FE,INTOSTM8_FE,INTOSTM9_FE
        BswInterruptEntity_133: implemented-entry=GPT_FEINT_CAT2_ISR, interrupt-category=CAT-2, interrupt-source=INTOSTM1_FE,INTOSTM2_FE,INTOSTM3_FE,INTOSTM4_FE,INTOSTM6_FE,INTOSTM7_FE,INTOSTM8_FE,INTOSTM9_FE
      15 x bsw called entity:
        BswCalledEntity_0: implemented-entry=Gpt_GetVersionInfo
        BswCalledEntity_1: implemented-entry=Gpt_Init
        BswCalledEntity_2: implemented-entry=Gpt_DeInit
        BswCalledEntity_3: can-enter-exclusive-area=GPT_TIMERINT_PROTECTION, implemented-entry=Gpt_GetTimeElapsed
        BswCalledEntity_4: can-enter-exclusive-area=GPT_TIMERINT_PROTECTION, implemented-entry=Gpt_GetTimeRemaining
        BswCalledEntity_5: can-enter-exclusive-area=GPT_TIMERINT_PROTECTION, implemented-entry=Gpt_StartTimer
        BswCalledEntity_6: can-enter-exclusive-area=GPT_TIMERINT_PROTECTION, implemented-entry=Gpt_StopTimer
        BswCalledEntity_7: can-enter-exclusive-area=[GPT_TIMERREG_PROTECTION, GPT_TIMERINT_PROTECTION], implemented-entry=Gpt_EnableNotification
        BswCalledEntity_8: can-enter-exclusive-area=[GPT_TIMERREG_PROTECTION, GPT_TIMERINT_PROTECTION], implemented-entry=Gpt_DisableNotification
        BswCalledEntity_9: can-enter-exclusive-area=GPT_TIMERINT_PROTECTION, implemented-entry=Gpt_SetMode
        BswCalledEntity_10: can-enter-exclusive-area=[GPT_TIMERREG_PROTECTION, GPT_TIMERINT_PROTECTION], implemented-entry=Gpt_DisableWakeup
        BswCalledEntity_11: can-enter-exclusive-area=[GPT_TIMERREG_PROTECTION, GPT_TIMERINT_PROTECTION], implemented-entry=Gpt_EnableWakeup
        BswCalledEntity_12: can-enter-exclusive-area=GPT_TIMERREG_PROTECTION, implemented-entry=Gpt_CheckWakeup
        BswCalledEntity_13: can-enter-exclusive-area=GPT_TIMERREG_PROTECTION, implemented-entry=Gpt_HWCheckConsistency
        BswCalledEntity_14: can-enter-exclusive-area=GPT_TIMERREG_PROTECTION, implemented-entry=Gpt_GetPredefTimerValue
  149 x bsw module entry, all with is-synchronous=true, sw-service-impl-policy=STANDARD:
    TAUB0_CH00_ISR: is-reentrant=true, call-type=INTERRUPT, execution-context=INTERRUPT-CAT-1
    TAUB0_CH00_CAT2_ISR: is-reentrant=true, call-type=INTERRUPT, execution-context=INTERRUPT-CAT-2
    TAUB0_CH01_ISR: is-reentrant=true, call-type=INTERRUPT, execution-context=INTERRUPT-CAT-1
    TAUB0_CH01_CAT2_ISR: is-reentrant=true, call-type=INTERRUPT, execution-context=INTERRUPT-CAT-2
    TAUB0_CH02_ISR: is-reentrant=true, call-type=INTERRUPT, execution-context=INTERRUPT-CAT-1
    TAUB0_CH02_CAT2_ISR: is-reentrant=true, call-type=INTERRUPT, execution-context=INTERRUPT-CAT-2
    TAUB0_CH03_ISR: is-reentrant=true, call-type=INTERRUPT, execution-context=INTERRUPT-CAT-1
    TAUB0_CH03_CAT2_ISR: is-reentrant=true, call-type=INTERRUPT, execution-context=INTERRUPT-CAT-2
    TAUB0_CH04_ISR: is-reentrant=true, call-type=INTERRUPT, execution-context=INTERRUPT-CAT-1
    TAUB0_CH04_CAT2_ISR: is-reentrant=true, call-type=INTERRUPT, execution-context=INTERRUPT-CAT-2
    TAUB0_CH05_ISR: is-reentrant=true, call-type=INTERRUPT, execution-context=INTERRUPT-CAT-1
    TAUB0_CH05_CAT2_ISR: is-reentrant=true, call-type=INTERRUPT, execution-context=INTERRUPT-CAT-2
    TAUB0_CH06_ISR: is-reentrant=true, call-type=INTERRUPT, execution-context=INTERRUPT-CAT-1
    TAUB0_CH06_CAT2_ISR: is-reentrant=true, call-type=INTERRUPT, execution-context=INTERRUPT-CAT-2
    TAUB0_CH07_ISR: is-reentrant=true, call-type=INTERRUPT, execution-context=INTERRUPT-CAT-1
    TAUB0_CH07_CAT2_ISR: is-reentrant=true, call-type=INTERRUPT, execution-context=INTERRUPT-CAT-2
    TAUB0_CH08_ISR: is-reentrant=true, call-type=INTERRUPT, execution-context=INTERRUPT-CAT-1
    TAUB0_CH08_CAT2_ISR: is-reentrant=true, call-type=INTERRUPT, execution-context=INTERRUPT-CAT-2
    TAUB0_CH09_ISR: is-reentrant=true, call-type=INTERRUPT, execution-context=INTERRUPT-CAT-1
    TAUB0_CH09_CAT2_ISR: is-reentrant=true, call-type=INTERRUPT, execution-context=INTERRUPT-CAT-2
    TAUB0_CH10_ISR: is-reentrant=true, call-type=INTERRUPT, execution-context=INTERRUPT-CAT-1
    TAUB0_CH10_CAT2_ISR: is-reentrant=true, call-type=INTERRUPT, execution-context=INTERRUPT-CAT-2
    TAUB0_CH11_ISR: is-reentrant=true, call-type=INTERRUPT, execution-context=INTERRUPT-CAT-1
    TAUB0_CH11_CAT2_ISR: is-reentrant=true, call-type=INTERRUPT, execution-context=INTERRUPT-CAT-2
    TAUB0_CH12_ISR: is-reentrant=true, call-type=INTERRUPT, execution-context=INTERRUPT-CAT-1
    TAUB0_CH12_CAT2_ISR: is-reentrant=true, call-type=INTERRUPT, execution-context=INTERRUPT-CAT-2
    TAUB0_CH13_ISR: is-reentrant=true, call-type=INTERRUPT, execution-context=INTERRUPT-CAT-1
    TAUB0_CH13_CAT2_ISR: is-reentrant=true, call-type=INTERRUPT, execution-context=INTERRUPT-CAT-2
    TAUB0_CH14_ISR: is-reentrant=true, call-type=INTERRUPT, execution-context=INTERRUPT-CAT-1
    TAUB0_CH14_CAT2_ISR: is-reentrant=true, call-type=INTERRUPT, execution-context=INTERRUPT-CAT-2
    TAUB0_CH15_ISR: is-reentrant=true, call-type=INTERRUPT, execution-context=INTERRUPT-CAT-1
    TAUB0_CH15_CAT2_ISR: is-reentrant=true, call-type=INTERRUPT, execution-context=INTERRUPT-CAT-2
    TAUB1_CH00_ISR: is-reentrant=true, call-type=INTERRUPT, execution-context=INTERRUPT-CAT-1
    TAUB1_CH00_CAT2_ISR: is-reentrant=true, call-type=INTERRUPT, execution-context=INTERRUPT-CAT-2
    TAUB1_CH01_ISR: is-reentrant=true, call-type=INTERRUPT, execution-context=INTERRUPT-CAT-1
    TAUB1_CH01_CAT2_ISR: is-reentrant=true, call-type=INTERRUPT, execution-context=INTERRUPT-CAT-2
    TAUB1_CH02_ISR: is-reentrant=true, call-type=INTERRUPT, execution-context=INTERRUPT-CAT-1
    TAUB1_CH02_CAT2_ISR: is-reentrant=true, call-type=INTERRUPT, execution-context=INTERRUPT-CAT-2
    TAUB1_CH03_ISR: is-reentrant=true, call-type=INTERRUPT, execution-context=INTERRUPT-CAT-1
    TAUB1_CH03_CAT2_ISR: is-reentrant=true, call-type=INTERRUPT, execution-context=INTERRUPT-CAT-2
    TAUB1_CH04_ISR: is-reentrant=true, call-type=INTERRUPT, execution-context=INTERRUPT-CAT-1
    TAUB1_CH04_CAT2_ISR: is-reentrant=true, call-type=INTERRUPT, execution-context=INTERRUPT-CAT-2
    TAUB1_CH05_ISR: is-reentrant=true, call-type=INTERRUPT, execution-context=INTERRUPT-CAT-1
    TAUB1_CH05_CAT2_ISR: is-reentrant=true, call-type=INTERRUPT, execution-context=INTERRUPT-CAT-2
    TAUB1_CH06_ISR: is-reentrant=true, call-type=INTERRUPT, execution-context=INTERRUPT-CAT-1
    TAUB1_CH06_CAT2_ISR: is-reentrant=true, call-type=INTERRUPT, execution-context=INTERRUPT-CAT-2
    TAUB1_CH07_ISR: is-reentrant=true, call-type=INTERRUPT, execution-context=INTERRUPT-CAT-1
    TAUB1_CH07_CAT2_ISR: is-reentrant=true, call-type=INTERRUPT, execution-context=INTERRUPT-CAT-2
    TAUB1_CH08_ISR: is-reentrant=true, call-type=INTERRUPT, execution-context=INTERRUPT-CAT-1
    TAUB1_CH08_CAT2_ISR: is-reentrant=true, call-type=INTERRUPT, execution-context=INTERRUPT-CAT-2
    TAUB1_CH09_ISR: is-reentrant=true, call-type=INTERRUPT, execution-context=INTERRUPT-CAT-1
    TAUB1_CH09_CAT2_ISR: is-reentrant=true, call-type=INTERRUPT, execution-context=INTERRUPT-CAT-2
    TAUB1_CH10_ISR: is-reentrant=true, call-type=INTERRUPT, execution-context=INTERRUPT-CAT-1
    TAUB1_CH10_CAT2_ISR: is-reentrant=true, call-type=INTERRUPT, execution-context=INTERRUPT-CAT-2
    TAUB1_CH11_ISR: is-reentrant=true, call-type=INTERRUPT, execution-context=INTERRUPT-CAT-1
    TAUB1_CH11_CAT2_ISR: is-reentrant=true, call-type=INTERRUPT, execution-context=INTERRUPT-CAT-2
    TAUB1_CH12_ISR: is-reentrant=true, call-type=INTERRUPT, execution-context=INTERRUPT-CAT-1
    TAUB1_CH12_CAT2_ISR: is-reentrant=true, call-type=INTERRUPT, execution-context=INTERRUPT-CAT-2
    TAUB1_CH13_ISR: is-reentrant=true, call-type=INTERRUPT, execution-context=INTERRUPT-CAT-1
    TAUB1_CH13_CAT2_ISR: is-reentrant=true, call-type=INTERRUPT, execution-context=INTERRUPT-CAT-2
    TAUB1_CH14_ISR: is-reentrant=true, call-type=INTERRUPT, execution-context=INTERRUPT-CAT-1
    TAUB1_CH14_CAT2_ISR: is-reentrant=true, call-type=INTERRUPT, execution-context=INTERRUPT-CAT-2
    TAUB1_CH15_ISR: is-reentrant=true, call-type=INTERRUPT, execution-context=INTERRUPT-CAT-1
    TAUB1_CH15_CAT2_ISR: is-reentrant=true, call-type=INTERRUPT, execution-context=INTERRUPT-CAT-2
    TAUD0_CH00_ISR: is-reentrant=true, call-type=INTERRUPT, execution-context=INTERRUPT-CAT-1
    TAUD0_CH00_CAT2_ISR: is-reentrant=true, call-type=INTERRUPT, execution-context=INTERRUPT-CAT-2
    TAUD0_CH01_ISR: is-reentrant=true, call-type=INTERRUPT, execution-context=INTERRUPT-CAT-1
    TAUD0_CH01_CAT2_ISR: is-reentrant=true, call-type=INTERRUPT, execution-context=INTERRUPT-CAT-2
    TAUD0_CH02_ISR: is-reentrant=true, call-type=INTERRUPT, execution-context=INTERRUPT-CAT-1
    TAUD0_CH02_CAT2_ISR: is-reentrant=true, call-type=INTERRUPT, execution-context=INTERRUPT-CAT-2
    TAUD0_CH03_ISR: is-reentrant=true, call-type=INTERRUPT, execution-context=INTERRUPT-CAT-1
    TAUD0_CH03_CAT2_ISR: is-reentrant=true, call-type=INTERRUPT, execution-context=INTERRUPT-CAT-2
    TAUD0_CH04_ISR: is-reentrant=true, call-type=INTERRUPT, execution-context=INTERRUPT-CAT-1
    TAUD0_CH04_CAT2_ISR: is-reentrant=true, call-type=INTERRUPT, execution-context=INTERRUPT-CAT-2
    TAUD0_CH05_ISR: is-reentrant=true, call-type=INTERRUPT, execution-context=INTERRUPT-CAT-1
    TAUD0_CH05_CAT2_ISR: is-reentrant=true, call-type=INTERRUPT, execution-context=INTERRUPT-CAT-2
    TAUD0_CH06_ISR: is-reentrant=true, call-type=INTERRUPT, execution-context=INTERRUPT-CAT-1
    TAUD0_CH06_CAT2_ISR: is-reentrant=true, call-type=INTERRUPT, execution-context=INTERRUPT-CAT-2
    TAUD0_CH07_ISR: is-reentrant=true, call-type=INTERRUPT, execution-context=INTERRUPT-CAT-1
    TAUD0_CH07_CAT2_ISR: is-reentrant=true, call-type=INTERRUPT, execution-context=INTERRUPT-CAT-2
    TAUD0_CH08_ISR: is-reentrant=true, call-type=INTERRUPT, execution-context=INTERRUPT-CAT-1
    TAUD0_CH08_CAT2_ISR: is-reentrant=true, call-type=INTERRUPT, execution-context=INTERRUPT-CAT-2
    TAUD0_CH09_ISR: is-reentrant=true, call-type=INTERRUPT, execution-context=INTERRUPT-CAT-1
    TAUD0_CH09_CAT2_ISR: is-reentrant=true, call-type=INTERRUPT, execution-context=INTERRUPT-CAT-2
    TAUD0_CH10_ISR: is-reentrant=true, call-type=INTERRUPT, execution-context=INTERRUPT-CAT-1
    TAUD0_CH10_CAT2_ISR: is-reentrant=true, call-type=INTERRUPT, execution-context=INTERRUPT-CAT-2
    TAUD0_CH11_ISR: is-reentrant=true, call-type=INTERRUPT, execution-context=INTERRUPT-CAT-1
    TAUD0_CH11_CAT2_ISR: is-reentrant=true, call-type=INTERRUPT, execution-context=INTERRUPT-CAT-2
    TAUD0_CH12_ISR: is-reentrant=true, call-type=INTERRUPT, execution-context=INTERRUPT-CAT-1
    TAUD0_CH12_CAT2_ISR: is-reentrant=true, call-type=INTERRUPT, execution-context=INTERRUPT-CAT-2
    TAUD0_CH13_ISR: is-reentrant=true, call-type=INTERRUPT, execution-context=INTERRUPT-CAT-1
    TAUD0_CH13_CAT2_ISR: is-reentrant=true, call-type=INTERRUPT, execution-context=INTERRUPT-CAT-2
    TAUD0_CH14_ISR: is-reentrant=true, call-type=INTERRUPT, execution-context=INTERRUPT-CAT-1
    TAUD0_CH14_CAT2_ISR: is-reentrant=true, call-type=INTERRUPT, execution-context=INTERRUPT-CAT-2
    TAUD0_CH15_ISR: is-reentrant=true, call-type=INTERRUPT, execution-context=INTERRUPT-CAT-1
    TAUD0_CH15_CAT2_ISR: is-reentrant=true, call-type=INTERRUPT, execution-context=INTERRUPT-CAT-2
    TAUJ0_CH00_ISR: is-reentrant=true, call-type=INTERRUPT, execution-context=INTERRUPT-CAT-1
    TAUJ0_CH00_CAT2_ISR: is-reentrant=true, call-type=INTERRUPT, execution-context=INTERRUPT-CAT-2
    TAUJ0_CH01_ISR: is-reentrant=true, call-type=INTERRUPT, execution-context=INTERRUPT-CAT-1
    TAUJ0_CH01_CAT2_ISR: is-reentrant=true, call-type=INTERRUPT, execution-context=INTERRUPT-CAT-2
    TAUJ0_CH02_ISR: is-reentrant=true, call-type=INTERRUPT, execution-context=INTERRUPT-CAT-1
    TAUJ0_CH02_CAT2_ISR: is-reentrant=true, call-type=INTERRUPT, execution-context=INTERRUPT-CAT-2
    TAUJ0_CH03_ISR: is-reentrant=true, call-type=INTERRUPT, execution-context=INTERRUPT-CAT-1
    TAUJ0_CH03_CAT2_ISR: is-reentrant=true, call-type=INTERRUPT, execution-context=INTERRUPT-CAT-2
    TAUJ1_CH00_ISR: is-reentrant=true, call-type=INTERRUPT, execution-context=INTERRUPT-CAT-1
    TAUJ1_CH00_CAT2_ISR: is-reentrant=true, call-type=INTERRUPT, execution-context=INTERRUPT-CAT-2
    TAUJ1_CH01_ISR: is-reentrant=true, call-type=INTERRUPT, execution-context=INTERRUPT-CAT-1
    TAUJ1_CH01_CAT2_ISR: is-reentrant=true, call-type=INTERRUPT, execution-context=INTERRUPT-CAT-2
    TAUJ1_CH02_ISR: is-reentrant=true, call-type=INTERRUPT, execution-context=INTERRUPT-CAT-1
    TAUJ1_CH02_CAT2_ISR: is-reentrant=true, call-type=INTERRUPT, execution-context=INTERRUPT-CAT-2
    TAUJ1_CH03_ISR: is-reentrant=true, call-type=INTERRUPT, execution-context=INTERRUPT-CAT-1
    TAUJ1_CH03_CAT2_ISR: is-reentrant=true, call-type=INTERRUPT, execution-context=INTERRUPT-CAT-2
    TAUJ2_CH00_ISR: is-reentrant=true, call-type=INTERRUPT, execution-context=INTERRUPT-CAT-1
    TAUJ2_CH00_CAT2_ISR: is-reentrant=true, call-type=INTERRUPT, execution-context=INTERRUPT-CAT-2
    TAUJ2_CH01_ISR: is-reentrant=true, call-type=INTERRUPT, execution-context=INTERRUPT-CAT-1
    TAUJ2_CH01_CAT2_ISR: is-reentrant=true, call-type=INTERRUPT, execution-context=INTERRUPT-CAT-2
    TAUJ2_CH02_ISR: is-reentrant=true, call-type=INTERRUPT, execution-context=INTERRUPT-CAT-1
    TAUJ2_CH02_CAT2_ISR: is-reentrant=true, call-type=INTERRUPT, execution-context=INTERRUPT-CAT-2
    TAUJ2_CH03_ISR: is-reentrant=true, call-type=INTERRUPT, execution-context=INTERRUPT-CAT-1
    TAUJ2_CH03_CAT2_ISR: is-reentrant=true, call-type=INTERRUPT, execution-context=INTERRUPT-CAT-2
    TAUJ3_CH00_ISR: is-reentrant=true, call-type=INTERRUPT, execution-context=INTERRUPT-CAT-1
    TAUJ3_CH00_CAT2_ISR: is-reentrant=true, call-type=INTERRUPT, execution-context=INTERRUPT-CAT-2
    TAUJ3_CH01_ISR: is-reentrant=true, call-type=INTERRUPT, execution-context=INTERRUPT-CAT-1
    TAUJ3_CH01_CAT2_ISR: is-reentrant=true, call-type=INTERRUPT, execution-context=INTERRUPT-CAT-2
    TAUJ3_CH02_ISR: is-reentrant=true, call-type=INTERRUPT, execution-context=INTERRUPT-CAT-1
    TAUJ3_CH02_CAT2_ISR: is-reentrant=true, call-type=INTERRUPT, execution-context=INTERRUPT-CAT-2
    TAUJ3_CH03_ISR: is-reentrant=true, call-type=INTERRUPT, execution-context=INTERRUPT-CAT-1
    TAUJ3_CH03_CAT2_ISR: is-reentrant=true, call-type=INTERRUPT, execution-context=INTERRUPT-CAT-2
    OSTM0_CH00_ISR: is-reentrant=true, call-type=INTERRUPT, execution-context=INTERRUPT-CAT-1
    OSTM0_CH00_CAT2_ISR: is-reentrant=true, call-type=INTERRUPT, execution-context=INTERRUPT-CAT-2
    OSTM5_CH00_ISR: is-reentrant=true, call-type=INTERRUPT, execution-context=INTERRUPT-CAT-1
    OSTM5_CH00_CAT2_ISR: is-reentrant=true, call-type=INTERRUPT, execution-context=INTERRUPT-CAT-2
    GPT_FEINT_ISR: is-reentrant=true, call-type=INTERRUPT, execution-context=INTERRUPT-CAT-1
    GPT_FEINT_CAT2_ISR: is-reentrant=true, call-type=INTERRUPT, execution-context=INTERRUPT-CAT-2
    Gpt_GetVersionInfo: service-id=0, is-reentrant=true, call-type=REGULAR, execution-context=TASK
    Gpt_Init: service-id=1, is-reentrant=false, call-type=REGULAR, execution-context=TASK
    Gpt_DeInit: service-id=2, is-reentrant=false, call-type=REGULAR, execution-context=TASK
    Gpt_GetTimeElapsed: service-id=3, is-reentrant=true, call-type=REGULAR, execution-context=TASK
    Gpt_GetTimeRemaining: service-id=4, is-reentrant=true, call-type=REGULAR, execution-context=TASK
    Gpt_StartTimer: service-id=5, is-reentrant=true, call-type=REGULAR, execution-context=TASK
    Gpt_StopTimer: service-id=6, is-reentrant=true, call-type=REGULAR, execution-context=TASK
    Gpt_EnableNotification: service-id=7, is-reentrant=true, call-type=REGULAR, execution-context=TASK
    Gpt_DisableNotification: service-id=8, is-reentrant=true, call-type=REGULAR, execution-context=TASK
    Gpt_SetMode: service-id=9, is-reentrant=false, call-type=REGULAR, execution-context=TASK
    Gpt_DisableWakeup: service-id=10, is-reentrant=true, call-type=REGULAR, execution-context=TASK
    Gpt_EnableWakeup: service-id=11, is-reentrant=true, call-type=REGULAR, execution-context=TASK
    Gpt_CheckWakeup: service-id=12, is-reentrant=true, call-type=REGULAR, execution-context=TASK
    Gpt_GetPredefTimerValue: service-id=13, is-reentrant=true, call-type=REGULAR, execution-context=TASK
    Gpt_HWCheckConsistency: service-id=14, is-reentrant=true, call-type=REGULAR, execution-context=TASK
