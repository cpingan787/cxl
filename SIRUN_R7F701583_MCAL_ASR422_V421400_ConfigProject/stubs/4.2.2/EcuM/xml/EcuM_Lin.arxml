AUTOSAR XML (schema 4-2-2)
package /AUTOSAR/EcucDefs_EcuM
  ecuc value collection ECUConfiguration: ecuc-values=EcuM0
  module config EcuM0: definition=EcuM, implementation-config-variant=VARIANT-POST-BUILD, module-description=EcuM
    EcuMConfiguration0 (EcuMConfiguration)
      EcuMCommonConfiguration0 (EcuMCommonConfiguration): EcuMConfigConsistencyHash=ba4f95fef4247daa, EcuMDefaultAppMode=OsAppMode, EcuMOSResource=OsResource
        EcuMDefaultShutdownTarget0 (EcuMDefaultShutdownTarget): EcuMDefaultState=EcuMStateReset, EcuMDefaultResetModeRef=, EcuMDefaultSleepModeRef=
        EcuMSleepMode0 (EcuMSleepMode): EcuMSleepModeId=0, EcuMSleepModeSuspend=1, EcuMSleepModeMcuModeRef=McuModeSettingConf, EcuMWakeupSourceMask=EcuMWakeupSource0
        EcuMWakeupSource0 (EcuMWakeupSource): EcuMValidationTimeout=0, EcuMWakeupSourceId=0, EcuMWakeupSourcePolling=1, EcuMComMChannelRef=ComMChannel, EcuMResetReasonRef=McuResetReasonConf
    EcuMGeneral0 (EcuMGeneral): EcuMDevErrorDetect=1, EcuMIncludeDem=1, EcuMIncludeDet=1, EcuMMainFunctionPeriod=0, EcuMVersionInfoApi=1
