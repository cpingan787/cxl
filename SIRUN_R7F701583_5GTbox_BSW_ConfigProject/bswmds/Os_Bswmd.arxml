AUTOSAR XML (schema 00048)
package /AUTOSAR/BswImplementations
  bsw implementation Imp_Os: programming-language=C, sw-version=3.0.0, ar-release-version=4.9.0, behavior=IB_Os
    resource consumption RC
      13 x memory section:
        CODE: sw-addrmethod=CODE
        CODE_FAST: sw-addrmethod=CODE_FAST
        CONST_UNSPECIFIED: sw-addrmethod=CONST
        CONFIG_DATA_UNSPECIFIED: sw-addrmethod=CONFIG_DATA
        VAR_CLONE_16: sw-addrmethod=VAR_CLONE
        VAR_CLONE_32: sw-addrmethod=VAR_CLONE
        VAR_CLONE_8: sw-addrmethod=VAR_CLONE
        VAR_CLONE_PTR: sw-addrmethod=VAR_CLONE
        VAR_CLONE_UNSPECIFIED: sw-addrmethod=VAR_CLONE
        VAR_CLEARED_CORE0_32: sw-addrmethod=VAR_CLEARED
        VAR_CLEARED_CORE0_UNSPECIFIED: sw-addrmethod=VAR_CLEARED
        VAR_CLEARED_GLOBAL_32: sw-addrmethod=VAR_CLEARED
        VAR_CLEARED_GLOBAL_UNSPECIFIED: sw-addrmethod=VAR_CLEARED
package /AUTOSAR/BswOverviews
  bsw module description Os
    bsw internal behavior IB_Os
