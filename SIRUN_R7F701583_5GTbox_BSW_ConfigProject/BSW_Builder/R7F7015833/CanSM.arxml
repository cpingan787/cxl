AUTOSAR XML (schema 00048)
package /R7F7015833
  module config CanSM
    CanSMGeneral:
      CanSMDevErrorDetect = true
      CanSMMainFunctionTimePeriod = 0.001
      CanSMPncSupport = false
      CanSMSetBaudrateApi = false
      CanSMTxOfflineActiveSupport = false
      CanSMVersionInfoApi = false
      CanSMMultipleControllerSupport = false
    CanSMConfiguration: CanSMModeRequestRepetitionMax=10, CanSMModeRequestRepetitionTime=0.01
      CanSMManagerNetwork_0 (CanSMManagerNetwork):
        CanSMBorCounterL1ToL2 = 10
        CanSMBorTimeL1 = 0.1
        CanSMBorTimeL2 = 1.0
        CanSMBorTimeTxEnsured = 0.01
        CanSMBorTxConfirmationPolling = false
        CanSMEnableBusOffDelay = false
        CanSMComMNetworkHandleRef = ComMChannel_0
        CanSMController_0 (CanSMController): CanSMControllerId=CANIF_CONTROLLER_0_IAM
        CanSMDemEventParameterRefs: CANSM_E_BUS_OFF=EventParameter_0xC07388
