AUTOSAR XML (schema 00048)
package /R7F7015833
  module config Dem
    DemConfigSet
      DTC_0x951171 (DemDTC): DemDtcValue=9769329, DemDTCSeverity=DEM_SEVERITY_NO_SEVERITY, DemDTCFunctionalUnit=255, DemDTCAttributesRef=DTCAttributes_0
      EventParameter_0x951171 (DemEventParameter):
        DemEventAvailable = true
        DemEventFailureCycleCounterThreshold = 0
        DemEventId = 1
        DemEventKind = DEM_EVENT_KIND_SWC
        DemFFPrestorageSupported = false
        DemOperationCycleRef = DEMPOWER
        DemDTCRef = DTC_0x951171
        DemDebounceAlgorithmClass
          DebounceCounterBased_0x951171 (DemDebounceCounterBased): DemDebounceCounterBasedClassRef=DebounceCounterBasedClass_0
        IndicatorAttribute_0x951171 (DemIndicatorAttribute): DemIndicatorBehaviour=DEM_INDICATOR_BLINKING, DemIndicatorHealingCycleCounterThreshold=0, DemIndicatorRef=Indicator_0
      DebounceCounterBasedClass_0 (DemDebounceCounterBasedClass):
        DemDebounceBehavior = DEM_DEBOUNCE_RESET
        DemDebounceCounterDecrementStepSize = 128
        DemDebounceCounterFailedThreshold = 127
        DemDebounceCounterIncrementStepSize = 13
        DemDebounceCounterJumpDown = false
        DemDebounceCounterJumpDownValue = 0
        DemDebounceCounterJumpUp = true
        DemDebounceCounterJumpUpValue = 0
        DemDebounceCounterPassedThreshold = -128
        DemDebounceCounterStorage = false
      DTCAttributes_0 (DemDTCAttributes):
        DemAgingAllowed = true
        DemDTCPriority = 0
        DemDTCSignificance = DEM_EVENT_SIGNIFICANCE_FAULT
        DemImmediateNvStorage = false
        DemAgingCycleCounterThreshold = 40
        DemMemoryDestinationRef = DemPrimaryMemory
        DemAgingCycleRef = DEMPOWER
        DemFreezeFrameClassRef = FreezeFrameClass_ENVDATA_ALLDTCS
        DemExtendedDataClassRef = ExtendedDataClass_DTCExtendedDataRecordNumber
        DemFreezeFrameRecNumClassRef = FreezeFrameRecNumClass_DTCSnapshotRecordNumber_Base_Variant_Data_Object
      DTC_0x951512 (DemDTC): DemDtcValue=9770258, DemDTCSeverity=DEM_SEVERITY_NO_SEVERITY, DemDTCFunctionalUnit=255, DemDTCAttributesRef=DTCAttributes_0
      EventParameter_0x951512 (DemEventParameter):
        DemEventAvailable = true
        DemEventFailureCycleCounterThreshold = 0
        DemEventId = 2
        DemEventKind = DEM_EVENT_KIND_SWC
        DemFFPrestorageSupported = false
        DemOperationCycleRef = DEMPOWER
        DemDTCRef = DTC_0x951512
        DemDebounceAlgorithmClass
          DebounceCounterBased_0x951512 (DemDebounceCounterBased): DemDebounceCounterBasedClassRef=DebounceCounterBasedClass_0
        IndicatorAttribute_0x951512 (DemIndicatorAttribute): DemIndicatorBehaviour=DEM_INDICATOR_BLINKING, DemIndicatorHealingCycleCounterThreshold=0, DemIndicatorRef=Indicator_0
      DTC_0x952111 (DemDTC): DemDtcValue=9773329, DemDTCSeverity=DEM_SEVERITY_NO_SEVERITY, DemDTCFunctionalUnit=255, DemDTCAttributesRef=DTCAttributes_0
      EventParameter_0x952111 (DemEventParameter):
        DemEventAvailable = true
        DemEventFailureCycleCounterThreshold = 0
        DemEventId = 3
        DemEventKind = DEM_EVENT_KIND_SWC
        DemFFPrestorageSupported = false
        DemOperationCycleRef = DEMPOWER
        DemDTCRef = DTC_0x952111
        DemDebounceAlgorithmClass
          DebounceCounterBased_0x952111 (DemDebounceCounterBased): DemDebounceCounterBasedClassRef=DebounceCounterBasedClass_0
        IndicatorAttribute_0x952111 (DemIndicatorAttribute): DemIndicatorBehaviour=DEM_INDICATOR_BLINKING, DemIndicatorHealingCycleCounterThreshold=0, DemIndicatorRef=Indicator_0
      DTC_0x952113 (DemDTC): DemDtcValue=9773331, DemDTCSeverity=DEM_SEVERITY_NO_SEVERITY, DemDTCFunctionalUnit=255, DemDTCAttributesRef=DTCAttributes_0
      EventParameter_0x952113 (DemEventParameter):
        DemEventAvailable = true
        DemEventFailureCycleCounterThreshold = 0
        DemEventId = 4
        DemEventKind = DEM_EVENT_KIND_SWC
        DemFFPrestorageSupported = false
        DemOperationCycleRef = DEMPOWER
        DemDTCRef = DTC_0x952113
        DemDebounceAlgorithmClass
          DebounceCounterBased_0x952113 (DemDebounceCounterBased): DemDebounceCounterBasedClassRef=DebounceCounterBasedClass_0
        IndicatorAttribute_0x952113 (DemIndicatorAttribute): DemIndicatorBehaviour=DEM_INDICATOR_BLINKING, DemIndicatorHealingCycleCounterThreshold=0, DemIndicatorRef=Indicator_0
      DTC_0x953111 (DemDTC): DemDtcValue=9777425, DemDTCSeverity=DEM_SEVERITY_NO_SEVERITY, DemDTCFunctionalUnit=255, DemDTCAttributesRef=DTCAttributes_0
      EventParameter_0x953111 (DemEventParameter):
        DemEventAvailable = true
        DemEventFailureCycleCounterThreshold = 0
        DemEventId = 5
        DemEventKind = DEM_EVENT_KIND_SWC
        DemFFPrestorageSupported = false
        DemOperationCycleRef = DEMPOWER
        DemDTCRef = DTC_0x953111
        DemDebounceAlgorithmClass
          DebounceCounterBased_0x953111 (DemDebounceCounterBased): DemDebounceCounterBasedClassRef=DebounceCounterBasedClass_0
        IndicatorAttribute_0x953111 (DemIndicatorAttribute): DemIndicatorBehaviour=DEM_INDICATOR_BLINKING, DemIndicatorHealingCycleCounterThreshold=0, DemIndicatorRef=Indicator_0
      DTC_0x953113 (DemDTC): DemDtcValue=9777427, DemDTCSeverity=DEM_SEVERITY_NO_SEVERITY, DemDTCFunctionalUnit=255, DemDTCAttributesRef=DTCAttributes_0
      EventParameter_0x953113 (DemEventParameter):
        DemEventAvailable = true
        DemEventFailureCycleCounterThreshold = 0
        DemEventId = 6
        DemEventKind = DEM_EVENT_KIND_SWC
        DemFFPrestorageSupported = false
        DemOperationCycleRef = DEMPOWER
        DemDTCRef = DTC_0x953113
        DemDebounceAlgorithmClass
          DebounceCounterBased_0x953113 (DemDebounceCounterBased): DemDebounceCounterBasedClassRef=DebounceCounterBasedClass_0
        IndicatorAttribute_0x953113 (DemIndicatorAttribute): DemIndicatorBehaviour=DEM_INDICATOR_BLINKING, DemIndicatorHealingCycleCounterThreshold=0, DemIndicatorRef=Indicator_0
      DTC_0x953311 (DemDTC): DemDtcValue=9777937, DemDTCSeverity=DEM_SEVERITY_NO_SEVERITY, DemDTCFunctionalUnit=255, DemDTCAttributesRef=DTCAttributes_0
      EventParameter_0x953311 (DemEventParameter):
        DemEventAvailable = true
        DemEventFailureCycleCounterThreshold = 0
        DemEventId = 7
        DemEventKind = DEM_EVENT_KIND_SWC
        DemFFPrestorageSupported = false
        DemOperationCycleRef = DEMPOWER
        DemDTCRef = DTC_0x953311
        DemDebounceAlgorithmClass
          DebounceCounterBased_0x953311 (DemDebounceCounterBased): DemDebounceCounterBasedClassRef=DebounceCounterBasedClass_0
        IndicatorAttribute_0x953311 (DemIndicatorAttribute): DemIndicatorBehaviour=DEM_INDICATOR_BLINKING, DemIndicatorHealingCycleCounterThreshold=0, DemIndicatorRef=Indicator_0
      DTC_0x953312 (DemDTC): DemDtcValue=9777938, DemDTCSeverity=DEM_SEVERITY_NO_SEVERITY, DemDTCFunctionalUnit=255, DemDTCAttributesRef=DTCAttributes_0
      EventParameter_0x953312 (DemEventParameter):
        DemEventAvailable = true
        DemEventFailureCycleCounterThreshold = 0
        DemEventId = 8
        DemEventKind = DEM_EVENT_KIND_SWC
        DemFFPrestorageSupported = false
        DemOperationCycleRef = DEMPOWER
        DemDTCRef = DTC_0x953312
        DemDebounceAlgorithmClass
          DebounceCounterBased_0x953312 (DemDebounceCounterBased): DemDebounceCounterBasedClassRef=DebounceCounterBasedClass_0
        IndicatorAttribute_0x953312 (DemIndicatorAttribute): DemIndicatorBehaviour=DEM_INDICATOR_BLINKING, DemIndicatorHealingCycleCounterThreshold=0, DemIndicatorRef=Indicator_0
      DTC_0x953313 (DemDTC): DemDtcValue=9777939, DemDTCSeverity=DEM_SEVERITY_NO_SEVERITY, DemDTCFunctionalUnit=255, DemDTCAttributesRef=DTCAttributes_0
      EventParameter_0x953313 (DemEventParameter):
        DemEventAvailable = true
        DemEventFailureCycleCounterThreshold = 0
        DemEventId = 9
        DemEventKind = DEM_EVENT_KIND_SWC
        DemFFPrestorageSupported = false
        DemOperationCycleRef = DEMPOWER
        DemDTCRef = DTC_0x953313
        DemDebounceAlgorithmClass
          DebounceCounterBased_0x953313 (DemDebounceCounterBased): DemDebounceCounterBasedClassRef=DebounceCounterBasedClass_0
        IndicatorAttribute_0x953313 (DemIndicatorAttribute): DemIndicatorBehaviour=DEM_INDICATOR_BLINKING, DemIndicatorHealingCycleCounterThreshold=0, DemIndicatorRef=Indicator_0
      DTC_0x953411 (DemDTC): DemDtcValue=9778193, DemDTCSeverity=DEM_SEVERITY_NO_SEVERITY, DemDTCFunctionalUnit=255, DemDTCAttributesRef=DTCAttributes_0
      EventParameter_0x953411 (DemEventParameter):
        DemEventAvailable = true
        DemEventFailureCycleCounterThreshold = 0
        DemEventId = 10
        DemEventKind = DEM_EVENT_KIND_SWC
        DemFFPrestorageSupported = false
        DemOperationCycleRef = DEMPOWER
        DemDTCRef = DTC_0x953411
        DemDebounceAlgorithmClass
          DebounceCounterBased_0x953411 (DemDebounceCounterBased): DemDebounceCounterBasedClassRef=DebounceCounterBasedClass_0
        IndicatorAttribute_0x953411 (DemIndicatorAttribute): DemIndicatorBehaviour=DEM_INDICATOR_BLINKING, DemIndicatorHealingCycleCounterThreshold=0, DemIndicatorRef=Indicator_0
      DTC_0x953412 (DemDTC): DemDtcValue=9778194, DemDTCSeverity=DEM_SEVERITY_NO_SEVERITY, DemDTCFunctionalUnit=255, DemDTCAttributesRef=DTCAttributes_0
      EventParameter_0x953412 (DemEventParameter):
        DemEventAvailable = true
        DemEventFailureCycleCounterThreshold = 0
        DemEventId = 11
        DemEventKind = DEM_EVENT_KIND_SWC
        DemFFPrestorageSupported = false
        DemOperationCycleRef = DEMPOWER
        DemDTCRef = DTC_0x953412
        DemDebounceAlgorithmClass
          DebounceCounterBased_0x953412 (DemDebounceCounterBased): DemDebounceCounterBasedClassRef=DebounceCounterBasedClass_0
        IndicatorAttribute_0x953412 (DemIndicatorAttribute): DemIndicatorBehaviour=DEM_INDICATOR_BLINKING, DemIndicatorHealingCycleCounterThreshold=0, DemIndicatorRef=Indicator_0
      DTC_0x953413 (DemDTC): DemDtcValue=9778195, DemDTCSeverity=DEM_SEVERITY_NO_SEVERITY, DemDTCFunctionalUnit=255, DemDTCAttributesRef=DTCAttributes_0
      EventParameter_0x953413 (DemEventParameter):
        DemEventAvailable = true
        DemEventFailureCycleCounterThreshold = 0
        DemEventId = 12
        DemEventKind = DEM_EVENT_KIND_SWC
        DemFFPrestorageSupported = false
        DemOperationCycleRef = DEMPOWER
        DemDTCRef = DTC_0x953413
        DemDebounceAlgorithmClass
          DebounceCounterBased_0x953413 (DemDebounceCounterBased): DemDebounceCounterBasedClassRef=DebounceCounterBasedClass_0
        IndicatorAttribute_0x953413 (DemIndicatorAttribute): DemIndicatorBehaviour=DEM_INDICATOR_BLINKING, DemIndicatorHealingCycleCounterThreshold=0, DemIndicatorRef=Indicator_0
      DTC_0x953512 (DemDTC): DemDtcValue=9778450, DemDTCSeverity=DEM_SEVERITY_NO_SEVERITY, DemDTCFunctionalUnit=255, DemDTCAttributesRef=DTCAttributes_0
      EventParameter_0x953512 (DemEventParameter):
        DemEventAvailable = true
        DemEventFailureCycleCounterThreshold = 0
        DemEventId = 13
        DemEventKind = DEM_EVENT_KIND_SWC
        DemFFPrestorageSupported = false
        DemOperationCycleRef = DEMPOWER
        DemDTCRef = DTC_0x953512
        DemDebounceAlgorithmClass
          DebounceCounterBased_0x953512 (DemDebounceCounterBased): DemDebounceCounterBasedClassRef=DebounceCounterBasedClass_0
        IndicatorAttribute_0x953512 (DemIndicatorAttribute): DemIndicatorBehaviour=DEM_INDICATOR_BLINKING, DemIndicatorHealingCycleCounterThreshold=0, DemIndicatorRef=Indicator_0
      DTC_0x954100 (DemDTC): DemDtcValue=9781504, DemDTCSeverity=DEM_SEVERITY_NO_SEVERITY, DemDTCFunctionalUnit=255, DemDTCAttributesRef=DTCAttributes_0
      EventParameter_0x954100 (DemEventParameter):
        DemEventAvailable = true
        DemEventFailureCycleCounterThreshold = 0
        DemEventId = 14
        DemEventKind = DEM_EVENT_KIND_SWC
        DemFFPrestorageSupported = false
        DemOperationCycleRef = DEMPOWER
        DemDTCRef = DTC_0x954100
        DemDebounceAlgorithmClass
          DebounceCounterBased_0x954100 (DemDebounceCounterBased): DemDebounceCounterBasedClassRef=DebounceCounterBasedClass_0
        IndicatorAttribute_0x954100 (DemIndicatorAttribute): DemIndicatorBehaviour=DEM_INDICATOR_BLINKING, DemIndicatorHealingCycleCounterThreshold=0, DemIndicatorRef=Indicator_0
      DTC_0x954200 (DemDTC): DemDtcValue=9781760, DemDTCSeverity=DEM_SEVERITY_NO_SEVERITY, DemDTCFunctionalUnit=255, DemDTCAttributesRef=DTCAttributes_0
      EventParameter_0x954200 (DemEventParameter):
        DemEventAvailable = true
        DemEventFailureCycleCounterThreshold = 0
        DemEventId = 15
        DemEventKind = DEM_EVENT_KIND_SWC
        DemFFPrestorageSupported = false
        DemOperationCycleRef = DEMPOWER
        DemDTCRef = DTC_0x954200
        DemDebounceAlgorithmClass
          DebounceCounterBased_0x954200 (DemDebounceCounterBased): DemDebounceCounterBasedClassRef=DebounceCounterBasedClass_0
        IndicatorAttribute_0x954200 (DemIndicatorAttribute): DemIndicatorBehaviour=DEM_INDICATOR_BLINKING, DemIndicatorHealingCycleCounterThreshold=0, DemIndicatorRef=Indicator_0
      DTC_0x955011 (DemDTC): DemDtcValue=9785361, DemDTCSeverity=DEM_SEVERITY_NO_SEVERITY, DemDTCFunctionalUnit=255, DemDTCAttributesRef=DTCAttributes_0
      EventParameter_0x955011 (DemEventParameter):
        DemEventAvailable = true
        DemEventFailureCycleCounterThreshold = 0
        DemEventId = 16
        DemEventKind = DEM_EVENT_KIND_SWC
        DemFFPrestorageSupported = false
        DemOperationCycleRef = DEMPOWER
        DemDTCRef = DTC_0x955011
        DemDebounceAlgorithmClass
          DebounceCounterBased_0x955011 (DemDebounceCounterBased): DemDebounceCounterBasedClassRef=DebounceCounterBasedClass_0
        IndicatorAttribute_0x955011 (DemIndicatorAttribute): DemIndicatorBehaviour=DEM_INDICATOR_BLINKING, DemIndicatorHealingCycleCounterThreshold=0, DemIndicatorRef=Indicator_0
      DTC_0x955013 (DemDTC): DemDtcValue=9785363, DemDTCSeverity=DEM_SEVERITY_NO_SEVERITY, DemDTCFunctionalUnit=255, DemDTCAttributesRef=DTCAttributes_0
      EventParameter_0x955013 (DemEventParameter):
        DemEventAvailable = true
        DemEventFailureCycleCounterThreshold = 0
        DemEventId = 17
        DemEventKind = DEM_EVENT_KIND_SWC
        DemFFPrestorageSupported = false
        DemOperationCycleRef = DEMPOWER
        DemDTCRef = DTC_0x955013
        DemDebounceAlgorithmClass
          DebounceCounterBased_0x955013 (DemDebounceCounterBased): DemDebounceCounterBasedClassRef=DebounceCounterBasedClass_0
        IndicatorAttribute_0x955013 (DemIndicatorAttribute): DemIndicatorBehaviour=DEM_INDICATOR_BLINKING, DemIndicatorHealingCycleCounterThreshold=0, DemIndicatorRef=Indicator_0
      DTC_0x955016 (DemDTC): DemDtcValue=9785366, DemDTCSeverity=DEM_SEVERITY_NO_SEVERITY, DemDTCFunctionalUnit=255, DemDTCAttributesRef=DTCAttributes_0
      EventParameter_0x955016 (DemEventParameter):
        DemEventAvailable = true
        DemEventFailureCycleCounterThreshold = 0
        DemEventId = 18
        DemEventKind = DEM_EVENT_KIND_SWC
        DemFFPrestorageSupported = false
        DemOperationCycleRef = DEMPOWER
        DemDTCRef = DTC_0x955016
        DemDebounceAlgorithmClass
          DebounceCounterBased_0x955016 (DemDebounceCounterBased): DemDebounceCounterBasedClassRef=DebounceCounterBasedClass_0
        IndicatorAttribute_0x955016 (DemIndicatorAttribute): DemIndicatorBehaviour=DEM_INDICATOR_BLINKING, DemIndicatorHealingCycleCounterThreshold=0, DemIndicatorRef=Indicator_0
      DTC_0x955017 (DemDTC): DemDtcValue=9785367, DemDTCSeverity=DEM_SEVERITY_NO_SEVERITY, DemDTCFunctionalUnit=255, DemDTCAttributesRef=DTCAttributes_0
      EventParameter_0x955017 (DemEventParameter):
        DemEventAvailable = true
        DemEventFailureCycleCounterThreshold = 0
        DemEventId = 19
        DemEventKind = DEM_EVENT_KIND_SWC
        DemFFPrestorageSupported = false
        DemOperationCycleRef = DEMPOWER
        DemDTCRef = DTC_0x955017
        DemDebounceAlgorithmClass
          DebounceCounterBased_0x955017 (DemDebounceCounterBased): DemDebounceCounterBasedClassRef=DebounceCounterBasedClass_0
        IndicatorAttribute_0x955017 (DemIndicatorAttribute): DemIndicatorBehaviour=DEM_INDICATOR_BLINKING, DemIndicatorHealingCycleCounterThreshold=0, DemIndicatorRef=Indicator_0
      DTC_0x955201 (DemDTC): DemDtcValue=9785857, DemDTCSeverity=DEM_SEVERITY_NO_SEVERITY, DemDTCFunctionalUnit=255, DemDTCAttributesRef=DTCAttributes_0
      EventParameter_0x955201 (DemEventParameter):
        DemEventAvailable = true
        DemEventFailureCycleCounterThreshold = 0
        DemEventId = 20
        DemEventKind = DEM_EVENT_KIND_SWC
        DemFFPrestorageSupported = false
        DemOperationCycleRef = DEMPOWER
        DemDTCRef = DTC_0x955201
        DemDebounceAlgorithmClass
          DebounceCounterBased_0x955201 (DemDebounceCounterBased): DemDebounceCounterBasedClassRef=DebounceCounterBasedClass_0
        IndicatorAttribute_0x955201 (DemIndicatorAttribute): DemIndicatorBehaviour=DEM_INDICATOR_BLINKING, DemIndicatorHealingCycleCounterThreshold=0, DemIndicatorRef=Indicator_0
      DTC_0x957111 (DemDTC): DemDtcValue=9793809, DemDTCSeverity=DEM_SEVERITY_NO_SEVERITY, DemDTCFunctionalUnit=255, DemDTCAttributesRef=DTCAttributes_0
      EventParameter_0x957111 (DemEventParameter):
        DemEventAvailable = true
        DemEventFailureCycleCounterThreshold = 0
        DemEventId = 21
        DemEventKind = DEM_EVENT_KIND_SWC
        DemFFPrestorageSupported = false
        DemOperationCycleRef = DEMPOWER
        DemDTCRef = DTC_0x957111
        DemDebounceAlgorithmClass
          DebounceCounterBased_0x957111 (DemDebounceCounterBased): DemDebounceCounterBasedClassRef=DebounceCounterBasedClass_0
        IndicatorAttribute_0x957111 (DemIndicatorAttribute): DemIndicatorBehaviour=DEM_INDICATOR_BLINKING, DemIndicatorHealingCycleCounterThreshold=0, DemIndicatorRef=Indicator_0
      DTC_0x957113 (DemDTC): DemDtcValue=9793811, DemDTCSeverity=DEM_SEVERITY_NO_SEVERITY, DemDTCFunctionalUnit=255, DemDTCAttributesRef=DTCAttributes_0
      EventParameter_0x957113 (DemEventParameter):
        DemEventAvailable = true
        DemEventFailureCycleCounterThreshold = 0
        DemEventId = 22
        DemEventKind = DEM_EVENT_KIND_SWC
        DemFFPrestorageSupported = false
        DemOperationCycleRef = DEMPOWER
        DemDTCRef = DTC_0x957113
        DemDebounceAlgorithmClass
          DebounceCounterBased_0x957113 (DemDebounceCounterBased): DemDebounceCounterBasedClassRef=DebounceCounterBasedClass_0
        IndicatorAttribute_0x957113 (DemIndicatorAttribute): DemIndicatorBehaviour=DEM_INDICATOR_BLINKING, DemIndicatorHealingCycleCounterThreshold=0, DemIndicatorRef=Indicator_0
      DTC_0x95A011 (DemDTC): DemDtcValue=9805841, DemDTCSeverity=DEM_SEVERITY_NO_SEVERITY, DemDTCFunctionalUnit=255, DemDTCAttributesRef=DTCAttributes_0
      EventParameter_0x95A011 (DemEventParameter):
        DemEventAvailable = true
        DemEventFailureCycleCounterThreshold = 0
        DemEventId = 23
        DemEventKind = DEM_EVENT_KIND_SWC
        DemFFPrestorageSupported = false
        DemOperationCycleRef = DEMPOWER
        DemDTCRef = DTC_0x95A011
        DemDebounceAlgorithmClass
          DebounceCounterBased_0x95A011 (DemDebounceCounterBased): DemDebounceCounterBasedClassRef=DebounceCounterBasedClass_0
        IndicatorAttribute_0x95A011 (DemIndicatorAttribute): DemIndicatorBehaviour=DEM_INDICATOR_BLINKING, DemIndicatorHealingCycleCounterThreshold=0, DemIndicatorRef=Indicator_0
      DTC_0x95A013 (DemDTC): DemDtcValue=9805843, DemDTCSeverity=DEM_SEVERITY_NO_SEVERITY, DemDTCFunctionalUnit=255, DemDTCAttributesRef=DTCAttributes_0
      EventParameter_0x95A013 (DemEventParameter):
        DemEventAvailable = true
        DemEventFailureCycleCounterThreshold = 0
        DemEventId = 24
        DemEventKind = DEM_EVENT_KIND_SWC
        DemFFPrestorageSupported = false
        DemOperationCycleRef = DEMPOWER
        DemDTCRef = DTC_0x95A013
        DemDebounceAlgorithmClass
          DebounceCounterBased_0x95A013 (DemDebounceCounterBased): DemDebounceCounterBasedClassRef=DebounceCounterBasedClass_0
        IndicatorAttribute_0x95A013 (DemIndicatorAttribute): DemIndicatorBehaviour=DEM_INDICATOR_BLINKING, DemIndicatorHealingCycleCounterThreshold=0, DemIndicatorRef=Indicator_0
      DTC_0x95A111 (DemDTC): DemDtcValue=9806097, DemDTCSeverity=DEM_SEVERITY_NO_SEVERITY, DemDTCFunctionalUnit=255, DemDTCAttributesRef=DTCAttributes_0
      EventParameter_0x95A111 (DemEventParameter):
        DemEventAvailable = true
        DemEventFailureCycleCounterThreshold = 0
        DemEventId = 25
        DemEventKind = DEM_EVENT_KIND_SWC
        DemFFPrestorageSupported = false
        DemOperationCycleRef = DEMPOWER
        DemDTCRef = DTC_0x95A111
        DemDebounceAlgorithmClass
          DebounceCounterBased_0x95A111 (DemDebounceCounterBased): DemDebounceCounterBasedClassRef=DebounceCounterBasedClass_0
        IndicatorAttribute_0x95A111 (DemIndicatorAttribute): DemIndicatorBehaviour=DEM_INDICATOR_BLINKING, DemIndicatorHealingCycleCounterThreshold=0, DemIndicatorRef=Indicator_0
      DTC_0x95A113 (DemDTC): DemDtcValue=9806099, DemDTCSeverity=DEM_SEVERITY_NO_SEVERITY, DemDTCFunctionalUnit=255, DemDTCAttributesRef=DTCAttributes_0
      EventParameter_0x95A113 (DemEventParameter):
        DemEventAvailable = true
        DemEventFailureCycleCounterThreshold = 0
        DemEventId = 26
        DemEventKind = DEM_EVENT_KIND_SWC
        DemFFPrestorageSupported = false
        DemOperationCycleRef = DEMPOWER
        DemDTCRef = DTC_0x95A113
        DemDebounceAlgorithmClass
          DebounceCounterBased_0x95A113 (DemDebounceCounterBased): DemDebounceCounterBasedClassRef=DebounceCounterBasedClass_0
        IndicatorAttribute_0x95A113 (DemIndicatorAttribute): DemIndicatorBehaviour=DEM_INDICATOR_BLINKING, DemIndicatorHealingCycleCounterThreshold=0, DemIndicatorRef=Indicator_0
      DTC_0x95A211 (DemDTC): DemDtcValue=9806353, DemDTCSeverity=DEM_SEVERITY_NO_SEVERITY, DemDTCFunctionalUnit=255, DemDTCAttributesRef=DTCAttributes_0
      EventParameter_0x95A211 (DemEventParameter):
        DemEventAvailable = true
        DemEventFailureCycleCounterThreshold = 0
        DemEventId = 27
        DemEventKind = DEM_EVENT_KIND_SWC
        DemFFPrestorageSupported = false
        DemOperationCycleRef = DEMPOWER
        DemDTCRef = DTC_0x95A211
        DemDebounceAlgorithmClass
          DebounceCounterBased_0x95A211 (DemDebounceCounterBased): DemDebounceCounterBasedClassRef=DebounceCounterBasedClass_0
        IndicatorAttribute_0x95A211 (DemIndicatorAttribute): DemIndicatorBehaviour=DEM_INDICATOR_BLINKING, DemIndicatorHealingCycleCounterThreshold=0, DemIndicatorRef=Indicator_0
      DTC_0x95A213 (DemDTC): DemDtcValue=9806355, DemDTCSeverity=DEM_SEVERITY_NO_SEVERITY, DemDTCFunctionalUnit=255, DemDTCAttributesRef=DTCAttributes_0
      EventParameter_0x95A213 (DemEventParameter):
        DemEventAvailable = true
        DemEventFailureCycleCounterThreshold = 0
        DemEventId = 28
        DemEventKind = DEM_EVENT_KIND_SWC
        DemFFPrestorageSupported = false
        DemOperationCycleRef = DEMPOWER
        DemDTCRef = DTC_0x95A213
        DemDebounceAlgorithmClass
          DebounceCounterBased_0x95A213 (DemDebounceCounterBased): DemDebounceCounterBasedClassRef=DebounceCounterBasedClass_0
        IndicatorAttribute_0x95A213 (DemIndicatorAttribute): DemIndicatorBehaviour=DEM_INDICATOR_BLINKING, DemIndicatorHealingCycleCounterThreshold=0, DemIndicatorRef=Indicator_0
      DTC_0x95A311 (DemDTC): DemDtcValue=9806609, DemDTCSeverity=DEM_SEVERITY_NO_SEVERITY, DemDTCFunctionalUnit=255, DemDTCAttributesRef=DTCAttributes_0
      EventParameter_0x95A311 (DemEventParameter):
        DemEventAvailable = true
        DemEventFailureCycleCounterThreshold = 0
        DemEventId = 29
        DemEventKind = DEM_EVENT_KIND_SWC
        DemFFPrestorageSupported = false
        DemOperationCycleRef = DEMPOWER
        DemDTCRef = DTC_0x95A311
        DemDebounceAlgorithmClass
          DebounceCounterBased_0x95A311 (DemDebounceCounterBased): DemDebounceCounterBasedClassRef=DebounceCounterBasedClass_0
        IndicatorAttribute_0x95A311 (DemIndicatorAttribute): DemIndicatorBehaviour=DEM_INDICATOR_BLINKING, DemIndicatorHealingCycleCounterThreshold=0, DemIndicatorRef=Indicator_0
      DTC_0x95A313 (DemDTC): DemDtcValue=9806611, DemDTCSeverity=DEM_SEVERITY_NO_SEVERITY, DemDTCFunctionalUnit=255, DemDTCAttributesRef=DTCAttributes_0
      EventParameter_0x95A313 (DemEventParameter):
        DemEventAvailable = true
        DemEventFailureCycleCounterThreshold = 0
        DemEventId = 30
        DemEventKind = DEM_EVENT_KIND_SWC
        DemFFPrestorageSupported = false
        DemOperationCycleRef = DEMPOWER
        DemDTCRef = DTC_0x95A313
        DemDebounceAlgorithmClass
          DebounceCounterBased_0x95A313 (DemDebounceCounterBased): DemDebounceCounterBasedClassRef=DebounceCounterBasedClass_0
        IndicatorAttribute_0x95A313 (DemIndicatorAttribute): DemIndicatorBehaviour=DEM_INDICATOR_BLINKING, DemIndicatorHealingCycleCounterThreshold=0, DemIndicatorRef=Indicator_0
      DTC_0x95A411 (DemDTC): DemDtcValue=9806865, DemDTCSeverity=DEM_SEVERITY_NO_SEVERITY, DemDTCFunctionalUnit=255, DemDTCAttributesRef=DTCAttributes_0
      EventParameter_0x95A411 (DemEventParameter):
        DemEventAvailable = true
        DemEventFailureCycleCounterThreshold = 0
        DemEventId = 31
        DemEventKind = DEM_EVENT_KIND_SWC
        DemFFPrestorageSupported = false
        DemOperationCycleRef = DEMPOWER
        DemDTCRef = DTC_0x95A411
        DemDebounceAlgorithmClass
          DebounceCounterBased_0x95A411 (DemDebounceCounterBased): DemDebounceCounterBasedClassRef=DebounceCounterBasedClass_0
        IndicatorAttribute_0x95A411 (DemIndicatorAttribute): DemIndicatorBehaviour=DEM_INDICATOR_BLINKING, DemIndicatorHealingCycleCounterThreshold=0, DemIndicatorRef=Indicator_0
      DTC_0x95A413 (DemDTC): DemDtcValue=9806867, DemDTCSeverity=DEM_SEVERITY_NO_SEVERITY, DemDTCFunctionalUnit=255, DemDTCAttributesRef=DTCAttributes_0
      EventParameter_0x95A413 (DemEventParameter):
        DemEventAvailable = true
        DemEventFailureCycleCounterThreshold = 0
        DemEventId = 32
        DemEventKind = DEM_EVENT_KIND_SWC
        DemFFPrestorageSupported = false
        DemOperationCycleRef = DEMPOWER
        DemDTCRef = DTC_0x95A413
        DemDebounceAlgorithmClass
          DebounceCounterBased_0x95A413 (DemDebounceCounterBased): DemDebounceCounterBasedClassRef=DebounceCounterBasedClass_0
        IndicatorAttribute_0x95A413 (DemIndicatorAttribute): DemIndicatorBehaviour=DEM_INDICATOR_BLINKING, DemIndicatorHealingCycleCounterThreshold=0, DemIndicatorRef=Indicator_0
      DTC_0x95A511 (DemDTC): DemDtcValue=9807121, DemDTCSeverity=DEM_SEVERITY_NO_SEVERITY, DemDTCFunctionalUnit=255, DemDTCAttributesRef=DTCAttributes_0
      EventParameter_0x95A511 (DemEventParameter):
        DemEventAvailable = true
        DemEventFailureCycleCounterThreshold = 0
        DemEventId = 33
        DemEventKind = DEM_EVENT_KIND_SWC
        DemFFPrestorageSupported = false
        DemOperationCycleRef = DEMPOWER
        DemDTCRef = DTC_0x95A511
        DemDebounceAlgorithmClass
          DebounceCounterBased_0x95A511 (DemDebounceCounterBased): DemDebounceCounterBasedClassRef=DebounceCounterBasedClass_0
        IndicatorAttribute_0x95A511 (DemIndicatorAttribute): DemIndicatorBehaviour=DEM_INDICATOR_BLINKING, DemIndicatorHealingCycleCounterThreshold=0, DemIndicatorRef=Indicator_0
      DTC_0x95A513 (DemDTC): DemDtcValue=9807123, DemDTCSeverity=DEM_SEVERITY_NO_SEVERITY, DemDTCFunctionalUnit=255, DemDTCAttributesRef=DTCAttributes_0
      EventParameter_0x95A513 (DemEventParameter):
        DemEventAvailable = true
        DemEventFailureCycleCounterThreshold = 0
        DemEventId = 34
        DemEventKind = DEM_EVENT_KIND_SWC
        DemFFPrestorageSupported = false
        DemOperationCycleRef = DEMPOWER
        DemDTCRef = DTC_0x95A513
        DemDebounceAlgorithmClass
          DebounceCounterBased_0x95A513 (DemDebounceCounterBased): DemDebounceCounterBasedClassRef=DebounceCounterBasedClass_0
        IndicatorAttribute_0x95A513 (DemIndicatorAttribute): DemIndicatorBehaviour=DEM_INDICATOR_BLINKING, DemIndicatorHealingCycleCounterThreshold=0, DemIndicatorRef=Indicator_0
      DTC_0x95A711 (DemDTC): DemDtcValue=9807633, DemDTCSeverity=DEM_SEVERITY_NO_SEVERITY, DemDTCFunctionalUnit=255, DemDTCAttributesRef=DTCAttributes_0
      EventParameter_0x95A711 (DemEventParameter):
        DemEventAvailable = true
        DemEventFailureCycleCounterThreshold = 0
        DemEventId = 35
        DemEventKind = DEM_EVENT_KIND_SWC
        DemFFPrestorageSupported = false
        DemOperationCycleRef = DEMPOWER
        DemDTCRef = DTC_0x95A711
        DemDebounceAlgorithmClass
          DebounceCounterBased_0x95A711 (DemDebounceCounterBased): DemDebounceCounterBasedClassRef=DebounceCounterBasedClass_0
        IndicatorAttribute_0x95A711 (DemIndicatorAttribute): DemIndicatorBehaviour=DEM_INDICATOR_BLINKING, DemIndicatorHealingCycleCounterThreshold=0, DemIndicatorRef=Indicator_0
      DTC_0x95A713 (DemDTC): DemDtcValue=9807635, DemDTCSeverity=DEM_SEVERITY_NO_SEVERITY, DemDTCFunctionalUnit=255, DemDTCAttributesRef=DTCAttributes_0
      EventParameter_0x95A713 (DemEventParameter):
        DemEventAvailable = true
        DemEventFailureCycleCounterThreshold = 0
        DemEventId = 36
        DemEventKind = DEM_EVENT_KIND_SWC
        DemFFPrestorageSupported = false
        DemOperationCycleRef = DEMPOWER
        DemDTCRef = DTC_0x95A713
        DemDebounceAlgorithmClass
          DebounceCounterBased_0x95A713 (DemDebounceCounterBased): DemDebounceCounterBasedClassRef=DebounceCounterBasedClass_0
        IndicatorAttribute_0x95A713 (DemIndicatorAttribute): DemIndicatorBehaviour=DEM_INDICATOR_BLINKING, DemIndicatorHealingCycleCounterThreshold=0, DemIndicatorRef=Indicator_0
      DTC_0x95A809 (DemDTC): DemDtcValue=9807881, DemDTCSeverity=DEM_SEVERITY_NO_SEVERITY, DemDTCFunctionalUnit=255, DemDTCAttributesRef=DTCAttributes_0
      EventParameter_0x95A809 (DemEventParameter):
        DemEventAvailable = true
        DemEventFailureCycleCounterThreshold = 0
        DemEventId = 37
        DemEventKind = DEM_EVENT_KIND_SWC
        DemFFPrestorageSupported = false
        DemOperationCycleRef = DEMPOWER
        DemDTCRef = DTC_0x95A809
        DemDebounceAlgorithmClass
          DebounceCounterBased_0x95A809 (DemDebounceCounterBased): DemDebounceCounterBasedClassRef=DebounceCounterBasedClass_0
        IndicatorAttribute_0x95A809 (DemIndicatorAttribute): DemIndicatorBehaviour=DEM_INDICATOR_BLINKING, DemIndicatorHealingCycleCounterThreshold=0, DemIndicatorRef=Indicator_0
      DTC_0x95A909 (DemDTC): DemDtcValue=9808137, DemDTCSeverity=DEM_SEVERITY_NO_SEVERITY, DemDTCFunctionalUnit=255, DemDTCAttributesRef=DTCAttributes_0
      EventParameter_0x95A909 (DemEventParameter):
        DemEventAvailable = true
        DemEventFailureCycleCounterThreshold = 0
        DemEventId = 38
        DemEventKind = DEM_EVENT_KIND_SWC
        DemFFPrestorageSupported = false
        DemOperationCycleRef = DEMPOWER
        DemDTCRef = DTC_0x95A909
        DemDebounceAlgorithmClass
          DebounceCounterBased_0x95A909 (DemDebounceCounterBased): DemDebounceCounterBasedClassRef=DebounceCounterBasedClass_0
        IndicatorAttribute_0x95A909 (DemIndicatorAttribute): DemIndicatorBehaviour=DEM_INDICATOR_BLINKING, DemIndicatorHealingCycleCounterThreshold=0, DemIndicatorRef=Indicator_0
      DTC_0x95AA09 (DemDTC): DemDtcValue=9808393, DemDTCSeverity=DEM_SEVERITY_NO_SEVERITY, DemDTCFunctionalUnit=255, DemDTCAttributesRef=DTCAttributes_0
      EventParameter_0x95AA09 (DemEventParameter):
        DemEventAvailable = true
        DemEventFailureCycleCounterThreshold = 0
        DemEventId = 39
        DemEventKind = DEM_EVENT_KIND_SWC
        DemFFPrestorageSupported = false
        DemOperationCycleRef = DEMPOWER
        DemDTCRef = DTC_0x95AA09
        DemDebounceAlgorithmClass
          DebounceCounterBased_0x95AA09 (DemDebounceCounterBased): DemDebounceCounterBasedClassRef=DebounceCounterBasedClass_0
        IndicatorAttribute_0x95AA09 (DemIndicatorAttribute): DemIndicatorBehaviour=DEM_INDICATOR_BLINKING, DemIndicatorHealingCycleCounterThreshold=0, DemIndicatorRef=Indicator_0
      DTC_0x95AD09 (DemDTC): DemDtcValue=9809161, DemDTCSeverity=DEM_SEVERITY_NO_SEVERITY, DemDTCFunctionalUnit=255, DemDTCAttributesRef=DTCAttributes_0
      EventParameter_0x95AD09 (DemEventParameter):
        DemEventAvailable = true
        DemEventFailureCycleCounterThreshold = 0
        DemEventId = 40
        DemEventKind = DEM_EVENT_KIND_SWC
        DemFFPrestorageSupported = false
        DemOperationCycleRef = DEMPOWER
        DemDTCRef = DTC_0x95AD09
        DemDebounceAlgorithmClass
          DebounceCounterBased_0x95AD09 (DemDebounceCounterBased): DemDebounceCounterBasedClassRef=DebounceCounterBasedClass_0
        IndicatorAttribute_0x95AD09 (DemIndicatorAttribute): DemIndicatorBehaviour=DEM_INDICATOR_BLINKING, DemIndicatorHealingCycleCounterThreshold=0, DemIndicatorRef=Indicator_0
      DTC_0x95AE09 (DemDTC): DemDtcValue=9809417, DemDTCSeverity=DEM_SEVERITY_NO_SEVERITY, DemDTCFunctionalUnit=255, DemDTCAttributesRef=DTCAttributes_0
      EventParameter_0x95AE09 (DemEventParameter):
        DemEventAvailable = true
        DemEventFailureCycleCounterThreshold = 0
        DemEventId = 41
        DemEventKind = DEM_EVENT_KIND_SWC
        DemFFPrestorageSupported = false
        DemOperationCycleRef = DEMPOWER
        DemDTCRef = DTC_0x95AE09
        DemDebounceAlgorithmClass
          DebounceCounterBased_0x95AE09 (DemDebounceCounterBased): DemDebounceCounterBasedClassRef=DebounceCounterBasedClass_0
        IndicatorAttribute_0x95AE09 (DemIndicatorAttribute): DemIndicatorBehaviour=DEM_INDICATOR_BLINKING, DemIndicatorHealingCycleCounterThreshold=0, DemIndicatorRef=Indicator_0
      DTC_0xC07388 (DemDTC): DemDtcValue=12612488, DemDTCSeverity=DEM_SEVERITY_NO_SEVERITY, DemDTCFunctionalUnit=255, DemDTCAttributesRef=DTCAttributes_0
      EventParameter_0xC07388 (DemEventParameter):
        DemEventAvailable = true
        DemEventFailureCycleCounterThreshold = 0
        DemEventId = 42
        DemEventKind = DEM_EVENT_KIND_BSW
        DemFFPrestorageSupported = false
        DemReportBehavior = REPORT_AFTER_INIT
        DemOperationCycleRef = DEMPOWER
        DemDTCRef = DTC_0xC07388
        DemDebounceAlgorithmClass
          DebounceCounterBased_0xC07388 (DemDebounceCounterBased): DemDebounceCounterBasedClassRef=DebounceCounterBasedClass_0
        IndicatorAttribute_0xC07388 (DemIndicatorAttribute): DemIndicatorBehaviour=DEM_INDICATOR_BLINKING, DemIndicatorHealingCycleCounterThreshold=0, DemIndicatorRef=Indicator_0
      DTC_0xC07488 (DemDTC): DemDtcValue=12612744, DemDTCSeverity=DEM_SEVERITY_NO_SEVERITY, DemDTCFunctionalUnit=255, DemDTCAttributesRef=DTCAttributes_0
      EventParameter_0xC07488 (DemEventParameter):
        DemEventAvailable = true
        DemEventFailureCycleCounterThreshold = 0
        DemEventId = 43
        DemEventKind = DEM_EVENT_KIND_SWC
        DemFFPrestorageSupported = false
        DemOperationCycleRef = DEMPOWER
        DemDTCRef = DTC_0xC07488
        DemDebounceAlgorithmClass
          DebounceCounterBased_0xC07488 (DemDebounceCounterBased): DemDebounceCounterBasedClassRef=DebounceCounterBasedClass_0
        IndicatorAttribute_0xC07488 (DemIndicatorAttribute): DemIndicatorBehaviour=DEM_INDICATOR_BLINKING, DemIndicatorHealingCycleCounterThreshold=0, DemIndicatorRef=Indicator_0
      DTC_0xC14687 (DemDTC): DemDtcValue=12666503, DemDTCSeverity=DEM_SEVERITY_NO_SEVERITY, DemDTCFunctionalUnit=255, DemDTCAttributesRef=DTCAttributes_0
      EventParameter_0xC14687 (DemEventParameter):
        DemEventAvailable = true
        DemEventFailureCycleCounterThreshold = 0
        DemEventId = 44
        DemEventKind = DEM_EVENT_KIND_SWC
        DemFFPrestorageSupported = false
        DemOperationCycleRef = DEMPOWER
        DemDTCRef = DTC_0xC14687
        DemDebounceAlgorithmClass
          DebounceCounterBased_0xC14687 (DemDebounceCounterBased): DemDebounceCounterBasedClassRef=DebounceCounterBasedClass_0
        IndicatorAttribute_0xC14687 (DemIndicatorAttribute): DemIndicatorBehaviour=DEM_INDICATOR_BLINKING, DemIndicatorHealingCycleCounterThreshold=0, DemIndicatorRef=Indicator_0
      DTC_0xD56217 (DemDTC): DemDtcValue=13984279, DemDTCSeverity=DEM_SEVERITY_NO_SEVERITY, DemDTCFunctionalUnit=255, DemDTCAttributesRef=DTCAttributes_0
      EventParameter_0xD56217 (DemEventParameter):
        DemEventAvailable = true
        DemEventFailureCycleCounterThreshold = 0
        DemEventId = 45
        DemEventKind = DEM_EVENT_KIND_SWC
        DemFFPrestorageSupported = false
        DemOperationCycleRef = DEMPOWER
        DemDTCRef = DTC_0xD56217
        DemDebounceAlgorithmClass
          DebounceCounterBased_0xD56217 (DemDebounceCounterBased): DemDebounceCounterBasedClassRef=DebounceCounterBasedClass_0
        IndicatorAttribute_0xD56217 (DemIndicatorAttribute): DemIndicatorBehaviour=DEM_INDICATOR_BLINKING, DemIndicatorHealingCycleCounterThreshold=0, DemIndicatorRef=Indicator_0
      DTC_0xD56316 (DemDTC): DemDtcValue=13984534, DemDTCSeverity=DEM_SEVERITY_NO_SEVERITY, DemDTCFunctionalUnit=255, DemDTCAttributesRef=DTCAttributes_0
      EventParameter_0xD56316 (DemEventParameter):
        DemEventAvailable = true
        DemEventFailureCycleCounterThreshold = 0
        DemEventId = 46
        DemEventKind = DEM_EVENT_KIND_SWC
        DemFFPrestorageSupported = false
        DemOperationCycleRef = DEMPOWER
        DemDTCRef = DTC_0xD56316
        DemDebounceAlgorithmClass
          DebounceCounterBased_0xD56316 (DemDebounceCounterBased): DemDebounceCounterBasedClassRef=DebounceCounterBasedClass_0
        IndicatorAttribute_0xD56316 (DemIndicatorAttribute): DemIndicatorBehaviour=DEM_INDICATOR_BLINKING, DemIndicatorHealingCycleCounterThreshold=0, DemIndicatorRef=Indicator_0
      DTC_0xD60087 (DemDTC): DemDtcValue=14024839, DemDTCSeverity=DEM_SEVERITY_NO_SEVERITY, DemDTCFunctionalUnit=255, DemDTCAttributesRef=DTCAttributes_0
      EventParameter_0xD60087 (DemEventParameter):
        DemEventAvailable = true
        DemEventFailureCycleCounterThreshold = 0
        DemEventId = 47
        DemEventKind = DEM_EVENT_KIND_SWC
        DemFFPrestorageSupported = false
        DemOperationCycleRef = DEMPOWER
        DemDTCRef = DTC_0xD60087
        DemDebounceAlgorithmClass
          DebounceCounterBased_0xD60087 (DemDebounceCounterBased): DemDebounceCounterBasedClassRef=DebounceCounterBasedClass_0
        IndicatorAttribute_0xD60087 (DemIndicatorAttribute): DemIndicatorBehaviour=DEM_INDICATOR_BLINKING, DemIndicatorHealingCycleCounterThreshold=0, DemIndicatorRef=Indicator_0
      DTC_0xE00142 (DemDTC): DemDtcValue=14680386, DemDTCSeverity=DEM_SEVERITY_NO_SEVERITY, DemDTCFunctionalUnit=255, DemDTCAttributesRef=DTCAttributes_0
      EventParameter_0xE00142 (DemEventParameter):
        DemEventAvailable = true
        DemEventFailureCycleCounterThreshold = 0
        DemEventId = 48
        DemEventKind = DEM_EVENT_KIND_SWC
        DemFFPrestorageSupported = false
        DemOperationCycleRef = DEMPOWER
        DemDTCRef = DTC_0xE00142
        DemDebounceAlgorithmClass
          DebounceCounterBased_0xE00142 (DemDebounceCounterBased): DemDebounceCounterBasedClassRef=DebounceCounterBasedClass_0
        IndicatorAttribute_0xE00142 (DemIndicatorAttribute): DemIndicatorBehaviour=DEM_INDICATOR_BLINKING, DemIndicatorHealingCycleCounterThreshold=0, DemIndicatorRef=Indicator_0
      DTC_0xE00444 (DemDTC): DemDtcValue=14681156, DemDTCSeverity=DEM_SEVERITY_NO_SEVERITY, DemDTCFunctionalUnit=255, DemDTCAttributesRef=DTCAttributes_0
      EventParameter_0xE00444 (DemEventParameter):
        DemEventAvailable = true
        DemEventFailureCycleCounterThreshold = 0
        DemEventId = 49
        DemEventKind = DEM_EVENT_KIND_SWC
        DemFFPrestorageSupported = false
        DemOperationCycleRef = DEMPOWER
        DemDTCRef = DTC_0xE00444
        DemDebounceAlgorithmClass
          DebounceCounterBased_0xE00444 (DemDebounceCounterBased): DemDebounceCounterBasedClassRef=DebounceCounterBasedClass_0
        IndicatorAttribute_0xE00444 (DemIndicatorAttribute): DemIndicatorBehaviour=DEM_INDICATOR_BLINKING, DemIndicatorHealingCycleCounterThreshold=0, DemIndicatorRef=Indicator_0
      DTC_0xE26200 (DemDTC): DemDtcValue=14836224, DemDTCSeverity=DEM_SEVERITY_NO_SEVERITY, DemDTCFunctionalUnit=255, DemDTCAttributesRef=DTCAttributes_0
      EventParameter_0xE26200 (DemEventParameter):
        DemEventAvailable = true
        DemEventFailureCycleCounterThreshold = 0
        DemEventId = 50
        DemEventKind = DEM_EVENT_KIND_SWC
        DemFFPrestorageSupported = false
        DemOperationCycleRef = DEMPOWER
        DemDTCRef = DTC_0xE26200
        DemDebounceAlgorithmClass
          DebounceCounterBased_0xE26200 (DemDebounceCounterBased): DemDebounceCounterBasedClassRef=DebounceCounterBasedClass_0
        IndicatorAttribute_0xE26200 (DemIndicatorAttribute): DemIndicatorBehaviour=DEM_INDICATOR_BLINKING, DemIndicatorHealingCycleCounterThreshold=0, DemIndicatorRef=Indicator_0
      DTC_0xE28000 (DemDTC): DemDtcValue=14843904, DemDTCSeverity=DEM_SEVERITY_NO_SEVERITY, DemDTCFunctionalUnit=255, DemDTCAttributesRef=DTCAttributes_0
      EventParameter_0xE28000 (DemEventParameter):
        DemEventAvailable = true
        DemEventFailureCycleCounterThreshold = 0
        DemEventId = 51
        DemEventKind = DEM_EVENT_KIND_SWC
        DemFFPrestorageSupported = false
        DemOperationCycleRef = DEMPOWER
        DemDTCRef = DTC_0xE28000
        DemDebounceAlgorithmClass
          DebounceCounterBased_0xE28000 (DemDebounceCounterBased): DemDebounceCounterBasedClassRef=DebounceCounterBasedClass_0
        IndicatorAttribute_0xE28000 (DemIndicatorAttribute): DemIndicatorBehaviour=DEM_INDICATOR_BLINKING, DemIndicatorHealingCycleCounterThreshold=0, DemIndicatorRef=Indicator_0
      DTC_0xE28200 (DemDTC): DemDtcValue=14844416, DemDTCSeverity=DEM_SEVERITY_NO_SEVERITY, DemDTCFunctionalUnit=255, DemDTCAttributesRef=DTCAttributes_0
      EventParameter_0xE28200 (DemEventParameter):
        DemEventAvailable = true
        DemEventFailureCycleCounterThreshold = 0
        DemEventId = 52
        DemEventKind = DEM_EVENT_KIND_SWC
        DemFFPrestorageSupported = false
        DemOperationCycleRef = DEMPOWER
        DemDTCRef = DTC_0xE28200
        DemDebounceAlgorithmClass
          DebounceCounterBased_0xE28200 (DemDebounceCounterBased): DemDebounceCounterBasedClassRef=DebounceCounterBasedClass_0
        IndicatorAttribute_0xE28200 (DemIndicatorAttribute): DemIndicatorBehaviour=DEM_INDICATOR_BLINKING, DemIndicatorHealingCycleCounterThreshold=0, DemIndicatorRef=Indicator_0
      DTC_0xE29887 (DemDTC): DemDtcValue=14850183, DemDTCSeverity=DEM_SEVERITY_NO_SEVERITY, DemDTCFunctionalUnit=255, DemDTCAttributesRef=DTCAttributes_0
      EventParameter_0xE29887 (DemEventParameter):
        DemEventAvailable = true
        DemEventFailureCycleCounterThreshold = 0
        DemEventId = 53
        DemEventKind = DEM_EVENT_KIND_SWC
        DemFFPrestorageSupported = false
        DemOperationCycleRef = DEMPOWER
        DemDTCRef = DTC_0xE29887
        DemDebounceAlgorithmClass
          DebounceCounterBased_0xE29887 (DemDebounceCounterBased): DemDebounceCounterBasedClassRef=DebounceCounterBasedClass_0
        IndicatorAttribute_0xE29887 (DemIndicatorAttribute): DemIndicatorBehaviour=DEM_INDICATOR_BLINKING, DemIndicatorHealingCycleCounterThreshold=0, DemIndicatorRef=Indicator_0
      DTC_0xE298F0 (DemDTC): DemDtcValue=14850288, DemDTCSeverity=DEM_SEVERITY_NO_SEVERITY, DemDTCFunctionalUnit=255, DemDTCAttributesRef=DTCAttributes_0
      EventParameter_0xE298F0 (DemEventParameter):
        DemEventAvailable = true
        DemEventFailureCycleCounterThreshold = 0
        DemEventId = 54
        DemEventKind = DEM_EVENT_KIND_SWC
        DemFFPrestorageSupported = false
        DemOperationCycleRef = DEMPOWER
        DemDTCRef = DTC_0xE298F0
        DemDebounceAlgorithmClass
          DebounceCounterBased_0xE298F0 (DemDebounceCounterBased): DemDebounceCounterBasedClassRef=DebounceCounterBasedClass_0
        IndicatorAttribute_0xE298F0 (DemIndicatorAttribute): DemIndicatorBehaviour=DEM_INDICATOR_BLINKING, DemIndicatorHealingCycleCounterThreshold=0, DemIndicatorRef=Indicator_0
      DTC_0xE298F1 (DemDTC): DemDtcValue=14850289, DemDTCSeverity=DEM_SEVERITY_NO_SEVERITY, DemDTCFunctionalUnit=255, DemDTCAttributesRef=DTCAttributes_0
      EventParameter_0xE298F1 (DemEventParameter):
        DemEventAvailable = true
        DemEventFailureCycleCounterThreshold = 0
        DemEventId = 55
        DemEventKind = DEM_EVENT_KIND_SWC
        DemFFPrestorageSupported = false
        DemOperationCycleRef = DEMPOWER
        DemDTCRef = DTC_0xE298F1
        DemDebounceAlgorithmClass
          DebounceCounterBased_0xE298F1 (DemDebounceCounterBased): DemDebounceCounterBasedClassRef=DebounceCounterBasedClass_0
        IndicatorAttribute_0xE298F1 (DemIndicatorAttribute): DemIndicatorBehaviour=DEM_INDICATOR_BLINKING, DemIndicatorHealingCycleCounterThreshold=0, DemIndicatorRef=Indicator_0
      DTC_0xE2A287 (DemDTC): DemDtcValue=14852743, DemDTCSeverity=DEM_SEVERITY_NO_SEVERITY, DemDTCFunctionalUnit=255, DemDTCAttributesRef=DTCAttributes_0
      EventParameter_0xE2A287 (DemEventParameter):
        DemEventAvailable = true
        DemEventFailureCycleCounterThreshold = 0
        DemEventId = 56
        DemEventKind = DEM_EVENT_KIND_SWC
        DemFFPrestorageSupported = false
        DemOperationCycleRef = DEMPOWER
        DemDTCRef = DTC_0xE2A287
        DemDebounceAlgorithmClass
          DebounceCounterBased_0xE2A287 (DemDebounceCounterBased): DemDebounceCounterBasedClassRef=DebounceCounterBasedClass_0
        IndicatorAttribute_0xE2A287 (DemIndicatorAttribute): DemIndicatorBehaviour=DEM_INDICATOR_BLINKING, DemIndicatorHealingCycleCounterThreshold=0, DemIndicatorRef=Indicator_0
      DTC_0xE2A2F0 (DemDTC): DemDtcValue=14852848, DemDTCSeverity=DEM_SEVERITY_NO_SEVERITY, DemDTCFunctionalUnit=255, DemDTCAttributesRef=DTCAttributes_0
      EventParameter_0xE2A2F0 (DemEventParameter):
        DemEventAvailable = true
        DemEventFailureCycleCounterThreshold = 0
        DemEventId = 57
        DemEventKind = DEM_EVENT_KIND_SWC
        DemFFPrestorageSupported = false
        DemOperationCycleRef = DEMPOWER
        DemDTCRef = DTC_0xE2A2F0
        DemDebounceAlgorithmClass
          DebounceCounterBased_0xE2A2F0 (DemDebounceCounterBased): DemDebounceCounterBasedClassRef=DebounceCounterBasedClass_0
        IndicatorAttribute_0xE2A2F0 (DemIndicatorAttribute): DemIndicatorBehaviour=DEM_INDICATOR_BLINKING, DemIndicatorHealingCycleCounterThreshold=0, DemIndicatorRef=Indicator_0
      DTC_0xE2A2F1 (DemDTC): DemDtcValue=14852849, DemDTCSeverity=DEM_SEVERITY_NO_SEVERITY, DemDTCFunctionalUnit=255, DemDTCAttributesRef=DTCAttributes_0
      EventParameter_0xE2A2F1 (DemEventParameter):
        DemEventAvailable = true
        DemEventFailureCycleCounterThreshold = 0
        DemEventId = 58
        DemEventKind = DEM_EVENT_KIND_SWC
        DemFFPrestorageSupported = false
        DemOperationCycleRef = DEMPOWER
        DemDTCRef = DTC_0xE2A2F1
        DemDebounceAlgorithmClass
          DebounceCounterBased_0xE2A2F1 (DemDebounceCounterBased): DemDebounceCounterBasedClassRef=DebounceCounterBasedClass_0
        IndicatorAttribute_0xE2A2F1 (DemIndicatorAttribute): DemIndicatorBehaviour=DEM_INDICATOR_BLINKING, DemIndicatorHealingCycleCounterThreshold=0, DemIndicatorRef=Indicator_0
    DemGeneral:
      DemConfigType = PC_CONFIG
      DemAgingRequieresTestedCycle = true
      DemAgingRequiresNotFailedCycle = true
      DemAvailabilitySupport = DEM_EVENT_AVAILABILITY
      DemClearDTCBehavior = DEM_CLRRESP_NONVOLATILE_FINISH
      DemClearDTCLimitation = DEM_ALL_SUPPORTED_DTCS
      DemDataElementDefaultEndianness = BIG_ENDIAN
      DemDebounceCounterBasedSupport = true
      DemDebounceTimeBasedSupport = false
      DemDevErrorDetect = true
      DemEventCombinationSupport = DEM_EVCOMB_DISABLED
      DemGeneralInterfaceSupport = true
      DemOperationCycleStatusStorage = false
      DemMaxNumberPrestoredFF = 0
      DemOBDSupport = DEM_OBD_NO_OBD_SUPPORT
      DemPTOSupport = false
      DemResetConfirmedBitOnOverflow = true
      DemStatusBitHandlingTestFailedSinceLastClear = DEM_STATUS_BIT_NORMAL
      DemStatusBitStorageTestFailed = false
      DemSuppressionSupport = DEM_DTC_SUPPRESSION
      DemTaskTime = 0.01
      DemTriggerDcmReports = false
      DemTriggerDltReports = false
      DemTriggerFiMReports = false
      DemTriggerMonitorInitBeforeClearOk = false
      DemVersionInfoApi = true
      DemEnableSoftFilterOfPass = true
      DemNvRAMDivaded = false
      DemBswErrorBufferSize = 58
      DemClient: DemClientFunctionality=DEM_CLIENT_USES_FULL_FUNCTIONALITY, DemClientId=0, DemClientUsesRte=false
      DemEventMemorySet: DemMaxNumberEventEntryPermanent=0, DemTypeOfDTCSupported=DEM_DTC_TRANSLATION_ISO14229_1
        DemPrimaryMemory:
          DemDtcStatusAvailabilityMask = 9
          DemEnvironmentDataCapture = DEM_CAPTURE_ASYNCHRONOUS_TO_REPORTING
          DemEventDisplacementStrategy = DEM_DISPLACEMENT_FULL
          DemEventMemoryEntryStorageTrigger = DEM_TRIGGER_ON_TEST_FAILED
          DemMaxNumberEventEntryPrimary = 58
          DemOccurrenceCounterProcessing = DEM_PROCESS_OCCCTR_CDTC
          DemOperationCycleStatusStorage = false
          DemTypeOfFreezeFrameRecordNumeration = DEM_FF_RECNUM_CONFIGURED
        Indicator_0 (DemIndicator): DemIndicatorID=0
      DEMPOWER (DemOperationCycle): DemOperationCycleAutomaticEnd=false, DemOperationCycleAutostart=true, DemOperationCycleId=0, DemOperationCycleType=DEM_OPCYC_IGNITION
      FreezeFrameRecNumClass_DTCSnapshotRecordNumber_Base_Variant_Data_Object (DemFreezeFrameRecNumClass):
        DemFreezeFrameRecordClassRef = FreezeFrameRecordClass_DTCSnapshotRecordNumber_Base_Variant_Data_Object_1
        DemFreezeFrameRecordClassRef = FreezeFrameRecordClass_DTCSnapshotRecordNumber_Base_Variant_Data_Object_2
      FreezeFrameRecordClass_DTCSnapshotRecordNumber_Base_Variant_Data_Object_1 (DemFreezeFrameRecordClass): DemFreezeFrameRecordNumber=1, DemFreezeFrameRecordUpdate=DEM_UPDATE_RECORD_NO, DemFreezeFrameRecordTrigger=DEM_TRIGGER_ON_TEST_FAILED
      FreezeFrameRecordClass_DTCSnapshotRecordNumber_Base_Variant_Data_Object_2 (DemFreezeFrameRecordClass): DemFreezeFrameRecordNumber=2, DemFreezeFrameRecordUpdate=DEM_UPDATE_RECORD_YES, DemFreezeFrameRecordTrigger=DEM_TRIGGER_ON_TEST_FAILED
      FreezeFrameClass_ENVDATA_ALLDTCS (DemFreezeFrameClass):
        DemDidClassRef = DemDidClass_0112
        DemDidClassRef = DemDidClass_E101
        DemDidClassRef = DemDidClass_010B
        DemDidClassRef = DemDidClass_E010
        DemDidClassRef = DemDidClass_D002
        DemDidClassRef = DemDidClass_BE80
      ExtendedDataClass_DTCExtendedDataRecordNumber (DemExtendedDataClass): DemExtendedDataRecordClassRef=ExtendedDataRecordClass_AgingCounter, DemExtendedDataRecordClassRef=ExtendedDataRecordClass_OccurCounter
      ExtendedDataRecordClass_AgingCounter (DemExtendedDataRecordClass):
        DemExtendedDataRecordNumber = 1
        DemExtendedDataRecordTrigger = DEM_TRIGGER_ON_CONFIRMED
        DemExtendedDataRecordUpdate = DEM_UPDATE_RECORD_YES
        DemDataElementClassRef = DataElementClass_AgingCounter
      DataElementClass_AgingCounter (DemDataElementClass)
        InternalDataElementClass_AgingCounter (DemInternalDataElementClass): DemDataElementDataSize=1, DemInternalDataElement=DEM_AGINGCTR_UPCNT
      DataElementClass_OccurCounter (DemDataElementClass)
        InternalDataElementClass_OccurCounter (DemInternalDataElementClass): DemDataElementDataSize=1, DemInternalDataElement=DEM_OCCCTR
      ExtendedDataRecordClass_OccurCounter (DemExtendedDataRecordClass):
        DemExtendedDataRecordNumber = 2
        DemExtendedDataRecordTrigger = DEM_TRIGGER_ON_CONFIRMED
        DemExtendedDataRecordUpdate = DEM_UPDATE_RECORD_YES
        DemDataElementClassRef = DataElementClass_OccurCounter
      5 x DemDataElementClass:
        DataElementClass_0112
          ExternalCSDataElementClass_0112 (DemExternalCSDataElementClass):
            DemDataElementArraySize = 1
            DemDataElementDataType = UINT8_N
            DemDataElementProvideMonitorData = false
            DemDataElementReadFnc = Rte_ReadData_0112
            DemDataElementUsePort = false
        DataElementClass_E101
          ExternalCSDataElementClass_E101 (DemExternalCSDataElementClass):
            DemDataElementArraySize = 3
            DemDataElementDataType = UINT8_N
            DemDataElementProvideMonitorData = false
            DemDataElementReadFnc = Rte_ReadData_E101
            DemDataElementUsePort = false
        DataElementClass_010B
          ExternalCSDataElementClass_010B (DemExternalCSDataElementClass):
            DemDataElementArraySize = 6
            DemDataElementDataType = UINT8_N
            DemDataElementProvideMonitorData = false
            DemDataElementReadFnc = Rte_ReadData_010B
            DemDataElementUsePort = false
        DataElementClass_E010
          ExternalCSDataElementClass_E010 (DemExternalCSDataElementClass):
            DemDataElementArraySize = 2
            DemDataElementDataType = UINT8_N
            DemDataElementProvideMonitorData = false
            DemDataElementReadFnc = Rte_ReadData_E010
            DemDataElementUsePort = false
        DataElementClass_D002
          ExternalCSDataElementClass_D002 (DemExternalCSDataElementClass):
            DemDataElementArraySize = 1
            DemDataElementDataType = UINT8_N
            DemDataElementProvideMonitorData = false
            DemDataElementReadFnc = Rte_ReadData_D002
            DemDataElementUsePort = false
      6 x DemDidClass:
        DemDidClass_0112: DemDidIdentifier=274, DemDidDataElementClassRef=DataElementClass_0112
        DemDidClass_E101: DemDidIdentifier=57601, DemDidDataElementClassRef=DataElementClass_E101
        DemDidClass_010B: DemDidIdentifier=267, DemDidDataElementClassRef=DataElementClass_010B
        DemDidClass_E010: DemDidIdentifier=57360, DemDidDataElementClassRef=DataElementClass_E010
        DemDidClass_D002: DemDidIdentifier=53250, DemDidDataElementClassRef=DataElementClass_D002
        DemDidClass_BE80: DemDidIdentifier=48768, DemDidDataElementClassRef=DataElementClass_BE80
      DataElementClass_BE80 (DemDataElementClass)
        ExternalCSDataElementClass_BE80 (DemExternalCSDataElementClass):
          DemDataElementArraySize = 7
          DemDataElementDataType = UINT8_N
          DemDataElementProvideMonitorData = false
          DemDataElementReadFnc = Rte_ReadData_BE80
          DemDataElementUsePort = false
      DemNvRamBlockId_All_EventEntry (DemNvRamBlockId): DemNvRamBlockIdRef=NvMBlock_All_EventEntry
      DemNvRamBlockId_UDS_InternalData (DemNvRamBlockId): DemNvRamBlockIdRef=NvMBlock_UDS_InternalData
