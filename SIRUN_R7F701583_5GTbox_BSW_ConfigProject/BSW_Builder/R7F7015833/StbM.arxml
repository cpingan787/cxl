AUTOSAR XML (schema 00048)
package /R7F7015833
  module config StbM
    StbMGeneral:
      StbMDevErrorDetect = true
      StbMMainFunctionPeriod = 0.01
      StbMTimeRecordingSupport = false
      StbMVersionInfoApi = false
      StbMGptTimerRef = GptChannelConfiguration3
    StbMSynchronizedTimeBase_Slave (StbMSynchronizedTimeBase): StbMIsSystemWideGlobalTimeMaster=false, StbMNotificationInterface=NO_NOTIFICATION, StbMSynchronizedTimeBaseIdentifier=0
      StbMLocalTimeClock: StbMClockFrequency=16000000, StbMClockPrescaler=1, StbMLocalTimeHardware=GptChannelConfiguration3
      StbMTimeCorrection: StbMAllowMasterRateCorrection=true, StbMRateCorrectionsPerMeasurementDuration=1
