AUTOSAR XML (schema 00048)
package /R7F7015833
  ecuc value collection R7F7015833
    ecuc-values:
      Os
      CanSM
      ComM
      EcuC
      CanIf
      Com
      PduR
      EcuM
      Xfrm
      Crc
      Nm
      CanNm
      CanTp
      Dem
      Dcm
      BswM
      Can
      IpduM
      WdgM
      Wdg
      WdgIf
      Fee_62
      MemIf
      NvM
      CryIf
      SecOC
      Crypto_ISoft
      Csm
      Gpt
      CanTSyn
      StbM
