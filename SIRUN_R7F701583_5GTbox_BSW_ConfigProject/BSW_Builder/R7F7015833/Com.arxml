[part 2 of 3: package /R7F7015833]
AUTOSAR XML (schema 00048)
package /R7F7015833  (continued)
  module config Com  (continued)
    ComConfig  (continued)
      IRZCU_10ms_Group22_RZCU_RZCUCANFD_10ms_FrP22_NoSecO_CONTROLLER_0_IAM_Rx (ComSignalGroup):
        ComHandleId = IRZCU_10ms_Group22_RZCU_RZCUCANFD_10ms_FrP22_NoSecO_CONTROLLER_0_IAM_Rx
        ComInvalidNotification = NULL_PTR
        ComRxDataTimeoutAction = NONE
        ComTransferProperty = PENDING
        ComDataInvalidAction = NOTIFY
        ComTimeout = 0.0
        ComFirstTimeout = 0.0
        ComNotification = Rte_COMCbk
        15 x ComGroupSignal, all with ComSignalEndianness=BIG_ENDIAN, ComSignalInitValue=0x0, ComSignalLength=0, ComSignalDataInvalidValue=0x0:
          IRZCU_10ms_Group22_CRC_IRZCU_10ms_Group22_RZCU_RZCUCANFD_10ms_FrP22_NoSecO_CONTROLLER_0_IAM_Rx: ComBitPosition=0, ComBitSize=8, ComHandleId=IRZCU_10ms_Group22_RZCU_RZCUCANFD_10ms_FrP22_NoSecO_CONTROLLER_0_IAM_Rx_IRZCU_10ms_Group22_CRC_IRZCU_10ms_Group22_RZCU_RZCUCANFD_10ms_FrP22_NoSecO_CONTROLLER_0_IAM_Rx, ComSignalType=UINT8
          IRZCU_10ms_Group22_RC_IRZCU_10ms_Group22_RZCU_RZCUCANFD_10ms_FrP22_NoSecO_CONTROLLER_0_IAM_Rx: ComBitPosition=8, ComBitSize=4, ComHandleId=IRZCU_10ms_Group22_RZCU_RZCUCANFD_10ms_FrP22_NoSecO_CONTROLLER_0_IAM_Rx_IRZCU_10ms_Group22_RC_IRZCU_10ms_Group22_RZCU_RZCUCANFD_10ms_FrP22_NoSecO_CONTROLLER_0_IAM_Rx, ComSignalType=UINT8
          IRZCU_10ms_Group22_Reserved1_IRZCU_10ms_Group22_RZCU_RZCUCANFD_10ms_FrP22_NoSecO_CONTROLLER_0_IAM_Rx: ComBitPosition=12, ComBitSize=2, ComHandleId=IRZCU_10ms_Group22_RZCU_RZCUCANFD_10ms_FrP22_NoSecO_CONTROLLER_0_IAM_Rx_IRZCU_10ms_Group22_Reserved1_IRZCU_10ms_Group22_RZCU_RZCUCANFD_10ms_FrP22_NoSecO_CONTROLLER_0_IAM_Rx, ComSignalType=UINT8
          IEPTTrOtptShaftTotMinAvlblToqV_IRZCU_10ms_Group22_RZCU_RZCUCANFD_10ms_FrP22_NoSecO_CONTROLLER_0_IAM_Rx: ComBitPosition=14, ComBitSize=1, ComHandleId=IRZCU_10ms_Group22_RZCU_RZCUCANFD_10ms_FrP22_NoSecO_CONTROLLER_0_IAM_Rx_IEPTTrOtptShaftTotMinAvlblToqV_IRZCU_10ms_Group22_RZCU_RZCUCANFD_10ms_FrP22_NoSecO_CONTROLLER_0_IAM_Rx, ComSignalType=BOOLEAN
          IEPTTrOtptShaftTotMaxAvlblToqV_IRZCU_10ms_Group22_RZCU_RZCUCANFD_10ms_FrP22_NoSecO_CONTROLLER_0_IAM_Rx: ComBitPosition=15, ComBitSize=1, ComHandleId=IRZCU_10ms_Group22_RZCU_RZCUCANFD_10ms_FrP22_NoSecO_CONTROLLER_0_IAM_Rx_IEPTTrOtptShaftTotMaxAvlblToqV_IRZCU_10ms_Group22_RZCU_RZCUCANFD_10ms_FrP22_NoSecO_CONTROLLER_0_IAM_Rx, ComSignalType=BOOLEAN
          IEPTTrOtptShaftTotMaxAvlblToq_IRZCU_10ms_Group22_RZCU_RZCUCANFD_10ms_FrP22_NoSecO_CONTROLLER_0_IAM_Rx: ComBitPosition=28, ComBitSize=12, ComHandleId=IRZCU_10ms_Group22_RZCU_RZCUCANFD_10ms_FrP22_NoSecO_CONTROLLER_0_IAM_Rx_IEPTTrOtptShaftTotMaxAvlblToq_IRZCU_10ms_Group22_RZCU_RZCUCANFD_10ms_FrP22_NoSecO_CONTROLLER_0_IAM_Rx, ComSignalType=UINT16
          IEPTTrOtptShaftTotMinAvlblToq_IRZCU_10ms_Group22_RZCU_RZCUCANFD_10ms_FrP22_NoSecO_CONTROLLER_0_IAM_Rx: ComBitPosition=32, ComBitSize=12, ComHandleId=IRZCU_10ms_Group22_RZCU_RZCUCANFD_10ms_FrP22_NoSecO_CONTROLLER_0_IAM_Rx_IEPTTrOtptShaftTotMinAvlblToq_IRZCU_10ms_Group22_RZCU_RZCUCANFD_10ms_FrP22_NoSecO_CONTROLLER_0_IAM_Rx, ComSignalType=UINT16
          IEPTTrOtptShaftTotToq_IRZCU_10ms_Group22_RZCU_RZCUCANFD_10ms_FrP22_NoSecO_CONTROLLER_0_IAM_Rx: ComBitPosition=48, ComBitSize=12, ComHandleId=IRZCU_10ms_Group22_RZCU_RZCUCANFD_10ms_FrP22_NoSecO_CONTROLLER_0_IAM_Rx_IEPTTrOtptShaftTotToq_IRZCU_10ms_Group22_RZCU_RZCUCANFD_10ms_FrP22_NoSecO_CONTROLLER_0_IAM_Rx, ComSignalType=UINT16
          IEPTTrOtptShaftTotToqV_IRZCU_10ms_Group22_RZCU_RZCUCANFD_10ms_FrP22_NoSecO_CONTROLLER_0_IAM_Rx: ComBitPosition=44, ComBitSize=1, ComHandleId=IRZCU_10ms_Group22_RZCU_RZCUCANFD_10ms_FrP22_NoSecO_CONTROLLER_0_IAM_Rx_IEPTTrOtptShaftTotToqV_IRZCU_10ms_Group22_RZCU_RZCUCANFD_10ms_FrP22_NoSecO_CONTROLLER_0_IAM_Rx, ComSignalType=BOOLEAN
          IRZCU_10ms_Group22_Reserved2_IRZCU_10ms_Group22_RZCU_RZCUCANFD_10ms_FrP22_NoSecO_CONTROLLER_0_IAM_Rx: ComBitPosition=45, ComBitSize=3, ComHandleId=IRZCU_10ms_Group22_RZCU_RZCUCANFD_10ms_FrP22_NoSecO_CONTROLLER_0_IAM_Rx_IRZCU_10ms_Group22_Reserved2_IRZCU_10ms_Group22_RZCU_RZCUCANFD_10ms_FrP22_NoSecO_CONTROLLER_0_IAM_Rx, ComSignalType=UINT8
          IRZCU_10ms_Group22_Reserved3_IRZCU_10ms_Group22_RZCU_RZCUCANFD_10ms_FrP22_NoSecO_CONTROLLER_0_IAM_Rx: ComBitPosition=56, ComBitSize=8, ComHandleId=IRZCU_10ms_Group22_RZCU_RZCUCANFD_10ms_FrP22_NoSecO_CONTROLLER_0_IAM_Rx_IRZCU_10ms_Group22_Reserved3_IRZCU_10ms_Group22_RZCU_RZCUCANFD_10ms_FrP22_NoSecO_CONTROLLER_0_IAM_Rx, ComSignalType=UINT8
          IRZCU_10ms_Group22_Reserved4_IRZCU_10ms_Group22_RZCU_RZCUCANFD_10ms_FrP22_NoSecO_CONTROLLER_0_IAM_Rx: ComBitPosition=64, ComBitSize=8, ComHandleId=IRZCU_10ms_Group22_RZCU_RZCUCANFD_10ms_FrP22_NoSecO_CONTROLLER_0_IAM_Rx_IRZCU_10ms_Group22_Reserved4_IRZCU_10ms_Group22_RZCU_RZCUCANFD_10ms_FrP22_NoSecO_CONTROLLER_0_IAM_Rx, ComSignalType=UINT8
          IRZCU_10ms_Group22_Reserved5_IRZCU_10ms_Group22_RZCU_RZCUCANFD_10ms_FrP22_NoSecO_CONTROLLER_0_IAM_Rx: ComBitPosition=72, ComBitSize=8, ComHandleId=IRZCU_10ms_Group22_RZCU_RZCUCANFD_10ms_FrP22_NoSecO_CONTROLLER_0_IAM_Rx_IRZCU_10ms_Group22_Reserved5_IRZCU_10ms_Group22_RZCU_RZCUCANFD_10ms_FrP22_NoSecO_CONTROLLER_0_IAM_Rx, ComSignalType=UINT8
          IRZCU_10ms_Group22_Reserved6_IRZCU_10ms_Group22_RZCU_RZCUCANFD_10ms_FrP22_NoSecO_CONTROLLER_0_IAM_Rx: ComBitPosition=80, ComBitSize=8, ComHandleId=IRZCU_10ms_Group22_RZCU_RZCUCANFD_10ms_FrP22_NoSecO_CONTROLLER_0_IAM_Rx_IRZCU_10ms_Group22_Reserved6_IRZCU_10ms_Group22_RZCU_RZCUCANFD_10ms_FrP22_NoSecO_CONTROLLER_0_IAM_Rx, ComSignalType=UINT8
          IRZCU_10ms_Group22_Reserved7_IRZCU_10ms_Group22_RZCU_RZCUCANFD_10ms_FrP22_NoSecO_CONTROLLER_0_IAM_Rx: ComBitPosition=88, ComBitSize=8, ComHandleId=IRZCU_10ms_Group22_RZCU_RZCUCANFD_10ms_FrP22_NoSecO_CONTROLLER_0_IAM_Rx_IRZCU_10ms_Group22_Reserved7_IRZCU_10ms_Group22_RZCU_RZCUCANFD_10ms_FrP22_NoSecO_CONTROLLER_0_IAM_Rx, ComSignalType=UINT8
      ESS_PTCANFD_20ms_FrP01_CONTROLLER_0_IAM_Rx (ComIPdu):
        ComIPduCancellationSupport = false
        ComIPduDirection = RECEIVE
        ComIPduHandleId = COM_RXPDU_COM_ESS_PTCANFD_20ms_FrP01_CONTROLLER_0_IAM_Rx
        ComIPduSignalProcessing = DEFERRED
        ComIPduType = NORMAL
        ComIPduCallout = ESS_PTCANFD_20ms_FrP01_CONTROLLER_0_IAM_Rx
        ComPduIdRef = COM_ESS_PTCANFD_20ms_FrP01_CONTROLLER_0_IAM_Rx
        ComIPduSignalGroupRef = IESS_20ms_Group01_ESS_PTCANFD_20ms_FrP01_CONTROLLER_0_IAM_Rx
        ComIPduGroupRef = Com_RxPduGroup_CONTROLLER_0_IAM
      IESS_20ms_Group01_ESS_PTCANFD_20ms_FrP01_CONTROLLER_0_IAM_Rx (ComSignalGroup):
        ComHandleId = IESS_20ms_Group01_ESS_PTCANFD_20ms_FrP01_CONTROLLER_0_IAM_Rx
        ComInvalidNotification = NULL_PTR
        ComRxDataTimeoutAction = NONE
        ComTransferProperty = PENDING
        ComDataInvalidAction = NOTIFY
        ComTimeout = 0.0
        ComFirstTimeout = 0.0
        ComNotification = Rte_COMCbk
        10 x ComGroupSignal, all with ComSignalEndianness=BIG_ENDIAN, ComSignalInitValue=0x0, ComSignalLength=0, ComSignalDataInvalidValue=0x0:
          IESS_20ms_Group01_CRC_IESS_20ms_Group01_ESS_PTCANFD_20ms_FrP01_CONTROLLER_0_IAM_Rx: ComBitPosition=0, ComBitSize=8, ComHandleId=IESS_20ms_Group01_ESS_PTCANFD_20ms_FrP01_CONTROLLER_0_IAM_Rx_IESS_20ms_Group01_CRC_IESS_20ms_Group01_ESS_PTCANFD_20ms_FrP01_CONTROLLER_0_IAM_Rx, ComSignalType=UINT8
          IESS_20ms_Group01_RC_IESS_20ms_Group01_ESS_PTCANFD_20ms_FrP01_CONTROLLER_0_IAM_Rx: ComBitPosition=8, ComBitSize=4, ComHandleId=IESS_20ms_Group01_ESS_PTCANFD_20ms_FrP01_CONTROLLER_0_IAM_Rx_IESS_20ms_Group01_RC_IESS_20ms_Group01_ESS_PTCANFD_20ms_FrP01_CONTROLLER_0_IAM_Rx, ComSignalType=UINT8
          IBMSMinVolLmtV_IESS_20ms_Group01_ESS_PTCANFD_20ms_FrP01_CONTROLLER_0_IAM_Rx: ComBitPosition=12, ComBitSize=1, ComHandleId=IESS_20ms_Group01_ESS_PTCANFD_20ms_FrP01_CONTROLLER_0_IAM_Rx_IBMSMinVolLmtV_IESS_20ms_Group01_ESS_PTCANFD_20ms_FrP01_CONTROLLER_0_IAM_Rx, ComSignalType=BOOLEAN
          IBMSMaxVolLmtV_IESS_20ms_Group01_ESS_PTCANFD_20ms_FrP01_CONTROLLER_0_IAM_Rx: ComBitPosition=13, ComBitSize=1, ComHandleId=IESS_20ms_Group01_ESS_PTCANFD_20ms_FrP01_CONTROLLER_0_IAM_Rx_IBMSMaxVolLmtV_IESS_20ms_Group01_ESS_PTCANFD_20ms_FrP01_CONTROLLER_0_IAM_Rx, ComSignalType=BOOLEAN
          IBMSPackVolV_IESS_20ms_Group01_ESS_PTCANFD_20ms_FrP01_CONTROLLER_0_IAM_Rx: ComBitPosition=14, ComBitSize=1, ComHandleId=IESS_20ms_Group01_ESS_PTCANFD_20ms_FrP01_CONTROLLER_0_IAM_Rx_IBMSPackVolV_IESS_20ms_Group01_ESS_PTCANFD_20ms_FrP01_CONTROLLER_0_IAM_Rx, ComSignalType=BOOLEAN
          IBMSPackCrntV_IESS_20ms_Group01_ESS_PTCANFD_20ms_FrP01_CONTROLLER_0_IAM_Rx: ComBitPosition=15, ComBitSize=1, ComHandleId=IESS_20ms_Group01_ESS_PTCANFD_20ms_FrP01_CONTROLLER_0_IAM_Rx_IBMSPackCrntV_IESS_20ms_Group01_ESS_PTCANFD_20ms_FrP01_CONTROLLER_0_IAM_Rx, ComSignalType=BOOLEAN
          IBMSPackCrnt_IESS_20ms_Group01_ESS_PTCANFD_20ms_FrP01_CONTROLLER_0_IAM_Rx: ComBitPosition=24, ComBitSize=16, ComHandleId=IESS_20ms_Group01_ESS_PTCANFD_20ms_FrP01_CONTROLLER_0_IAM_Rx_IBMSPackCrnt_IESS_20ms_Group01_ESS_PTCANFD_20ms_FrP01_CONTROLLER_0_IAM_Rx, ComSignalType=UINT16
          IBMSPackVol_IESS_20ms_Group01_ESS_PTCANFD_20ms_FrP01_CONTROLLER_0_IAM_Rx: ComBitPosition=44, ComBitSize=12, ComHandleId=IESS_20ms_Group01_ESS_PTCANFD_20ms_FrP01_CONTROLLER_0_IAM_Rx_IBMSPackVol_IESS_20ms_Group01_ESS_PTCANFD_20ms_FrP01_CONTROLLER_0_IAM_Rx, ComSignalType=UINT16
          IBMSMaxVolLmt_IESS_20ms_Group01_ESS_PTCANFD_20ms_FrP01_CONTROLLER_0_IAM_Rx: ComBitPosition=50, ComBitSize=10, ComHandleId=IESS_20ms_Group01_ESS_PTCANFD_20ms_FrP01_CONTROLLER_0_IAM_Rx_IBMSMaxVolLmt_IESS_20ms_Group01_ESS_PTCANFD_20ms_FrP01_CONTROLLER_0_IAM_Rx, ComSignalType=UINT16
          IBMSMinVolLmt_IESS_20ms_Group01_ESS_PTCANFD_20ms_FrP01_CONTROLLER_0_IAM_Rx: ComBitPosition=56, ComBitSize=10, ComHandleId=IESS_20ms_Group01_ESS_PTCANFD_20ms_FrP01_CONTROLLER_0_IAM_Rx_IBMSMinVolLmt_IESS_20ms_Group01_ESS_PTCANFD_20ms_FrP01_CONTROLLER_0_IAM_Rx, ComSignalType=UINT16
      ESS_PTCANFD_20ms_FrP02_CONTROLLER_0_IAM_Rx (ComIPdu):
        ComIPduCancellationSupport = false
        ComIPduDirection = RECEIVE
        ComIPduHandleId = COM_RXPDU_COM_ESS_PTCANFD_20ms_FrP02_CONTROLLER_0_IAM_Rx
        ComIPduSignalProcessing = DEFERRED
        ComIPduType = NORMAL
        ComPduIdRef = COM_ESS_PTCANFD_20ms_FrP02_CONTROLLER_0_IAM_Rx
        ComIPduSignalRef = IBMSCellMaxTemV_ESS_PTCANFD_20ms_FrP02_CONTROLLER_0_IAM_Rx
        ComIPduSignalRef = IBMSCellMinTemV_ESS_PTCANFD_20ms_FrP02_CONTROLLER_0_IAM_Rx
        ComIPduSignalRef = IBMSCellMaxTem_ESS_PTCANFD_20ms_FrP02_CONTROLLER_0_IAM_Rx
        ComIPduSignalRef = IBMSCellMinTem_ESS_PTCANFD_20ms_FrP02_CONTROLLER_0_IAM_Rx
        ComIPduSignalRef = IBMSCellMaxTemIndx_ESS_PTCANFD_20ms_FrP02_CONTROLLER_0_IAM_Rx
        ComIPduSignalRef = IBMSCellMinTemIndx_ESS_PTCANFD_20ms_FrP02_CONTROLLER_0_IAM_Rx
        ComIPduSignalRef = IBMSBusbarTempMax_ESS_PTCANFD_20ms_FrP02_CONTROLLER_0_IAM_Rx
        ComIPduGroupRef = Com_RxPduGroup_CONTROLLER_0_IAM
      7 x ComSignal, all with ComInvalidNotification=NULL_PTR, ComRxDataTimeoutAction=NONE, ComSignalEndianness=BIG_ENDIAN, ComSignalInitValue=0x0, ComSignalLength=0, ComTransferProperty=PENDING, ComSignalDataInvalidValue=0x0, ComDataInvalidAction=NOTIFY, ComTimeout=0.0, ComFirstTimeout=0.0, ComNotification=Rte_COMCbk:
        IBMSCellMaxTemV_ESS_PTCANFD_20ms_FrP02_CONTROLLER_0_IAM_Rx: ComBitPosition=12, ComBitSize=1, ComHandleId=IBMSCellMaxTemV_ESS_PTCANFD_20ms_FrP02_CONTROLLER_0_IAM_Rx, ComSignalType=BOOLEAN
        IBMSCellMinTemV_ESS_PTCANFD_20ms_FrP02_CONTROLLER_0_IAM_Rx: ComBitPosition=15, ComBitSize=1, ComHandleId=IBMSCellMinTemV_ESS_PTCANFD_20ms_FrP02_CONTROLLER_0_IAM_Rx, ComSignalType=BOOLEAN
        IBMSCellMaxTem_ESS_PTCANFD_20ms_FrP02_CONTROLLER_0_IAM_Rx: ComBitPosition=16, ComBitSize=8, ComHandleId=IBMSCellMaxTem_ESS_PTCANFD_20ms_FrP02_CONTROLLER_0_IAM_Rx, ComSignalType=UINT8
        IBMSCellMinTem_ESS_PTCANFD_20ms_FrP02_CONTROLLER_0_IAM_Rx: ComBitPosition=24, ComBitSize=8, ComHandleId=IBMSCellMinTem_ESS_PTCANFD_20ms_FrP02_CONTROLLER_0_IAM_Rx, ComSignalType=UINT8
        IBMSCellMaxTemIndx_ESS_PTCANFD_20ms_FrP02_CONTROLLER_0_IAM_Rx: ComBitPosition=32, ComBitSize=8, ComHandleId=IBMSCellMaxTemIndx_ESS_PTCANFD_20ms_FrP02_CONTROLLER_0_IAM_Rx, ComSignalType=UINT8
        IBMSCellMinTemIndx_ESS_PTCANFD_20ms_FrP02_CONTROLLER_0_IAM_Rx: ComBitPosition=40, ComBitSize=8, ComHandleId=IBMSCellMinTemIndx_ESS_PTCANFD_20ms_FrP02_CONTROLLER_0_IAM_Rx, ComSignalType=UINT8
        IBMSBusbarTempMax_ESS_PTCANFD_20ms_FrP02_CONTROLLER_0_IAM_Rx: ComBitPosition=48, ComBitSize=8, ComHandleId=IBMSBusbarTempMax_ESS_PTCANFD_20ms_FrP02_CONTROLLER_0_IAM_Rx, ComSignalType=UINT8
      ICBAD_CHCANFD_20ms_FrP08_CONTROLLER_0_IAM_Rx (ComIPdu):
        ComIPduCancellationSupport = false
        ComIPduDirection = RECEIVE
        ComIPduHandleId = COM_RXPDU_COM_ICBAD_CHCANFD_20ms_FrP08_CONTROLLER_0_IAM_Rx
        ComIPduSignalProcessing = DEFERRED
        ComIPduType = NORMAL
        ComPduIdRef = COM_ICBAD_CHCANFD_20ms_FrP08_CONTROLLER_0_IAM_Rx
        ComIPduSignalRef = IAIPilotSysSts_ICBAD_CHCANFD_20ms_FrP08_CONTROLLER_0_IAM_Rx
        ComIPduGroupRef = Com_RxPduGroup_CONTROLLER_0_IAM
      IAIPilotSysSts_ICBAD_CHCANFD_20ms_FrP08_CONTROLLER_0_IAM_Rx (ComSignal):
        ComBitPosition = 12
        ComBitSize = 4
        ComHandleId = IAIPilotSysSts_ICBAD_CHCANFD_20ms_FrP08_CONTROLLER_0_IAM_Rx
        ComInvalidNotification = NULL_PTR
        ComRxDataTimeoutAction = NONE
        ComSignalEndianness = BIG_ENDIAN
        ComSignalInitValue = 0x0
        ComSignalLength = 0
        ComSignalType = UINT8
        ComTransferProperty = PENDING
        ComSignalDataInvalidValue = 0x0
        ComDataInvalidAction = NOTIFY
        ComTimeout = 0.0
        ComFirstTimeout = 0.0
        ComNotification = Rte_COMCbk
      PEU_ERCANFD_20ms_FrP33_CONTROLLER_0_IAM_Rx (ComIPdu):
        ComIPduCancellationSupport = false
        ComIPduDirection = RECEIVE
        ComIPduHandleId = COM_RXPDU_COM_PEU_ERCANFD_20ms_FrP33_CONTROLLER_0_IAM_Rx
        ComIPduSignalProcessing = DEFERRED
        ComIPduType = NORMAL
        ComPduIdRef = COM_PEU_ERCANFD_20ms_FrP33_CONTROLLER_0_IAM_Rx
        ComIPduSignalRef = ISAMActuToqHiPre_PEU_PEU_ERCANFD_20ms_FrP33_CONTROLLER_0_IAM_Rx
        ComIPduGroupRef = Com_RxPduGroup_CONTROLLER_0_IAM
      ISAMActuToqHiPre_PEU_PEU_ERCANFD_20ms_FrP33_CONTROLLER_0_IAM_Rx (ComSignal):
        ComBitPosition = 24
        ComBitSize = 16
        ComHandleId = ISAMActuToqHiPre_PEU_PEU_ERCANFD_20ms_FrP33_CONTROLLER_0_IAM_Rx
        ComInvalidNotification = NULL_PTR
        ComRxDataTimeoutAction = NONE
        ComSignalEndianness = BIG_ENDIAN
        ComSignalInitValue = 0x0
        ComSignalLength = 0
        ComSignalType = UINT16
        ComTransferProperty = PENDING
        ComSignalDataInvalidValue = 0x0
        ComDataInvalidAction = NOTIFY
        ComTimeout = 0.0
        ComFirstTimeout = 0.0
        ComNotification = Rte_COMCbk
      SDM_CHCANFD_20ms_FrP01_CONTROLLER_0_IAM_Rx (ComIPdu):
        ComIPduCancellationSupport = false
        ComIPduDirection = RECEIVE
        ComIPduHandleId = COM_RXPDU_COM_SDM_CHCANFD_20ms_FrP01_CONTROLLER_0_IAM_Rx
        ComIPduSignalProcessing = DEFERRED
        ComIPduType = NORMAL
        ComIPduCallout = SDM_CHCANFD_20ms_FrP01_CONTROLLER_0_IAM_Rx
        ComPduIdRef = COM_SDM_CHCANFD_20ms_FrP01_CONTROLLER_0_IAM_Rx
        ComIPduSignalGroupRef = ISDM_20ms_Group01_SDM_CHCANFD_20ms_FrP01_CONTROLLER_0_IAM_Rx
        ComIPduGroupRef = Com_RxPduGroup_CONTROLLER_0_IAM
      ISDM_20ms_Group01_SDM_CHCANFD_20ms_FrP01_CONTROLLER_0_IAM_Rx (ComSignalGroup):
        ComHandleId = ISDM_20ms_Group01_SDM_CHCANFD_20ms_FrP01_CONTROLLER_0_IAM_Rx
        ComInvalidNotification = NULL_PTR
        ComRxDataTimeoutAction = NONE
        ComTransferProperty = PENDING
        ComDataInvalidAction = NOTIFY
        ComTimeout = 0.0
        ComFirstTimeout = 0.0
        ComNotification = Rte_COMCbk
        34 x ComGroupSignal, all with ComSignalEndianness=BIG_ENDIAN, ComSignalInitValue=0x0, ComSignalLength=0, ComSignalDataInvalidValue=0x0:
          ISDM_20ms_Group01_CRC_ISDM_20ms_Group01_SDM_CHCANFD_20ms_FrP01_CONTROLLER_0_IAM_Rx: ComBitPosition=0, ComBitSize=8, ComHandleId=ISDM_20ms_Group01_SDM_CHCANFD_20ms_FrP01_CONTROLLER_0_IAM_Rx_ISDM_20ms_Group01_CRC_ISDM_20ms_Group01_SDM_CHCANFD_20ms_FrP01_CONTROLLER_0_IAM_Rx, ComSignalType=UINT8
          ISDM_20ms_Group01_RC_ISDM_20ms_Group01_SDM_CHCANFD_20ms_FrP01_CONTROLLER_0_IAM_Rx: ComBitPosition=8, ComBitSize=4, ComHandleId=ISDM_20ms_Group01_SDM_CHCANFD_20ms_FrP01_CONTROLLER_0_IAM_Rx_ISDM_20ms_Group01_RC_ISDM_20ms_Group01_SDM_CHCANFD_20ms_FrP01_CONTROLLER_0_IAM_Rx, ComSignalType=UINT8
          ISDM_20ms_Group01_Reserved1_ISDM_20ms_Group01_SDM_CHCANFD_20ms_FrP01_CONTROLLER_0_IAM_Rx: ComBitPosition=12, ComBitSize=1, ComHandleId=ISDM_20ms_Group01_SDM_CHCANFD_20ms_FrP01_CONTROLLER_0_IAM_Rx_ISDM_20ms_Group01_Reserved1_ISDM_20ms_Group01_SDM_CHCANFD_20ms_FrP01_CONTROLLER_0_IAM_Rx, ComSignalType=BOOLEAN
          IAirbagSysFltForeCall_ISDM_20ms_Group01_SDM_CHCANFD_20ms_FrP01_CONTROLLER_0_IAM_Rx: ComBitPosition=13, ComBitSize=1, ComHandleId=ISDM_20ms_Group01_SDM_CHCANFD_20ms_FrP01_CONTROLLER_0_IAM_Rx_IAirbagSysFltForeCall_ISDM_20ms_Group01_SDM_CHCANFD_20ms_FrP01_CONTROLLER_0_IAM_Rx, ComSignalType=BOOLEAN
          IAirbagDplInvsneForeCall_ISDM_20ms_Group01_SDM_CHCANFD_20ms_FrP01_CONTROLLER_0_IAM_Rx: ComBitPosition=14, ComBitSize=1, ComHandleId=ISDM_20ms_Group01_SDM_CHCANFD_20ms_FrP01_CONTROLLER_0_IAM_Rx_IAirbagDplInvsneForeCall_ISDM_20ms_Group01_SDM_CHCANFD_20ms_FrP01_CONTROLLER_0_IAM_Rx, ComSignalType=BOOLEAN
          IAirbagDplForeCall_ISDM_20ms_Group01_SDM_CHCANFD_20ms_FrP01_CONTROLLER_0_IAM_Rx: ComBitPosition=15, ComBitSize=1, ComHandleId=ISDM_20ms_Group01_SDM_CHCANFD_20ms_FrP01_CONTROLLER_0_IAM_Rx_IAirbagDplForeCall_ISDM_20ms_Group01_SDM_CHCANFD_20ms_FrP01_CONTROLLER_0_IAM_Rx, ComSignalType=BOOLEAN
          IFasnSbltAudRmndr_ISDM_20ms_Group01_SDM_CHCANFD_20ms_FrP01_CONTROLLER_0_IAM_Rx: ComBitPosition=16, ComBitSize=1, ComHandleId=ISDM_20ms_Group01_SDM_CHCANFD_20ms_FrP01_CONTROLLER_0_IAM_Rx_IFasnSbltAudRmndr_ISDM_20ms_Group01_SDM_CHCANFD_20ms_FrP01_CONTROLLER_0_IAM_Rx, ComSignalType=BOOLEAN
          IFasnFrtPsngSbltIndCmd_ISDM_20ms_Group01_SDM_CHCANFD_20ms_FrP01_CONTROLLER_0_IAM_Rx: ComBitPosition=17, ComBitSize=2, ComHandleId=ISDM_20ms_Group01_SDM_CHCANFD_20ms_FrP01_CONTROLLER_0_IAM_Rx_IFasnFrtPsngSbltIndCmd_ISDM_20ms_Group01_SDM_CHCANFD_20ms_FrP01_CONTROLLER_0_IAM_Rx, ComSignalType=UINT8
          IFasnDrvrSbltIndCmd_ISDM_20ms_Group01_SDM_CHCANFD_20ms_FrP01_CONTROLLER_0_IAM_Rx: ComBitPosition=19, ComBitSize=2, ComHandleId=ISDM_20ms_Group01_SDM_CHCANFD_20ms_FrP01_CONTROLLER_0_IAM_Rx_IFasnDrvrSbltIndCmd_ISDM_20ms_Group01_SDM_CHCANFD_20ms_FrP01_CONTROLLER_0_IAM_Rx, ComSignalType=UINT8
          ISDM_20ms_Group01_Reserved2_ISDM_20ms_Group01_SDM_CHCANFD_20ms_FrP01_CONTROLLER_0_IAM_Rx: ComBitPosition=21, ComBitSize=1, ComHandleId=ISDM_20ms_Group01_SDM_CHCANFD_20ms_FrP01_CONTROLLER_0_IAM_Rx_ISDM_20ms_Group01_Reserved2_ISDM_20ms_Group01_SDM_CHCANFD_20ms_FrP01_CONTROLLER_0_IAM_Rx, ComSignalType=BOOLEAN
          IDrvrSbltAtcV_ISDM_20ms_Group01_SDM_CHCANFD_20ms_FrP01_CONTROLLER_0_IAM_Rx: ComBitPosition=22, ComBitSize=1, ComHandleId=ISDM_20ms_Group01_SDM_CHCANFD_20ms_FrP01_CONTROLLER_0_IAM_Rx_IDrvrSbltAtcV_ISDM_20ms_Group01_SDM_CHCANFD_20ms_FrP01_CONTROLLER_0_IAM_Rx, ComSignalType=BOOLEAN
          IDrvrSbltAtc_ISDM_20ms_Group01_SDM_CHCANFD_20ms_FrP01_CONTROLLER_0_IAM_Rx: ComBitPosition=23, ComBitSize=1, ComHandleId=ISDM_20ms_Group01_SDM_CHCANFD_20ms_FrP01_CONTROLLER_0_IAM_Rx_IDrvrSbltAtc_ISDM_20ms_Group01_SDM_CHCANFD_20ms_FrP01_CONTROLLER_0_IAM_Rx, ComSignalType=BOOLEAN
          IFasnSecRowMidSbltAtcV_ISDM_20ms_Group01_SDM_CHCANFD_20ms_FrP01_CONTROLLER_0_IAM_Rx: ComBitPosition=24, ComBitSize=1, ComHandleId=ISDM_20ms_Group01_SDM_CHCANFD_20ms_FrP01_CONTROLLER_0_IAM_Rx_IFasnSecRowMidSbltAtcV_ISDM_20ms_Group01_SDM_CHCANFD_20ms_FrP01_CONTROLLER_0_IAM_Rx, ComSignalType=BOOLEAN
          IFasnSecRowMidSbltAtc_ISDM_20ms_Group01_SDM_CHCANFD_20ms_FrP01_CONTROLLER_0_IAM_Rx: ComBitPosition=25, ComBitSize=1, ComHandleId=ISDM_20ms_Group01_SDM_CHCANFD_20ms_FrP01_CONTROLLER_0_IAM_Rx_IFasnSecRowMidSbltAtc_ISDM_20ms_Group01_SDM_CHCANFD_20ms_FrP01_CONTROLLER_0_IAM_Rx, ComSignalType=BOOLEAN
          IFasnSecRowLSbltAtcV_ISDM_20ms_Group01_SDM_CHCANFD_20ms_FrP01_CONTROLLER_0_IAM_Rx: ComBitPosition=26, ComBitSize=1, ComHandleId=ISDM_20ms_Group01_SDM_CHCANFD_20ms_FrP01_CONTROLLER_0_IAM_Rx_IFasnSecRowLSbltAtcV_ISDM_20ms_Group01_SDM_CHCANFD_20ms_FrP01_CONTROLLER_0_IAM_Rx, ComSignalType=BOOLEAN
          IFasnSecRowLSbltAtc_ISDM_20ms_Group01_SDM_CHCANFD_20ms_FrP01_CONTROLLER_0_IAM_Rx: ComBitPosition=27, ComBitSize=1, ComHandleId=ISDM_20ms_Group01_SDM_CHCANFD_20ms_FrP01_CONTROLLER_0_IAM_Rx_IFasnSecRowLSbltAtc_ISDM_20ms_Group01_SDM_CHCANFD_20ms_FrP01_CONTROLLER_0_IAM_Rx, ComSignalType=BOOLEAN
          IFasnSecRowLSbltIndCmd_ISDM_20ms_Group01_SDM_CHCANFD_20ms_FrP01_CONTROLLER_0_IAM_Rx: ComBitPosition=28, ComBitSize=2, ComHandleId=ISDM_20ms_Group01_SDM_CHCANFD_20ms_FrP01_CONTROLLER_0_IAM_Rx_IFasnSecRowLSbltIndCmd_ISDM_20ms_Group01_SDM_CHCANFD_20ms_FrP01_CONTROLLER_0_IAM_Rx, ComSignalType=UINT8
          IFasnSecRowMidSbltIndCmd_ISDM_20ms_Group01_SDM_CHCANFD_20ms_FrP01_CONTROLLER_0_IAM_Rx: ComBitPosition=30, ComBitSize=2, ComHandleId=ISDM_20ms_Group01_SDM_CHCANFD_20ms_FrP01_CONTROLLER_0_IAM_Rx_IFasnSecRowMidSbltIndCmd_ISDM_20ms_Group01_SDM_CHCANFD_20ms_FrP01_CONTROLLER_0_IAM_Rx, ComSignalType=UINT8
          IFasnThrdRowLSbltIndCmd_ISDM_20ms_Group01_SDM_CHCANFD_20ms_FrP01_CONTROLLER_0_IAM_Rx: ComBitPosition=32, ComBitSize=2, ComHandleId=ISDM_20ms_Group01_SDM_CHCANFD_20ms_FrP01_CONTROLLER_0_IAM_Rx_IFasnThrdRowLSbltIndCmd_ISDM_20ms_Group01_SDM_CHCANFD_20ms_FrP01_CONTROLLER_0_IAM_Rx, ComSignalType=UINT8
          IFasnThrdRowLSbltAtcV_ISDM_20ms_Group01_SDM_CHCANFD_20ms_FrP01_CONTROLLER_0_IAM_Rx: ComBitPosition=34, ComBitSize=1, ComHandleId=ISDM_20ms_Group01_SDM_CHCANFD_20ms_FrP01_CONTROLLER_0_IAM_Rx_IFasnThrdRowLSbltAtcV_ISDM_20ms_Group01_SDM_CHCANFD_20ms_FrP01_CONTROLLER_0_IAM_Rx, ComSignalType=BOOLEAN
          IFasnThrdRowLSbltAtc_ISDM_20ms_Group01_SDM_CHCANFD_20ms_FrP01_CONTROLLER_0_IAM_Rx: ComBitPosition=35, ComBitSize=1, ComHandleId=ISDM_20ms_Group01_SDM_CHCANFD_20ms_FrP01_CONTROLLER_0_IAM_Rx_IFasnThrdRowLSbltAtc_ISDM_20ms_Group01_SDM_CHCANFD_20ms_FrP01_CONTROLLER_0_IAM_Rx, ComSignalType=BOOLEAN
          IFasnSecRowRSbltIndCmd_ISDM_20ms_Group01_SDM_CHCANFD_20ms_FrP01_CONTROLLER_0_IAM_Rx: ComBitPosition=36, ComBitSize=2, ComHandleId=ISDM_20ms_Group01_SDM_CHCANFD_20ms_FrP01_CONTROLLER_0_IAM_Rx_IFasnSecRowRSbltIndCmd_ISDM_20ms_Group01_SDM_CHCANFD_20ms_FrP01_CONTROLLER_0_IAM_Rx, ComSignalType=UINT8
          IFasnSecRowRSbltAtcV_ISDM_20ms_Group01_SDM_CHCANFD_20ms_FrP01_CONTROLLER_0_IAM_Rx: ComBitPosition=38, ComBitSize=1, ComHandleId=ISDM_20ms_Group01_SDM_CHCANFD_20ms_FrP01_CONTROLLER_0_IAM_Rx_IFasnSecRowRSbltAtcV_ISDM_20ms_Group01_SDM_CHCANFD_20ms_FrP01_CONTROLLER_0_IAM_Rx, ComSignalType=BOOLEAN
          IFasnSecRowRSbltAtc_ISDM_20ms_Group01_SDM_CHCANFD_20ms_FrP01_CONTROLLER_0_IAM_Rx: ComBitPosition=39, ComBitSize=1, ComHandleId=ISDM_20ms_Group01_SDM_CHCANFD_20ms_FrP01_CONTROLLER_0_IAM_Rx_IFasnSecRowRSbltAtc_ISDM_20ms_Group01_SDM_CHCANFD_20ms_FrP01_CONTROLLER_0_IAM_Rx, ComSignalType=BOOLEAN
          IFasnThrdRowRSbltIndCmd_ISDM_20ms_Group01_SDM_CHCANFD_20ms_FrP01_CONTROLLER_0_IAM_Rx: ComBitPosition=40, ComBitSize=2, ComHandleId=ISDM_20ms_Group01_SDM_CHCANFD_20ms_FrP01_CONTROLLER_0_IAM_Rx_IFasnThrdRowRSbltIndCmd_ISDM_20ms_Group01_SDM_CHCANFD_20ms_FrP01_CONTROLLER_0_IAM_Rx, ComSignalType=UINT8
          IFasnThrdRowRSbltAtcV_ISDM_20ms_Group01_SDM_CHCANFD_20ms_FrP01_CONTROLLER_0_IAM_Rx: ComBitPosition=42, ComBitSize=1, ComHandleId=ISDM_20ms_Group01_SDM_CHCANFD_20ms_FrP01_CONTROLLER_0_IAM_Rx_IFasnThrdRowRSbltAtcV_ISDM_20ms_Group01_SDM_CHCANFD_20ms_FrP01_CONTROLLER_0_IAM_Rx, ComSignalType=BOOLEAN
          IFasnThrdRowRSbltAtc_ISDM_20ms_Group01_SDM_CHCANFD_20ms_FrP01_CONTROLLER_0_IAM_Rx: ComBitPosition=43, ComBitSize=1, ComHandleId=ISDM_20ms_Group01_SDM_CHCANFD_20ms_FrP01_CONTROLLER_0_IAM_Rx_IFasnThrdRowRSbltAtc_ISDM_20ms_Group01_SDM_CHCANFD_20ms_FrP01_CONTROLLER_0_IAM_Rx, ComSignalType=BOOLEAN
          IFasnThrdRowMidSbltIndCmd_ISDM_20ms_Group01_SDM_CHCANFD_20ms_FrP01_CONTROLLER_0_IAM_Rx: ComBitPosition=44, ComBitSize=2, ComHandleId=ISDM_20ms_Group01_SDM_CHCANFD_20ms_FrP01_CONTROLLER_0_IAM_Rx_IFasnThrdRowMidSbltIndCmd_ISDM_20ms_Group01_SDM_CHCANFD_20ms_FrP01_CONTROLLER_0_IAM_Rx, ComSignalType=UINT8
          IFasnThrdRowMidSbltAtcV_ISDM_20ms_Group01_SDM_CHCANFD_20ms_FrP01_CONTROLLER_0_IAM_Rx: ComBitPosition=46, ComBitSize=1, ComHandleId=ISDM_20ms_Group01_SDM_CHCANFD_20ms_FrP01_CONTROLLER_0_IAM_Rx_IFasnThrdRowMidSbltAtcV_ISDM_20ms_Group01_SDM_CHCANFD_20ms_FrP01_CONTROLLER_0_IAM_Rx, ComSignalType=BOOLEAN
          IFasnThrdRowMidSbltAtc_ISDM_20ms_Group01_SDM_CHCANFD_20ms_FrP01_CONTROLLER_0_IAM_Rx: ComBitPosition=47, ComBitSize=1, ComHandleId=ISDM_20ms_Group01_SDM_CHCANFD_20ms_FrP01_CONTROLLER_0_IAM_Rx_IFasnThrdRowMidSbltAtc_ISDM_20ms_Group01_SDM_CHCANFD_20ms_FrP01_CONTROLLER_0_IAM_Rx, ComSignalType=BOOLEAN
          IFrtPsngSbltAtcV_ISDM_20ms_Group01_SDM_CHCANFD_20ms_FrP01_CONTROLLER_0_IAM_Rx: ComBitPosition=48, ComBitSize=1, ComHandleId=ISDM_20ms_Group01_SDM_CHCANFD_20ms_FrP01_CONTROLLER_0_IAM_Rx_IFrtPsngSbltAtcV_ISDM_20ms_Group01_SDM_CHCANFD_20ms_FrP01_CONTROLLER_0_IAM_Rx, ComSignalType=BOOLEAN
          IFrtPsngSbltAtc_ISDM_20ms_Group01_SDM_CHCANFD_20ms_FrP01_CONTROLLER_0_IAM_Rx: ComBitPosition=49, ComBitSize=1, ComHandleId=ISDM_20ms_Group01_SDM_CHCANFD_20ms_FrP01_CONTROLLER_0_IAM_Rx_IFrtPsngSbltAtc_ISDM_20ms_Group01_SDM_CHCANFD_20ms_FrP01_CONTROLLER_0_IAM_Rx, ComSignalType=BOOLEAN
          ISDM_20ms_Group01_Reserved3_ISDM_20ms_Group01_SDM_CHCANFD_20ms_FrP01_CONTROLLER_0_IAM_Rx: ComBitPosition=50, ComBitSize=6, ComHandleId=ISDM_20ms_Group01_SDM_CHCANFD_20ms_FrP01_CONTROLLER_0_IAM_Rx_ISDM_20ms_Group01_Reserved3_ISDM_20ms_Group01_SDM_CHCANFD_20ms_FrP01_CONTROLLER_0_IAM_Rx, ComSignalType=UINT8
          ISDM_20ms_Group01_Reserved4_ISDM_20ms_Group01_SDM_CHCANFD_20ms_FrP01_CONTROLLER_0_IAM_Rx: ComBitPosition=56, ComBitSize=8, ComHandleId=ISDM_20ms_Group01_SDM_CHCANFD_20ms_FrP01_CONTROLLER_0_IAM_Rx_ISDM_20ms_Group01_Reserved4_ISDM_20ms_Group01_SDM_CHCANFD_20ms_FrP01_CONTROLLER_0_IAM_Rx, ComSignalType=UINT8
      ICBVC_RZCUCANFD_20ms_FrP00_CONTROLLER_0_IAM_Rx (ComIPdu):
        ComIPduCancellationSupport = false
        ComIPduDirection = RECEIVE
        ComIPduHandleId = COM_RXPDU_COM_ICBVC_RZCUCANFD_20ms_FrP00_CONTROLLER_0_IAM_Rx
        ComIPduSignalProcessing = DEFERRED
        ComIPduType = NORMAL
        ComPduIdRef = COM_ICBVC_RZCUCANFD_20ms_FrP00_CONTROLLER_0_IAM_Rx
        ComIPduSignalRef = INFCSMAvlbly_ICBVC_RZCUCANFD_20ms_FrP00_CONTROLLER_0_IAM_Rx
        ComIPduSignalRef = INFCAMAvlbly_ICBVC_RZCUCANFD_20ms_FrP00_CONTROLLER_0_IAM_Rx
        ComIPduSignalRef = ISDMAvlbly_ICBVC_RZCUCANFD_20ms_FrP00_CONTROLLER_0_IAM_Rx
        ComIPduSignalRef = IRHZCUAvlbly_ICBVC_RZCUCANFD_20ms_FrP00_CONTROLLER_0_IAM_Rx
        ComIPduSignalRef = ILHZCUAvlbly_ICBVC_RZCUCANFD_20ms_FrP00_CONTROLLER_0_IAM_Rx
        ComIPduSignalRef = ITC_ExtdAvlbly_ICBVC_RZCUCANFD_20ms_FrP00_CONTROLLER_0_IAM_Rx
        ComIPduSignalRef = IIBS_SFAvlbly_ICBVC_RZCUCANFD_20ms_FrP00_CONTROLLER_0_IAM_Rx
        ComIPduSignalRef = IEPSAvlbly_ICBVC_RZCUCANFD_20ms_FrP00_CONTROLLER_0_IAM_Rx
        ComIPduSignalRef = ITC_PTAvlbly_ICBVC_RZCUCANFD_20ms_FrP00_CONTROLLER_0_IAM_Rx
        ComIPduSignalRef = IECM_PTAvlbly_ICBVC_RZCUCANFD_20ms_FrP00_CONTROLLER_0_IAM_Rx
        ComIPduSignalRef = ILVBM_ExtdAvlbly_ICBVC_RZCUCANFD_20ms_FrP00_CONTROLLER_0_IAM_Rx
        ComIPduSignalRef = IRZCU_RZCUCANFDAvlbly_ICBVC_RZCUCANFD_20ms_FrP00_CONTROLLER_0_IAM_Rx
        ComIPduSignalRef = IPEU_PTAvlbly_ICBVC_RZCUCANFD_20ms_FrP00_CONTROLLER_0_IAM_Rx
        ComIPduSignalRef = IPEU_ERAvlbly_ICBVC_RZCUCANFD_20ms_FrP00_CONTROLLER_0_IAM_Rx
        ComIPduSignalRef = IECM_ERAvlbly_ICBVC_RZCUCANFD_20ms_FrP00_CONTROLLER_0_IAM_Rx
        ComIPduSignalRef = IIPD_RZCUCANFDAvlbly_ICBVC_RZCUCANFD_20ms_FrP00_CONTROLLER_0_IAM_Rx
        ComIPduSignalRef = IESS_PTAvlbly_ICBVC_RZCUCANFD_20ms_FrP00_CONTROLLER_0_IAM_Rx
        ComIPduSignalRef = ICCU_ExtdAvlbly_ICBVC_RZCUCANFD_20ms_FrP00_CONTROLLER_0_IAM_Rx
        ComIPduSignalRef = IESS_ExtdAvlbly_ICBVC_RZCUCANFD_20ms_FrP00_CONTROLLER_0_IAM_Rx
        ComIPduSignalRef = ICCU_PTAvlbly_ICBVC_RZCUCANFD_20ms_FrP00_CONTROLLER_0_IAM_Rx
        ComIPduSignalRef = IIAMAvlbly_ICBVC_RZCUCANFD_20ms_FrP00_CONTROLLER_0_IAM_Rx
        ComIPduSignalRef = IEAC_Avlbly_ICBVC_RZCUCANFD_20ms_FrP00_CONTROLLER_0_IAM_Rx
        ComIPduSignalRef = IIPD_SFAvlbly_ICBVC_RZCUCANFD_20ms_FrP00_CONTROLLER_0_IAM_Rx
        ComIPduSignalRef = IRZCU_BKBCANFDAvlbly_ICBVC_RZCUCANFD_20ms_FrP00_CONTROLLER_0_IAM_Rx
        ComIPduSignalRef = IIPD_BKPCANFDAvlbly_ICBVC_RZCUCANFD_20ms_FrP00_CONTROLLER_0_IAM_Rx
        ComIPduSignalRef = IIBS_CHAvlbly_ICBVC_RZCUCANFD_20ms_FrP00_CONTROLLER_0_IAM_Rx
        ComIPduSignalRef = IFDRAvlbly_ICBVC_RZCUCANFD_20ms_FrP00_CONTROLLER_0_IAM_Rx
        ComIPduSignalRef = IRWSAvlbly_ICBVC_RZCUCANFD_20ms_FrP00_CONTROLLER_0_IAM_Rx
        ComIPduSignalRef = ISCMAvlbly_ICBVC_RZCUCANFD_20ms_FrP00_CONTROLLER_0_IAM_Rx
        ComIPduSignalRef = ITPMSAvlbly_ICBVC_RZCUCANFD_20ms_FrP00_CONTROLLER_0_IAM_Rx
        ComIPduGroupRef = Com_RxPduGroup_CONTROLLER_0_IAM
      30 x ComSignal, all with ComBitSize=1, ComInvalidNotification=NULL_PTR, ComRxDataTimeoutAction=NONE, ComSignalEndianness=BIG_ENDIAN, ComSignalInitValue=0x0, ComSignalLength=0, ComSignalType=BOOLEAN, ComTransferProperty=PENDING, ComSignalDataInvalidValue=0x0, ComDataInvalidAction=NOTIFY, ComTimeout=0.0, ComFirstTimeout=0.0, ComNotification=Rte_COMCbk:
        INFCSMAvlbly_ICBVC_RZCUCANFD_20ms_FrP00_CONTROLLER_0_IAM_Rx: ComBitPosition=1, ComHandleId=INFCSMAvlbly_ICBVC_RZCUCANFD_20ms_FrP00_CONTROLLER_0_IAM_Rx
        INFCAMAvlbly_ICBVC_RZCUCANFD_20ms_FrP00_CONTROLLER_0_IAM_Rx: ComBitPosition=2, ComHandleId=INFCAMAvlbly_ICBVC_RZCUCANFD_20ms_FrP00_CONTROLLER_0_IAM_Rx
        ISDMAvlbly_ICBVC_RZCUCANFD_20ms_FrP00_CONTROLLER_0_IAM_Rx: ComBitPosition=5, ComHandleId=ISDMAvlbly_ICBVC_RZCUCANFD_20ms_FrP00_CONTROLLER_0_IAM_Rx
        IRHZCUAvlbly_ICBVC_RZCUCANFD_20ms_FrP00_CONTROLLER_0_IAM_Rx: ComBitPosition=6, ComHandleId=IRHZCUAvlbly_ICBVC_RZCUCANFD_20ms_FrP00_CONTROLLER_0_IAM_Rx
        ILHZCUAvlbly_ICBVC_RZCUCANFD_20ms_FrP00_CONTROLLER_0_IAM_Rx: ComBitPosition=7, ComHandleId=ILHZCUAvlbly_ICBVC_RZCUCANFD_20ms_FrP00_CONTROLLER_0_IAM_Rx
        ITC_ExtdAvlbly_ICBVC_RZCUCANFD_20ms_FrP00_CONTROLLER_0_IAM_Rx: ComBitPosition=8, ComHandleId=ITC_ExtdAvlbly_ICBVC_RZCUCANFD_20ms_FrP00_CONTROLLER_0_IAM_Rx
        IIBS_SFAvlbly_ICBVC_RZCUCANFD_20ms_FrP00_CONTROLLER_0_IAM_Rx: ComBitPosition=9, ComHandleId=IIBS_SFAvlbly_ICBVC_RZCUCANFD_20ms_FrP00_CONTROLLER_0_IAM_Rx
        IEPSAvlbly_ICBVC_RZCUCANFD_20ms_FrP00_CONTROLLER_0_IAM_Rx: ComBitPosition=10, ComHandleId=IEPSAvlbly_ICBVC_RZCUCANFD_20ms_FrP00_CONTROLLER_0_IAM_Rx
        ITC_PTAvlbly_ICBVC_RZCUCANFD_20ms_FrP00_CONTROLLER_0_IAM_Rx: ComBitPosition=12, ComHandleId=ITC_PTAvlbly_ICBVC_RZCUCANFD_20ms_FrP00_CONTROLLER_0_IAM_Rx
        IECM_PTAvlbly_ICBVC_RZCUCANFD_20ms_FrP00_CONTROLLER_0_IAM_Rx: ComBitPosition=13, ComHandleId=IECM_PTAvlbly_ICBVC_RZCUCANFD_20ms_FrP00_CONTROLLER_0_IAM_Rx
        ILVBM_ExtdAvlbly_ICBVC_RZCUCANFD_20ms_FrP00_CONTROLLER_0_IAM_Rx: ComBitPosition=14, ComHandleId=ILVBM_ExtdAvlbly_ICBVC_RZCUCANFD_20ms_FrP00_CONTROLLER_0_IAM_Rx
        IRZCU_RZCUCANFDAvlbly_ICBVC_RZCUCANFD_20ms_FrP00_CONTROLLER_0_IAM_Rx: ComBitPosition=15, ComHandleId=IRZCU_RZCUCANFDAvlbly_ICBVC_RZCUCANFD_20ms_FrP00_CONTROLLER_0_IAM_Rx
        IPEU_PTAvlbly_ICBVC_RZCUCANFD_20ms_FrP00_CONTROLLER_0_IAM_Rx: ComBitPosition=16, ComHandleId=IPEU_PTAvlbly_ICBVC_RZCUCANFD_20ms_FrP00_CONTROLLER_0_IAM_Rx
        IPEU_ERAvlbly_ICBVC_RZCUCANFD_20ms_FrP00_CONTROLLER_0_IAM_Rx: ComBitPosition=17, ComHandleId=IPEU_ERAvlbly_ICBVC_RZCUCANFD_20ms_FrP00_CONTROLLER_0_IAM_Rx
        IECM_ERAvlbly_ICBVC_RZCUCANFD_20ms_FrP00_CONTROLLER_0_IAM_Rx: ComBitPosition=18, ComHandleId=IECM_ERAvlbly_ICBVC_RZCUCANFD_20ms_FrP00_CONTROLLER_0_IAM_Rx
        IIPD_RZCUCANFDAvlbly_ICBVC_RZCUCANFD_20ms_FrP00_CONTROLLER_0_IAM_Rx: ComBitPosition=20, ComHandleId=IIPD_RZCUCANFDAvlbly_ICBVC_RZCUCANFD_20ms_FrP00_CONTROLLER_0_IAM_Rx
        IESS_PTAvlbly_ICBVC_RZCUCANFD_20ms_FrP00_CONTROLLER_0_IAM_Rx: ComBitPosition=22, ComHandleId=IESS_PTAvlbly_ICBVC_RZCUCANFD_20ms_FrP00_CONTROLLER_0_IAM_Rx
        ICCU_ExtdAvlbly_ICBVC_RZCUCANFD_20ms_FrP00_CONTROLLER_0_IAM_Rx: ComBitPosition=23, ComHandleId=ICCU_ExtdAvlbly_ICBVC_RZCUCANFD_20ms_FrP00_CONTROLLER_0_IAM_Rx
        IESS_ExtdAvlbly_ICBVC_RZCUCANFD_20ms_FrP00_CONTROLLER_0_IAM_Rx: ComBitPosition=24, ComHandleId=IESS_ExtdAvlbly_ICBVC_RZCUCANFD_20ms_FrP00_CONTROLLER_0_IAM_Rx
        ICCU_PTAvlbly_ICBVC_RZCUCANFD_20ms_FrP00_CONTROLLER_0_IAM_Rx: ComBitPosition=25, ComHandleId=ICCU_PTAvlbly_ICBVC_RZCUCANFD_20ms_FrP00_CONTROLLER_0_IAM_Rx
        IIAMAvlbly_ICBVC_RZCUCANFD_20ms_FrP00_CONTROLLER_0_IAM_Rx: ComBitPosition=26, ComHandleId=IIAMAvlbly_ICBVC_RZCUCANFD_20ms_FrP00_CONTROLLER_0_IAM_Rx
        IEAC_Avlbly_ICBVC_RZCUCANFD_20ms_FrP00_CONTROLLER_0_IAM_Rx: ComBitPosition=27, ComHandleId=IEAC_Avlbly_ICBVC_RZCUCANFD_20ms_FrP00_CONTROLLER_0_IAM_Rx
        IIPD_SFAvlbly_ICBVC_RZCUCANFD_20ms_FrP00_CONTROLLER_0_IAM_Rx: ComBitPosition=33, ComHandleId=IIPD_SFAvlbly_ICBVC_RZCUCANFD_20ms_FrP00_CONTROLLER_0_IAM_Rx
        IRZCU_BKBCANFDAvlbly_ICBVC_RZCUCANFD_20ms_FrP00_CONTROLLER_0_IAM_Rx: ComBitPosition=39, ComHandleId=IRZCU_BKBCANFDAvlbly_ICBVC_RZCUCANFD_20ms_FrP00_CONTROLLER_0_IAM_Rx
        IIPD_BKPCANFDAvlbly_ICBVC_RZCUCANFD_20ms_FrP00_CONTROLLER_0_IAM_Rx: ComBitPosition=40, ComHandleId=IIPD_BKPCANFDAvlbly_ICBVC_RZCUCANFD_20ms_FrP00_CONTROLLER_0_IAM_Rx
        IIBS_CHAvlbly_ICBVC_RZCUCANFD_20ms_FrP00_CONTROLLER_0_IAM_Rx: ComBitPosition=43, ComHandleId=IIBS_CHAvlbly_ICBVC_RZCUCANFD_20ms_FrP00_CONTROLLER_0_IAM_Rx
        IFDRAvlbly_ICBVC_RZCUCANFD_20ms_FrP00_CONTROLLER_0_IAM_Rx: ComBitPosition=44, ComHandleId=IFDRAvlbly_ICBVC_RZCUCANFD_20ms_FrP00_CONTROLLER_0_IAM_Rx
        IRWSAvlbly_ICBVC_RZCUCANFD_20ms_FrP00_CONTROLLER_0_IAM_Rx: ComBitPosition=52, ComHandleId=IRWSAvlbly_ICBVC_RZCUCANFD_20ms_FrP00_CONTROLLER_0_IAM_Rx
        ISCMAvlbly_ICBVC_RZCUCANFD_20ms_FrP00_CONTROLLER_0_IAM_Rx: ComBitPosition=57, ComHandleId=ISCMAvlbly_ICBVC_RZCUCANFD_20ms_FrP00_CONTROLLER_0_IAM_Rx
        ITPMSAvlbly_ICBVC_RZCUCANFD_20ms_FrP00_CONTROLLER_0_IAM_Rx: ComBitPosition=63, ComHandleId=ITPMSAvlbly_ICBVC_RZCUCANFD_20ms_FrP00_CONTROLLER_0_IAM_Rx
      PEU_PTCANFD_100ms_FrP03_CONTROLLER_0_IAM_Rx (ComIPdu):
        ComIPduCancellationSupport = false
        ComIPduDirection = RECEIVE
        ComIPduHandleId = COM_RXPDU_COM_PEU_PTCANFD_100ms_FrP03_CONTROLLER_0_IAM_Rx
        ComIPduSignalProcessing = DEFERRED
        ComIPduType = NORMAL
        ComIPduCallout = PEU_PTCANFD_100ms_FrP03_CONTROLLER_0_IAM_Rx
        ComPduIdRef = COM_PEU_PTCANFD_100ms_FrP03_CONTROLLER_0_IAM_Rx
        ComIPduSignalGroupRef = IPEU_100ms_Group03_PEU_PTCANFD_100ms_FrP03_CONTROLLER_0_IAM_Rx
        ComIPduGroupRef = Com_RxPduGroup_CONTROLLER_0_IAM
      IPEU_100ms_Group03_PEU_PTCANFD_100ms_FrP03_CONTROLLER_0_IAM_Rx (ComSignalGroup):
        ComHandleId = IPEU_100ms_Group03_PEU_PTCANFD_100ms_FrP03_CONTROLLER_0_IAM_Rx
        ComInvalidNotification = NULL_PTR
        ComRxDataTimeoutAction = NONE
        ComTransferProperty = PENDING
        ComDataInvalidAction = NOTIFY
        ComTimeout = 0.0
        ComFirstTimeout = 0.0
        ComNotification = Rte_COMCbk
        19 x ComGroupSignal, all with ComSignalEndianness=BIG_ENDIAN, ComSignalInitValue=0x0, ComSignalLength=0, ComSignalDataInvalidValue=0x0:
          IPEU_100ms_Group03_CRC_IPEU_100ms_Group03_PEU_PTCANFD_100ms_FrP03_CONTROLLER_0_IAM_Rx: ComBitPosition=0, ComBitSize=8, ComHandleId=IPEU_100ms_Group03_PEU_PTCANFD_100ms_FrP03_CONTROLLER_0_IAM_Rx_IPEU_100ms_Group03_CRC_IPEU_100ms_Group03_PEU_PTCANFD_100ms_FrP03_CONTROLLER_0_IAM_Rx, ComSignalType=UINT8
          IPEU_100ms_Group03_RC_IPEU_100ms_Group03_PEU_PTCANFD_100ms_FrP03_CONTROLLER_0_IAM_Rx: ComBitPosition=8, ComBitSize=4, ComHandleId=IPEU_100ms_Group03_PEU_PTCANFD_100ms_FrP03_CONTROLLER_0_IAM_Rx_IPEU_100ms_Group03_RC_IPEU_100ms_Group03_PEU_PTCANFD_100ms_FrP03_CONTROLLER_0_IAM_Rx, ComSignalType=UINT8
          ISAMHVInhd_PEU_IPEU_100ms_Group03_PEU_PTCANFD_100ms_FrP03_CONTROLLER_0_IAM_Rx: ComBitPosition=12, ComBitSize=1, ComHandleId=IPEU_100ms_Group03_PEU_PTCANFD_100ms_FrP03_CONTROLLER_0_IAM_Rx_ISAMHVInhd_PEU_IPEU_100ms_Group03_PEU_PTCANFD_100ms_FrP03_CONTROLLER_0_IAM_Rx, ComSignalType=BOOLEAN
          IEPTSysCoolResp_PEU_IPEU_100ms_Group03_PEU_PTCANFD_100ms_FrP03_CONTROLLER_0_IAM_Rx: ComBitPosition=13, ComBitSize=3, ComHandleId=IPEU_100ms_Group03_PEU_PTCANFD_100ms_FrP03_CONTROLLER_0_IAM_Rx_IEPTSysCoolResp_PEU_IPEU_100ms_Group03_PEU_PTCANFD_100ms_FrP03_CONTROLLER_0_IAM_Rx, ComSignalType=UINT8
          ISAMSttrTem_PEU_IPEU_100ms_Group03_PEU_PTCANFD_100ms_FrP03_CONTROLLER_0_IAM_Rx: ComBitPosition=16, ComBitSize=8, ComHandleId=IPEU_100ms_Group03_PEU_PTCANFD_100ms_FrP03_CONTROLLER_0_IAM_Rx_ISAMSttrTem_PEU_IPEU_100ms_Group03_PEU_PTCANFD_100ms_FrP03_CONTROLLER_0_IAM_Rx, ComSignalType=UINT8
          ISAMInvtrTem_PEU_IPEU_100ms_Group03_PEU_PTCANFD_100ms_FrP03_CONTROLLER_0_IAM_Rx: ComBitPosition=24, ComBitSize=8, ComHandleId=IPEU_100ms_Group03_PEU_PTCANFD_100ms_FrP03_CONTROLLER_0_IAM_Rx_ISAMInvtrTem_PEU_IPEU_100ms_Group03_PEU_PTCANFD_100ms_FrP03_CONTROLLER_0_IAM_Rx, ComSignalType=UINT8
          IPEU_100ms_Group03_Reserved2_IPEU_100ms_Group03_PEU_PTCANFD_100ms_FrP03_CONTROLLER_0_IAM_Rx: ComBitPosition=47, ComBitSize=2, ComHandleId=IPEU_100ms_Group03_PEU_PTCANFD_100ms_FrP03_CONTROLLER_0_IAM_Rx_IPEU_100ms_Group03_Reserved2_IPEU_100ms_Group03_PEU_PTCANFD_100ms_FrP03_CONTROLLER_0_IAM_Rx, ComSignalType=UINT8
          ISAMAShrtCircuitRdy_PEU_IPEU_100ms_Group03_PEU_PTCANFD_100ms_FrP03_CONTROLLER_0_IAM_Rx: ComBitPosition=33, ComBitSize=1, ComHandleId=IPEU_100ms_Group03_PEU_PTCANFD_100ms_FrP03_CONTROLLER_0_IAM_Rx_ISAMAShrtCircuitRdy_PEU_IPEU_100ms_Group03_PEU_PTCANFD_100ms_FrP03_CONTROLLER_0_IAM_Rx, ComSignalType=BOOLEAN
          ISAMSttrTemV_IPEU_100ms_Group03_PEU_PTCANFD_100ms_FrP03_CONTROLLER_0_IAM_Rx: ComBitPosition=34, ComBitSize=1, ComHandleId=IPEU_100ms_Group03_PEU_PTCANFD_100ms_FrP03_CONTROLLER_0_IAM_Rx_ISAMSttrTemV_IPEU_100ms_Group03_PEU_PTCANFD_100ms_FrP03_CONTROLLER_0_IAM_Rx, ComSignalType=BOOLEAN
          ISAMOvhtd_IPEU_100ms_Group03_PEU_PTCANFD_100ms_FrP03_CONTROLLER_0_IAM_Rx: ComBitPosition=35, ComBitSize=1, ComHandleId=IPEU_100ms_Group03_PEU_PTCANFD_100ms_FrP03_CONTROLLER_0_IAM_Rx_ISAMOvhtd_IPEU_100ms_Group03_PEU_PTCANFD_100ms_FrP03_CONTROLLER_0_IAM_Rx, ComSignalType=BOOLEAN
          ISAMInvtrTemV_IPEU_100ms_Group03_PEU_PTCANFD_100ms_FrP03_CONTROLLER_0_IAM_Rx: ComBitPosition=36, ComBitSize=1, ComHandleId=IPEU_100ms_Group03_PEU_PTCANFD_100ms_FrP03_CONTROLLER_0_IAM_Rx_ISAMInvtrTemV_IPEU_100ms_Group03_PEU_PTCANFD_100ms_FrP03_CONTROLLER_0_IAM_Rx, ComSignalType=BOOLEAN
          IISGHVILSts_IPEU_100ms_Group03_PEU_PTCANFD_100ms_FrP03_CONTROLLER_0_IAM_Rx: ComBitPosition=37, ComBitSize=2, ComHandleId=IPEU_100ms_Group03_PEU_PTCANFD_100ms_FrP03_CONTROLLER_0_IAM_Rx_IISGHVILSts_IPEU_100ms_Group03_PEU_PTCANFD_100ms_FrP03_CONTROLLER_0_IAM_Rx, ComSignalType=UINT8
          IPEU_100ms_Group03_Reserved1_IPEU_100ms_Group03_PEU_PTCANFD_100ms_FrP03_CONTROLLER_0_IAM_Rx: ComBitPosition=39, ComBitSize=1, ComHandleId=IPEU_100ms_Group03_PEU_PTCANFD_100ms_FrP03_CONTROLLER_0_IAM_Rx_IPEU_100ms_Group03_Reserved1_IPEU_100ms_Group03_PEU_PTCANFD_100ms_FrP03_CONTROLLER_0_IAM_Rx, ComSignalType=BOOLEAN
          IPEU_100ms_Group03_Reserved3_IPEU_100ms_Group03_PEU_PTCANFD_100ms_FrP03_CONTROLLER_0_IAM_Rx: ComBitPosition=40, ComBitSize=3, ComHandleId=IPEU_100ms_Group03_PEU_PTCANFD_100ms_FrP03_CONTROLLER_0_IAM_Rx_IPEU_100ms_Group03_Reserved3_IPEU_100ms_Group03_PEU_PTCANFD_100ms_FrP03_CONTROLLER_0_IAM_Rx, ComSignalType=UINT8
          ISAMHVILSts_PEU_IPEU_100ms_Group03_PEU_PTCANFD_100ms_FrP03_CONTROLLER_0_IAM_Rx: ComBitPosition=43, ComBitSize=2, ComHandleId=IPEU_100ms_Group03_PEU_PTCANFD_100ms_FrP03_CONTROLLER_0_IAM_Rx_ISAMHVILSts_PEU_IPEU_100ms_Group03_PEU_PTCANFD_100ms_FrP03_CONTROLLER_0_IAM_Rx, ComSignalType=UINT8
          ISAMToqDrtng_PEU_IPEU_100ms_Group03_PEU_PTCANFD_100ms_FrP03_CONTROLLER_0_IAM_Rx: ComBitPosition=45, ComBitSize=1, ComHandleId=IPEU_100ms_Group03_PEU_PTCANFD_100ms_FrP03_CONTROLLER_0_IAM_Rx_ISAMToqDrtng_PEU_IPEU_100ms_Group03_PEU_PTCANFD_100ms_FrP03_CONTROLLER_0_IAM_Rx, ComSignalType=BOOLEAN
          ISAMOfstAngCalReq_PEU_IPEU_100ms_Group03_PEU_PTCANFD_100ms_FrP03_CONTROLLER_0_IAM_Rx: ComBitPosition=46, ComBitSize=1, ComHandleId=IPEU_100ms_Group03_PEU_PTCANFD_100ms_FrP03_CONTROLLER_0_IAM_Rx_ISAMOfstAngCalReq_PEU_IPEU_100ms_Group03_PEU_PTCANFD_100ms_FrP03_CONTROLLER_0_IAM_Rx, ComSignalType=BOOLEAN
          IPEU_100ms_Group03_Reserved4_IPEU_100ms_Group03_PEU_PTCANFD_100ms_FrP03_CONTROLLER_0_IAM_Rx: ComBitPosition=48, ComBitSize=8, ComHandleId=IPEU_100ms_Group03_PEU_PTCANFD_100ms_FrP03_CONTROLLER_0_IAM_Rx_IPEU_100ms_Group03_Reserved4_IPEU_100ms_Group03_PEU_PTCANFD_100ms_FrP03_CONTROLLER_0_IAM_Rx, ComSignalType=UINT8
          IPEU_100ms_Group03_Reserved5_IPEU_100ms_Group03_PEU_PTCANFD_100ms_FrP03_CONTROLLER_0_IAM_Rx: ComBitPosition=56, ComBitSize=8, ComHandleId=IPEU_100ms_Group03_PEU_PTCANFD_100ms_FrP03_CONTROLLER_0_IAM_Rx_IPEU_100ms_Group03_Reserved5_IPEU_100ms_Group03_PEU_PTCANFD_100ms_FrP03_CONTROLLER_0_IAM_Rx, ComSignalType=UINT8
      ICBAD_BKPCANFD_20ms_FrP07_CONTROLLER_0_IAM_Rx (ComIPdu):
        ComIPduCancellationSupport = false
        ComIPduDirection = RECEIVE
        ComIPduHandleId = COM_RXPDU_COM_ICBAD_BKPCANFD_20ms_FrP07_CONTROLLER_0_IAM_Rx
        ComIPduSignalProcessing = DEFERRED
        ComIPduType = NORMAL
        ComIPduCallout = ICBAD_BKPCANFD_20ms_FrP07_CONTROLLER_0_IAM_Rx
        ComPduIdRef = COM_ICBAD_BKPCANFD_20ms_FrP07_CONTROLLER_0_IAM_Rx
        ComIPduSignalGroupRef = IICBAD_20ms_Group07_ICBAD_BKPCANFD_20ms_FrP07_CONTROLLER_0_IAM_Rx
        ComIPduGroupRef = Com_RxPduGroup_CONTROLLER_0_IAM
      IICBAD_20ms_Group07_ICBAD_BKPCANFD_20ms_FrP07_CONTROLLER_0_IAM_Rx (ComSignalGroup):
        ComHandleId = IICBAD_20ms_Group07_ICBAD_BKPCANFD_20ms_FrP07_CONTROLLER_0_IAM_Rx
        ComInvalidNotification = NULL_PTR
        ComRxDataTimeoutAction = NONE
        ComTransferProperty = PENDING
        ComDataInvalidAction = NOTIFY
        ComTimeout = 0.0
        ComFirstTimeout = 0.0
        ComNotification = Rte_COMCbk
        25 x ComGroupSignal, all with ComSignalEndianness=BIG_ENDIAN, ComSignalInitValue=0x0, ComSignalLength=0, ComSignalDataInvalidValue=0x0:
          IICBAD_20ms_Group07_CRC_IICBAD_20ms_Group07_ICBAD_BKPCANFD_20ms_FrP07_CONTROLLER_0_IAM_Rx: ComBitPosition=0, ComBitSize=8, ComHandleId=IICBAD_20ms_Group07_ICBAD_BKPCANFD_20ms_FrP07_CONTROLLER_0_IAM_Rx_IICBAD_20ms_Group07_CRC_IICBAD_20ms_Group07_ICBAD_BKPCANFD_20ms_FrP07_CONTROLLER_0_IAM_Rx, ComSignalType=UINT8
          IICBAD_20ms_Group07_RC_IICBAD_20ms_Group07_ICBAD_BKPCANFD_20ms_FrP07_CONTROLLER_0_IAM_Rx: ComBitPosition=8, ComBitSize=4, ComHandleId=IICBAD_20ms_Group07_ICBAD_BKPCANFD_20ms_FrP07_CONTROLLER_0_IAM_Rx_IICBAD_20ms_Group07_RC_IICBAD_20ms_Group07_ICBAD_BKPCANFD_20ms_FrP07_CONTROLLER_0_IAM_Rx, ComSignalType=UINT8
          IACCSdslReq_IICBAD_20ms_Group07_ICBAD_BKPCANFD_20ms_FrP07_CONTROLLER_0_IAM_Rx: ComBitPosition=12, ComBitSize=1, ComHandleId=IICBAD_20ms_Group07_ICBAD_BKPCANFD_20ms_FrP07_CONTROLLER_0_IAM_Rx_IACCSdslReq_IICBAD_20ms_Group07_ICBAD_BKPCANFD_20ms_FrP07_CONTROLLER_0_IAM_Rx, ComSignalType=BOOLEAN
          IACCGoReq_IICBAD_20ms_Group07_ICBAD_BKPCANFD_20ms_FrP07_CONTROLLER_0_IAM_Rx: ComBitPosition=13, ComBitSize=1, ComHandleId=IICBAD_20ms_Group07_ICBAD_BKPCANFD_20ms_FrP07_CONTROLLER_0_IAM_Rx_IACCGoReq_IICBAD_20ms_Group07_ICBAD_BKPCANFD_20ms_FrP07_CONTROLLER_0_IAM_Rx, ComSignalType=BOOLEAN
          IACCAccReqSts_CH_IICBAD_20ms_Group07_ICBAD_BKPCANFD_20ms_FrP07_CONTROLLER_0_IAM_Rx: ComBitPosition=14, ComBitSize=2, ComHandleId=IICBAD_20ms_Group07_ICBAD_BKPCANFD_20ms_FrP07_CONTROLLER_0_IAM_Rx_IACCAccReqSts_CH_IICBAD_20ms_Group07_ICBAD_BKPCANFD_20ms_FrP07_CONTROLLER_0_IAM_Rx, ComSignalType=UINT8
          IACCAccReqVal_IICBAD_20ms_Group07_ICBAD_BKPCANFD_20ms_FrP07_CONTROLLER_0_IAM_Rx: ComBitPosition=24, ComBitSize=11, ComHandleId=IICBAD_20ms_Group07_ICBAD_BKPCANFD_20ms_FrP07_CONTROLLER_0_IAM_Rx_IACCAccReqVal_IICBAD_20ms_Group07_ICBAD_BKPCANFD_20ms_FrP07_CONTROLLER_0_IAM_Rx, ComSignalType=UINT16
          IAPAEPBOPReq_IICBAD_20ms_Group07_ICBAD_BKPCANFD_20ms_FrP07_CONTROLLER_0_IAM_Rx: ComBitPosition=19, ComBitSize=2, ComHandleId=IICBAD_20ms_Group07_ICBAD_BKPCANFD_20ms_FrP07_CONTROLLER_0_IAM_Rx_IAPAEPBOPReq_IICBAD_20ms_Group07_ICBAD_BKPCANFD_20ms_FrP07_CONTROLLER_0_IAM_Rx, ComSignalType=UINT8
          IACCSysFltSts_IICBAD_20ms_Group07_ICBAD_BKPCANFD_20ms_FrP07_CONTROLLER_0_IAM_Rx: ComBitPosition=21, ComBitSize=3, ComHandleId=IICBAD_20ms_Group07_ICBAD_BKPCANFD_20ms_FrP07_CONTROLLER_0_IAM_Rx_IACCSysFltSts_IICBAD_20ms_Group07_ICBAD_BKPCANFD_20ms_FrP07_CONTROLLER_0_IAM_Rx, ComSignalType=UINT8
          IAIPkgAPASCSAcclReqVal_IICBAD_20ms_Group07_ICBAD_BKPCANFD_20ms_FrP07_CONTROLLER_0_IAM_Rx: ComBitPosition=40, ComBitSize=11, ComHandleId=IICBAD_20ms_Group07_ICBAD_BKPCANFD_20ms_FrP07_CONTROLLER_0_IAM_Rx_IAIPkgAPASCSAcclReqVal_IICBAD_20ms_Group07_ICBAD_BKPCANFD_20ms_FrP07_CONTROLLER_0_IAM_Rx, ComSignalType=UINT16
          IACCSysSts_IICBAD_20ms_Group07_ICBAD_BKPCANFD_20ms_FrP07_CONTROLLER_0_IAM_Rx: ComBitPosition=35, ComBitSize=3, ComHandleId=IICBAD_20ms_Group07_ICBAD_BKPCANFD_20ms_FrP07_CONTROLLER_0_IAM_Rx_IACCSysSts_IICBAD_20ms_Group07_ICBAD_BKPCANFD_20ms_FrP07_CONTROLLER_0_IAM_Rx, ComSignalType=UINT8
          IAPASCSAcclReqSts_IICBAD_20ms_Group07_ICBAD_BKPCANFD_20ms_FrP07_CONTROLLER_0_IAM_Rx: ComBitPosition=38, ComBitSize=1, ComHandleId=IICBAD_20ms_Group07_ICBAD_BKPCANFD_20ms_FrP07_CONTROLLER_0_IAM_Rx_IAPASCSAcclReqSts_IICBAD_20ms_Group07_ICBAD_BKPCANFD_20ms_FrP07_CONTROLLER_0_IAM_Rx, ComSignalType=BOOLEAN
          IAPAEPBOPReqV_IICBAD_20ms_Group07_ICBAD_BKPCANFD_20ms_FrP07_CONTROLLER_0_IAM_Rx: ComBitPosition=39, ComBitSize=1, ComHandleId=IICBAD_20ms_Group07_ICBAD_BKPCANFD_20ms_FrP07_CONTROLLER_0_IAM_Rx_IAPAEPBOPReqV_IICBAD_20ms_Group07_ICBAD_BKPCANFD_20ms_FrP07_CONTROLLER_0_IAM_Rx, ComSignalType=BOOLEAN
          IAutodDrvngSysSCSSdslReqV_IICBAD_20ms_Group07_ICBAD_BKPCANFD_20ms_FrP07_CONTROLLER_0_IAM_Rx: ComBitPosition=48, ComBitSize=1, ComHandleId=IICBAD_20ms_Group07_ICBAD_BKPCANFD_20ms_FrP07_CONTROLLER_0_IAM_Rx_IAutodDrvngSysSCSSdslReqV_IICBAD_20ms_Group07_ICBAD_BKPCANFD_20ms_FrP07_CONTROLLER_0_IAM_Rx, ComSignalType=BOOLEAN
          IAutodDrvngSysSCSSdslReq_IICBAD_20ms_Group07_ICBAD_BKPCANFD_20ms_FrP07_CONTROLLER_0_IAM_Rx: ComBitPosition=49, ComBitSize=1, ComHandleId=IICBAD_20ms_Group07_ICBAD_BKPCANFD_20ms_FrP07_CONTROLLER_0_IAM_Rx_IAutodDrvngSysSCSSdslReq_IICBAD_20ms_Group07_ICBAD_BKPCANFD_20ms_FrP07_CONTROLLER_0_IAM_Rx, ComSignalType=BOOLEAN
          IAutodDrvngSysEmgcBrkReqV_IICBAD_20ms_Group07_ICBAD_BKPCANFD_20ms_FrP07_CONTROLLER_0_IAM_Rx: ComBitPosition=50, ComBitSize=1, ComHandleId=IICBAD_20ms_Group07_ICBAD_BKPCANFD_20ms_FrP07_CONTROLLER_0_IAM_Rx_IAutodDrvngSysEmgcBrkReqV_IICBAD_20ms_Group07_ICBAD_BKPCANFD_20ms_FrP07_CONTROLLER_0_IAM_Rx, ComSignalType=BOOLEAN
          IAutodDrvngSysEmgcBrkReq_IICBAD_20ms_Group07_ICBAD_BKPCANFD_20ms_FrP07_CONTROLLER_0_IAM_Rx: ComBitPosition=51, ComBitSize=1, ComHandleId=IICBAD_20ms_Group07_ICBAD_BKPCANFD_20ms_FrP07_CONTROLLER_0_IAM_Rx_IAutodDrvngSysEmgcBrkReq_IICBAD_20ms_Group07_ICBAD_BKPCANFD_20ms_FrP07_CONTROLLER_0_IAM_Rx, ComSignalType=BOOLEAN
          IAIPilotBrkRddyMdReq_IICBAD_20ms_Group07_ICBAD_BKPCANFD_20ms_FrP07_CONTROLLER_0_IAM_Rx: ComBitPosition=52, ComBitSize=1, ComHandleId=IICBAD_20ms_Group07_ICBAD_BKPCANFD_20ms_FrP07_CONTROLLER_0_IAM_Rx_IAIPilotBrkRddyMdReq_IICBAD_20ms_Group07_ICBAD_BKPCANFD_20ms_FrP07_CONTROLLER_0_IAM_Rx, ComSignalType=BOOLEAN
          IAIPkgBrkRddyMdReq_IICBAD_20ms_Group07_ICBAD_BKPCANFD_20ms_FrP07_CONTROLLER_0_IAM_Rx: ComBitPosition=53, ComBitSize=1, ComHandleId=IICBAD_20ms_Group07_ICBAD_BKPCANFD_20ms_FrP07_CONTROLLER_0_IAM_Rx_IAIPkgBrkRddyMdReq_IICBAD_20ms_Group07_ICBAD_BKPCANFD_20ms_FrP07_CONTROLLER_0_IAM_Rx, ComSignalType=BOOLEAN
          IICBAD_20ms_Group07_Reserved1_IICBAD_20ms_Group07_ICBAD_BKPCANFD_20ms_FrP07_CONTROLLER_0_IAM_Rx: ComBitPosition=54, ComBitSize=2, ComHandleId=IICBAD_20ms_Group07_ICBAD_BKPCANFD_20ms_FrP07_CONTROLLER_0_IAM_Rx_IICBAD_20ms_Group07_Reserved1_IICBAD_20ms_Group07_ICBAD_BKPCANFD_20ms_FrP07_CONTROLLER_0_IAM_Rx, ComSignalType=UINT8
          IAutodDrvngSysSCSDrvOffReqV_IICBAD_20ms_Group07_ICBAD_BKPCANFD_20ms_FrP07_CONTROLLER_0_IAM_Rx: ComBitPosition=56, ComBitSize=1, ComHandleId=IICBAD_20ms_Group07_ICBAD_BKPCANFD_20ms_FrP07_CONTROLLER_0_IAM_Rx_IAutodDrvngSysSCSDrvOffReqV_IICBAD_20ms_Group07_ICBAD_BKPCANFD_20ms_FrP07_CONTROLLER_0_IAM_Rx, ComSignalType=BOOLEAN
          IAutodDrvngSysSCSDrvOffReq_IICBAD_20ms_Group07_ICBAD_BKPCANFD_20ms_FrP07_CONTROLLER_0_IAM_Rx: ComBitPosition=57, ComBitSize=1, ComHandleId=IICBAD_20ms_Group07_ICBAD_BKPCANFD_20ms_FrP07_CONTROLLER_0_IAM_Rx_IAutodDrvngSysSCSDrvOffReq_IICBAD_20ms_Group07_ICBAD_BKPCANFD_20ms_FrP07_CONTROLLER_0_IAM_Rx, ComSignalType=BOOLEAN
          IAutodDrvngSysMdReqV_IICBAD_20ms_Group07_ICBAD_BKPCANFD_20ms_FrP07_CONTROLLER_0_IAM_Rx: ComBitPosition=58, ComBitSize=1, ComHandleId=IICBAD_20ms_Group07_ICBAD_BKPCANFD_20ms_FrP07_CONTROLLER_0_IAM_Rx_IAutodDrvngSysMdReqV_IICBAD_20ms_Group07_ICBAD_BKPCANFD_20ms_FrP07_CONTROLLER_0_IAM_Rx, ComSignalType=BOOLEAN
          IAutodDrvngSysMdReq_IICBAD_20ms_Group07_ICBAD_BKPCANFD_20ms_FrP07_CONTROLLER_0_IAM_Rx: ComBitPosition=59, ComBitSize=1, ComHandleId=IICBAD_20ms_Group07_ICBAD_BKPCANFD_20ms_FrP07_CONTROLLER_0_IAM_Rx_IAutodDrvngSysMdReq_IICBAD_20ms_Group07_ICBAD_BKPCANFD_20ms_FrP07_CONTROLLER_0_IAM_Rx, ComSignalType=BOOLEAN
          IAutodDrvngSysFlrStsV_IICBAD_20ms_Group07_ICBAD_BKPCANFD_20ms_FrP07_CONTROLLER_0_IAM_Rx: ComBitPosition=60, ComBitSize=1, ComHandleId=IICBAD_20ms_Group07_ICBAD_BKPCANFD_20ms_FrP07_CONTROLLER_0_IAM_Rx_IAutodDrvngSysFlrStsV_IICBAD_20ms_Group07_ICBAD_BKPCANFD_20ms_FrP07_CONTROLLER_0_IAM_Rx, ComSignalType=BOOLEAN
          IAutodDrvngSysFlrSts_IICBAD_20ms_Group07_ICBAD_BKPCANFD_20ms_FrP07_CONTROLLER_0_IAM_Rx: ComBitPosition=61, ComBitSize=3, ComHandleId=IICBAD_20ms_Group07_ICBAD_BKPCANFD_20ms_FrP07_CONTROLLER_0_IAM_Rx_IAutodDrvngSysFlrSts_IICBAD_20ms_Group07_ICBAD_BKPCANFD_20ms_FrP07_CONTROLLER_0_IAM_Rx, ComSignalType=UINT8
      SDM_CHCANFD_20ms_FrP02_CONTROLLER_0_IAM_Rx (ComIPdu):
        ComIPduCancellationSupport = false
        ComIPduDirection = RECEIVE
        ComIPduHandleId = COM_RXPDU_COM_SDM_CHCANFD_20ms_FrP02_CONTROLLER_0_IAM_Rx
        ComIPduSignalProcessing = DEFERRED
        ComIPduType = NORMAL
        ComIPduCallout = SDM_CHCANFD_20ms_FrP02_CONTROLLER_0_IAM_Rx
        ComPduIdRef = COM_SDM_CHCANFD_20ms_FrP02_CONTROLLER_0_IAM_Rx
        ComIPduSignalGroupRef = ISDM_20ms_Group02_SDM_CHCANFD_20ms_FrP02_CONTROLLER_0_IAM_Rx
        ComIPduGroupRef = Com_RxPduGroup_CONTROLLER_0_IAM
      ISDM_20ms_Group02_SDM_CHCANFD_20ms_FrP02_CONTROLLER_0_IAM_Rx (ComSignalGroup):
        ComHandleId = ISDM_20ms_Group02_SDM_CHCANFD_20ms_FrP02_CONTROLLER_0_IAM_Rx
        ComInvalidNotification = NULL_PTR
        ComRxDataTimeoutAction = NONE
        ComTransferProperty = PENDING
        ComDataInvalidAction = NOTIFY
        ComTimeout = 0.0
        ComFirstTimeout = 0.0
        ComNotification = Rte_COMCbk
        20 x ComGroupSignal, all with ComSignalEndianness=BIG_ENDIAN, ComSignalInitValue=0x0, ComSignalLength=0, ComSignalDataInvalidValue=0x0:
          ISDM_20ms_Group02_CRC_ISDM_20ms_Group02_SDM_CHCANFD_20ms_FrP02_CONTROLLER_0_IAM_Rx: ComBitPosition=0, ComBitSize=8, ComHandleId=ISDM_20ms_Group02_SDM_CHCANFD_20ms_FrP02_CONTROLLER_0_IAM_Rx_ISDM_20ms_Group02_CRC_ISDM_20ms_Group02_SDM_CHCANFD_20ms_FrP02_CONTROLLER_0_IAM_Rx, ComSignalType=UINT8
          ISDM_20ms_Group02_RC_ISDM_20ms_Group02_SDM_CHCANFD_20ms_FrP02_CONTROLLER_0_IAM_Rx: ComBitPosition=8, ComBitSize=4, ComHandleId=ISDM_20ms_Group02_SDM_CHCANFD_20ms_FrP02_CONTROLLER_0_IAM_Rx_ISDM_20ms_Group02_RC_ISDM_20ms_Group02_SDM_CHCANFD_20ms_FrP02_CONTROLLER_0_IAM_Rx, ComSignalType=UINT8
          IAirbagSysFltIndCmd_ISDM_20ms_Group02_SDM_CHCANFD_20ms_FrP02_CONTROLLER_0_IAM_Rx: ComBitPosition=12, ComBitSize=2, ComHandleId=ISDM_20ms_Group02_SDM_CHCANFD_20ms_FrP02_CONTROLLER_0_IAM_Rx_IAirbagSysFltIndCmd_ISDM_20ms_Group02_SDM_CHCANFD_20ms_FrP02_CONTROLLER_0_IAM_Rx, ComSignalType=UINT8
          IAirbagDplInvsn_ISDM_20ms_Group02_SDM_CHCANFD_20ms_FrP02_CONTROLLER_0_IAM_Rx: ComBitPosition=14, ComBitSize=1, ComHandleId=ISDM_20ms_Group02_SDM_CHCANFD_20ms_FrP02_CONTROLLER_0_IAM_Rx_IAirbagDplInvsn_ISDM_20ms_Group02_SDM_CHCANFD_20ms_FrP02_CONTROLLER_0_IAM_Rx, ComSignalType=BOOLEAN
          IAirbagDpl_ISDM_20ms_Group02_SDM_CHCANFD_20ms_FrP02_CONTROLLER_0_IAM_Rx: ComBitPosition=15, ComBitSize=1, ComHandleId=ISDM_20ms_Group02_SDM_CHCANFD_20ms_FrP02_CONTROLLER_0_IAM_Rx_IAirbagDpl_ISDM_20ms_Group02_SDM_CHCANFD_20ms_FrP02_CONTROLLER_0_IAM_Rx, ComSignalType=BOOLEAN
          ISDM_20ms_Group02_Reserved1_ISDM_20ms_Group02_SDM_CHCANFD_20ms_FrP02_CONTROLLER_0_IAM_Rx: ComBitPosition=16, ComBitSize=1, ComHandleId=ISDM_20ms_Group02_SDM_CHCANFD_20ms_FrP02_CONTROLLER_0_IAM_Rx_ISDM_20ms_Group02_Reserved1_ISDM_20ms_Group02_SDM_CHCANFD_20ms_FrP02_CONTROLLER_0_IAM_Rx, ComSignalType=BOOLEAN
          IPedtrnProtnSysDplStsV_ISDM_20ms_Group02_SDM_CHCANFD_20ms_FrP02_CONTROLLER_0_IAM_Rx: ComBitPosition=17, ComBitSize=1, ComHandleId=ISDM_20ms_Group02_SDM_CHCANFD_20ms_FrP02_CONTROLLER_0_IAM_Rx_IPedtrnProtnSysDplStsV_ISDM_20ms_Group02_SDM_CHCANFD_20ms_FrP02_CONTROLLER_0_IAM_Rx, ComSignalType=BOOLEAN
          IPedtrnProtnSysDplSts_ISDM_20ms_Group02_SDM_CHCANFD_20ms_FrP02_CONTROLLER_0_IAM_Rx: ComBitPosition=18, ComBitSize=1, ComHandleId=ISDM_20ms_Group02_SDM_CHCANFD_20ms_FrP02_CONTROLLER_0_IAM_Rx_IPedtrnProtnSysDplSts_ISDM_20ms_Group02_SDM_CHCANFD_20ms_FrP02_CONTROLLER_0_IAM_Rx, ComSignalType=BOOLEAN
          IPedtrnProtnSysIndrCmd_ISDM_20ms_Group02_SDM_CHCANFD_20ms_FrP02_CONTROLLER_0_IAM_Rx: ComBitPosition=19, ComBitSize=2, ComHandleId=ISDM_20ms_Group02_SDM_CHCANFD_20ms_FrP02_CONTROLLER_0_IAM_Rx_IPedtrnProtnSysIndrCmd_ISDM_20ms_Group02_SDM_CHCANFD_20ms_FrP02_CONTROLLER_0_IAM_Rx, ComSignalType=UINT8
          IAirbagSysFlt_ISDM_20ms_Group02_SDM_CHCANFD_20ms_FrP02_CONTROLLER_0_IAM_Rx: ComBitPosition=21, ComBitSize=1, ComHandleId=ISDM_20ms_Group02_SDM_CHCANFD_20ms_FrP02_CONTROLLER_0_IAM_Rx_IAirbagSysFlt_ISDM_20ms_Group02_SDM_CHCANFD_20ms_FrP02_CONTROLLER_0_IAM_Rx, ComSignalType=BOOLEAN
          IFrtPsngAirbagSwSts_ISDM_20ms_Group02_SDM_CHCANFD_20ms_FrP02_CONTROLLER_0_IAM_Rx: ComBitPosition=22, ComBitSize=2, ComHandleId=ISDM_20ms_Group02_SDM_CHCANFD_20ms_FrP02_CONTROLLER_0_IAM_Rx_IFrtPsngAirbagSwSts_ISDM_20ms_Group02_SDM_CHCANFD_20ms_FrP02_CONTROLLER_0_IAM_Rx, ComSignalType=UINT8
          ISDM_20ms_Group02_Reserved2_ISDM_20ms_Group02_SDM_CHCANFD_20ms_FrP02_CONTROLLER_0_IAM_Rx: ComBitPosition=24, ComBitSize=8, ComHandleId=ISDM_20ms_Group02_SDM_CHCANFD_20ms_FrP02_CONTROLLER_0_IAM_Rx_ISDM_20ms_Group02_Reserved2_ISDM_20ms_Group02_SDM_CHCANFD_20ms_FrP02_CONTROLLER_0_IAM_Rx, ComSignalType=UINT8
          ISDM_20ms_Group02_Reserved3_ISDM_20ms_Group02_SDM_CHCANFD_20ms_FrP02_CONTROLLER_0_IAM_Rx: ComBitPosition=32, ComBitSize=8, ComHandleId=ISDM_20ms_Group02_SDM_CHCANFD_20ms_FrP02_CONTROLLER_0_IAM_Rx_ISDM_20ms_Group02_Reserved3_ISDM_20ms_Group02_SDM_CHCANFD_20ms_FrP02_CONTROLLER_0_IAM_Rx, ComSignalType=UINT8
          ISDM_20ms_Group02_Reserved4_ISDM_20ms_Group02_SDM_CHCANFD_20ms_FrP02_CONTROLLER_0_IAM_Rx: ComBitPosition=40, ComBitSize=8, ComHandleId=ISDM_20ms_Group02_SDM_CHCANFD_20ms_FrP02_CONTROLLER_0_IAM_Rx_ISDM_20ms_Group02_Reserved4_ISDM_20ms_Group02_SDM_CHCANFD_20ms_FrP02_CONTROLLER_0_IAM_Rx, ComSignalType=UINT8
          ISDM_20ms_Group02_Reserved5_ISDM_20ms_Group02_SDM_CHCANFD_20ms_FrP02_CONTROLLER_0_IAM_Rx: ComBitPosition=61, ComBitSize=7, ComHandleId=ISDM_20ms_Group02_SDM_CHCANFD_20ms_FrP02_CONTROLLER_0_IAM_Rx_ISDM_20ms_Group02_Reserved5_ISDM_20ms_Group02_SDM_CHCANFD_20ms_FrP02_CONTROLLER_0_IAM_Rx, ComSignalType=UINT8
          IFrtPsngAirbagIndReq_ISDM_20ms_Group02_SDM_CHCANFD_20ms_FrP02_CONTROLLER_0_IAM_Rx: ComBitPosition=52, ComBitSize=2, ComHandleId=ISDM_20ms_Group02_SDM_CHCANFD_20ms_FrP02_CONTROLLER_0_IAM_Rx_IFrtPsngAirbagIndReq_ISDM_20ms_Group02_SDM_CHCANFD_20ms_FrP02_CONTROLLER_0_IAM_Rx, ComSignalType=UINT8
          IFrtPsngAirbagEnbIndF_ISDM_20ms_Group02_SDM_CHCANFD_20ms_FrP02_CONTROLLER_0_IAM_Rx: ComBitPosition=54, ComBitSize=1, ComHandleId=ISDM_20ms_Group02_SDM_CHCANFD_20ms_FrP02_CONTROLLER_0_IAM_Rx_IFrtPsngAirbagEnbIndF_ISDM_20ms_Group02_SDM_CHCANFD_20ms_FrP02_CONTROLLER_0_IAM_Rx, ComSignalType=BOOLEAN
          IFrtPsngAirbagDsblIndF_ISDM_20ms_Group02_SDM_CHCANFD_20ms_FrP02_CONTROLLER_0_IAM_Rx: ComBitPosition=55, ComBitSize=1, ComHandleId=ISDM_20ms_Group02_SDM_CHCANFD_20ms_FrP02_CONTROLLER_0_IAM_Rx_IFrtPsngAirbagDsblIndF_ISDM_20ms_Group02_SDM_CHCANFD_20ms_FrP02_CONTROLLER_0_IAM_Rx, ComSignalType=BOOLEAN
          ISDM_20ms_Group02_Reserved6_ISDM_20ms_Group02_SDM_CHCANFD_20ms_FrP02_CONTROLLER_0_IAM_Rx: ComBitPosition=56, ComBitSize=2, ComHandleId=ISDM_20ms_Group02_SDM_CHCANFD_20ms_FrP02_CONTROLLER_0_IAM_Rx_ISDM_20ms_Group02_Reserved6_ISDM_20ms_Group02_SDM_CHCANFD_20ms_FrP02_CONTROLLER_0_IAM_Rx, ComSignalType=UINT8
          IVehCrshTyp_ISDM_20ms_Group02_SDM_CHCANFD_20ms_FrP02_CONTROLLER_0_IAM_Rx: ComBitPosition=58, ComBitSize=3, ComHandleId=ISDM_20ms_Group02_SDM_CHCANFD_20ms_FrP02_CONTROLLER_0_IAM_Rx_IVehCrshTyp_ISDM_20ms_Group02_SDM_CHCANFD_20ms_FrP02_CONTROLLER_0_IAM_Rx, ComSignalType=UINT8
      RZCU_PTCANFD_20ms_FrP06_CONTROLLER_0_IAM_Rx (ComIPdu):
        ComIPduCancellationSupport = false
        ComIPduDirection = RECEIVE
        ComIPduHandleId = COM_RXPDU_COM_RZCU_PTCANFD_20ms_FrP06_CONTROLLER_0_IAM_Rx
        ComIPduSignalProcessing = DEFERRED
        ComIPduType = NORMAL
        ComIPduCallout = RZCU_PTCANFD_20ms_FrP06_CONTROLLER_0_IAM_Rx
        ComPduIdRef = COM_RZCU_PTCANFD_20ms_FrP06_CONTROLLER_0_IAM_Rx
        ComIPduSignalGroupRef = IRZCU_20ms_Group06_RZCU_PTCANFD_20ms_FrP06_CONTROLLER_0_IAM_Rx
        ComIPduGroupRef = Com_RxPduGroup_CONTROLLER_0_IAM
      IRZCU_20ms_Group06_RZCU_PTCANFD_20ms_FrP06_CONTROLLER_0_IAM_Rx (ComSignalGroup):
        ComHandleId = IRZCU_20ms_Group06_RZCU_PTCANFD_20ms_FrP06_CONTROLLER_0_IAM_Rx
        ComInvalidNotification = NULL_PTR
        ComRxDataTimeoutAction = NONE
        ComTransferProperty = PENDING
        ComDataInvalidAction = NOTIFY
        ComTimeout = 0.0
        ComFirstTimeout = 0.0
        ComNotification = Rte_COMCbk
        15 x ComGroupSignal, all with ComSignalEndianness=BIG_ENDIAN, ComSignalInitValue=0x0, ComSignalLength=0, ComSignalDataInvalidValue=0x0:
          IRZCU_20ms_Group06_CRC_IRZCU_20ms_Group06_RZCU_PTCANFD_20ms_FrP06_CONTROLLER_0_IAM_Rx: ComBitPosition=0, ComBitSize=8, ComHandleId=IRZCU_20ms_Group06_RZCU_PTCANFD_20ms_FrP06_CONTROLLER_0_IAM_Rx_IRZCU_20ms_Group06_CRC_IRZCU_20ms_Group06_RZCU_PTCANFD_20ms_FrP06_CONTROLLER_0_IAM_Rx, ComSignalType=UINT8
          IRZCU_20ms_Group06_RC_IRZCU_20ms_Group06_RZCU_PTCANFD_20ms_FrP06_CONTROLLER_0_IAM_Rx: ComBitPosition=8, ComBitSize=4, ComHandleId=IRZCU_20ms_Group06_RZCU_PTCANFD_20ms_FrP06_CONTROLLER_0_IAM_Rx_IRZCU_20ms_Group06_RC_IRZCU_20ms_Group06_RZCU_PTCANFD_20ms_FrP06_CONTROLLER_0_IAM_Rx, ComSignalType=UINT8
          ITrEstdGearV_IRZCU_20ms_Group06_RZCU_PTCANFD_20ms_FrP06_CONTROLLER_0_IAM_Rx: ComBitPosition=12, ComBitSize=1, ComHandleId=IRZCU_20ms_Group06_RZCU_PTCANFD_20ms_FrP06_CONTROLLER_0_IAM_Rx_ITrEstdGearV_IRZCU_20ms_Group06_RZCU_PTCANFD_20ms_FrP06_CONTROLLER_0_IAM_Rx, ComSignalType=BOOLEAN
          IEPTRdyV_IRZCU_20ms_Group06_RZCU_PTCANFD_20ms_FrP06_CONTROLLER_0_IAM_Rx: ComBitPosition=13, ComBitSize=1, ComHandleId=IRZCU_20ms_Group06_RZCU_PTCANFD_20ms_FrP06_CONTROLLER_0_IAM_Rx_IEPTRdyV_IRZCU_20ms_Group06_RZCU_PTCANFD_20ms_FrP06_CONTROLLER_0_IAM_Rx, ComSignalType=BOOLEAN
          IEPTRdy_IRZCU_20ms_Group06_RZCU_PTCANFD_20ms_FrP06_CONTROLLER_0_IAM_Rx: ComBitPosition=14, ComBitSize=1, ComHandleId=IRZCU_20ms_Group06_RZCU_PTCANFD_20ms_FrP06_CONTROLLER_0_IAM_Rx_IEPTRdy_IRZCU_20ms_Group06_RZCU_PTCANFD_20ms_FrP06_CONTROLLER_0_IAM_Rx, ComSignalType=BOOLEAN
          ITrShftLvrPosV_IRZCU_20ms_Group06_RZCU_PTCANFD_20ms_FrP06_CONTROLLER_0_IAM_Rx: ComBitPosition=15, ComBitSize=1, ComHandleId=IRZCU_20ms_Group06_RZCU_PTCANFD_20ms_FrP06_CONTROLLER_0_IAM_Rx_ITrShftLvrPosV_IRZCU_20ms_Group06_RZCU_PTCANFD_20ms_FrP06_CONTROLLER_0_IAM_Rx, ComSignalType=BOOLEAN
          ITrEstdGear_IRZCU_20ms_Group06_RZCU_PTCANFD_20ms_FrP06_CONTROLLER_0_IAM_Rx: ComBitPosition=16, ComBitSize=4, ComHandleId=IRZCU_20ms_Group06_RZCU_PTCANFD_20ms_FrP06_CONTROLLER_0_IAM_Rx_ITrEstdGear_IRZCU_20ms_Group06_RZCU_PTCANFD_20ms_FrP06_CONTROLLER_0_IAM_Rx, ComSignalType=UINT8
          ITrShftLvrPos_IRZCU_20ms_Group06_RZCU_PTCANFD_20ms_FrP06_CONTROLLER_0_IAM_Rx: ComBitPosition=20, ComBitSize=4, ComHandleId=IRZCU_20ms_Group06_RZCU_PTCANFD_20ms_FrP06_CONTROLLER_0_IAM_Rx_ITrShftLvrPos_IRZCU_20ms_Group06_RZCU_PTCANFD_20ms_FrP06_CONTROLLER_0_IAM_Rx, ComSignalType=UINT8
          IRZCU_20ms_Group06_Reserved2_IRZCU_20ms_Group06_RZCU_PTCANFD_20ms_FrP06_CONTROLLER_0_IAM_Rx: ComBitPosition=24, ComBitSize=1, ComHandleId=IRZCU_20ms_Group06_RZCU_PTCANFD_20ms_FrP06_CONTROLLER_0_IAM_Rx_IRZCU_20ms_Group06_Reserved2_IRZCU_20ms_Group06_RZCU_PTCANFD_20ms_FrP06_CONTROLLER_0_IAM_Rx, ComSignalType=BOOLEAN
          IPreEPTRdy_IRZCU_20ms_Group06_RZCU_PTCANFD_20ms_FrP06_CONTROLLER_0_IAM_Rx: ComBitPosition=25, ComBitSize=1, ComHandleId=IRZCU_20ms_Group06_RZCU_PTCANFD_20ms_FrP06_CONTROLLER_0_IAM_Rx_IPreEPTRdy_IRZCU_20ms_Group06_RZCU_PTCANFD_20ms_FrP06_CONTROLLER_0_IAM_Rx, ComSignalType=BOOLEAN
          IRZCU_20ms_Group06_Reserved1_IRZCU_20ms_Group06_RZCU_PTCANFD_20ms_FrP06_CONTROLLER_0_IAM_Rx: ComBitPosition=26, ComBitSize=6, ComHandleId=IRZCU_20ms_Group06_RZCU_PTCANFD_20ms_FrP06_CONTROLLER_0_IAM_Rx_IRZCU_20ms_Group06_Reserved1_IRZCU_20ms_Group06_RZCU_PTCANFD_20ms_FrP06_CONTROLLER_0_IAM_Rx, ComSignalType=UINT8
          IRZCU_20ms_Group06_Reserved3_IRZCU_20ms_Group06_RZCU_PTCANFD_20ms_FrP06_CONTROLLER_0_IAM_Rx: ComBitPosition=32, ComBitSize=8, ComHandleId=IRZCU_20ms_Group06_RZCU_PTCANFD_20ms_FrP06_CONTROLLER_0_IAM_Rx_IRZCU_20ms_Group06_Reserved3_IRZCU_20ms_Group06_RZCU_PTCANFD_20ms_FrP06_CONTROLLER_0_IAM_Rx, ComSignalType=UINT8
          IRZCU_20ms_Group06_Reserved4_IRZCU_20ms_Group06_RZCU_PTCANFD_20ms_FrP06_CONTROLLER_0_IAM_Rx: ComBitPosition=40, ComBitSize=8, ComHandleId=IRZCU_20ms_Group06_RZCU_PTCANFD_20ms_FrP06_CONTROLLER_0_IAM_Rx_IRZCU_20ms_Group06_Reserved4_IRZCU_20ms_Group06_RZCU_PTCANFD_20ms_FrP06_CONTROLLER_0_IAM_Rx, ComSignalType=UINT8
          IRZCU_20ms_Group06_Reserved5_IRZCU_20ms_Group06_RZCU_PTCANFD_20ms_FrP06_CONTROLLER_0_IAM_Rx: ComBitPosition=48, ComBitSize=8, ComHandleId=IRZCU_20ms_Group06_RZCU_PTCANFD_20ms_FrP06_CONTROLLER_0_IAM_Rx_IRZCU_20ms_Group06_Reserved5_IRZCU_20ms_Group06_RZCU_PTCANFD_20ms_FrP06_CONTROLLER_0_IAM_Rx, ComSignalType=UINT8
          IRZCU_20ms_Group06_Reserved6_IRZCU_20ms_Group06_RZCU_PTCANFD_20ms_FrP06_CONTROLLER_0_IAM_Rx: ComBitPosition=56, ComBitSize=8, ComHandleId=IRZCU_20ms_Group06_RZCU_PTCANFD_20ms_FrP06_CONTROLLER_0_IAM_Rx_IRZCU_20ms_Group06_Reserved6_IRZCU_20ms_Group06_RZCU_PTCANFD_20ms_FrP06_CONTROLLER_0_IAM_Rx, ComSignalType=UINT8
      IBS_CHCANFD_20ms_FrP07_CONTROLLER_0_IAM_Rx (ComIPdu):
        ComIPduCancellationSupport = false
        ComIPduDirection = RECEIVE
        ComIPduHandleId = COM_RXPDU_COM_IBS_CHCANFD_20ms_FrP07_CONTROLLER_0_IAM_Rx
        ComIPduSignalProcessing = DEFERRED
        ComIPduType = NORMAL
        ComIPduCallout = IBS_CHCANFD_20ms_FrP07_CONTROLLER_0_IAM_Rx
        ComPduIdRef = COM_IBS_CHCANFD_20ms_FrP07_CONTROLLER_0_IAM_Rx
        ComIPduSignalGroupRef = IIBS_20ms_Group07_IBS_CHCANFD_20ms_FrP07_CONTROLLER_0_IAM_Rx
        ComIPduGroupRef = Com_RxPduGroup_CONTROLLER_0_IAM
      IIBS_20ms_Group07_IBS_CHCANFD_20ms_FrP07_CONTROLLER_0_IAM_Rx (ComSignalGroup):
        ComHandleId = IIBS_20ms_Group07_IBS_CHCANFD_20ms_FrP07_CONTROLLER_0_IAM_Rx
        ComInvalidNotification = NULL_PTR
        ComRxDataTimeoutAction = NONE
        ComTransferProperty = PENDING
        ComDataInvalidAction = NOTIFY
        ComTimeout = 0.0
        ComFirstTimeout = 0.0
        ComNotification = Rte_COMCbk
        36 x ComGroupSignal, all with ComSignalEndianness=BIG_ENDIAN, ComSignalInitValue=0x0, ComSignalLength=0, ComSignalDataInvalidValue=0x0:
          IIBS_20ms_Group07_CRC_IIBS_20ms_Group07_IBS_CHCANFD_20ms_FrP07_CONTROLLER_0_IAM_Rx: ComBitPosition=0, ComBitSize=8, ComHandleId=IIBS_20ms_Group07_IBS_CHCANFD_20ms_FrP07_CONTROLLER_0_IAM_Rx_IIBS_20ms_Group07_CRC_IIBS_20ms_Group07_IBS_CHCANFD_20ms_FrP07_CONTROLLER_0_IAM_Rx, ComSignalType=UINT8
          IIBS_20ms_Group07_RC_IIBS_20ms_Group07_IBS_CHCANFD_20ms_FrP07_CONTROLLER_0_IAM_Rx: ComBitPosition=8, ComBitSize=4, ComHandleId=IIBS_20ms_Group07_IBS_CHCANFD_20ms_FrP07_CONTROLLER_0_IAM_Rx_IIBS_20ms_Group07_RC_IIBS_20ms_Group07_IBS_CHCANFD_20ms_FrP07_CONTROLLER_0_IAM_Rx, ComSignalType=UINT8
          IHDCSysSts_IIBS_20ms_Group07_IBS_CHCANFD_20ms_FrP07_CONTROLLER_0_IAM_Rx: ComBitPosition=12, ComBitSize=3, ComHandleId=IIBS_20ms_Group07_IBS_CHCANFD_20ms_FrP07_CONTROLLER_0_IAM_Rx_IHDCSysSts_IIBS_20ms_Group07_IBS_CHCANFD_20ms_FrP07_CONTROLLER_0_IAM_Rx, ComSignalType=UINT8
          IABSIO_IIBS_20ms_Group07_IBS_CHCANFD_20ms_FrP07_CONTROLLER_0_IAM_Rx: ComBitPosition=15, ComBitSize=1, ComHandleId=IIBS_20ms_Group07_IBS_CHCANFD_20ms_FrP07_CONTROLLER_0_IAM_Rx_IABSIO_IIBS_20ms_Group07_IBS_CHCANFD_20ms_FrP07_CONTROLLER_0_IAM_Rx, ComSignalType=BOOLEAN
          IVSESysA_IIBS_20ms_Group07_IBS_CHCANFD_20ms_FrP07_CONTROLLER_0_IAM_Rx: ComBitPosition=16, ComBitSize=1, ComHandleId=IIBS_20ms_Group07_IBS_CHCANFD_20ms_FrP07_CONTROLLER_0_IAM_Rx_IVSESysA_IIBS_20ms_Group07_IBS_CHCANFD_20ms_FrP07_CONTROLLER_0_IAM_Rx, ComSignalType=BOOLEAN
          IBrkSysYlwBrkTlltReq_IIBS_20ms_Group07_IBS_CHCANFD_20ms_FrP07_CONTROLLER_0_IAM_Rx: ComBitPosition=17, ComBitSize=1, ComHandleId=IIBS_20ms_Group07_IBS_CHCANFD_20ms_FrP07_CONTROLLER_0_IAM_Rx_IBrkSysYlwBrkTlltReq_IIBS_20ms_Group07_IBS_CHCANFD_20ms_FrP07_CONTROLLER_0_IAM_Rx, ComSignalType=BOOLEAN
          IVSESts_IIBS_20ms_Group07_IBS_CHCANFD_20ms_FrP07_CONTROLLER_0_IAM_Rx: ComBitPosition=18, ComBitSize=3, ComHandleId=IIBS_20ms_Group07_IBS_CHCANFD_20ms_FrP07_CONTROLLER_0_IAM_Rx_IVSESts_IIBS_20ms_Group07_IBS_CHCANFD_20ms_FrP07_CONTROLLER_0_IAM_Rx, ComSignalType=UINT8
          IVSEMd_IIBS_20ms_Group07_IBS_CHCANFD_20ms_FrP07_CONTROLLER_0_IAM_Rx: ComBitPosition=21, ComBitSize=3, ComHandleId=IIBS_20ms_Group07_IBS_CHCANFD_20ms_FrP07_CONTROLLER_0_IAM_Rx_IVSEMd_IIBS_20ms_Group07_IBS_CHCANFD_20ms_FrP07_CONTROLLER_0_IAM_Rx, ComSignalType=UINT8
          IMultColBrkEnbA_IIBS_20ms_Group07_IBS_CHCANFD_20ms_FrP07_CONTROLLER_0_IAM_Rx: ComBitPosition=24, ComBitSize=1, ComHandleId=IIBS_20ms_Group07_IBS_CHCANFD_20ms_FrP07_CONTROLLER_0_IAM_Rx_IMultColBrkEnbA_IIBS_20ms_Group07_IBS_CHCANFD_20ms_FrP07_CONTROLLER_0_IAM_Rx, ComSignalType=BOOLEAN
          IEBDFaultSt_IIBS_20ms_Group07_IBS_CHCANFD_20ms_FrP07_CONTROLLER_0_IAM_Rx: ComBitPosition=25, ComBitSize=1, ComHandleId=IIBS_20ms_Group07_IBS_CHCANFD_20ms_FrP07_CONTROLLER_0_IAM_Rx_IEBDFaultSt_IIBS_20ms_Group07_IBS_CHCANFD_20ms_FrP07_CONTROLLER_0_IAM_Rx, ComSignalType=BOOLEAN
          ITCSOpngSts_IIBS_20ms_Group07_IBS_CHCANFD_20ms_FrP07_CONTROLLER_0_IAM_Rx: ComBitPosition=26, ComBitSize=3, ComHandleId=IIBS_20ms_Group07_IBS_CHCANFD_20ms_FrP07_CONTROLLER_0_IAM_Rx_ITCSOpngSts_IIBS_20ms_Group07_IBS_CHCANFD_20ms_FrP07_CONTROLLER_0_IAM_Rx, ComSignalType=UINT8
          ITCSOpngMd_IIBS_20ms_Group07_IBS_CHCANFD_20ms_FrP07_CONTROLLER_0_IAM_Rx: ComBitPosition=29, ComBitSize=3, ComHandleId=IIBS_20ms_Group07_IBS_CHCANFD_20ms_FrP07_CONTROLLER_0_IAM_Rx_ITCSOpngMd_IIBS_20ms_Group07_IBS_CHCANFD_20ms_FrP07_CONTROLLER_0_IAM_Rx, ComSignalType=UINT8
          IBrkSysHillStAstAvlbl_IIBS_20ms_Group07_IBS_CHCANFD_20ms_FrP07_CONTROLLER_0_IAM_Rx: ComBitPosition=32, ComBitSize=1, ComHandleId=IIBS_20ms_Group07_IBS_CHCANFD_20ms_FrP07_CONTROLLER_0_IAM_Rx_IBrkSysHillStAstAvlbl_IIBS_20ms_Group07_IBS_CHCANFD_20ms_FrP07_CONTROLLER_0_IAM_Rx, ComSignalType=BOOLEAN
          IRgtvBrkFnFltSts_IIBS_20ms_Group07_IBS_CHCANFD_20ms_FrP07_CONTROLLER_0_IAM_Rx: ComBitPosition=33, ComBitSize=1, ComHandleId=IIBS_20ms_Group07_IBS_CHCANFD_20ms_FrP07_CONTROLLER_0_IAM_Rx_IRgtvBrkFnFltSts_IIBS_20ms_Group07_IBS_CHCANFD_20ms_FrP07_CONTROLLER_0_IAM_Rx, ComSignalType=BOOLEAN
          IMSRF_IIBS_20ms_Group07_IBS_CHCANFD_20ms_FrP07_CONTROLLER_0_IAM_Rx: ComBitPosition=34, ComBitSize=1, ComHandleId=IIBS_20ms_Group07_IBS_CHCANFD_20ms_FrP07_CONTROLLER_0_IAM_Rx_IMSRF_IIBS_20ms_Group07_IBS_CHCANFD_20ms_FrP07_CONTROLLER_0_IAM_Rx, ComSignalType=BOOLEAN
          IAutoHoldSysSts_IIBS_20ms_Group07_IBS_CHCANFD_20ms_FrP07_CONTROLLER_0_IAM_Rx: ComBitPosition=35, ComBitSize=2, ComHandleId=IIBS_20ms_Group07_IBS_CHCANFD_20ms_FrP07_CONTROLLER_0_IAM_Rx_IAutoHoldSysSts_IIBS_20ms_Group07_IBS_CHCANFD_20ms_FrP07_CONTROLLER_0_IAM_Rx, ComSignalType=UINT8
          IAutoHoldMsg_IIBS_20ms_Group07_IBS_CHCANFD_20ms_FrP07_CONTROLLER_0_IAM_Rx: ComBitPosition=37, ComBitSize=3, ComHandleId=IIBS_20ms_Group07_IBS_CHCANFD_20ms_FrP07_CONTROLLER_0_IAM_Rx_IAutoHoldMsg_IIBS_20ms_Group07_IBS_CHCANFD_20ms_FrP07_CONTROLLER_0_IAM_Rx, ComSignalType=UINT8
          IEBDA_IIBS_20ms_Group07_IBS_CHCANFD_20ms_FrP07_CONTROLLER_0_IAM_Rx: ComBitPosition=40, ComBitSize=1, ComHandleId=IIBS_20ms_Group07_IBS_CHCANFD_20ms_FrP07_CONTROLLER_0_IAM_Rx_IEBDA_IIBS_20ms_Group07_IBS_CHCANFD_20ms_FrP07_CONTROLLER_0_IAM_Rx, ComSignalType=BOOLEAN
          IRgtvBrkFnSts_IIBS_20ms_Group07_IBS_CHCANFD_20ms_FrP07_CONTROLLER_0_IAM_Rx: ComBitPosition=41, ComBitSize=1, ComHandleId=IIBS_20ms_Group07_IBS_CHCANFD_20ms_FrP07_CONTROLLER_0_IAM_Rx_IRgtvBrkFnSts_IIBS_20ms_Group07_IBS_CHCANFD_20ms_FrP07_CONTROLLER_0_IAM_Rx, ComSignalType=BOOLEAN
          ITCSEnbd_IIBS_20ms_Group07_IBS_CHCANFD_20ms_FrP07_CONTROLLER_0_IAM_Rx: ComBitPosition=42, ComBitSize=1, ComHandleId=IIBS_20ms_Group07_IBS_CHCANFD_20ms_FrP07_CONTROLLER_0_IAM_Rx_ITCSEnbd_IIBS_20ms_Group07_IBS_CHCANFD_20ms_FrP07_CONTROLLER_0_IAM_Rx, ComSignalType=BOOLEAN
          IHBAActiveSt_IIBS_20ms_Group07_IBS_CHCANFD_20ms_FrP07_CONTROLLER_0_IAM_Rx: ComBitPosition=43, ComBitSize=1, ComHandleId=IIBS_20ms_Group07_IBS_CHCANFD_20ms_FrP07_CONTROLLER_0_IAM_Rx_IHBAActiveSt_IIBS_20ms_Group07_IBS_CHCANFD_20ms_FrP07_CONTROLLER_0_IAM_Rx, ComSignalType=BOOLEAN
          ITCSA_IIBS_20ms_Group07_IBS_CHCANFD_20ms_FrP07_CONTROLLER_0_IAM_Rx: ComBitPosition=44, ComBitSize=1, ComHandleId=IIBS_20ms_Group07_IBS_CHCANFD_20ms_FrP07_CONTROLLER_0_IAM_Rx_ITCSA_IIBS_20ms_Group07_IBS_CHCANFD_20ms_FrP07_CONTROLLER_0_IAM_Rx, ComSignalType=BOOLEAN
          IEnDragToqRducnA_IIBS_20ms_Group07_IBS_CHCANFD_20ms_FrP07_CONTROLLER_0_IAM_Rx: ComBitPosition=45, ComBitSize=1, ComHandleId=IIBS_20ms_Group07_IBS_CHCANFD_20ms_FrP07_CONTROLLER_0_IAM_Rx_IEnDragToqRducnA_IIBS_20ms_Group07_IBS_CHCANFD_20ms_FrP07_CONTROLLER_0_IAM_Rx, ComSignalType=BOOLEAN
          IABSF_IIBS_20ms_Group07_IBS_CHCANFD_20ms_FrP07_CONTROLLER_0_IAM_Rx: ComBitPosition=46, ComBitSize=1, ComHandleId=IIBS_20ms_Group07_IBS_CHCANFD_20ms_FrP07_CONTROLLER_0_IAM_Rx_IABSF_IIBS_20ms_Group07_IBS_CHCANFD_20ms_FrP07_CONTROLLER_0_IAM_Rx, ComSignalType=BOOLEAN
          IABSA_IIBS_20ms_Group07_IBS_CHCANFD_20ms_FrP07_CONTROLLER_0_IAM_Rx: ComBitPosition=47, ComBitSize=1, ComHandleId=IIBS_20ms_Group07_IBS_CHCANFD_20ms_FrP07_CONTROLLER_0_IAM_Rx_IABSA_IIBS_20ms_Group07_IBS_CHCANFD_20ms_FrP07_CONTROLLER_0_IAM_Rx, ComSignalType=BOOLEAN
          IHBAValidSt_IIBS_20ms_Group07_IBS_CHCANFD_20ms_FrP07_CONTROLLER_0_IAM_Rx: ComBitPosition=48, ComBitSize=1, ComHandleId=IIBS_20ms_Group07_IBS_CHCANFD_20ms_FrP07_CONTROLLER_0_IAM_Rx_IHBAValidSt_IIBS_20ms_Group07_IBS_CHCANFD_20ms_FrP07_CONTROLLER_0_IAM_Rx, ComSignalType=BOOLEAN
          IMSRA_IIBS_20ms_Group07_IBS_CHCANFD_20ms_FrP07_CONTROLLER_0_IAM_Rx: ComBitPosition=49, ComBitSize=1, ComHandleId=IIBS_20ms_Group07_IBS_CHCANFD_20ms_FrP07_CONTROLLER_0_IAM_Rx_IMSRA_IIBS_20ms_Group07_IBS_CHCANFD_20ms_FrP07_CONTROLLER_0_IAM_Rx, ComSignalType=BOOLEAN
          IEmgcBrkAV_IIBS_20ms_Group07_IBS_CHCANFD_20ms_FrP07_CONTROLLER_0_IAM_Rx: ComBitPosition=50, ComBitSize=1, ComHandleId=IIBS_20ms_Group07_IBS_CHCANFD_20ms_FrP07_CONTROLLER_0_IAM_Rx_IEmgcBrkAV_IIBS_20ms_Group07_IBS_CHCANFD_20ms_FrP07_CONTROLLER_0_IAM_Rx, ComSignalType=BOOLEAN
          IEmgcBrkA_IIBS_20ms_Group07_IBS_CHCANFD_20ms_FrP07_CONTROLLER_0_IAM_Rx: ComBitPosition=51, ComBitSize=1, ComHandleId=IIBS_20ms_Group07_IBS_CHCANFD_20ms_FrP07_CONTROLLER_0_IAM_Rx_IEmgcBrkA_IIBS_20ms_Group07_IBS_CHCANFD_20ms_FrP07_CONTROLLER_0_IAM_Rx, ComSignalType=BOOLEAN
          IBrkSysRedBrkTlltReq_IIBS_20ms_Group07_IBS_CHCANFD_20ms_FrP07_CONTROLLER_0_IAM_Rx: ComBitPosition=52, ComBitSize=1, ComHandleId=IIBS_20ms_Group07_IBS_CHCANFD_20ms_FrP07_CONTROLLER_0_IAM_Rx_IBrkSysRedBrkTlltReq_IIBS_20ms_Group07_IBS_CHCANFD_20ms_FrP07_CONTROLLER_0_IAM_Rx, ComSignalType=BOOLEAN
          IBrkSysHillStAstSts_IIBS_20ms_Group07_IBS_CHCANFD_20ms_FrP07_CONTROLLER_0_IAM_Rx: ComBitPosition=53, ComBitSize=3, ComHandleId=IIBS_20ms_Group07_IBS_CHCANFD_20ms_FrP07_CONTROLLER_0_IAM_Rx_IBrkSysHillStAstSts_IIBS_20ms_Group07_IBS_CHCANFD_20ms_FrP07_CONTROLLER_0_IAM_Rx, ComSignalType=UINT8
          IAVHSigPdlSts_IIBS_20ms_Group07_IBS_CHCANFD_20ms_FrP07_CONTROLLER_0_IAM_Rx: ComBitPosition=56, ComBitSize=2, ComHandleId=IIBS_20ms_Group07_IBS_CHCANFD_20ms_FrP07_CONTROLLER_0_IAM_Rx_IAVHSigPdlSts_IIBS_20ms_Group07_IBS_CHCANFD_20ms_FrP07_CONTROLLER_0_IAM_Rx, ComSignalType=UINT8
          IAutoHoldMdSts_IIBS_20ms_Group07_IBS_CHCANFD_20ms_FrP07_CONTROLLER_0_IAM_Rx: ComBitPosition=58, ComBitSize=2, ComHandleId=IIBS_20ms_Group07_IBS_CHCANFD_20ms_FrP07_CONTROLLER_0_IAM_Rx_IAutoHoldMdSts_IIBS_20ms_Group07_IBS_CHCANFD_20ms_FrP07_CONTROLLER_0_IAM_Rx, ComSignalType=UINT8
          ISoftSpSysSts_IIBS_20ms_Group07_IBS_CHCANFD_20ms_FrP07_CONTROLLER_0_IAM_Rx: ComBitPosition=60, ComBitSize=2, ComHandleId=IIBS_20ms_Group07_IBS_CHCANFD_20ms_FrP07_CONTROLLER_0_IAM_Rx_ISoftSpSysSts_IIBS_20ms_Group07_IBS_CHCANFD_20ms_FrP07_CONTROLLER_0_IAM_Rx, ComSignalType=UINT8
          IMulColBrkA_IIBS_20ms_Group07_IBS_CHCANFD_20ms_FrP07_CONTROLLER_0_IAM_Rx: ComBitPosition=62, ComBitSize=1, ComHandleId=IIBS_20ms_Group07_IBS_CHCANFD_20ms_FrP07_CONTROLLER_0_IAM_Rx_IMulColBrkA_IIBS_20ms_Group07_IBS_CHCANFD_20ms_FrP07_CONTROLLER_0_IAM_Rx, ComSignalType=BOOLEAN
          IMulColBrkAvlblySts_IIBS_20ms_Group07_IBS_CHCANFD_20ms_FrP07_CONTROLLER_0_IAM_Rx: ComBitPosition=63, ComBitSize=1, ComHandleId=IIBS_20ms_Group07_IBS_CHCANFD_20ms_FrP07_CONTROLLER_0_IAM_Rx_IMulColBrkAvlblySts_IIBS_20ms_Group07_IBS_CHCANFD_20ms_FrP07_CONTROLLER_0_IAM_Rx, ComSignalType=BOOLEAN
      ICBAD_RZCUCANFD_20ms_FrP12_CONTROLLER_0_IAM_Rx (ComIPdu):
        ComIPduCancellationSupport = false
        ComIPduDirection = RECEIVE
        ComIPduHandleId = COM_RXPDU_COM_ICBAD_RZCUCANFD_20ms_FrP12_CONTROLLER_0_IAM_Rx
        ComIPduSignalProcessing = DEFERRED
        ComIPduType = NORMAL
        ComIPduCallout = ICBAD_RZCUCANFD_20ms_FrP12_CONTROLLER_0_IAM_Rx
        ComPduIdRef = COM_ICBAD_RZCUCANFD_20ms_FrP12_CONTROLLER_0_IAM_Rx
        ComIPduSignalGroupRef = IICBAD_20ms_Group12_ICBAD_RZCUCANFD_20ms_FrP12_CONTROLLER_0_IAM_Rx
        ComIPduGroupRef = Com_RxPduGroup_CONTROLLER_0_IAM
      IICBAD_20ms_Group12_ICBAD_RZCUCANFD_20ms_FrP12_CONTROLLER_0_IAM_Rx (ComSignalGroup):
        ComHandleId = IICBAD_20ms_Group12_ICBAD_RZCUCANFD_20ms_FrP12_CONTROLLER_0_IAM_Rx
        ComInvalidNotification = NULL_PTR
        ComRxDataTimeoutAction = NONE
        ComTransferProperty = PENDING
        ComDataInvalidAction = NOTIFY
        ComTimeout = 0.0
        ComFirstTimeout = 0.0
        ComNotification = Rte_COMCbk
        10 x ComGroupSignal, all with ComSignalEndianness=BIG_ENDIAN, ComSignalInitValue=0x0, ComSignalLength=0, ComSignalType=UINT8, ComSignalDataInvalidValue=0x0:
          IICBAD_20ms_Group12_CRC_IICBAD_20ms_Group12_ICBAD_RZCUCANFD_20ms_FrP12_CONTROLLER_0_IAM_Rx: ComBitPosition=0, ComBitSize=8, ComHandleId=IICBAD_20ms_Group12_ICBAD_RZCUCANFD_20ms_FrP12_CONTROLLER_0_IAM_Rx_IICBAD_20ms_Group12_CRC_IICBAD_20ms_Group12_ICBAD_RZCUCANFD_20ms_FrP12_CONTROLLER_0_IAM_Rx
          IICBAD_20ms_Group12_RC_IICBAD_20ms_Group12_ICBAD_RZCUCANFD_20ms_FrP12_CONTROLLER_0_IAM_Rx: ComBitPosition=8, ComBitSize=4, ComHandleId=IICBAD_20ms_Group12_ICBAD_RZCUCANFD_20ms_FrP12_CONTROLLER_0_IAM_Rx_IICBAD_20ms_Group12_RC_IICBAD_20ms_Group12_ICBAD_RZCUCANFD_20ms_FrP12_CONTROLLER_0_IAM_Rx
          IICBAD_20ms_Group12_Reserved1_IICBAD_20ms_Group12_ICBAD_RZCUCANFD_20ms_FrP12_CONTROLLER_0_IAM_Rx: ComBitPosition=12, ComBitSize=4, ComHandleId=IICBAD_20ms_Group12_ICBAD_RZCUCANFD_20ms_FrP12_CONTROLLER_0_IAM_Rx_IICBAD_20ms_Group12_Reserved1_IICBAD_20ms_Group12_ICBAD_RZCUCANFD_20ms_FrP12_CONTROLLER_0_IAM_Rx
          IICBAD_20ms_Group12_Reserved2_IICBAD_20ms_Group12_ICBAD_RZCUCANFD_20ms_FrP12_CONTROLLER_0_IAM_Rx: ComBitPosition=16, ComBitSize=5, ComHandleId=IICBAD_20ms_Group12_ICBAD_RZCUCANFD_20ms_FrP12_CONTROLLER_0_IAM_Rx_IICBAD_20ms_Group12_Reserved2_IICBAD_20ms_Group12_ICBAD_RZCUCANFD_20ms_FrP12_CONTROLLER_0_IAM_Rx
          IAPASts_IICBAD_20ms_Group12_ICBAD_RZCUCANFD_20ms_FrP12_CONTROLLER_0_IAM_Rx: ComBitPosition=21, ComBitSize=3, ComHandleId=IICBAD_20ms_Group12_ICBAD_RZCUCANFD_20ms_FrP12_CONTROLLER_0_IAM_Rx_IAPASts_IICBAD_20ms_Group12_ICBAD_RZCUCANFD_20ms_FrP12_CONTROLLER_0_IAM_Rx
          IAutodDrvngSysSts_IICBAD_20ms_Group12_ICBAD_RZCUCANFD_20ms_FrP12_CONTROLLER_0_IAM_Rx: ComBitPosition=24, ComBitSize=8, ComHandleId=IICBAD_20ms_Group12_ICBAD_RZCUCANFD_20ms_FrP12_CONTROLLER_0_IAM_Rx_IAutodDrvngSysSts_IICBAD_20ms_Group12_ICBAD_RZCUCANFD_20ms_FrP12_CONTROLLER_0_IAM_Rx
          IICBAD_20ms_Group12_Reserved3_IICBAD_20ms_Group12_ICBAD_RZCUCANFD_20ms_FrP12_CONTROLLER_0_IAM_Rx: ComBitPosition=32, ComBitSize=8, ComHandleId=IICBAD_20ms_Group12_ICBAD_RZCUCANFD_20ms_FrP12_CONTROLLER_0_IAM_Rx_IICBAD_20ms_Group12_Reserved3_IICBAD_20ms_Group12_ICBAD_RZCUCANFD_20ms_FrP12_CONTROLLER_0_IAM_Rx
          IICBAD_20ms_Group12_Reserved4_IICBAD_20ms_Group12_ICBAD_RZCUCANFD_20ms_FrP12_CONTROLLER_0_IAM_Rx: ComBitPosition=40, ComBitSize=8, ComHandleId=IICBAD_20ms_Group12_ICBAD_RZCUCANFD_20ms_FrP12_CONTROLLER_0_IAM_Rx_IICBAD_20ms_Group12_Reserved4_IICBAD_20ms_Group12_ICBAD_RZCUCANFD_20ms_FrP12_CONTROLLER_0_IAM_Rx
          IICBAD_20ms_Group12_Reserved5_IICBAD_20ms_Group12_ICBAD_RZCUCANFD_20ms_FrP12_CONTROLLER_0_IAM_Rx: ComBitPosition=48, ComBitSize=8, ComHandleId=IICBAD_20ms_Group12_ICBAD_RZCUCANFD_20ms_FrP12_CONTROLLER_0_IAM_Rx_IICBAD_20ms_Group12_Reserved5_IICBAD_20ms_Group12_ICBAD_RZCUCANFD_20ms_FrP12_CONTROLLER_0_IAM_Rx
          IICBAD_20ms_Group12_Reserved6_IICBAD_20ms_Group12_ICBAD_RZCUCANFD_20ms_FrP12_CONTROLLER_0_IAM_Rx: ComBitPosition=56, ComBitSize=8, ComHandleId=IICBAD_20ms_Group12_ICBAD_RZCUCANFD_20ms_FrP12_CONTROLLER_0_IAM_Rx_IICBAD_20ms_Group12_Reserved6_IICBAD_20ms_Group12_ICBAD_RZCUCANFD_20ms_FrP12_CONTROLLER_0_IAM_Rx
      IBS_CHCANFD_20ms_FrP11_CONTROLLER_0_IAM_Rx (ComIPdu):
        ComIPduCancellationSupport = false
        ComIPduDirection = RECEIVE
        ComIPduHandleId = COM_RXPDU_COM_IBS_CHCANFD_20ms_FrP11_CONTROLLER_0_IAM_Rx
        ComIPduSignalProcessing = DEFERRED
        ComIPduType = NORMAL
        ComIPduCallout = IBS_CHCANFD_20ms_FrP11_CONTROLLER_0_IAM_Rx
        ComPduIdRef = COM_IBS_CHCANFD_20ms_FrP11_CONTROLLER_0_IAM_Rx
        ComIPduSignalGroupRef = IIBS_20ms_Group11_IBS_CHCANFD_20ms_FrP11_CONTROLLER_0_IAM_Rx
        ComIPduGroupRef = Com_RxPduGroup_CONTROLLER_0_IAM
      IIBS_20ms_Group11_IBS_CHCANFD_20ms_FrP11_CONTROLLER_0_IAM_Rx (ComSignalGroup):
        ComHandleId = IIBS_20ms_Group11_IBS_CHCANFD_20ms_FrP11_CONTROLLER_0_IAM_Rx
        ComInvalidNotification = NULL_PTR
        ComRxDataTimeoutAction = NONE
        ComTransferProperty = PENDING
        ComDataInvalidAction = NOTIFY
        ComTimeout = 0.0
        ComFirstTimeout = 0.0
        ComNotification = Rte_COMCbk
        10 x ComGroupSignal, all with ComSignalEndianness=BIG_ENDIAN, ComSignalInitValue=0x0, ComSignalLength=0, ComSignalDataInvalidValue=0x0:
          IIBS_20ms_Group11_CRC_IIBS_20ms_Group11_IBS_CHCANFD_20ms_FrP11_CONTROLLER_0_IAM_Rx: ComBitPosition=0, ComBitSize=8, ComHandleId=IIBS_20ms_Group11_IBS_CHCANFD_20ms_FrP11_CONTROLLER_0_IAM_Rx_IIBS_20ms_Group11_CRC_IIBS_20ms_Group11_IBS_CHCANFD_20ms_FrP11_CONTROLLER_0_IAM_Rx, ComSignalType=UINT8
          IIBS_20ms_Group11_RC_IIBS_20ms_Group11_IBS_CHCANFD_20ms_FrP11_CONTROLLER_0_IAM_Rx: ComBitPosition=8, ComBitSize=4, ComHandleId=IIBS_20ms_Group11_IBS_CHCANFD_20ms_FrP11_CONTROLLER_0_IAM_Rx_IIBS_20ms_Group11_RC_IIBS_20ms_Group11_IBS_CHCANFD_20ms_FrP11_CONTROLLER_0_IAM_Rx, ComSignalType=UINT8
          IIBS_20ms_Group11_Reserved1_IIBS_20ms_Group11_IBS_CHCANFD_20ms_FrP11_CONTROLLER_0_IAM_Rx: ComBitPosition=12, ComBitSize=3, ComHandleId=IIBS_20ms_Group11_IBS_CHCANFD_20ms_FrP11_CONTROLLER_0_IAM_Rx_IIBS_20ms_Group11_Reserved1_IIBS_20ms_Group11_IBS_CHCANFD_20ms_FrP11_CONTROLLER_0_IAM_Rx, ComSignalType=UINT8
          IVehSpdAvgNonDrvnV_IIBS_20ms_Group11_IBS_CHCANFD_20ms_FrP11_CONTROLLER_0_IAM_Rx: ComBitPosition=15, ComBitSize=1, ComHandleId=IIBS_20ms_Group11_IBS_CHCANFD_20ms_FrP11_CONTROLLER_0_IAM_Rx_IVehSpdAvgNonDrvnV_IIBS_20ms_Group11_IBS_CHCANFD_20ms_FrP11_CONTROLLER_0_IAM_Rx, ComSignalType=BOOLEAN
          IVehSpdAvg_IIBS_20ms_Group11_IBS_CHCANFD_20ms_FrP11_CONTROLLER_0_IAM_Rx: ComBitPosition=24, ComBitSize=15, ComHandleId=IIBS_20ms_Group11_IBS_CHCANFD_20ms_FrP11_CONTROLLER_0_IAM_Rx_IVehSpdAvg_IIBS_20ms_Group11_IBS_CHCANFD_20ms_FrP11_CONTROLLER_0_IAM_Rx, ComSignalType=UINT16
          IVehSpdAvgV_IIBS_20ms_Group11_IBS_CHCANFD_20ms_FrP11_CONTROLLER_0_IAM_Rx: ComBitPosition=23, ComBitSize=1, ComHandleId=IIBS_20ms_Group11_IBS_CHCANFD_20ms_FrP11_CONTROLLER_0_IAM_Rx_IVehSpdAvgV_IIBS_20ms_Group11_IBS_CHCANFD_20ms_FrP11_CONTROLLER_0_IAM_Rx, ComSignalType=BOOLEAN
          IVehSpdAvgDrvn_IIBS_20ms_Group11_IBS_CHCANFD_20ms_FrP11_CONTROLLER_0_IAM_Rx: ComBitPosition=41, ComBitSize=15, ComHandleId=IIBS_20ms_Group11_IBS_CHCANFD_20ms_FrP11_CONTROLLER_0_IAM_Rx_IVehSpdAvgDrvn_IIBS_20ms_Group11_IBS_CHCANFD_20ms_FrP11_CONTROLLER_0_IAM_Rx, ComSignalType=UINT16
          IVehSpdAvgDrvnV_IIBS_20ms_Group11_IBS_CHCANFD_20ms_FrP11_CONTROLLER_0_IAM_Rx: ComBitPosition=40, ComBitSize=1, ComHandleId=IIBS_20ms_Group11_IBS_CHCANFD_20ms_FrP11_CONTROLLER_0_IAM_Rx_IVehSpdAvgDrvnV_IIBS_20ms_Group11_IBS_CHCANFD_20ms_FrP11_CONTROLLER_0_IAM_Rx, ComSignalType=BOOLEAN
          IVehSpdAvgNonDrvn_IIBS_20ms_Group11_IBS_CHCANFD_20ms_FrP11_CONTROLLER_0_IAM_Rx: ComBitPosition=56, ComBitSize=15, ComHandleId=IIBS_20ms_Group11_IBS_CHCANFD_20ms_FrP11_CONTROLLER_0_IAM_Rx_IVehSpdAvgNonDrvn_IIBS_20ms_Group11_IBS_CHCANFD_20ms_FrP11_CONTROLLER_0_IAM_Rx, ComSignalType=UINT16
          IVehSpdAvgDrvnSrc_IIBS_20ms_Group11_IBS_CHCANFD_20ms_FrP11_CONTROLLER_0_IAM_Rx: ComBitPosition=55, ComBitSize=1, ComHandleId=IIBS_20ms_Group11_IBS_CHCANFD_20ms_FrP11_CONTROLLER_0_IAM_Rx_IVehSpdAvgDrvnSrc_IIBS_20ms_Group11_IBS_CHCANFD_20ms_FrP11_CONTROLLER_0_IAM_Rx, ComSignalType=BOOLEAN
      ESS_PTCANFD_20ms_FrP04_CONTROLLER_0_IAM_Rx (ComIPdu):
        ComIPduCancellationSupport = false
        ComIPduDirection = RECEIVE
        ComIPduHandleId = COM_RXPDU_COM_ESS_PTCANFD_20ms_FrP04_CONTROLLER_0_IAM_Rx
        ComIPduSignalProcessing = DEFERRED
        ComIPduType = NORMAL
        ComPduIdRef = COM_ESS_PTCANFD_20ms_FrP04_CONTROLLER_0_IAM_Rx
        ComIPduSignalRef = IBMSCellMaxVolV_ESS_PTCANFD_20ms_FrP04_CONTROLLER_0_IAM_Rx
        ComIPduSignalRef = IBMSCellMinVolV_ESS_PTCANFD_20ms_FrP04_CONTROLLER_0_IAM_Rx
        ComIPduSignalRef = IBMSCellMaxVolIndx_ESS_PTCANFD_20ms_FrP04_CONTROLLER_0_IAM_Rx
        ComIPduSignalRef = IBMSCellMinVolIndx_ESS_PTCANFD_20ms_FrP04_CONTROLLER_0_IAM_Rx
        ComIPduSignalRef = IBMSCellMinVol_ESS_PTCANFD_20ms_FrP04_CONTROLLER_0_IAM_Rx
        ComIPduSignalRef = IBMSCellMaxVol_ESS_PTCANFD_20ms_FrP04_CONTROLLER_0_IAM_Rx
        ComIPduGroupRef = Com_RxPduGroup_CONTROLLER_0_IAM
      6 x ComSignal, all with ComInvalidNotification=NULL_PTR, ComRxDataTimeoutAction=NONE, ComSignalEndianness=BIG_ENDIAN, ComSignalInitValue=0x0, ComSignalLength=0, ComTransferProperty=PENDING, ComSignalDataInvalidValue=0x0, ComDataInvalidAction=NOTIFY, ComTimeout=0.0, ComFirstTimeout=0.0, ComNotification=Rte_COMCbk:
        IBMSCellMaxVolV_ESS_PTCANFD_20ms_FrP04_CONTROLLER_0_IAM_Rx: ComBitPosition=13, ComBitSize=1, ComHandleId=IBMSCellMaxVolV_ESS_PTCANFD_20ms_FrP04_CONTROLLER_0_IAM_Rx, ComSignalType=BOOLEAN
        IBMSCellMinVolV_ESS_PTCANFD_20ms_FrP04_CONTROLLER_0_IAM_Rx: ComBitPosition=14, ComBitSize=1, ComHandleId=IBMSCellMinVolV_ESS_PTCANFD_20ms_FrP04_CONTROLLER_0_IAM_Rx, ComSignalType=BOOLEAN
        IBMSCellMaxVolIndx_ESS_PTCANFD_20ms_FrP04_CONTROLLER_0_IAM_Rx: ComBitPosition=16, ComBitSize=8, ComHandleId=IBMSCellMaxVolIndx_ESS_PTCANFD_20ms_FrP04_CONTROLLER_0_IAM_Rx, ComSignalType=UINT8
        IBMSCellMinVolIndx_ESS_PTCANFD_20ms_FrP04_CONTROLLER_0_IAM_Rx: ComBitPosition=24, ComBitSize=8, ComHandleId=IBMSCellMinVolIndx_ESS_PTCANFD_20ms_FrP04_CONTROLLER_0_IAM_Rx, ComSignalType=UINT8
        IBMSCellMinVol_ESS_PTCANFD_20ms_FrP04_CONTROLLER_0_IAM_Rx: ComBitPosition=40, ComBitSize=13, ComHandleId=IBMSCellMinVol_ESS_PTCANFD_20ms_FrP04_CONTROLLER_0_IAM_Rx, ComSignalType=UINT16
        IBMSCellMaxVol_ESS_PTCANFD_20ms_FrP04_CONTROLLER_0_IAM_Rx: ComBitPosition=56, ComBitSize=13, ComHandleId=IBMSCellMaxVol_ESS_PTCANFD_20ms_FrP04_CONTROLLER_0_IAM_Rx, ComSignalType=UINT16
      ICBVC_RZCUCANFD_20ms_FrP03_CONTROLLER_0_IAM_Rx (ComIPdu):
        ComIPduCancellationSupport = false
        ComIPduDirection = RECEIVE
        ComIPduHandleId = COM_RXPDU_COM_ICBVC_RZCUCANFD_20ms_FrP03_CONTROLLER_0_IAM_Rx
        ComIPduSignalProcessing = DEFERRED
        ComIPduType = NORMAL
        ComIPduCallout = ICBVC_RZCUCANFD_20ms_FrP03_CONTROLLER_0_IAM_Rx
        ComPduIdRef = COM_ICBVC_RZCUCANFD_20ms_FrP03_CONTROLLER_0_IAM_Rx
        ComIPduSignalGroupRef = IICBVC_20ms_Group03_ICBVC_RZCUCANFD_20ms_FrP03_CONTROLLER_0_IAM_Rx
        ComIPduGroupRef = Com_RxPduGroup_CONTROLLER_0_IAM
      IICBVC_20ms_Group03_ICBVC_RZCUCANFD_20ms_FrP03_CONTROLLER_0_IAM_Rx (ComSignalGroup):
        ComHandleId = IICBVC_20ms_Group03_ICBVC_RZCUCANFD_20ms_FrP03_CONTROLLER_0_IAM_Rx
        ComInvalidNotification = NULL_PTR
        ComRxDataTimeoutAction = NONE
        ComTransferProperty = PENDING
        ComDataInvalidAction = NOTIFY
        ComTimeout = 0.0
        ComFirstTimeout = 0.0
        ComNotification = Rte_COMCbk
        21 x ComGroupSignal, all with ComSignalEndianness=BIG_ENDIAN, ComSignalInitValue=0x0, ComSignalLength=0, ComSignalDataInvalidValue=0x0:
          IICBVC_20ms_Group03_CRC_IICBVC_20ms_Group03_ICBVC_RZCUCANFD_20ms_FrP03_CONTROLLER_0_IAM_Rx: ComBitPosition=0, ComBitSize=8, ComHandleId=IICBVC_20ms_Group03_ICBVC_RZCUCANFD_20ms_FrP03_CONTROLLER_0_IAM_Rx_IICBVC_20ms_Group03_CRC_IICBVC_20ms_Group03_ICBVC_RZCUCANFD_20ms_FrP03_CONTROLLER_0_IAM_Rx, ComSignalType=UINT8
          IICBVC_20ms_Group03_RC_IICBVC_20ms_Group03_ICBVC_RZCUCANFD_20ms_FrP03_CONTROLLER_0_IAM_Rx: ComBitPosition=8, ComBitSize=4, ComHandleId=IICBVC_20ms_Group03_ICBVC_RZCUCANFD_20ms_FrP03_CONTROLLER_0_IAM_Rx_IICBVC_20ms_Group03_RC_IICBVC_20ms_Group03_ICBVC_RZCUCANFD_20ms_FrP03_CONTROLLER_0_IAM_Rx, ComSignalType=UINT8
          IAMRPrtensonReq_IICBVC_20ms_Group03_ICBVC_RZCUCANFD_20ms_FrP03_CONTROLLER_0_IAM_Rx: ComBitPosition=12, ComBitSize=4, ComHandleId=IICBVC_20ms_Group03_ICBVC_RZCUCANFD_20ms_FrP03_CONTROLLER_0_IAM_Rx_IAMRPrtensonReq_IICBVC_20ms_Group03_ICBVC_RZCUCANFD_20ms_FrP03_CONTROLLER_0_IAM_Rx, ComSignalType=UINT8
          IICBVC_20ms_Group03_Reserved2_IICBVC_20ms_Group03_ICBVC_RZCUCANFD_20ms_FrP03_CONTROLLER_0_IAM_Rx: ComBitPosition=16, ComBitSize=4, ComHandleId=IICBVC_20ms_Group03_ICBVC_RZCUCANFD_20ms_FrP03_CONTROLLER_0_IAM_Rx_IICBVC_20ms_Group03_Reserved2_IICBVC_20ms_Group03_ICBVC_RZCUCANFD_20ms_FrP03_CONTROLLER_0_IAM_Rx, ComSignalType=UINT8
          ISysVolMdV_IICBVC_20ms_Group03_ICBVC_RZCUCANFD_20ms_FrP03_CONTROLLER_0_IAM_Rx: ComBitPosition=20, ComBitSize=1, ComHandleId=IICBVC_20ms_Group03_ICBVC_RZCUCANFD_20ms_FrP03_CONTROLLER_0_IAM_Rx_ISysVolMdV_IICBVC_20ms_Group03_ICBVC_RZCUCANFD_20ms_FrP03_CONTROLLER_0_IAM_Rx, ComSignalType=BOOLEAN
          IICBVC_20ms_Group03_Reserved1_IICBVC_20ms_Group03_ICBVC_RZCUCANFD_20ms_FrP03_CONTROLLER_0_IAM_Rx: ComBitPosition=21, ComBitSize=3, ComHandleId=IICBVC_20ms_Group03_ICBVC_RZCUCANFD_20ms_FrP03_CONTROLLER_0_IAM_Rx_IICBVC_20ms_Group03_Reserved1_IICBVC_20ms_Group03_ICBVC_RZCUCANFD_20ms_FrP03_CONTROLLER_0_IAM_Rx, ComSignalType=UINT8
          IICBVC_20ms_Group03_Reserved3_IICBVC_20ms_Group03_ICBVC_RZCUCANFD_20ms_FrP03_CONTROLLER_0_IAM_Rx: ComBitPosition=24, ComBitSize=4, ComHandleId=IICBVC_20ms_Group03_ICBVC_RZCUCANFD_20ms_FrP03_CONTROLLER_0_IAM_Rx_IICBVC_20ms_Group03_Reserved3_IICBVC_20ms_Group03_ICBVC_RZCUCANFD_20ms_FrP03_CONTROLLER_0_IAM_Rx, ComSignalType=UINT8
          IVehMd_IICBVC_20ms_Group03_ICBVC_RZCUCANFD_20ms_FrP03_CONTROLLER_0_IAM_Rx: ComBitPosition=28, ComBitSize=4, ComHandleId=IICBVC_20ms_Group03_ICBVC_RZCUCANFD_20ms_FrP03_CONTROLLER_0_IAM_Rx_IVehMd_IICBVC_20ms_Group03_ICBVC_RZCUCANFD_20ms_FrP03_CONTROLLER_0_IAM_Rx, ComSignalType=UINT8
          ISysVolV_IICBVC_20ms_Group03_ICBVC_RZCUCANFD_20ms_FrP03_CONTROLLER_0_IAM_Rx: ComBitPosition=32, ComBitSize=1, ComHandleId=IICBVC_20ms_Group03_ICBVC_RZCUCANFD_20ms_FrP03_CONTROLLER_0_IAM_Rx_ISysVolV_IICBVC_20ms_Group03_ICBVC_RZCUCANFD_20ms_FrP03_CONTROLLER_0_IAM_Rx, ComSignalType=BOOLEAN
          ISysPwrMdV_IICBVC_20ms_Group03_ICBVC_RZCUCANFD_20ms_FrP03_CONTROLLER_0_IAM_Rx: ComBitPosition=33, ComBitSize=1, ComHandleId=IICBVC_20ms_Group03_ICBVC_RZCUCANFD_20ms_FrP03_CONTROLLER_0_IAM_Rx_ISysPwrMdV_IICBVC_20ms_Group03_ICBVC_RZCUCANFD_20ms_FrP03_CONTROLLER_0_IAM_Rx, ComSignalType=BOOLEAN
          IVehMdV_IICBVC_20ms_Group03_ICBVC_RZCUCANFD_20ms_FrP03_CONTROLLER_0_IAM_Rx: ComBitPosition=34, ComBitSize=1, ComHandleId=IICBVC_20ms_Group03_ICBVC_RZCUCANFD_20ms_FrP03_CONTROLLER_0_IAM_Rx_IVehMdV_IICBVC_20ms_Group03_ICBVC_RZCUCANFD_20ms_FrP03_CONTROLLER_0_IAM_Rx, ComSignalType=BOOLEAN
          IUsgMdV_IICBVC_20ms_Group03_ICBVC_RZCUCANFD_20ms_FrP03_CONTROLLER_0_IAM_Rx: ComBitPosition=35, ComBitSize=1, ComHandleId=IICBVC_20ms_Group03_ICBVC_RZCUCANFD_20ms_FrP03_CONTROLLER_0_IAM_Rx_IUsgMdV_IICBVC_20ms_Group03_ICBVC_RZCUCANFD_20ms_FrP03_CONTROLLER_0_IAM_Rx, ComSignalType=BOOLEAN
          IUsgMd_IICBVC_20ms_Group03_ICBVC_RZCUCANFD_20ms_FrP03_CONTROLLER_0_IAM_Rx: ComBitPosition=36, ComBitSize=4, ComHandleId=IICBVC_20ms_Group03_ICBVC_RZCUCANFD_20ms_FrP03_CONTROLLER_0_IAM_Rx_IUsgMd_IICBVC_20ms_Group03_ICBVC_RZCUCANFD_20ms_FrP03_CONTROLLER_0_IAM_Rx, ComSignalType=UINT8
          ISysVol_IICBVC_20ms_Group03_ICBVC_RZCUCANFD_20ms_FrP03_CONTROLLER_0_IAM_Rx: ComBitPosition=40, ComBitSize=8, ComHandleId=IICBVC_20ms_Group03_ICBVC_RZCUCANFD_20ms_FrP03_CONTROLLER_0_IAM_Rx_ISysVol_IICBVC_20ms_Group03_ICBVC_RZCUCANFD_20ms_FrP03_CONTROLLER_0_IAM_Rx, ComSignalType=UINT8
          IPwrMdMstrRunCrkA_IICBVC_20ms_Group03_ICBVC_RZCUCANFD_20ms_FrP03_CONTROLLER_0_IAM_Rx: ComBitPosition=48, ComBitSize=1, ComHandleId=IICBVC_20ms_Group03_ICBVC_RZCUCANFD_20ms_FrP03_CONTROLLER_0_IAM_Rx_IPwrMdMstrRunCrkA_IICBVC_20ms_Group03_ICBVC_RZCUCANFD_20ms_FrP03_CONTROLLER_0_IAM_Rx, ComSignalType=BOOLEAN
          ISysPwrMd_IICBVC_20ms_Group03_ICBVC_RZCUCANFD_20ms_FrP03_CONTROLLER_0_IAM_Rx: ComBitPosition=49, ComBitSize=2, ComHandleId=IICBVC_20ms_Group03_ICBVC_RZCUCANFD_20ms_FrP03_CONTROLLER_0_IAM_Rx_ISysPwrMd_IICBVC_20ms_Group03_ICBVC_RZCUCANFD_20ms_FrP03_CONTROLLER_0_IAM_Rx, ComSignalType=UINT8
          IPwrMdMstrAccryA_IICBVC_20ms_Group03_ICBVC_RZCUCANFD_20ms_FrP03_CONTROLLER_0_IAM_Rx: ComBitPosition=51, ComBitSize=1, ComHandleId=IICBVC_20ms_Group03_ICBVC_RZCUCANFD_20ms_FrP03_CONTROLLER_0_IAM_Rx_IPwrMdMstrAccryA_IICBVC_20ms_Group03_ICBVC_RZCUCANFD_20ms_FrP03_CONTROLLER_0_IAM_Rx, ComSignalType=BOOLEAN
          ISysOpnlMd_IICBVC_20ms_Group03_ICBVC_RZCUCANFD_20ms_FrP03_CONTROLLER_0_IAM_Rx: ComBitPosition=52, ComBitSize=4, ComHandleId=IICBVC_20ms_Group03_ICBVC_RZCUCANFD_20ms_FrP03_CONTROLLER_0_IAM_Rx_ISysOpnlMd_IICBVC_20ms_Group03_ICBVC_RZCUCANFD_20ms_FrP03_CONTROLLER_0_IAM_Rx, ComSignalType=UINT8
          IICBVC_20ms_Group03_Reserved4_IICBVC_20ms_Group03_ICBVC_RZCUCANFD_20ms_FrP03_CONTROLLER_0_IAM_Rx: ComBitPosition=56, ComBitSize=5, ComHandleId=IICBVC_20ms_Group03_ICBVC_RZCUCANFD_20ms_FrP03_CONTROLLER_0_IAM_Rx_IICBVC_20ms_Group03_Reserved4_IICBVC_20ms_Group03_ICBVC_RZCUCANFD_20ms_FrP03_CONTROLLER_0_IAM_Rx, ComSignalType=UINT8
          IBPMMstrAvlbly_IICBVC_20ms_Group03_ICBVC_RZCUCANFD_20ms_FrP03_CONTROLLER_0_IAM_Rx: ComBitPosition=61, ComBitSize=1, ComHandleId=IICBVC_20ms_Group03_ICBVC_RZCUCANFD_20ms_FrP03_CONTROLLER_0_IAM_Rx_IBPMMstrAvlbly_IICBVC_20ms_Group03_ICBVC_RZCUCANFD_20ms_FrP03_CONTROLLER_0_IAM_Rx, ComSignalType=BOOLEAN
          ISysVolMd_IICBVC_20ms_Group03_ICBVC_RZCUCANFD_20ms_FrP03_CONTROLLER_0_IAM_Rx: ComBitPosition=62, ComBitSize=2, ComHandleId=IICBVC_20ms_Group03_ICBVC_RZCUCANFD_20ms_FrP03_CONTROLLER_0_IAM_Rx_ISysVolMd_IICBVC_20ms_Group03_ICBVC_RZCUCANFD_20ms_FrP03_CONTROLLER_0_IAM_Rx, ComSignalType=UINT8
      PEU_PTCANFD_50ms_FrP05_CONTROLLER_0_IAM_Rx (ComIPdu):
        ComIPduCancellationSupport = false
        ComIPduDirection = RECEIVE
        ComIPduHandleId = COM_RXPDU_COM_PEU_PTCANFD_50ms_FrP05_CONTROLLER_0_IAM_Rx
        ComIPduSignalProcessing = DEFERRED
        ComIPduType = NORMAL
        ComPduIdRef = COM_PEU_PTCANFD_50ms_FrP05_CONTROLLER_0_IAM_Rx
        ComIPduSignalRef = IEDUOilTem_PEU_PEU_PTCANFD_50ms_FrP05_CONTROLLER_0_IAM_Rx
        ComIPduSignalRef = IEDUOilTemV_PEU_PEU_PTCANFD_50ms_FrP05_CONTROLLER_0_IAM_Rx
        ComIPduGroupRef = Com_RxPduGroup_CONTROLLER_0_IAM
      IEDUOilTem_PEU_PEU_PTCANFD_50ms_FrP05_CONTROLLER_0_IAM_Rx (ComSignal):
        ComBitPosition = 16
        ComBitSize = 8
        ComHandleId = IEDUOilTem_PEU_PEU_PTCANFD_50ms_FrP05_CONTROLLER_0_IAM_Rx
        ComInvalidNotification = NULL_PTR
        ComRxDataTimeoutAction = NONE
        ComSignalEndianness = BIG_ENDIAN
        ComSignalInitValue = 0x0
        ComSignalLength = 0
        ComSignalType = UINT8
        ComTransferProperty = PENDING
        ComSignalDataInvalidValue = 0x0
        ComDataInvalidAction = NOTIFY
        ComTimeout = 0.5
        ComFirstTimeout = 0.5
        ComNotification = Rte_COMCbk
        ComTimeoutNotification = Rte_COMCbkRxTOut
      IEDUOilTemV_PEU_PEU_PTCANFD_50ms_FrP05_CONTROLLER_0_IAM_Rx (ComSignal):
        ComBitPosition = 31
        ComBitSize = 1
        ComHandleId = IEDUOilTemV_PEU_PEU_PTCANFD_50ms_FrP05_CONTROLLER_0_IAM_Rx
        ComInvalidNotification = NULL_PTR
        ComRxDataTimeoutAction = NONE
        ComSignalEndianness = BIG_ENDIAN
        ComSignalInitValue = 0x0
        ComSignalLength = 0
        ComSignalType = BOOLEAN
        ComTransferProperty = PENDING
        ComSignalDataInvalidValue = 0x0
        ComDataInvalidAction = NOTIFY
        ComTimeout = 0.5
        ComFirstTimeout = 0.5
        ComNotification = Rte_COMCbk
        ComTimeoutNotification = Rte_COMCbkRxTOut
      ESS_PTCANFD_50ms_FrP14_CONTROLLER_0_IAM_Rx (ComIPdu):
        ComIPduCancellationSupport = false
        ComIPduDirection = RECEIVE
        ComIPduHandleId = COM_RXPDU_COM_ESS_PTCANFD_50ms_FrP14_CONTROLLER_0_IAM_Rx
        ComIPduSignalProcessing = DEFERRED
        ComIPduType = NORMAL
        ComIPduCallout = ESS_PTCANFD_50ms_FrP14_CONTROLLER_0_IAM_Rx
        ComPduIdRef = COM_ESS_PTCANFD_50ms_FrP14_CONTROLLER_0_IAM_Rx
        ComIPduSignalGroupRef = IESS_50ms_Group14_ESS_PTCANFD_50ms_FrP14_CONTROLLER_0_IAM_Rx
        ComIPduGroupRef = Com_RxPduGroup_CONTROLLER_0_IAM
      IESS_50ms_Group14_ESS_PTCANFD_50ms_FrP14_CONTROLLER_0_IAM_Rx (ComSignalGroup):
        ComHandleId = IESS_50ms_Group14_ESS_PTCANFD_50ms_FrP14_CONTROLLER_0_IAM_Rx
        ComInvalidNotification = NULL_PTR
        ComRxDataTimeoutAction = NONE
        ComTransferProperty = PENDING
        ComDataInvalidAction = NOTIFY
        ComTimeout = 0.0
        ComFirstTimeout = 0.0
        ComNotification = Rte_COMCbk
        16 x ComGroupSignal, all with ComSignalEndianness=BIG_ENDIAN, ComSignalInitValue=0x0, ComSignalLength=0, ComSignalDataInvalidValue=0x0:
          IESS_50ms_Group14_CRC_IESS_50ms_Group14_ESS_PTCANFD_50ms_FrP14_CONTROLLER_0_IAM_Rx: ComBitPosition=0, ComBitSize=8, ComHandleId=IESS_50ms_Group14_ESS_PTCANFD_50ms_FrP14_CONTROLLER_0_IAM_Rx_IESS_50ms_Group14_CRC_IESS_50ms_Group14_ESS_PTCANFD_50ms_FrP14_CONTROLLER_0_IAM_Rx, ComSignalType=UINT8
          IESS_50ms_Group14_RC_IESS_50ms_Group14_ESS_PTCANFD_50ms_FrP14_CONTROLLER_0_IAM_Rx: ComBitPosition=8, ComBitSize=4, ComHandleId=IESS_50ms_Group14_ESS_PTCANFD_50ms_FrP14_CONTROLLER_0_IAM_Rx_IESS_50ms_Group14_RC_IESS_50ms_Group14_ESS_PTCANFD_50ms_FrP14_CONTROLLER_0_IAM_Rx, ComSignalType=UINT8
          IBMSVehicleEPO_IESS_50ms_Group14_ESS_PTCANFD_50ms_FrP14_CONTROLLER_0_IAM_Rx: ComBitPosition=12, ComBitSize=4, ComHandleId=IESS_50ms_Group14_ESS_PTCANFD_50ms_FrP14_CONTROLLER_0_IAM_Rx_IBMSVehicleEPO_IESS_50ms_Group14_ESS_PTCANFD_50ms_FrP14_CONTROLLER_0_IAM_Rx, ComSignalType=UINT8
          IBMSHVReq_IESS_50ms_Group14_ESS_PTCANFD_50ms_FrP14_CONTROLLER_0_IAM_Rx: ComBitPosition=16, ComBitSize=3, ComHandleId=IESS_50ms_Group14_ESS_PTCANFD_50ms_FrP14_CONTROLLER_0_IAM_Rx_IBMSHVReq_IESS_50ms_Group14_ESS_PTCANFD_50ms_FrP14_CONTROLLER_0_IAM_Rx, ComSignalType=UINT8
          IBMSBscSta_IESS_50ms_Group14_ESS_PTCANFD_50ms_FrP14_CONTROLLER_0_IAM_Rx: ComBitPosition=19, ComBitSize=5, ComHandleId=IESS_50ms_Group14_ESS_PTCANFD_50ms_FrP14_CONTROLLER_0_IAM_Rx_IBMSBscSta_IESS_50ms_Group14_ESS_PTCANFD_50ms_FrP14_CONTROLLER_0_IAM_Rx, ComSignalType=UINT8
          IBMSFltLvl_IESS_50ms_Group14_ESS_PTCANFD_50ms_FrP14_CONTROLLER_0_IAM_Rx: ComBitPosition=24, ComBitSize=3, ComHandleId=IESS_50ms_Group14_ESS_PTCANFD_50ms_FrP14_CONTROLLER_0_IAM_Rx_IBMSFltLvl_IESS_50ms_Group14_ESS_PTCANFD_50ms_FrP14_CONTROLLER_0_IAM_Rx, ComSignalType=UINT8
          IBMSPtIsltnRstcV_IESS_50ms_Group14_ESS_PTCANFD_50ms_FrP14_CONTROLLER_0_IAM_Rx: ComBitPosition=27, ComBitSize=1, ComHandleId=IESS_50ms_Group14_ESS_PTCANFD_50ms_FrP14_CONTROLLER_0_IAM_Rx_IBMSPtIsltnRstcV_IESS_50ms_Group14_ESS_PTCANFD_50ms_FrP14_CONTROLLER_0_IAM_Rx, ComSignalType=BOOLEAN
          IESS_50ms_Group14_Reserved1_IESS_50ms_Group14_ESS_PTCANFD_50ms_FrP14_CONTROLLER_0_IAM_Rx: ComBitPosition=28, ComBitSize=1, ComHandleId=IESS_50ms_Group14_ESS_PTCANFD_50ms_FrP14_CONTROLLER_0_IAM_Rx_IESS_50ms_Group14_Reserved1_IESS_50ms_Group14_ESS_PTCANFD_50ms_FrP14_CONTROLLER_0_IAM_Rx, ComSignalType=BOOLEAN
          IBMSMainRelaySts_IESS_50ms_Group14_ESS_PTCANFD_50ms_FrP14_CONTROLLER_0_IAM_Rx: ComBitPosition=29, ComBitSize=2, ComHandleId=IESS_50ms_Group14_ESS_PTCANFD_50ms_FrP14_CONTROLLER_0_IAM_Rx_IBMSMainRelaySts_IESS_50ms_Group14_ESS_PTCANFD_50ms_FrP14_CONTROLLER_0_IAM_Rx, ComSignalType=UINT8
          IBMSHVILClsd_IESS_50ms_Group14_ESS_PTCANFD_50ms_FrP14_CONTROLLER_0_IAM_Rx: ComBitPosition=31, ComBitSize=1, ComHandleId=IESS_50ms_Group14_ESS_PTCANFD_50ms_FrP14_CONTROLLER_0_IAM_Rx_IBMSHVILClsd_IESS_50ms_Group14_ESS_PTCANFD_50ms_FrP14_CONTROLLER_0_IAM_Rx, ComSignalType=BOOLEAN
          IESS_50ms_Group14_Reserved2_IESS_50ms_Group14_ESS_PTCANFD_50ms_FrP14_CONTROLLER_0_IAM_Rx: ComBitPosition=32, ComBitSize=2, ComHandleId=IESS_50ms_Group14_ESS_PTCANFD_50ms_FrP14_CONTROLLER_0_IAM_Rx_IESS_50ms_Group14_Reserved2_IESS_50ms_Group14_ESS_PTCANFD_50ms_FrP14_CONTROLLER_0_IAM_Rx, ComSignalType=UINT8
          IBMSOfbdChrgRelayAdh_IESS_50ms_Group14_ESS_PTCANFD_50ms_FrP14_CONTROLLER_0_IAM_Rx: ComBitPosition=34, ComBitSize=6, ComHandleId=IESS_50ms_Group14_ESS_PTCANFD_50ms_FrP14_CONTROLLER_0_IAM_Rx_IBMSOfbdChrgRelayAdh_IESS_50ms_Group14_ESS_PTCANFD_50ms_FrP14_CONTROLLER_0_IAM_Rx, ComSignalType=UINT8
          IESS_50ms_Group14_Reserved3_IESS_50ms_Group14_ESS_PTCANFD_50ms_FrP14_CONTROLLER_0_IAM_Rx: ComBitPosition=40, ComBitSize=4, ComHandleId=IESS_50ms_Group14_ESS_PTCANFD_50ms_FrP14_CONTROLLER_0_IAM_Rx_IESS_50ms_Group14_Reserved3_IESS_50ms_Group14_ESS_PTCANFD_50ms_FrP14_CONTROLLER_0_IAM_Rx, ComSignalType=UINT8
          IBMSKeepSysAwkScene_IESS_50ms_Group14_ESS_PTCANFD_50ms_FrP14_CONTROLLER_0_IAM_Rx: ComBitPosition=44, ComBitSize=4, ComHandleId=IESS_50ms_Group14_ESS_PTCANFD_50ms_FrP14_CONTROLLER_0_IAM_Rx_IBMSKeepSysAwkScene_IESS_50ms_Group14_ESS_PTCANFD_50ms_FrP14_CONTROLLER_0_IAM_Rx, ComSignalType=UINT8
          IBMSPtIsltnRstc_IESS_50ms_Group14_ESS_PTCANFD_50ms_FrP14_CONTROLLER_0_IAM_Rx: ComBitPosition=58, ComBitSize=14, ComHandleId=IESS_50ms_Group14_ESS_PTCANFD_50ms_FrP14_CONTROLLER_0_IAM_Rx_IBMSPtIsltnRstc_IESS_50ms_Group14_ESS_PTCANFD_50ms_FrP14_CONTROLLER_0_IAM_Rx, ComSignalType=UINT16
          IBMSHVILSts_IESS_50ms_Group14_ESS_PTCANFD_50ms_FrP14_CONTROLLER_0_IAM_Rx: ComBitPosition=56, ComBitSize=2, ComHandleId=IESS_50ms_Group14_ESS_PTCANFD_50ms_FrP14_CONTROLLER_0_IAM_Rx_IBMSHVILSts_IESS_50ms_Group14_ESS_PTCANFD_50ms_FrP14_CONTROLLER_0_IAM_Rx, ComSignalType=UINT8
      ESS_PTCANFD_100ms_FrP29_CONTROLLER_0_IAM_Rx (ComIPdu):
        ComIPduCancellationSupport = false
        ComIPduDirection = RECEIVE
        ComIPduHandleId = COM_RXPDU_COM_ESS_PTCANFD_100ms_FrP29_CONTROLLER_0_IAM_Rx
        ComIPduSignalProcessing = DEFERRED
        ComIPduType = NORMAL
        ComPduIdRef = COM_ESS_PTCANFD_100ms_FrP29_CONTROLLER_0_IAM_Rx
        ComIPduSignalRef = IBMSDsChrgSpRsn_ESS_PTCANFD_100ms_FrP29_CONTROLLER_0_IAM_Rx
        ComIPduGroupRef = Com_RxPduGroup_CONTROLLER_0_IAM
      IBMSDsChrgSpRsn_ESS_PTCANFD_100ms_FrP29_CONTROLLER_0_IAM_Rx (ComSignal):
        ComBitPosition = 18
        ComBitSize = 5
        ComHandleId = IBMSDsChrgSpRsn_ESS_PTCANFD_100ms_FrP29_CONTROLLER_0_IAM_Rx
        ComInvalidNotification = NULL_PTR
        ComRxDataTimeoutAction = NONE
        ComSignalEndianness = BIG_ENDIAN
        ComSignalInitValue = 0x0
        ComSignalLength = 0
        ComSignalType = UINT8
        ComTransferProperty = PENDING
        ComSignalDataInvalidValue = 0x0
        ComDataInvalidAction = NOTIFY
        ComTimeout = 0.0
        ComFirstTimeout = 0.0
        ComNotification = Rte_COMCbk
      ESS_PTCANFD_100ms_FrP26_CONTROLLER_0_IAM_Rx (ComIPdu):
        ComIPduCancellationSupport = false
        ComIPduDirection = RECEIVE
        ComIPduHandleId = COM_RXPDU_COM_ESS_PTCANFD_100ms_FrP26_CONTROLLER_0_IAM_Rx
        ComIPduSignalProcessing = DEFERRED
        ComIPduType = NORMAL
        ComPduIdRef = COM_ESS_PTCANFD_100ms_FrP26_CONTROLLER_0_IAM_Rx
        ComIPduSignalRef = IBMSPackSOC_ESS_PTCANFD_100ms_FrP26_CONTROLLER_0_IAM_Rx
        ComIPduSignalRef = IBMSPackSOCV_ESS_PTCANFD_100ms_FrP26_CONTROLLER_0_IAM_Rx
        ComIPduSignalRef = IBMSPackSOCDsp_ESS_PTCANFD_100ms_FrP26_CONTROLLER_0_IAM_Rx
        ComIPduSignalRef = IBMSPackSOCDspV_ESS_PTCANFD_100ms_FrP26_CONTROLLER_0_IAM_Rx
        ComIPduGroupRef = Com_RxPduGroup_CONTROLLER_0_IAM
      4 x ComSignal, all with ComInvalidNotification=NULL_PTR, ComRxDataTimeoutAction=NONE, ComSignalEndianness=BIG_ENDIAN, ComSignalInitValue=0x0, ComSignalLength=0, ComTransferProperty=PENDING, ComSignalDataInvalidValue=0x0, ComDataInvalidAction=NOTIFY, ComTimeout=0.0, ComFirstTimeout=0.0, ComNotification=Rte_COMCbk:
        IBMSPackSOC_ESS_PTCANFD_100ms_FrP26_CONTROLLER_0_IAM_Rx: ComBitPosition=24, ComBitSize=10, ComHandleId=IBMSPackSOC_ESS_PTCANFD_100ms_FrP26_CONTROLLER_0_IAM_Rx, ComSignalType=UINT16
        IBMSPackSOCV_ESS_PTCANFD_100ms_FrP26_CONTROLLER_0_IAM_Rx: ComBitPosition=18, ComBitSize=1, ComHandleId=IBMSPackSOCV_ESS_PTCANFD_100ms_FrP26_CONTROLLER_0_IAM_Rx, ComSignalType=BOOLEAN
        IBMSPackSOCDsp_ESS_PTCANFD_100ms_FrP26_CONTROLLER_0_IAM_Rx: ComBitPosition=48, ComBitSize=10, ComHandleId=IBMSPackSOCDsp_ESS_PTCANFD_100ms_FrP26_CONTROLLER_0_IAM_Rx, ComSignalType=UINT16
        IBMSPackSOCDspV_ESS_PTCANFD_100ms_FrP26_CONTROLLER_0_IAM_Rx: ComBitPosition=42, ComBitSize=1, ComHandleId=IBMSPackSOCDspV_ESS_PTCANFD_100ms_FrP26_CONTROLLER_0_IAM_Rx, ComSignalType=BOOLEAN
      ESS_PTCANFD_50ms_FrP06_CONTROLLER_0_IAM_Rx (ComIPdu):
        ComIPduCancellationSupport = false
        ComIPduDirection = RECEIVE
        ComIPduHandleId = COM_RXPDU_COM_ESS_PTCANFD_50ms_FrP06_CONTROLLER_0_IAM_Rx
        ComIPduSignalProcessing = DEFERRED
        ComIPduType = NORMAL
        ComPduIdRef = COM_ESS_PTCANFD_50ms_FrP06_CONTROLLER_0_IAM_Rx
        ComIPduSignalRef = IGroupVolIndex_Sec00_ESS_PTCANFD_50ms_FrP06_CONTROLLER_0_IAM_Rx
        ComIPduSignalRef = ICellAVol_Sec00_ESS_PTCANFD_50ms_FrP06_CONTROLLER_0_IAM_Rx
        ComIPduSignalRef = ICellBVol_Sec00_ESS_PTCANFD_50ms_FrP06_CONTROLLER_0_IAM_Rx
        ComIPduSignalRef = ICellAVolV_Sec00_ESS_PTCANFD_50ms_FrP06_CONTROLLER_0_IAM_Rx
        ComIPduSignalRef = ICellCVol_Sec00_ESS_PTCANFD_50ms_FrP06_CONTROLLER_0_IAM_Rx
        ComIPduSignalRef = ICellDVol_Sec00_ESS_PTCANFD_50ms_FrP06_CONTROLLER_0_IAM_Rx
        ComIPduSignalRef = ICellDVolV_Sec00_ESS_PTCANFD_50ms_FrP06_CONTROLLER_0_IAM_Rx
        ComIPduSignalRef = ICellCVolV_Sec00_ESS_PTCANFD_50ms_FrP06_CONTROLLER_0_IAM_Rx
        ComIPduSignalRef = ICellBVolV_Sec00_ESS_PTCANFD_50ms_FrP06_CONTROLLER_0_IAM_Rx
        ComIPduGroupRef = Com_RxPduGroup_CONTROLLER_0_IAM
      9 x ComSignal, all with ComInvalidNotification=NULL_PTR, ComRxDataTimeoutAction=NONE, ComSignalEndianness=BIG_ENDIAN, ComSignalInitValue=0x0, ComSignalLength=0, ComTransferProperty=PENDING, ComSignalDataInvalidValue=0x0, ComDataInvalidAction=NOTIFY, ComTimeout=0.0, ComFirstTimeout=0.0, ComNotification=Rte_COMCbk:
        IGroupVolIndex_Sec00_ESS_PTCANFD_50ms_FrP06_CONTROLLER_0_IAM_Rx: ComBitPosition=0, ComBitSize=8, ComHandleId=IGroupVolIndex_Sec00_ESS_PTCANFD_50ms_FrP06_CONTROLLER_0_IAM_Rx, ComSignalType=UINT8
        ICellAVol_Sec00_ESS_PTCANFD_50ms_FrP06_CONTROLLER_0_IAM_Rx: ComBitPosition=19, ComBitSize=13, ComHandleId=ICellAVol_Sec00_ESS_PTCANFD_50ms_FrP06_CONTROLLER_0_IAM_Rx, ComSignalType=UINT16
        ICellBVol_Sec00_ESS_PTCANFD_50ms_FrP06_CONTROLLER_0_IAM_Rx: ComBitPosition=37, ComBitSize=13, ComHandleId=ICellBVol_Sec00_ESS_PTCANFD_50ms_FrP06_CONTROLLER_0_IAM_Rx, ComSignalType=UINT16
        ICellAVolV_Sec00_ESS_PTCANFD_50ms_FrP06_CONTROLLER_0_IAM_Rx: ComBitPosition=18, ComBitSize=1, ComHandleId=ICellAVolV_Sec00_ESS_PTCANFD_50ms_FrP06_CONTROLLER_0_IAM_Rx, ComSignalType=BOOLEAN
        ICellCVol_Sec00_ESS_PTCANFD_50ms_FrP06_CONTROLLER_0_IAM_Rx: ComBitPosition=40, ComBitSize=13, ComHandleId=ICellCVol_Sec00_ESS_PTCANFD_50ms_FrP06_CONTROLLER_0_IAM_Rx, ComSignalType=UINT16
        ICellDVol_Sec00_ESS_PTCANFD_50ms_FrP06_CONTROLLER_0_IAM_Rx: ComBitPosition=56, ComBitSize=13, ComHandleId=ICellDVol_Sec00_ESS_PTCANFD_50ms_FrP06_CONTROLLER_0_IAM_Rx, ComSignalType=UINT16
        ICellDVolV_Sec00_ESS_PTCANFD_50ms_FrP06_CONTROLLER_0_IAM_Rx: ComBitPosition=53, ComBitSize=1, ComHandleId=ICellDVolV_Sec00_ESS_PTCANFD_50ms_FrP06_CONTROLLER_0_IAM_Rx, ComSignalType=BOOLEAN
        ICellCVolV_Sec00_ESS_PTCANFD_50ms_FrP06_CONTROLLER_0_IAM_Rx: ComBitPosition=54, ComBitSize=1, ComHandleId=ICellCVolV_Sec00_ESS_PTCANFD_50ms_FrP06_CONTROLLER_0_IAM_Rx, ComSignalType=BOOLEAN
        ICellBVolV_Sec00_ESS_PTCANFD_50ms_FrP06_CONTROLLER_0_IAM_Rx: ComBitPosition=55, ComBitSize=1, ComHandleId=ICellBVolV_Sec00_ESS_PTCANFD_50ms_FrP06_CONTROLLER_0_IAM_Rx, ComSignalType=BOOLEAN
      ESS_PTCANFD_50ms_FrP07_CONTROLLER_0_IAM_Rx (ComIPdu):
        ComIPduCancellationSupport = false
        ComIPduDirection = RECEIVE
        ComIPduHandleId = COM_RXPDU_COM_ESS_PTCANFD_50ms_FrP07_CONTROLLER_0_IAM_Rx
        ComIPduSignalProcessing = DEFERRED
        ComIPduType = NORMAL
        ComPduIdRef = COM_ESS_PTCANFD_50ms_FrP07_CONTROLLER_0_IAM_Rx
        ComIPduSignalRef = ICellBVol_Sec01_ESS_PTCANFD_50ms_FrP07_CONTROLLER_0_IAM_Rx
        ComIPduSignalRef = ICellAVolV_Sec01_ESS_PTCANFD_50ms_FrP07_CONTROLLER_0_IAM_Rx
        ComIPduSignalRef = ICellBVolV_Sec01_ESS_PTCANFD_50ms_FrP07_CONTROLLER_0_IAM_Rx
        ComIPduSignalRef = ICellCVolV_Sec01_ESS_PTCANFD_50ms_FrP07_CONTROLLER_0_IAM_Rx
        ComIPduSignalRef = IGroupVolIndex_Sec01_ESS_PTCANFD_50ms_FrP07_CONTROLLER_0_IAM_Rx
        ComIPduSignalRef = ICellDVol_Sec01_ESS_PTCANFD_50ms_FrP07_CONTROLLER_0_IAM_Rx
        ComIPduSignalRef = ICellCVol_Sec01_ESS_PTCANFD_50ms_FrP07_CONTROLLER_0_IAM_Rx
        ComIPduSignalRef = ICellDVolV_Sec01_ESS_PTCANFD_50ms_FrP07_CONTROLLER_0_IAM_Rx
        ComIPduSignalRef = ICellAVol_Sec01_ESS_PTCANFD_50ms_FrP07_CONTROLLER_0_IAM_Rx
        ComIPduGroupRef = Com_RxPduGroup_CONTROLLER_0_IAM
      9 x ComSignal, all with ComInvalidNotification=NULL_PTR, ComRxDataTimeoutAction=NONE, ComSignalEndianness=BIG_ENDIAN, ComSignalInitValue=0x0, ComSignalLength=0, ComTransferProperty=PENDING, ComSignalDataInvalidValue=0x0, ComDataInvalidAction=NOTIFY, ComTimeout=0.0, ComFirstTimeout=0.0, ComNotification=Rte_COMCbk:
        ICellBVol_Sec01_ESS_PTCANFD_50ms_FrP07_CONTROLLER_0_IAM_Rx: ComBitPosition=8, ComBitSize=13, ComHandleId=ICellBVol_Sec01_ESS_PTCANFD_50ms_FrP07_CONTROLLER_0_IAM_Rx, ComSignalType=UINT16
        ICellAVolV_Sec01_ESS_PTCANFD_50ms_FrP07_CONTROLLER_0_IAM_Rx: ComBitPosition=5, ComBitSize=1, ComHandleId=ICellAVolV_Sec01_ESS_PTCANFD_50ms_FrP07_CONTROLLER_0_IAM_Rx, ComSignalType=BOOLEAN
        ICellBVolV_Sec01_ESS_PTCANFD_50ms_FrP07_CONTROLLER_0_IAM_Rx: ComBitPosition=6, ComBitSize=1, ComHandleId=ICellBVolV_Sec01_ESS_PTCANFD_50ms_FrP07_CONTROLLER_0_IAM_Rx, ComSignalType=BOOLEAN
        ICellCVolV_Sec01_ESS_PTCANFD_50ms_FrP07_CONTROLLER_0_IAM_Rx: ComBitPosition=7, ComBitSize=1, ComHandleId=ICellCVolV_Sec01_ESS_PTCANFD_50ms_FrP07_CONTROLLER_0_IAM_Rx, ComSignalType=BOOLEAN
        IGroupVolIndex_Sec01_ESS_PTCANFD_50ms_FrP07_CONTROLLER_0_IAM_Rx: ComBitPosition=16, ComBitSize=8, ComHandleId=IGroupVolIndex_Sec01_ESS_PTCANFD_50ms_FrP07_CONTROLLER_0_IAM_Rx, ComSignalType=UINT8
        ICellDVol_Sec01_ESS_PTCANFD_50ms_FrP07_CONTROLLER_0_IAM_Rx: ComBitPosition=35, ComBitSize=13, ComHandleId=ICellDVol_Sec01_ESS_PTCANFD_50ms_FrP07_CONTROLLER_0_IAM_Rx, ComSignalType=UINT16
        ICellCVol_Sec01_ESS_PTCANFD_50ms_FrP07_CONTROLLER_0_IAM_Rx: ComBitPosition=53, ComBitSize=13, ComHandleId=ICellCVol_Sec01_ESS_PTCANFD_50ms_FrP07_CONTROLLER_0_IAM_Rx, ComSignalType=UINT16
        ICellDVolV_Sec01_ESS_PTCANFD_50ms_FrP07_CONTROLLER_0_IAM_Rx: ComBitPosition=34, ComBitSize=1, ComHandleId=ICellDVolV_Sec01_ESS_PTCANFD_50ms_FrP07_CONTROLLER_0_IAM_Rx, ComSignalType=BOOLEAN
        ICellAVol_Sec01_ESS_PTCANFD_50ms_FrP07_CONTROLLER_0_IAM_Rx: ComBitPosition=56, ComBitSize=13, ComHandleId=ICellAVol_Sec01_ESS_PTCANFD_50ms_FrP07_CONTROLLER_0_IAM_Rx, ComSignalType=UINT16
      ESS_PTCANFD_50ms_FrP09_CONTROLLER_0_IAM_Rx (ComIPdu):
        ComIPduCancellationSupport = false
        ComIPduDirection = RECEIVE
        ComIPduHandleId = COM_RXPDU_COM_ESS_PTCANFD_50ms_FrP09_CONTROLLER_0_IAM_Rx
        ComIPduSignalProcessing = DEFERRED
        ComIPduType = NORMAL
        ComPduIdRef = COM_ESS_PTCANFD_50ms_FrP09_CONTROLLER_0_IAM_Rx
        ComIPduSignalRef = ICellBVol_Sec02_ESS_PTCANFD_50ms_FrP09_CONTROLLER_0_IAM_Rx
        ComIPduSignalRef = ICellAVolV_Sec02_ESS_PTCANFD_50ms_FrP09_CONTROLLER_0_IAM_Rx
        ComIPduSignalRef = ICellBVolV_Sec02_ESS_PTCANFD_50ms_FrP09_CONTROLLER_0_IAM_Rx
        ComIPduSignalRef = ICellCVolV_Sec02_ESS_PTCANFD_50ms_FrP09_CONTROLLER_0_IAM_Rx
        ComIPduSignalRef = IGroupVolIndex_Sec02_ESS_PTCANFD_50ms_FrP09_CONTROLLER_0_IAM_Rx
        ComIPduSignalRef = ICellDVol_Sec02_ESS_PTCANFD_50ms_FrP09_CONTROLLER_0_IAM_Rx
        ComIPduSignalRef = ICellCVol_Sec02_ESS_PTCANFD_50ms_FrP09_CONTROLLER_0_IAM_Rx
        ComIPduSignalRef = ICellDVolV_Sec02_ESS_PTCANFD_50ms_FrP09_CONTROLLER_0_IAM_Rx
        ComIPduSignalRef = ICellAVol_Sec02_ESS_PTCANFD_50ms_FrP09_CONTROLLER_0_IAM_Rx
        ComIPduGroupRef = Com_RxPduGroup_CONTROLLER_0_IAM
      9 x ComSignal, all with ComInvalidNotification=NULL_PTR, ComRxDataTimeoutAction=NONE, ComSignalEndianness=BIG_ENDIAN, ComSignalInitValue=0x0, ComSignalLength=0, ComTransferProperty=PENDING, ComSignalDataInvalidValue=0x0, ComDataInvalidAction=NOTIFY, ComTimeout=0.0, ComFirstTimeout=0.0, ComNotification=Rte_COMCbk:
        ICellBVol_Sec02_ESS_PTCANFD_50ms_FrP09_CONTROLLER_0_IAM_Rx: ComBitPosition=8, ComBitSize=13, ComHandleId=ICellBVol_Sec02_ESS_PTCANFD_50ms_FrP09_CONTROLLER_0_IAM_Rx, ComSignalType=UINT16
        ICellAVolV_Sec02_ESS_PTCANFD_50ms_FrP09_CONTROLLER_0_IAM_Rx: ComBitPosition=5, ComBitSize=1, ComHandleId=ICellAVolV_Sec02_ESS_PTCANFD_50ms_FrP09_CONTROLLER_0_IAM_Rx, ComSignalType=BOOLEAN
        ICellBVolV_Sec02_ESS_PTCANFD_50ms_FrP09_CONTROLLER_0_IAM_Rx: ComBitPosition=6, ComBitSize=1, ComHandleId=ICellBVolV_Sec02_ESS_PTCANFD_50ms_FrP09_CONTROLLER_0_IAM_Rx, ComSignalType=BOOLEAN
        ICellCVolV_Sec02_ESS_PTCANFD_50ms_FrP09_CONTROLLER_0_IAM_Rx: ComBitPosition=7, ComBitSize=1, ComHandleId=ICellCVolV_Sec02_ESS_PTCANFD_50ms_FrP09_CONTROLLER_0_IAM_Rx, ComSignalType=BOOLEAN
        IGroupVolIndex_Sec02_ESS_PTCANFD_50ms_FrP09_CONTROLLER_0_IAM_Rx: ComBitPosition=16, ComBitSize=8, ComHandleId=IGroupVolIndex_Sec02_ESS_PTCANFD_50ms_FrP09_CONTROLLER_0_IAM_Rx, ComSignalType=UINT8
        ICellDVol_Sec02_ESS_PTCANFD_50ms_FrP09_CONTROLLER_0_IAM_Rx: ComBitPosition=35, ComBitSize=13, ComHandleId=ICellDVol_Sec02_ESS_PTCANFD_50ms_FrP09_CONTROLLER_0_IAM_Rx, ComSignalType=UINT16
        ICellCVol_Sec02_ESS_PTCANFD_50ms_FrP09_CONTROLLER_0_IAM_Rx: ComBitPosition=53, ComBitSize=13, ComHandleId=ICellCVol_Sec02_ESS_PTCANFD_50ms_FrP09_CONTROLLER_0_IAM_Rx, ComSignalType=UINT16
        ICellDVolV_Sec02_ESS_PTCANFD_50ms_FrP09_CONTROLLER_0_IAM_Rx: ComBitPosition=34, ComBitSize=1, ComHandleId=ICellDVolV_Sec02_ESS_PTCANFD_50ms_FrP09_CONTROLLER_0_IAM_Rx, ComSignalType=BOOLEAN
        ICellAVol_Sec02_ESS_PTCANFD_50ms_FrP09_CONTROLLER_0_IAM_Rx: ComBitPosition=56, ComBitSize=13, ComHandleId=ICellAVol_Sec02_ESS_PTCANFD_50ms_FrP09_CONTROLLER_0_IAM_Rx, ComSignalType=UINT16
      ESS_PTCANFD_50ms_FrP13_CONTROLLER_0_IAM_Rx (ComIPdu):
        ComIPduCancellationSupport = false
        ComIPduDirection = RECEIVE
        ComIPduHandleId = COM_RXPDU_COM_ESS_PTCANFD_50ms_FrP13_CONTROLLER_0_IAM_Rx
        ComIPduSignalProcessing = DEFERRED
        ComIPduType = NORMAL
        ComPduIdRef = COM_ESS_PTCANFD_50ms_FrP13_CONTROLLER_0_IAM_Rx
        ComIPduSignalRef = IBusbarCTemV_Sec00_ESS_PTCANFD_50ms_FrP13_CONTROLLER_0_IAM_Rx
        ComIPduSignalRef = IBusbarBTemV_Sec00_ESS_PTCANFD_50ms_FrP13_CONTROLLER_0_IAM_Rx
        ComIPduSignalRef = IBusbarATemV_Sec00_ESS_PTCANFD_50ms_FrP13_CONTROLLER_0_IAM_Rx
        ComIPduSignalRef = IBusbarFTemV_Sec00_ESS_PTCANFD_50ms_FrP13_CONTROLLER_0_IAM_Rx
        ComIPduSignalRef = IBusbarETemV_Sec00_ESS_PTCANFD_50ms_FrP13_CONTROLLER_0_IAM_Rx
        ComIPduSignalRef = IBusbarDTemV_Sec00_ESS_PTCANFD_50ms_FrP13_CONTROLLER_0_IAM_Rx
        ComIPduSignalRef = IBusbarDTem_Sec00_ESS_PTCANFD_50ms_FrP13_CONTROLLER_0_IAM_Rx
        ComIPduSignalRef = IBusbarETem_Sec00_ESS_PTCANFD_50ms_FrP13_CONTROLLER_0_IAM_Rx
        ComIPduSignalRef = IBusbarFTem_Sec00_ESS_PTCANFD_50ms_FrP13_CONTROLLER_0_IAM_Rx
        ComIPduSignalRef = IBusbarATem_Sec00_ESS_PTCANFD_50ms_FrP13_CONTROLLER_0_IAM_Rx
        ComIPduSignalRef = IBusbarBTem_Sec00_ESS_PTCANFD_50ms_FrP13_CONTROLLER_0_IAM_Rx
        ComIPduSignalRef = IBusbarCTem_Sec00_ESS_PTCANFD_50ms_FrP13_CONTROLLER_0_IAM_Rx
        ComIPduSignalRef = IGroupBusbarTemIndex_Sec00_ESS_PTCANFD_50ms_FrP13_CONTROLLER_0_IAM_Rx
        ComIPduGroupRef = Com_RxPduGroup_CONTROLLER_0_IAM
      13 x ComSignal, all with ComInvalidNotification=NULL_PTR, ComRxDataTimeoutAction=NONE, ComSignalEndianness=BIG_ENDIAN, ComSignalInitValue=0x0, ComSignalLength=0, ComTransferProperty=PENDING, ComSignalDataInvalidValue=0x0, ComDataInvalidAction=NOTIFY, ComTimeout=0.0, ComFirstTimeout=0.0, ComNotification=Rte_COMCbk:
        IBusbarCTemV_Sec00_ESS_PTCANFD_50ms_FrP13_CONTROLLER_0_IAM_Rx: ComBitPosition=2, ComBitSize=1, ComHandleId=IBusbarCTemV_Sec00_ESS_PTCANFD_50ms_FrP13_CONTROLLER_0_IAM_Rx, ComSignalType=BOOLEAN
        IBusbarBTemV_Sec00_ESS_PTCANFD_50ms_FrP13_CONTROLLER_0_IAM_Rx: ComBitPosition=3, ComBitSize=1, ComHandleId=IBusbarBTemV_Sec00_ESS_PTCANFD_50ms_FrP13_CONTROLLER_0_IAM_Rx, ComSignalType=BOOLEAN
        IBusbarATemV_Sec00_ESS_PTCANFD_50ms_FrP13_CONTROLLER_0_IAM_Rx: ComBitPosition=4, ComBitSize=1, ComHandleId=IBusbarATemV_Sec00_ESS_PTCANFD_50ms_FrP13_CONTROLLER_0_IAM_Rx, ComSignalType=BOOLEAN
        IBusbarFTemV_Sec00_ESS_PTCANFD_50ms_FrP13_CONTROLLER_0_IAM_Rx: ComBitPosition=5, ComBitSize=1, ComHandleId=IBusbarFTemV_Sec00_ESS_PTCANFD_50ms_FrP13_CONTROLLER_0_IAM_Rx, ComSignalType=BOOLEAN
        IBusbarETemV_Sec00_ESS_PTCANFD_50ms_FrP13_CONTROLLER_0_IAM_Rx: ComBitPosition=6, ComBitSize=1, ComHandleId=IBusbarETemV_Sec00_ESS_PTCANFD_50ms_FrP13_CONTROLLER_0_IAM_Rx, ComSignalType=BOOLEAN
        IBusbarDTemV_Sec00_ESS_PTCANFD_50ms_FrP13_CONTROLLER_0_IAM_Rx: ComBitPosition=7, ComBitSize=1, ComHandleId=IBusbarDTemV_Sec00_ESS_PTCANFD_50ms_FrP13_CONTROLLER_0_IAM_Rx, ComSignalType=BOOLEAN
        IBusbarDTem_Sec00_ESS_PTCANFD_50ms_FrP13_CONTROLLER_0_IAM_Rx: ComBitPosition=8, ComBitSize=8, ComHandleId=IBusbarDTem_Sec00_ESS_PTCANFD_50ms_FrP13_CONTROLLER_0_IAM_Rx, ComSignalType=UINT8
        IBusbarETem_Sec00_ESS_PTCANFD_50ms_FrP13_CONTROLLER_0_IAM_Rx: ComBitPosition=16, ComBitSize=8, ComHandleId=IBusbarETem_Sec00_ESS_PTCANFD_50ms_FrP13_CONTROLLER_0_IAM_Rx, ComSignalType=UINT8
        IBusbarFTem_Sec00_ESS_PTCANFD_50ms_FrP13_CONTROLLER_0_IAM_Rx: ComBitPosition=24, ComBitSize=8, ComHandleId=IBusbarFTem_Sec00_ESS_PTCANFD_50ms_FrP13_CONTROLLER_0_IAM_Rx, ComSignalType=UINT8
        IBusbarATem_Sec00_ESS_PTCANFD_50ms_FrP13_CONTROLLER_0_IAM_Rx: ComBitPosition=32, ComBitSize=8, ComHandleId=IBusbarATem_Sec00_ESS_PTCANFD_50ms_FrP13_CONTROLLER_0_IAM_Rx, ComSignalType=UINT8
        IBusbarBTem_Sec00_ESS_PTCANFD_50ms_FrP13_CONTROLLER_0_IAM_Rx: ComBitPosition=40, ComBitSize=8, ComHandleId=IBusbarBTem_Sec00_ESS_PTCANFD_50ms_FrP13_CONTROLLER_0_IAM_Rx, ComSignalType=UINT8
        IBusbarCTem_Sec00_ESS_PTCANFD_50ms_FrP13_CONTROLLER_0_IAM_Rx: ComBitPosition=48, ComBitSize=8, ComHandleId=IBusbarCTem_Sec00_ESS_PTCANFD_50ms_FrP13_CONTROLLER_0_IAM_Rx, ComSignalType=UINT8
        IGroupBusbarTemIndex_Sec00_ESS_PTCANFD_50ms_FrP13_CONTROLLER_0_IAM_Rx: ComBitPosition=56, ComBitSize=8, ComHandleId=IGroupBusbarTemIndex_Sec00_ESS_PTCANFD_50ms_FrP13_CONTROLLER_0_IAM_Rx, ComSignalType=UINT8
      ESS_PTCANFD_50ms_FrP08_CONTROLLER_0_IAM_Rx (ComIPdu):
        ComIPduCancellationSupport = false
        ComIPduDirection = RECEIVE
        ComIPduHandleId = COM_RXPDU_COM_ESS_PTCANFD_50ms_FrP08_CONTROLLER_0_IAM_Rx
        ComIPduSignalProcessing = DEFERRED
        ComIPduType = NORMAL
        ComPduIdRef = COM_ESS_PTCANFD_50ms_FrP08_CONTROLLER_0_IAM_Rx
        ComIPduSignalRef = ICellATem_Sec00_ESS_PTCANFD_50ms_FrP08_CONTROLLER_0_IAM_Rx
        ComIPduSignalRef = ICellBTem_Sec00_ESS_PTCANFD_50ms_FrP08_CONTROLLER_0_IAM_Rx
        ComIPduSignalRef = IGroupCellTemIndex_Sec00_ESS_PTCANFD_50ms_FrP08_CONTROLLER_0_IAM_Rx
        ComIPduSignalRef = ICellATemV_Sec00_ESS_PTCANFD_50ms_FrP08_CONTROLLER_0_IAM_Rx
        ComIPduSignalRef = ICellBTemV_Sec00_ESS_PTCANFD_50ms_FrP08_CONTROLLER_0_IAM_Rx
        ComIPduSignalRef = ICellCTemV_Sec00_ESS_PTCANFD_50ms_FrP08_CONTROLLER_0_IAM_Rx
        ComIPduSignalRef = ICellDTemV_Sec00_ESS_PTCANFD_50ms_FrP08_CONTROLLER_0_IAM_Rx
        ComIPduSignalRef = ICellETemV_Sec00_ESS_PTCANFD_50ms_FrP08_CONTROLLER_0_IAM_Rx
        ComIPduSignalRef = ICellFTemV_Sec00_ESS_PTCANFD_50ms_FrP08_CONTROLLER_0_IAM_Rx
        ComIPduSignalRef = ICellCTem_Sec00_ESS_PTCANFD_50ms_FrP08_CONTROLLER_0_IAM_Rx
        ComIPduSignalRef = ICellDTem_Sec00_ESS_PTCANFD_50ms_FrP08_CONTROLLER_0_IAM_Rx
        ComIPduSignalRef = ICellETem_Sec00_ESS_PTCANFD_50ms_FrP08_CONTROLLER_0_IAM_Rx
        ComIPduSignalRef = ICellFTem_Sec00_ESS_PTCANFD_50ms_FrP08_CONTROLLER_0_IAM_Rx
        ComIPduGroupRef = Com_RxPduGroup_CONTROLLER_0_IAM
      13 x ComSignal, all with ComInvalidNotification=NULL_PTR, ComRxDataTimeoutAction=NONE, ComSignalEndianness=BIG_ENDIAN, ComSignalInitValue=0x0, ComSignalLength=0, ComTransferProperty=PENDING, ComSignalDataInvalidValue=0x0, ComDataInvalidAction=NOTIFY, ComTimeout=0.0, ComFirstTimeout=0.0, ComNotification=Rte_COMCbk:
        ICellATem_Sec00_ESS_PTCANFD_50ms_FrP08_CONTROLLER_0_IAM_Rx: ComBitPosition=0, ComBitSize=8, ComHandleId=ICellATem_Sec00_ESS_PTCANFD_50ms_FrP08_CONTROLLER_0_IAM_Rx, ComSignalType=UINT8
        ICellBTem_Sec00_ESS_PTCANFD_50ms_FrP08_CONTROLLER_0_IAM_Rx: ComBitPosition=8, ComBitSize=8, ComHandleId=ICellBTem_Sec00_ESS_PTCANFD_50ms_FrP08_CONTROLLER_0_IAM_Rx, ComSignalType=UINT8
        IGroupCellTemIndex_Sec00_ESS_PTCANFD_50ms_FrP08_CONTROLLER_0_IAM_Rx: ComBitPosition=16, ComBitSize=8, ComHandleId=IGroupCellTemIndex_Sec00_ESS_PTCANFD_50ms_FrP08_CONTROLLER_0_IAM_Rx, ComSignalType=UINT8
        ICellATemV_Sec00_ESS_PTCANFD_50ms_FrP08_CONTROLLER_0_IAM_Rx: ComBitPosition=24, ComBitSize=1, ComHandleId=ICellATemV_Sec00_ESS_PTCANFD_50ms_FrP08_CONTROLLER_0_IAM_Rx, ComSignalType=BOOLEAN
        ICellBTemV_Sec00_ESS_PTCANFD_50ms_FrP08_CONTROLLER_0_IAM_Rx: ComBitPosition=25, ComBitSize=1, ComHandleId=ICellBTemV_Sec00_ESS_PTCANFD_50ms_FrP08_CONTROLLER_0_IAM_Rx, ComSignalType=BOOLEAN
        ICellCTemV_Sec00_ESS_PTCANFD_50ms_FrP08_CONTROLLER_0_IAM_Rx: ComBitPosition=26, ComBitSize=1, ComHandleId=ICellCTemV_Sec00_ESS_PTCANFD_50ms_FrP08_CONTROLLER_0_IAM_Rx, ComSignalType=BOOLEAN
        ICellDTemV_Sec00_ESS_PTCANFD_50ms_FrP08_CONTROLLER_0_IAM_Rx: ComBitPosition=27, ComBitSize=1, ComHandleId=ICellDTemV_Sec00_ESS_PTCANFD_50ms_FrP08_CONTROLLER_0_IAM_Rx, ComSignalType=BOOLEAN
        ICellETemV_Sec00_ESS_PTCANFD_50ms_FrP08_CONTROLLER_0_IAM_Rx: ComBitPosition=28, ComBitSize=1, ComHandleId=ICellETemV_Sec00_ESS_PTCANFD_50ms_FrP08_CONTROLLER_0_IAM_Rx, ComSignalType=BOOLEAN
        ICellFTemV_Sec00_ESS_PTCANFD_50ms_FrP08_CONTROLLER_0_IAM_Rx: ComBitPosition=29, ComBitSize=1, ComHandleId=ICellFTemV_Sec00_ESS_PTCANFD_50ms_FrP08_CONTROLLER_0_IAM_Rx, ComSignalType=BOOLEAN
        ICellCTem_Sec00_ESS_PTCANFD_50ms_FrP08_CONTROLLER_0_IAM_Rx: ComBitPosition=32, ComBitSize=8, ComHandleId=ICellCTem_Sec00_ESS_PTCANFD_50ms_FrP08_CONTROLLER_0_IAM_Rx, ComSignalType=UINT8
        ICellDTem_Sec00_ESS_PTCANFD_50ms_FrP08_CONTROLLER_0_IAM_Rx: ComBitPosition=40, ComBitSize=8, ComHandleId=ICellDTem_Sec00_ESS_PTCANFD_50ms_FrP08_CONTROLLER_0_IAM_Rx, ComSignalType=UINT8
        ICellETem_Sec00_ESS_PTCANFD_50ms_FrP08_CONTROLLER_0_IAM_Rx: ComBitPosition=48, ComBitSize=8, ComHandleId=ICellETem_Sec00_ESS_PTCANFD_50ms_FrP08_CONTROLLER_0_IAM_Rx, ComSignalType=UINT8
        ICellFTem_Sec00_ESS_PTCANFD_50ms_FrP08_CONTROLLER_0_IAM_Rx: ComBitPosition=56, ComBitSize=8, ComHandleId=ICellFTem_Sec00_ESS_PTCANFD_50ms_FrP08_CONTROLLER_0_IAM_Rx, ComSignalType=UINT8
      ESS_PTCANFD_100ms_FrP21_CONTROLLER_0_IAM_Rx (ComIPdu):
        ComIPduCancellationSupport = false
        ComIPduDirection = RECEIVE
        ComIPduHandleId = COM_RXPDU_COM_ESS_PTCANFD_100ms_FrP21_CONTROLLER_0_IAM_Rx
        ComIPduSignalProcessing = DEFERRED
        ComIPduType = NORMAL
        ComPduIdRef = COM_ESS_PTCANFD_100ms_FrP21_CONTROLLER_0_IAM_Rx
        ComIPduSignalRef = IBMSDisChrgngEstdElecRng_ESS_PTCANFD_100ms_FrP21_CONTROLLER_0_IAM_Rx
        ComIPduSignalRef = IBMSDisChrgngEstdElecRngV_ESS_PTCANFD_100ms_FrP21_CONTROLLER_0_IAM_Rx
        ComIPduSignalRef = IBMSDisChrgTrgtSOCResp_ESS_PTCANFD_100ms_FrP21_CONTROLLER_0_IAM_Rx
        ComIPduSignalRef = IBMSDsChrgTrgtSOCDspCmd_ESS_PTCANFD_100ms_FrP21_CONTROLLER_0_IAM_Rx
        ComIPduSignalRef = IBMSChrgngAddedElecRngV_ESS_PTCANFD_100ms_FrP21_CONTROLLER_0_IAM_Rx
        ComIPduSignalRef = IBMSChrgngAddedElecRng_ESS_PTCANFD_100ms_FrP21_CONTROLLER_0_IAM_Rx
        ComIPduGroupRef = Com_RxPduGroup_CONTROLLER_0_IAM
      6 x ComSignal, all with ComInvalidNotification=NULL_PTR, ComRxDataTimeoutAction=NONE, ComSignalEndianness=BIG_ENDIAN, ComSignalInitValue=0x0, ComSignalLength=0, ComTransferProperty=PENDING, ComSignalDataInvalidValue=0x0, ComDataInvalidAction=NOTIFY, ComTimeout=0.0, ComFirstTimeout=0.0, ComNotification=Rte_COMCbk:
        IBMSDisChrgngEstdElecRng_ESS_PTCANFD_100ms_FrP21_CONTROLLER_0_IAM_Rx: ComBitPosition=12, ComBitSize=12, ComHandleId=IBMSDisChrgngEstdElecRng_ESS_PTCANFD_100ms_FrP21_CONTROLLER_0_IAM_Rx, ComSignalType=UINT16
        IBMSDisChrgngEstdElecRngV_ESS_PTCANFD_100ms_FrP21_CONTROLLER_0_IAM_Rx: ComBitPosition=8, ComBitSize=1, ComHandleId=IBMSDisChrgngEstdElecRngV_ESS_PTCANFD_100ms_FrP21_CONTROLLER_0_IAM_Rx, ComSignalType=BOOLEAN
        IBMSDisChrgTrgtSOCResp_ESS_PTCANFD_100ms_FrP21_CONTROLLER_0_IAM_Rx: ComBitPosition=9, ComBitSize=3, ComHandleId=IBMSDisChrgTrgtSOCResp_ESS_PTCANFD_100ms_FrP21_CONTROLLER_0_IAM_Rx, ComSignalType=UINT8
        IBMSDsChrgTrgtSOCDspCmd_ESS_PTCANFD_100ms_FrP21_CONTROLLER_0_IAM_Rx: ComBitPosition=16, ComBitSize=3, ComHandleId=IBMSDsChrgTrgtSOCDspCmd_ESS_PTCANFD_100ms_FrP21_CONTROLLER_0_IAM_Rx, ComSignalType=UINT8
        IBMSChrgngAddedElecRngV_ESS_PTCANFD_100ms_FrP21_CONTROLLER_0_IAM_Rx: ComBitPosition=33, ComBitSize=1, ComHandleId=IBMSChrgngAddedElecRngV_ESS_PTCANFD_100ms_FrP21_CONTROLLER_0_IAM_Rx, ComSignalType=BOOLEAN
        IBMSChrgngAddedElecRng_ESS_PTCANFD_100ms_FrP21_CONTROLLER_0_IAM_Rx: ComBitPosition=56, ComBitSize=11, ComHandleId=IBMSChrgngAddedElecRng_ESS_PTCANFD_100ms_FrP21_CONTROLLER_0_IAM_Rx, ComSignalType=UINT16
      RZCU_LHBKBCANFD_50ms_FrP37_CONTROLLER_0_IAM_Rx (ComIPdu):
        ComIPduCancellationSupport = false
        ComIPduDirection = RECEIVE
        ComIPduHandleId = COM_RXPDU_COM_RZCU_LHBKBCANFD_50ms_FrP37_CONTROLLER_0_IAM_Rx
        ComIPduSignalProcessing = DEFERRED
        ComIPduType = NORMAL
        ComPduIdRef = COM_RZCU_LHBKBCANFD_50ms_FrP37_CONTROLLER_0_IAM_Rx
        ComIPduSignalRef = ILdspcOpenSts_RZCU_LHBKBCANFD_50ms_FrP37_CONTROLLER_0_IAM_Rx
        ComIPduSignalRef = ILdspcOpenStsV_RZCU_LHBKBCANFD_50ms_FrP37_CONTROLLER_0_IAM_Rx
        ComIPduGroupRef = Com_RxPduGroup_CONTROLLER_0_IAM
      ILdspcOpenSts_RZCU_LHBKBCANFD_50ms_FrP37_CONTROLLER_0_IAM_Rx (ComSignal):
        ComBitPosition = 53
        ComBitSize = 1
        ComHandleId = ILdspcOpenSts_RZCU_LHBKBCANFD_50ms_FrP37_CONTROLLER_0_IAM_Rx
        ComInvalidNotification = NULL_PTR
        ComRxDataTimeoutAction = NONE
        ComSignalEndianness = BIG_ENDIAN
        ComSignalInitValue = 0x0
        ComSignalLength = 0
        ComSignalType = BOOLEAN
        ComTransferProperty = PENDING
        ComSignalDataInvalidValue = 0x0
        ComDataInvalidAction = NOTIFY
        ComTimeout = 0.0
        ComFirstTimeout = 0.0
        ComNotification = Rte_COMCbk
      ILdspcOpenStsV_RZCU_LHBKBCANFD_50ms_FrP37_CONTROLLER_0_IAM_Rx (ComSignal):
        ComBitPosition = 55
        ComBitSize = 1
        ComHandleId = ILdspcOpenStsV_RZCU_LHBKBCANFD_50ms_FrP37_CONTROLLER_0_IAM_Rx
        ComInvalidNotification = NULL_PTR
        ComRxDataTimeoutAction = NONE
        ComSignalEndianness = BIG_ENDIAN
        ComSignalInitValue = 0x0
        ComSignalLength = 0
        ComSignalType = BOOLEAN
        ComTransferProperty = PENDING
        ComSignalDataInvalidValue = 0x0
        ComDataInvalidAction = NOTIFY
        ComTimeout = 0.0
        ComFirstTimeout = 0.0
        ComNotification = Rte_COMCbk
      LHZCU_LHBKBCANFD_50ms_FrP04_CONTROLLER_0_IAM_Rx (ComIPdu):
        ComIPduCancellationSupport = false
        ComIPduDirection = RECEIVE
        ComIPduHandleId = COM_RXPDU_COM_LHZCU_LHBKBCANFD_50ms_FrP04_CONTROLLER_0_IAM_Rx
        ComIPduSignalProcessing = DEFERRED
        ComIPduType = NORMAL
        ComPduIdRef = COM_LHZCU_LHBKBCANFD_50ms_FrP04_CONTROLLER_0_IAM_Rx
        ComIPduSignalRef = IVehHzrdMdSts_LHZCU_LHBKBCANFD_50ms_FrP04_CONTROLLER_0_IAM_Rx
        ComIPduGroupRef = Com_RxPduGroup_CONTROLLER_0_IAM
      IVehHzrdMdSts_LHZCU_LHBKBCANFD_50ms_FrP04_CONTROLLER_0_IAM_Rx (ComSignal):
        ComBitPosition = 16
        ComBitSize = 4
        ComHandleId = IVehHzrdMdSts_LHZCU_LHBKBCANFD_50ms_FrP04_CONTROLLER_0_IAM_Rx
        ComInvalidNotification = NULL_PTR
        ComRxDataTimeoutAction = NONE
        ComSignalEndianness = BIG_ENDIAN
        ComSignalInitValue = 0x0
        ComSignalLength = 0
        ComSignalType = UINT8
        ComTransferProperty = PENDING
        ComSignalDataInvalidValue = 0x0
        ComDataInvalidAction = NOTIFY
        ComTimeout = 0.0
        ComFirstTimeout = 0.0
        ComNotification = Rte_COMCbk
      LHZCU_BKBCANFD_50ms_FrP24_CONTROLLER_0_IAM_Rx (ComIPdu):
        ComIPduCancellationSupport = false
        ComIPduDirection = RECEIVE
        ComIPduHandleId = COM_RXPDU_COM_LHZCU_BKBCANFD_50ms_FrP24_CONTROLLER_0_IAM_Rx
        ComIPduSignalProcessing = DEFERRED
        ComIPduType = NORMAL
        ComIPduCallout = LHZCU_BKBCANFD_50ms_FrP24_CONTROLLER_0_IAM_Rx
        ComPduIdRef = COM_LHZCU_BKBCANFD_50ms_FrP24_CONTROLLER_0_IAM_Rx
        ComIPduSignalGroupRef = ILHZCU_50ms_Group24_LHZCU_BKBCANFD_50ms_FrP24_CONTROLLER_0_IAM_Rx
        ComIPduGroupRef = Com_RxPduGroup_CONTROLLER_0_IAM
      ILHZCU_50ms_Group24_LHZCU_BKBCANFD_50ms_FrP24_CONTROLLER_0_IAM_Rx (ComSignalGroup):
        ComHandleId = ILHZCU_50ms_Group24_LHZCU_BKBCANFD_50ms_FrP24_CONTROLLER_0_IAM_Rx
        ComInvalidNotification = NULL_PTR
        ComRxDataTimeoutAction = NONE
        ComTransferProperty = PENDING
        ComDataInvalidAction = NOTIFY
        ComTimeout = 0.0
        ComFirstTimeout = 0.0
        ComNotification = Rte_COMCbk
        48 x ComGroupSignal, all with ComSignalEndianness=BIG_ENDIAN, ComSignalInitValue=0x0, ComSignalLength=0, ComSignalDataInvalidValue=0x0:
          ILHZCU_50ms_Group24_CRC_ILHZCU_50ms_Group24_LHZCU_BKBCANFD_50ms_FrP24_CONTROLLER_0_IAM_Rx: ComBitPosition=0, ComBitSize=8, ComHandleId=ILHZCU_50ms_Group24_LHZCU_BKBCANFD_50ms_FrP24_CONTROLLER_0_IAM_Rx_ILHZCU_50ms_Group24_CRC_ILHZCU_50ms_Group24_LHZCU_BKBCANFD_50ms_FrP24_CONTROLLER_0_IAM_Rx, ComSignalType=UINT8
          ILHZCU_50ms_Group24_RC_ILHZCU_50ms_Group24_LHZCU_BKBCANFD_50ms_FrP24_CONTROLLER_0_IAM_Rx: ComBitPosition=8, ComBitSize=4, ComHandleId=ILHZCU_50ms_Group24_LHZCU_BKBCANFD_50ms_FrP24_CONTROLLER_0_IAM_Rx_ILHZCU_50ms_Group24_RC_ILHZCU_50ms_Group24_LHZCU_BKBCANFD_50ms_FrP24_CONTROLLER_0_IAM_Rx, ComSignalType=UINT8
          ILHZCU_50ms_Group24_Reserved1_ILHZCU_50ms_Group24_LHZCU_BKBCANFD_50ms_FrP24_CONTROLLER_0_IAM_Rx: ComBitPosition=12, ComBitSize=4, ComHandleId=ILHZCU_50ms_Group24_LHZCU_BKBCANFD_50ms_FrP24_CONTROLLER_0_IAM_Rx_ILHZCU_50ms_Group24_Reserved1_ILHZCU_50ms_Group24_LHZCU_BKBCANFD_50ms_FrP24_CONTROLLER_0_IAM_Rx, ComSignalType=UINT8
          ILHZCU_50ms_Group24_Reserved2_ILHZCU_50ms_Group24_LHZCU_BKBCANFD_50ms_FrP24_CONTROLLER_0_IAM_Rx: ComBitPosition=16, ComBitSize=8, ComHandleId=ILHZCU_50ms_Group24_LHZCU_BKBCANFD_50ms_FrP24_CONTROLLER_0_IAM_Rx_ILHZCU_50ms_Group24_Reserved2_ILHZCU_50ms_Group24_LHZCU_BKBCANFD_50ms_FrP24_CONTROLLER_0_IAM_Rx, ComSignalType=UINT8
          IVehIlluminateCtrlCmd_ILHZCU_50ms_Group24_LHZCU_BKBCANFD_50ms_FrP24_CONTROLLER_0_IAM_Rx: ComBitPosition=24, ComBitSize=1, ComHandleId=ILHZCU_50ms_Group24_LHZCU_BKBCANFD_50ms_FrP24_CONTROLLER_0_IAM_Rx_IVehIlluminateCtrlCmd_ILHZCU_50ms_Group24_LHZCU_BKBCANFD_50ms_FrP24_CONTROLLER_0_IAM_Rx, ComSignalType=BOOLEAN
          ILHZCU_50ms_Group24_Reserved3_ILHZCU_50ms_Group24_LHZCU_BKBCANFD_50ms_FrP24_CONTROLLER_0_IAM_Rx: ComBitPosition=25, ComBitSize=7, ComHandleId=ILHZCU_50ms_Group24_LHZCU_BKBCANFD_50ms_FrP24_CONTROLLER_0_IAM_Rx_ILHZCU_50ms_Group24_Reserved3_ILHZCU_50ms_Group24_LHZCU_BKBCANFD_50ms_FrP24_CONTROLLER_0_IAM_Rx, ComSignalType=UINT8
          IBrkLghtSta_ILHZCU_50ms_Group24_LHZCU_BKBCANFD_50ms_FrP24_CONTROLLER_0_IAM_Rx: ComBitPosition=32, ComBitSize=1, ComHandleId=ILHZCU_50ms_Group24_LHZCU_BKBCANFD_50ms_FrP24_CONTROLLER_0_IAM_Rx_IBrkLghtSta_ILHZCU_50ms_Group24_LHZCU_BKBCANFD_50ms_FrP24_CONTROLLER_0_IAM_Rx, ComSignalType=BOOLEAN
          IRLChildProtnA_ILHZCU_50ms_Group24_LHZCU_BKBCANFD_50ms_FrP24_CONTROLLER_0_IAM_Rx: ComBitPosition=33, ComBitSize=2, ComHandleId=ILHZCU_50ms_Group24_LHZCU_BKBCANFD_50ms_FrP24_CONTROLLER_0_IAM_Rx_IRLChildProtnA_ILHZCU_50ms_Group24_LHZCU_BKBCANFD_50ms_FrP24_CONTROLLER_0_IAM_Rx, ComSignalType=UINT8
          ILHZCU_50ms_Group24_Reserved4_ILHZCU_50ms_Group24_LHZCU_BKBCANFD_50ms_FrP24_CONTROLLER_0_IAM_Rx: ComBitPosition=35, ComBitSize=5, ComHandleId=ILHZCU_50ms_Group24_LHZCU_BKBCANFD_50ms_FrP24_CONTROLLER_0_IAM_Rx_ILHZCU_50ms_Group24_Reserved4_ILHZCU_50ms_Group24_LHZCU_BKBCANFD_50ms_FrP24_CONTROLLER_0_IAM_Rx, ComSignalType=UINT8
          IBrkLghtFltSta_ILHZCU_50ms_Group24_LHZCU_BKBCANFD_50ms_FrP24_CONTROLLER_0_IAM_Rx: ComBitPosition=40, ComBitSize=1, ComHandleId=ILHZCU_50ms_Group24_LHZCU_BKBCANFD_50ms_FrP24_CONTROLLER_0_IAM_Rx_IBrkLghtFltSta_ILHZCU_50ms_Group24_LHZCU_BKBCANFD_50ms_FrP24_CONTROLLER_0_IAM_Rx, ComSignalType=BOOLEAN
          IRRChildProtnA_ILHZCU_50ms_Group24_LHZCU_BKBCANFD_50ms_FrP24_CONTROLLER_0_IAM_Rx: ComBitPosition=41, ComBitSize=2, ComHandleId=ILHZCU_50ms_Group24_LHZCU_BKBCANFD_50ms_FrP24_CONTROLLER_0_IAM_Rx_IRRChildProtnA_ILHZCU_50ms_Group24_LHZCU_BKBCANFD_50ms_FrP24_CONTROLLER_0_IAM_Rx, ComSignalType=UINT8
          ILHZCU_50ms_Group24_Reserved5_ILHZCU_50ms_Group24_LHZCU_BKBCANFD_50ms_FrP24_CONTROLLER_0_IAM_Rx: ComBitPosition=43, ComBitSize=5, ComHandleId=ILHZCU_50ms_Group24_LHZCU_BKBCANFD_50ms_FrP24_CONTROLLER_0_IAM_Rx_ILHZCU_50ms_Group24_Reserved5_ILHZCU_50ms_Group24_LHZCU_BKBCANFD_50ms_FrP24_CONTROLLER_0_IAM_Rx, ComSignalType=UINT8
          ILHZCU_50ms_Group24_Reserved7_ILHZCU_50ms_Group24_LHZCU_BKBCANFD_50ms_FrP24_CONTROLLER_0_IAM_Rx: ComBitPosition=63, ComBitSize=3, ComHandleId=ILHZCU_50ms_Group24_LHZCU_BKBCANFD_50ms_FrP24_CONTROLLER_0_IAM_Rx_ILHZCU_50ms_Group24_Reserved7_ILHZCU_50ms_Group24_LHZCU_BKBCANFD_50ms_FrP24_CONTROLLER_0_IAM_Rx, ComSignalType=UINT8
          IDircnLghtSts_ILHZCU_50ms_Group24_LHZCU_BKBCANFD_50ms_FrP24_CONTROLLER_0_IAM_Rx: ComBitPosition=50, ComBitSize=3, ComHandleId=ILHZCU_50ms_Group24_LHZCU_BKBCANFD_50ms_FrP24_CONTROLLER_0_IAM_Rx_IDircnLghtSts_ILHZCU_50ms_Group24_LHZCU_BKBCANFD_50ms_FrP24_CONTROLLER_0_IAM_Rx, ComSignalType=UINT8
          ILHZCU_50ms_Group24_Reserved6_ILHZCU_50ms_Group24_LHZCU_BKBCANFD_50ms_FrP24_CONTROLLER_0_IAM_Rx: ComBitPosition=53, ComBitSize=1, ComHandleId=ILHZCU_50ms_Group24_LHZCU_BKBCANFD_50ms_FrP24_CONTROLLER_0_IAM_Rx_ILHZCU_50ms_Group24_Reserved6_ILHZCU_50ms_Group24_LHZCU_BKBCANFD_50ms_FrP24_CONTROLLER_0_IAM_Rx, ComSignalType=BOOLEAN
          IRevsLghtFltSta_ILHZCU_50ms_Group24_LHZCU_BKBCANFD_50ms_FrP24_CONTROLLER_0_IAM_Rx: ComBitPosition=54, ComBitSize=1, ComHandleId=ILHZCU_50ms_Group24_LHZCU_BKBCANFD_50ms_FrP24_CONTROLLER_0_IAM_Rx_IRevsLghtFltSta_ILHZCU_50ms_Group24_LHZCU_BKBCANFD_50ms_FrP24_CONTROLLER_0_IAM_Rx, ComSignalType=BOOLEAN
          IRevsLghtSta_ILHZCU_50ms_Group24_LHZCU_BKBCANFD_50ms_FrP24_CONTROLLER_0_IAM_Rx: ComBitPosition=55, ComBitSize=1, ComHandleId=ILHZCU_50ms_Group24_LHZCU_BKBCANFD_50ms_FrP24_CONTROLLER_0_IAM_Rx_IRevsLghtSta_ILHZCU_50ms_Group24_LHZCU_BKBCANFD_50ms_FrP24_CONTROLLER_0_IAM_Rx, ComSignalType=BOOLEAN
          IRearFogLghtAcFltsts_ILHZCU_50ms_Group24_LHZCU_BKBCANFD_50ms_FrP24_CONTROLLER_0_IAM_Rx: ComBitPosition=56, ComBitSize=1, ComHandleId=ILHZCU_50ms_Group24_LHZCU_BKBCANFD_50ms_FrP24_CONTROLLER_0_IAM_Rx_IRearFogLghtAcFltsts_ILHZCU_50ms_Group24_LHZCU_BKBCANFD_50ms_FrP24_CONTROLLER_0_IAM_Rx, ComSignalType=BOOLEAN
          IRearFogLghtAcSts_ILHZCU_50ms_Group24_LHZCU_BKBCANFD_50ms_FrP24_CONTROLLER_0_IAM_Rx: ComBitPosition=57, ComBitSize=1, ComHandleId=ILHZCU_50ms_Group24_LHZCU_BKBCANFD_50ms_FrP24_CONTROLLER_0_IAM_Rx_IRearFogLghtAcSts_ILHZCU_50ms_Group24_LHZCU_BKBCANFD_50ms_FrP24_CONTROLLER_0_IAM_Rx, ComSignalType=BOOLEAN
          IRearFogLghtCtrl_ILHZCU_50ms_Group24_LHZCU_BKBCANFD_50ms_FrP24_CONTROLLER_0_IAM_Rx: ComBitPosition=58, ComBitSize=1, ComHandleId=ILHZCU_50ms_Group24_LHZCU_BKBCANFD_50ms_FrP24_CONTROLLER_0_IAM_Rx_IRearFogLghtCtrl_ILHZCU_50ms_Group24_LHZCU_BKBCANFD_50ms_FrP24_CONTROLLER_0_IAM_Rx, ComSignalType=BOOLEAN
          ISideLghtFltsts_ILHZCU_50ms_Group24_LHZCU_BKBCANFD_50ms_FrP24_CONTROLLER_0_IAM_Rx: ComBitPosition=59, ComBitSize=1, ComHandleId=ILHZCU_50ms_Group24_LHZCU_BKBCANFD_50ms_FrP24_CONTROLLER_0_IAM_Rx_ISideLghtFltsts_ILHZCU_50ms_Group24_LHZCU_BKBCANFD_50ms_FrP24_CONTROLLER_0_IAM_Rx, ComSignalType=BOOLEAN
          ILHZCU_50ms_Group24_Reserved8_ILHZCU_50ms_Group24_LHZCU_BKBCANFD_50ms_FrP24_CONTROLLER_0_IAM_Rx: ComBitPosition=60, ComBitSize=1, ComHandleId=ILHZCU_50ms_Group24_LHZCU_BKBCANFD_50ms_FrP24_CONTROLLER_0_IAM_Rx_ILHZCU_50ms_Group24_Reserved8_ILHZCU_50ms_Group24_LHZCU_BKBCANFD_50ms_FrP24_CONTROLLER_0_IAM_Rx, ComSignalType=BOOLEAN
          IRRSideLghtCtrl_ILHZCU_50ms_Group24_LHZCU_BKBCANFD_50ms_FrP24_CONTROLLER_0_IAM_Rx: ComBitPosition=61, ComBitSize=1, ComHandleId=ILHZCU_50ms_Group24_LHZCU_BKBCANFD_50ms_FrP24_CONTROLLER_0_IAM_Rx_IRRSideLghtCtrl_ILHZCU_50ms_Group24_LHZCU_BKBCANFD_50ms_FrP24_CONTROLLER_0_IAM_Rx, ComSignalType=BOOLEAN
          IRLSideLghtCtrl_ILHZCU_50ms_Group24_LHZCU_BKBCANFD_50ms_FrP24_CONTROLLER_0_IAM_Rx: ComBitPosition=62, ComBitSize=1, ComHandleId=ILHZCU_50ms_Group24_LHZCU_BKBCANFD_50ms_FrP24_CONTROLLER_0_IAM_Rx_IRLSideLghtCtrl_ILHZCU_50ms_Group24_LHZCU_BKBCANFD_50ms_FrP24_CONTROLLER_0_IAM_Rx, ComSignalType=BOOLEAN
          IHdlmpLvlngFltSts_ILHZCU_50ms_Group24_LHZCU_BKBCANFD_50ms_FrP24_CONTROLLER_0_IAM_Rx: ComBitPosition=64, ComBitSize=1, ComHandleId=ILHZCU_50ms_Group24_LHZCU_BKBCANFD_50ms_FrP24_CONTROLLER_0_IAM_Rx_IHdlmpLvlngFltSts_ILHZCU_50ms_Group24_LHZCU_BKBCANFD_50ms_FrP24_CONTROLLER_0_IAM_Rx, ComSignalType=BOOLEAN
          IHdlmpLvlngCrtl_ILHZCU_50ms_Group24_LHZCU_BKBCANFD_50ms_FrP24_CONTROLLER_0_IAM_Rx: ComBitPosition=65, ComBitSize=3, ComHandleId=ILHZCU_50ms_Group24_LHZCU_BKBCANFD_50ms_FrP24_CONTROLLER_0_IAM_Rx_IHdlmpLvlngCrtl_ILHZCU_50ms_Group24_LHZCU_BKBCANFD_50ms_FrP24_CONTROLLER_0_IAM_Rx, ComSignalType=UINT8
          IDayTmRunngLghtFltsts_ILHZCU_50ms_Group24_LHZCU_BKBCANFD_50ms_FrP24_CONTROLLER_0_IAM_Rx: ComBitPosition=68, ComBitSize=1, ComHandleId=ILHZCU_50ms_Group24_LHZCU_BKBCANFD_50ms_FrP24_CONTROLLER_0_IAM_Rx_IDayTmRunngLghtFltsts_ILHZCU_50ms_Group24_LHZCU_BKBCANFD_50ms_FrP24_CONTROLLER_0_IAM_Rx, ComSignalType=BOOLEAN
          IDayTmRunngLghtSts_ILHZCU_50ms_Group24_LHZCU_BKBCANFD_50ms_FrP24_CONTROLLER_0_IAM_Rx: ComBitPosition=69, ComBitSize=1, ComHandleId=ILHZCU_50ms_Group24_LHZCU_BKBCANFD_50ms_FrP24_CONTROLLER_0_IAM_Rx_IDayTmRunngLghtSts_ILHZCU_50ms_Group24_LHZCU_BKBCANFD_50ms_FrP24_CONTROLLER_0_IAM_Rx, ComSignalType=BOOLEAN
          ILHZCU_50ms_Group24_Reserved9_ILHZCU_50ms_Group24_LHZCU_BKBCANFD_50ms_FrP24_CONTROLLER_0_IAM_Rx: ComBitPosition=70, ComBitSize=2, ComHandleId=ILHZCU_50ms_Group24_LHZCU_BKBCANFD_50ms_FrP24_CONTROLLER_0_IAM_Rx_ILHZCU_50ms_Group24_Reserved9_ILHZCU_50ms_Group24_LHZCU_BKBCANFD_50ms_FrP24_CONTROLLER_0_IAM_Rx, ComSignalType=UINT8
          ILHZCU_50ms_Group24_Reserved10_ILHZCU_50ms_Group24_LHZCU_BKBCANFD_50ms_FrP24_CONTROLLER_0_IAM_Rx: ComBitPosition=72, ComBitSize=2, ComHandleId=ILHZCU_50ms_Group24_LHZCU_BKBCANFD_50ms_FrP24_CONTROLLER_0_IAM_Rx_ILHZCU_50ms_Group24_Reserved10_ILHZCU_50ms_Group24_LHZCU_BKBCANFD_50ms_FrP24_CONTROLLER_0_IAM_Rx, ComSignalType=UINT8
          IFrtFogLghtSts_ILHZCU_50ms_Group24_LHZCU_BKBCANFD_50ms_FrP24_CONTROLLER_0_IAM_Rx: ComBitPosition=74, ComBitSize=1, ComHandleId=ILHZCU_50ms_Group24_LHZCU_BKBCANFD_50ms_FrP24_CONTROLLER_0_IAM_Rx_IFrtFogLghtSts_ILHZCU_50ms_Group24_LHZCU_BKBCANFD_50ms_FrP24_CONTROLLER_0_IAM_Rx, ComSignalType=BOOLEAN
          IRFrtFogLghtCtrl_ILHZCU_50ms_Group24_LHZCU_BKBCANFD_50ms_FrP24_CONTROLLER_0_IAM_Rx: ComBitPosition=75, ComBitSize=1, ComHandleId=ILHZCU_50ms_Group24_LHZCU_BKBCANFD_50ms_FrP24_CONTROLLER_0_IAM_Rx_IRFrtFogLghtCtrl_ILHZCU_50ms_Group24_LHZCU_BKBCANFD_50ms_FrP24_CONTROLLER_0_IAM_Rx, ComSignalType=BOOLEAN
          ILFrtFogLghtCtrl_ILHZCU_50ms_Group24_LHZCU_BKBCANFD_50ms_FrP24_CONTROLLER_0_IAM_Rx: ComBitPosition=76, ComBitSize=1, ComHandleId=ILHZCU_50ms_Group24_LHZCU_BKBCANFD_50ms_FrP24_CONTROLLER_0_IAM_Rx_ILFrtFogLghtCtrl_ILHZCU_50ms_Group24_LHZCU_BKBCANFD_50ms_FrP24_CONTROLLER_0_IAM_Rx, ComSignalType=BOOLEAN
          IHdlmpLvlngSts_ILHZCU_50ms_Group24_LHZCU_BKBCANFD_50ms_FrP24_CONTROLLER_0_IAM_Rx: ComBitPosition=77, ComBitSize=3, ComHandleId=ILHZCU_50ms_Group24_LHZCU_BKBCANFD_50ms_FrP24_CONTROLLER_0_IAM_Rx_IHdlmpLvlngSts_ILHZCU_50ms_Group24_LHZCU_BKBCANFD_50ms_FrP24_CONTROLLER_0_IAM_Rx, ComSignalType=UINT8
          ILHZCU_50ms_Group24_Reserved12_ILHZCU_50ms_Group24_LHZCU_BKBCANFD_50ms_FrP24_CONTROLLER_0_IAM_Rx: ComBitPosition=80, ComBitSize=3, ComHandleId=ILHZCU_50ms_Group24_LHZCU_BKBCANFD_50ms_FrP24_CONTROLLER_0_IAM_Rx_ILHZCU_50ms_Group24_Reserved12_ILHZCU_50ms_Group24_LHZCU_BKBCANFD_50ms_FrP24_CONTROLLER_0_IAM_Rx, ComSignalType=UINT8
          IDircnLghtSwReq_ILHZCU_50ms_Group24_LHZCU_BKBCANFD_50ms_FrP24_CONTROLLER_0_IAM_Rx: ComBitPosition=83, ComBitSize=2, ComHandleId=ILHZCU_50ms_Group24_LHZCU_BKBCANFD_50ms_FrP24_CONTROLLER_0_IAM_Rx_IDircnLghtSwReq_ILHZCU_50ms_Group24_LHZCU_BKBCANFD_50ms_FrP24_CONTROLLER_0_IAM_Rx, ComSignalType=UINT8
          ILHZCU_50ms_Group24_Reserved11_ILHZCU_50ms_Group24_LHZCU_BKBCANFD_50ms_FrP24_CONTROLLER_0_IAM_Rx: ComBitPosition=85, ComBitSize=2, ComHandleId=ILHZCU_50ms_Group24_LHZCU_BKBCANFD_50ms_FrP24_CONTROLLER_0_IAM_Rx_ILHZCU_50ms_Group24_Reserved11_ILHZCU_50ms_Group24_LHZCU_BKBCANFD_50ms_FrP24_CONTROLLER_0_IAM_Rx, ComSignalType=UINT8
          IFrtFogLghtFltSts_ILHZCU_50ms_Group24_LHZCU_BKBCANFD_50ms_FrP24_CONTROLLER_0_IAM_Rx: ComBitPosition=87, ComBitSize=1, ComHandleId=ILHZCU_50ms_Group24_LHZCU_BKBCANFD_50ms_FrP24_CONTROLLER_0_IAM_Rx_IFrtFogLghtFltSts_ILHZCU_50ms_Group24_LHZCU_BKBCANFD_50ms_FrP24_CONTROLLER_0_IAM_Rx, ComSignalType=BOOLEAN
          ILHZCU_50ms_Group24_Reserved13_ILHZCU_50ms_Group24_LHZCU_BKBCANFD_50ms_FrP24_CONTROLLER_0_IAM_Rx: ComBitPosition=88, ComBitSize=8, ComHandleId=ILHZCU_50ms_Group24_LHZCU_BKBCANFD_50ms_FrP24_CONTROLLER_0_IAM_Rx_ILHZCU_50ms_Group24_Reserved13_ILHZCU_50ms_Group24_LHZCU_BKBCANFD_50ms_FrP24_CONTROLLER_0_IAM_Rx, ComSignalType=UINT8
          ILHZCU_50ms_Group24_Reserved14_ILHZCU_50ms_Group24_LHZCU_BKBCANFD_50ms_FrP24_CONTROLLER_0_IAM_Rx: ComBitPosition=96, ComBitSize=8, ComHandleId=ILHZCU_50ms_Group24_LHZCU_BKBCANFD_50ms_FrP24_CONTROLLER_0_IAM_Rx_ILHZCU_50ms_Group24_Reserved14_ILHZCU_50ms_Group24_LHZCU_BKBCANFD_50ms_FrP24_CONTROLLER_0_IAM_Rx, ComSignalType=UINT8
          IDircnLghtFltsts_ILHZCU_50ms_Group24_LHZCU_BKBCANFD_50ms_FrP24_CONTROLLER_0_IAM_Rx: ComBitPosition=104, ComBitSize=2, ComHandleId=ILHZCU_50ms_Group24_LHZCU_BKBCANFD_50ms_FrP24_CONTROLLER_0_IAM_Rx_IDircnLghtFltsts_ILHZCU_50ms_Group24_LHZCU_BKBCANFD_50ms_FrP24_CONTROLLER_0_IAM_Rx, ComSignalType=UINT8
          ILHZCU_50ms_Group24_Reserved15_ILHZCU_50ms_Group24_LHZCU_BKBCANFD_50ms_FrP24_CONTROLLER_0_IAM_Rx: ComBitPosition=106, ComBitSize=6, ComHandleId=ILHZCU_50ms_Group24_LHZCU_BKBCANFD_50ms_FrP24_CONTROLLER_0_IAM_Rx_ILHZCU_50ms_Group24_Reserved15_ILHZCU_50ms_Group24_LHZCU_BKBCANFD_50ms_FrP24_CONTROLLER_0_IAM_Rx, ComSignalType=UINT8
          ILHZCU_50ms_Group24_Reserved16_ILHZCU_50ms_Group24_LHZCU_BKBCANFD_50ms_FrP24_CONTROLLER_0_IAM_Rx: ComBitPosition=112, ComBitSize=8, ComHandleId=ILHZCU_50ms_Group24_LHZCU_BKBCANFD_50ms_FrP24_CONTROLLER_0_IAM_Rx_ILHZCU_50ms_Group24_Reserved16_ILHZCU_50ms_Group24_LHZCU_BKBCANFD_50ms_FrP24_CONTROLLER_0_IAM_Rx, ComSignalType=UINT8
          ILHZCU_50ms_Group24_Reserved17_ILHZCU_50ms_Group24_LHZCU_BKBCANFD_50ms_FrP24_CONTROLLER_0_IAM_Rx: ComBitPosition=120, ComBitSize=8, ComHandleId=ILHZCU_50ms_Group24_LHZCU_BKBCANFD_50ms_FrP24_CONTROLLER_0_IAM_Rx_ILHZCU_50ms_Group24_Reserved17_ILHZCU_50ms_Group24_LHZCU_BKBCANFD_50ms_FrP24_CONTROLLER_0_IAM_Rx, ComSignalType=UINT8
          ILHZCU_50ms_Group24_Reserved18_ILHZCU_50ms_Group24_LHZCU_BKBCANFD_50ms_FrP24_CONTROLLER_0_IAM_Rx: ComBitPosition=128, ComBitSize=8, ComHandleId=ILHZCU_50ms_Group24_LHZCU_BKBCANFD_50ms_FrP24_CONTROLLER_0_IAM_Rx_ILHZCU_50ms_Group24_Reserved18_ILHZCU_50ms_Group24_LHZCU_BKBCANFD_50ms_FrP24_CONTROLLER_0_IAM_Rx, ComSignalType=UINT8
          ILHZCU_50ms_Group24_Reserved19_ILHZCU_50ms_Group24_LHZCU_BKBCANFD_50ms_FrP24_CONTROLLER_0_IAM_Rx: ComBitPosition=136, ComBitSize=8, ComHandleId=ILHZCU_50ms_Group24_LHZCU_BKBCANFD_50ms_FrP24_CONTROLLER_0_IAM_Rx_ILHZCU_50ms_Group24_Reserved19_ILHZCU_50ms_Group24_LHZCU_BKBCANFD_50ms_FrP24_CONTROLLER_0_IAM_Rx, ComSignalType=UINT8
          ILHZCU_50ms_Group24_Reserved20_ILHZCU_50ms_Group24_LHZCU_BKBCANFD_50ms_FrP24_CONTROLLER_0_IAM_Rx: ComBitPosition=144, ComBitSize=8, ComHandleId=ILHZCU_50ms_Group24_LHZCU_BKBCANFD_50ms_FrP24_CONTROLLER_0_IAM_Rx_ILHZCU_50ms_Group24_Reserved20_ILHZCU_50ms_Group24_LHZCU_BKBCANFD_50ms_FrP24_CONTROLLER_0_IAM_Rx, ComSignalType=UINT8
          ILHZCU_50ms_Group24_Reserved21_ILHZCU_50ms_Group24_LHZCU_BKBCANFD_50ms_FrP24_CONTROLLER_0_IAM_Rx: ComBitPosition=152, ComBitSize=8, ComHandleId=ILHZCU_50ms_Group24_LHZCU_BKBCANFD_50ms_FrP24_CONTROLLER_0_IAM_Rx_ILHZCU_50ms_Group24_Reserved21_ILHZCU_50ms_Group24_LHZCU_BKBCANFD_50ms_FrP24_CONTROLLER_0_IAM_Rx, ComSignalType=UINT8
      LHZCU_LHBKBCANFD_50ms_FrP06_CONTROLLER_0_IAM_Rx (ComIPdu):
        ComIPduCancellationSupport = false
        ComIPduDirection = RECEIVE
        ComIPduHandleId = COM_RXPDU_COM_LHZCU_LHBKBCANFD_50ms_FrP06_CONTROLLER_0_IAM_Rx
        ComIPduSignalProcessing = DEFERRED
        ComIPduType = NORMAL
        ComIPduCallout = LHZCU_LHBKBCANFD_50ms_FrP06_CONTROLLER_0_IAM_Rx
        ComPduIdRef = COM_LHZCU_LHBKBCANFD_50ms_FrP06_CONTROLLER_0_IAM_Rx
        ComIPduSignalGroupRef = ILHZCU_50ms_Group06_LHZCU_LHBKBCANFD_50ms_FrP06_CONTROLLER_0_IAM_Rx
        ComIPduGroupRef = Com_RxPduGroup_CONTROLLER_0_IAM
      ILHZCU_50ms_Group06_LHZCU_LHBKBCANFD_50ms_FrP06_CONTROLLER_0_IAM_Rx (ComSignalGroup):
        ComHandleId = ILHZCU_50ms_Group06_LHZCU_LHBKBCANFD_50ms_FrP06_CONTROLLER_0_IAM_Rx
        ComInvalidNotification = NULL_PTR
        ComRxDataTimeoutAction = NONE
        ComTransferProperty = PENDING
        ComDataInvalidAction = NOTIFY
        ComTimeout = 0.0
        ComFirstTimeout = 0.0
        ComNotification = Rte_COMCbk
        15 x ComGroupSignal, all with ComSignalEndianness=BIG_ENDIAN, ComSignalInitValue=0x0, ComSignalLength=0, ComSignalDataInvalidValue=0x0:
          ILHZCU_50ms_Group06_CRC_ILHZCU_50ms_Group06_LHZCU_LHBKBCANFD_50ms_FrP06_CONTROLLER_0_IAM_Rx: ComBitPosition=0, ComBitSize=8, ComHandleId=ILHZCU_50ms_Group06_LHZCU_LHBKBCANFD_50ms_FrP06_CONTROLLER_0_IAM_Rx_ILHZCU_50ms_Group06_CRC_ILHZCU_50ms_Group06_LHZCU_LHBKBCANFD_50ms_FrP06_CONTROLLER_0_IAM_Rx, ComSignalType=UINT8
          ILHZCU_50ms_Group06_RC_ILHZCU_50ms_Group06_LHZCU_LHBKBCANFD_50ms_FrP06_CONTROLLER_0_IAM_Rx: ComBitPosition=8, ComBitSize=4, ComHandleId=ILHZCU_50ms_Group06_LHZCU_LHBKBCANFD_50ms_FrP06_CONTROLLER_0_IAM_Rx_ILHZCU_50ms_Group06_RC_ILHZCU_50ms_Group06_LHZCU_LHBKBCANFD_50ms_FrP06_CONTROLLER_0_IAM_Rx, ComSignalType=UINT8
          IDrvrDetSts_ILHZCU_50ms_Group06_LHZCU_LHBKBCANFD_50ms_FrP06_CONTROLLER_0_IAM_Rx: ComBitPosition=12, ComBitSize=2, ComHandleId=ILHZCU_50ms_Group06_LHZCU_LHBKBCANFD_50ms_FrP06_CONTROLLER_0_IAM_Rx_IDrvrDetSts_ILHZCU_50ms_Group06_LHZCU_LHBKBCANFD_50ms_FrP06_CONTROLLER_0_IAM_Rx, ComSignalType=UINT8
          IRLDoorOpenSts_ILHZCU_50ms_Group06_LHZCU_LHBKBCANFD_50ms_FrP06_CONTROLLER_0_IAM_Rx: ComBitPosition=14, ComBitSize=2, ComHandleId=ILHZCU_50ms_Group06_LHZCU_LHBKBCANFD_50ms_FrP06_CONTROLLER_0_IAM_Rx_IRLDoorOpenSts_ILHZCU_50ms_Group06_LHZCU_LHBKBCANFD_50ms_FrP06_CONTROLLER_0_IAM_Rx, ComSignalType=UINT8
          ILHZCU_50ms_Group06_Reserved1_ILHZCU_50ms_Group06_LHZCU_LHBKBCANFD_50ms_FrP06_CONTROLLER_0_IAM_Rx: ComBitPosition=16, ComBitSize=1, ComHandleId=ILHZCU_50ms_Group06_LHZCU_LHBKBCANFD_50ms_FrP06_CONTROLLER_0_IAM_Rx_ILHZCU_50ms_Group06_Reserved1_ILHZCU_50ms_Group06_LHZCU_LHBKBCANFD_50ms_FrP06_CONTROLLER_0_IAM_Rx, ComSignalType=BOOLEAN
          IDrvrDoorOpenSts_ILHZCU_50ms_Group06_LHZCU_LHBKBCANFD_50ms_FrP06_CONTROLLER_0_IAM_Rx: ComBitPosition=17, ComBitSize=2, ComHandleId=ILHZCU_50ms_Group06_LHZCU_LHBKBCANFD_50ms_FrP06_CONTROLLER_0_IAM_Rx_IDrvrDoorOpenSts_ILHZCU_50ms_Group06_LHZCU_LHBKBCANFD_50ms_FrP06_CONTROLLER_0_IAM_Rx, ComSignalType=UINT8
          IBntOpenSts_ILHZCU_50ms_Group06_LHZCU_LHBKBCANFD_50ms_FrP06_CONTROLLER_0_IAM_Rx: ComBitPosition=19, ComBitSize=2, ComHandleId=ILHZCU_50ms_Group06_LHZCU_LHBKBCANFD_50ms_FrP06_CONTROLLER_0_IAM_Rx_IBntOpenSts_ILHZCU_50ms_Group06_LHZCU_LHBKBCANFD_50ms_FrP06_CONTROLLER_0_IAM_Rx, ComSignalType=UINT8
          IVehLckSts_ILHZCU_50ms_Group06_LHZCU_LHBKBCANFD_50ms_FrP06_CONTROLLER_0_IAM_Rx: ComBitPosition=21, ComBitSize=3, ComHandleId=ILHZCU_50ms_Group06_LHZCU_LHBKBCANFD_50ms_FrP06_CONTROLLER_0_IAM_Rx_IVehLckSts_ILHZCU_50ms_Group06_LHZCU_LHBKBCANFD_50ms_FrP06_CONTROLLER_0_IAM_Rx, ComSignalType=UINT8
          ILHZCU_50ms_Group06_Reserved2_ILHZCU_50ms_Group06_LHZCU_LHBKBCANFD_50ms_FrP06_CONTROLLER_0_IAM_Rx: ComBitPosition=24, ComBitSize=8, ComHandleId=ILHZCU_50ms_Group06_LHZCU_LHBKBCANFD_50ms_FrP06_CONTROLLER_0_IAM_Rx_ILHZCU_50ms_Group06_Reserved2_ILHZCU_50ms_Group06_LHZCU_LHBKBCANFD_50ms_FrP06_CONTROLLER_0_IAM_Rx, ComSignalType=UINT8
          ILHZCU_50ms_Group06_Reserved3_ILHZCU_50ms_Group06_LHZCU_LHBKBCANFD_50ms_FrP06_CONTROLLER_0_IAM_Rx: ComBitPosition=32, ComBitSize=8, ComHandleId=ILHZCU_50ms_Group06_LHZCU_LHBKBCANFD_50ms_FrP06_CONTROLLER_0_IAM_Rx_ILHZCU_50ms_Group06_Reserved3_ILHZCU_50ms_Group06_LHZCU_LHBKBCANFD_50ms_FrP06_CONTROLLER_0_IAM_Rx, ComSignalType=UINT8
          ILHZCU_50ms_Group06_Reserved4_ILHZCU_50ms_Group06_LHZCU_LHBKBCANFD_50ms_FrP06_CONTROLLER_0_IAM_Rx: ComBitPosition=40, ComBitSize=8, ComHandleId=ILHZCU_50ms_Group06_LHZCU_LHBKBCANFD_50ms_FrP06_CONTROLLER_0_IAM_Rx_ILHZCU_50ms_Group06_Reserved4_ILHZCU_50ms_Group06_LHZCU_LHBKBCANFD_50ms_FrP06_CONTROLLER_0_IAM_Rx, ComSignalType=UINT8
          ILHZCU_50ms_Group06_Reserved6_ILHZCU_50ms_Group06_LHZCU_LHBKBCANFD_50ms_FrP06_CONTROLLER_0_IAM_Rx: ComBitPosition=48, ComBitSize=3, ComHandleId=ILHZCU_50ms_Group06_LHZCU_LHBKBCANFD_50ms_FrP06_CONTROLLER_0_IAM_Rx_ILHZCU_50ms_Group06_Reserved6_ILHZCU_50ms_Group06_LHZCU_LHBKBCANFD_50ms_FrP06_CONTROLLER_0_IAM_Rx, ComSignalType=UINT8
          ILHDircnLghtFusaWrn_ILHZCU_50ms_Group06_LHZCU_LHBKBCANFD_50ms_FrP06_CONTROLLER_0_IAM_Rx: ComBitPosition=51, ComBitSize=3, ComHandleId=ILHZCU_50ms_Group06_LHZCU_LHBKBCANFD_50ms_FrP06_CONTROLLER_0_IAM_Rx_ILHDircnLghtFusaWrn_ILHZCU_50ms_Group06_LHZCU_LHBKBCANFD_50ms_FrP06_CONTROLLER_0_IAM_Rx, ComSignalType=UINT8
          ILHZCU_50ms_Group06_Reserved5_ILHZCU_50ms_Group06_LHZCU_LHBKBCANFD_50ms_FrP06_CONTROLLER_0_IAM_Rx: ComBitPosition=54, ComBitSize=2, ComHandleId=ILHZCU_50ms_Group06_LHZCU_LHBKBCANFD_50ms_FrP06_CONTROLLER_0_IAM_Rx_ILHZCU_50ms_Group06_Reserved5_ILHZCU_50ms_Group06_LHZCU_LHBKBCANFD_50ms_FrP06_CONTROLLER_0_IAM_Rx, ComSignalType=UINT8
          ILHZCU_50ms_Group06_Reserved7_ILHZCU_50ms_Group06_LHZCU_LHBKBCANFD_50ms_FrP06_CONTROLLER_0_IAM_Rx: ComBitPosition=56, ComBitSize=8, ComHandleId=ILHZCU_50ms_Group06_LHZCU_LHBKBCANFD_50ms_FrP06_CONTROLLER_0_IAM_Rx_ILHZCU_50ms_Group06_Reserved7_ILHZCU_50ms_Group06_LHZCU_LHBKBCANFD_50ms_FrP06_CONTROLLER_0_IAM_Rx, ComSignalType=UINT8
      ESS_PTEXTDCAN_100ms_FrP33_CONTROLLER_0_IAM_Rx (ComIPdu):
        ComIPduCancellationSupport = false
        ComIPduDirection = RECEIVE
        ComIPduHandleId = COM_RXPDU_COM_ESS_PTEXTDCAN_100ms_FrP33_CONTROLLER_0_IAM_Rx
        ComIPduSignalProcessing = DEFERRED
        ComIPduType = NORMAL
        ComIPduCallout = ESS_PTEXTDCAN_100ms_FrP33_CONTROLLER_0_IAM_Rx
        ComPduIdRef = COM_ESS_PTEXTDCAN_100ms_FrP33_CONTROLLER_0_IAM_Rx
        ComIPduSignalGroupRef = IESS_100ms_Group33_ESS_PTEXTDCAN_100ms_FrP33_CONTROLLER_0_IAM_Rx
        ComIPduGroupRef = Com_RxPduGroup_CONTROLLER_0_IAM
      IESS_100ms_Group33_ESS_PTEXTDCAN_100ms_FrP33_CONTROLLER_0_IAM_Rx (ComSignalGroup):
        ComHandleId = IESS_100ms_Group33_ESS_PTEXTDCAN_100ms_FrP33_CONTROLLER_0_IAM_Rx
        ComInvalidNotification = NULL_PTR
        ComRxDataTimeoutAction = NONE
        ComTransferProperty = PENDING
        ComDataInvalidAction = NOTIFY
        ComTimeout = 0.0
        ComFirstTimeout = 0.0
        ComNotification = Rte_COMCbk
        9 x ComGroupSignal, all with ComSignalEndianness=BIG_ENDIAN, ComSignalInitValue=0x0, ComSignalLength=0, ComSignalDataInvalidValue=0x0:
          IESS_100ms_Group33_CRC_IESS_100ms_Group33_ESS_PTEXTDCAN_100ms_FrP33_CONTROLLER_0_IAM_Rx: ComBitPosition=0, ComBitSize=8, ComHandleId=IESS_100ms_Group33_ESS_PTEXTDCAN_100ms_FrP33_CONTROLLER_0_IAM_Rx_IESS_100ms_Group33_CRC_IESS_100ms_Group33_ESS_PTEXTDCAN_100ms_FrP33_CONTROLLER_0_IAM_Rx, ComSignalType=UINT8
          IESS_100ms_Group33_RC_IESS_100ms_Group33_ESS_PTEXTDCAN_100ms_FrP33_CONTROLLER_0_IAM_Rx: ComBitPosition=8, ComBitSize=4, ComHandleId=IESS_100ms_Group33_ESS_PTEXTDCAN_100ms_FrP33_CONTROLLER_0_IAM_Rx_IESS_100ms_Group33_RC_IESS_100ms_Group33_ESS_PTEXTDCAN_100ms_FrP33_CONTROLLER_0_IAM_Rx, ComSignalType=UINT8
          IESS_100ms_Group33_Reserved1_IESS_100ms_Group33_ESS_PTEXTDCAN_100ms_FrP33_CONTROLLER_0_IAM_Rx: ComBitPosition=12, ComBitSize=4, ComHandleId=IESS_100ms_Group33_ESS_PTEXTDCAN_100ms_FrP33_CONTROLLER_0_IAM_Rx_IESS_100ms_Group33_Reserved1_IESS_100ms_Group33_ESS_PTEXTDCAN_100ms_FrP33_CONTROLLER_0_IAM_Rx, ComSignalType=UINT8
          IBMSBatPrsSnsrValBkup_IESS_100ms_Group33_ESS_PTEXTDCAN_100ms_FrP33_CONTROLLER_0_IAM_Rx: ComBitPosition=24, ComBitSize=15, ComHandleId=IESS_100ms_Group33_ESS_PTEXTDCAN_100ms_FrP33_CONTROLLER_0_IAM_Rx_IBMSBatPrsSnsrValBkup_IESS_100ms_Group33_ESS_PTEXTDCAN_100ms_FrP33_CONTROLLER_0_IAM_Rx, ComSignalType=UINT16
          IBMSBatPrsSnsrVBkup_IESS_100ms_Group33_ESS_PTEXTDCAN_100ms_FrP33_CONTROLLER_0_IAM_Rx: ComBitPosition=23, ComBitSize=1, ComHandleId=IESS_100ms_Group33_ESS_PTEXTDCAN_100ms_FrP33_CONTROLLER_0_IAM_Rx_IBMSBatPrsSnsrVBkup_IESS_100ms_Group33_ESS_PTEXTDCAN_100ms_FrP33_CONTROLLER_0_IAM_Rx, ComSignalType=BOOLEAN
          IESS_100ms_Group33_Reserved2_IESS_100ms_Group33_ESS_PTEXTDCAN_100ms_FrP33_CONTROLLER_0_IAM_Rx: ComBitPosition=32, ComBitSize=8, ComHandleId=IESS_100ms_Group33_ESS_PTEXTDCAN_100ms_FrP33_CONTROLLER_0_IAM_Rx_IESS_100ms_Group33_Reserved2_IESS_100ms_Group33_ESS_PTEXTDCAN_100ms_FrP33_CONTROLLER_0_IAM_Rx, ComSignalType=UINT8
          IESS_100ms_Group33_Reserved3_IESS_100ms_Group33_ESS_PTEXTDCAN_100ms_FrP33_CONTROLLER_0_IAM_Rx: ComBitPosition=40, ComBitSize=8, ComHandleId=IESS_100ms_Group33_ESS_PTEXTDCAN_100ms_FrP33_CONTROLLER_0_IAM_Rx_IESS_100ms_Group33_Reserved3_IESS_100ms_Group33_ESS_PTEXTDCAN_100ms_FrP33_CONTROLLER_0_IAM_Rx, ComSignalType=UINT8
          IESS_100ms_Group33_Reserved4_IESS_100ms_Group33_ESS_PTEXTDCAN_100ms_FrP33_CONTROLLER_0_IAM_Rx: ComBitPosition=48, ComBitSize=8, ComHandleId=IESS_100ms_Group33_ESS_PTEXTDCAN_100ms_FrP33_CONTROLLER_0_IAM_Rx_IESS_100ms_Group33_Reserved4_IESS_100ms_Group33_ESS_PTEXTDCAN_100ms_FrP33_CONTROLLER_0_IAM_Rx, ComSignalType=UINT8
          IESS_100ms_Group33_Reserved5_IESS_100ms_Group33_ESS_PTEXTDCAN_100ms_FrP33_CONTROLLER_0_IAM_Rx: ComBitPosition=56, ComBitSize=8, ComHandleId=IESS_100ms_Group33_ESS_PTEXTDCAN_100ms_FrP33_CONTROLLER_0_IAM_Rx_IESS_100ms_Group33_Reserved5_IESS_100ms_Group33_ESS_PTEXTDCAN_100ms_FrP33_CONTROLLER_0_IAM_Rx, ComSignalType=UINT8
      PEU_ERCANFD_50ms_FrP10_CONTROLLER_0_IAM_Rx (ComIPdu):
        ComIPduCancellationSupport = false
        ComIPduDirection = RECEIVE
        ComIPduHandleId = COM_RXPDU_COM_PEU_ERCANFD_50ms_FrP10_CONTROLLER_0_IAM_Rx
        ComIPduSignalProcessing = DEFERRED
        ComIPduType = NORMAL
        ComPduIdRef = COM_PEU_ERCANFD_50ms_FrP10_CONTROLLER_0_IAM_Rx
        ComIPduSignalRef = IEDUOilPmpMotSpdReq_PEU_PEU_ERCANFD_50ms_FrP10_CONTROLLER_0_IAM_Rx
        ComIPduSignalRef = IEDUOilPmpMotSts_PEU_PEU_ERCANFD_50ms_FrP10_CONTROLLER_0_IAM_Rx
        ComIPduSignalRef = IEDUOilPmpMotSpd_PEU_PEU_ERCANFD_50ms_FrP10_CONTROLLER_0_IAM_Rx
        ComIPduSignalRef = IEDUOilPmpMotSpdV_PEU_PEU_ERCANFD_50ms_FrP10_CONTROLLER_0_IAM_Rx
        ComIPduSignalRef = IEDUOilPmpMotEnb_PEU_PEU_ERCANFD_50ms_FrP10_CONTROLLER_0_IAM_Rx
        ComIPduSignalRef = IEDUOilPmpMotCrnt_PEU_PEU_ERCANFD_50ms_FrP10_CONTROLLER_0_IAM_Rx
        ComIPduSignalRef = IEDUOilPmpMotVol_PEU_PEU_ERCANFD_50ms_FrP10_CONTROLLER_0_IAM_Rx
        ComIPduSignalRef = IEDUOilPmpMotFltResn_PEU_PEU_ERCANFD_50ms_FrP10_CONTROLLER_0_IAM_Rx
        ComIPduGroupRef = Com_RxPduGroup_CONTROLLER_0_IAM
      8 x ComSignal, all with ComInvalidNotification=NULL_PTR, ComRxDataTimeoutAction=NONE, ComSignalEndianness=BIG_ENDIAN, ComSignalInitValue=0x0, ComSignalLength=0, ComTransferProperty=PENDING, ComSignalDataInvalidValue=0x0, ComDataInvalidAction=NOTIFY, ComTimeout=0.0, ComFirstTimeout=0.0, ComNotification=Rte_COMCbk:
        IEDUOilPmpMotSpdReq_PEU_PEU_ERCANFD_50ms_FrP10_CONTROLLER_0_IAM_Rx: ComBitPosition=26, ComBitSize=14, ComHandleId=IEDUOilPmpMotSpdReq_PEU_PEU_ERCANFD_50ms_FrP10_CONTROLLER_0_IAM_Rx, ComSignalType=UINT16
        IEDUOilPmpMotSts_PEU_PEU_ERCANFD_50ms_FrP10_CONTROLLER_0_IAM_Rx: ComBitPosition=24, ComBitSize=2, ComHandleId=IEDUOilPmpMotSts_PEU_PEU_ERCANFD_50ms_FrP10_CONTROLLER_0_IAM_Rx, ComSignalType=UINT8
        IEDUOilPmpMotSpd_PEU_PEU_ERCANFD_50ms_FrP10_CONTROLLER_0_IAM_Rx: ComBitPosition=42, ComBitSize=14, ComHandleId=IEDUOilPmpMotSpd_PEU_PEU_ERCANFD_50ms_FrP10_CONTROLLER_0_IAM_Rx, ComSignalType=UINT16
        IEDUOilPmpMotSpdV_PEU_PEU_ERCANFD_50ms_FrP10_CONTROLLER_0_IAM_Rx: ComBitPosition=40, ComBitSize=1, ComHandleId=IEDUOilPmpMotSpdV_PEU_PEU_ERCANFD_50ms_FrP10_CONTROLLER_0_IAM_Rx, ComSignalType=BOOLEAN
        IEDUOilPmpMotEnb_PEU_PEU_ERCANFD_50ms_FrP10_CONTROLLER_0_IAM_Rx: ComBitPosition=41, ComBitSize=1, ComHandleId=IEDUOilPmpMotEnb_PEU_PEU_ERCANFD_50ms_FrP10_CONTROLLER_0_IAM_Rx, ComSignalType=BOOLEAN
        IEDUOilPmpMotCrnt_PEU_PEU_ERCANFD_50ms_FrP10_CONTROLLER_0_IAM_Rx: ComBitPosition=48, ComBitSize=8, ComHandleId=IEDUOilPmpMotCrnt_PEU_PEU_ERCANFD_50ms_FrP10_CONTROLLER_0_IAM_Rx, ComSignalType=UINT8
        IEDUOilPmpMotVol_PEU_PEU_ERCANFD_50ms_FrP10_CONTROLLER_0_IAM_Rx: ComBitPosition=57, ComBitSize=7, ComHandleId=IEDUOilPmpMotVol_PEU_PEU_ERCANFD_50ms_FrP10_CONTROLLER_0_IAM_Rx, ComSignalType=UINT8
        IEDUOilPmpMotFltResn_PEU_PEU_ERCANFD_50ms_FrP10_CONTROLLER_0_IAM_Rx: ComBitPosition=68, ComBitSize=4, ComHandleId=IEDUOilPmpMotFltResn_PEU_PEU_ERCANFD_50ms_FrP10_CONTROLLER_0_IAM_Rx, ComSignalType=UINT8
      LVBM_PTEXTDCAN_100ms_FrP01_CONTROLLER_0_IAM_Rx (ComIPdu):
        ComIPduCancellationSupport = false
        ComIPduDirection = RECEIVE
        ComIPduHandleId = COM_RXPDU_COM_LVBM_PTEXTDCAN_100ms_FrP01_CONTROLLER_0_IAM_Rx
        ComIPduSignalProcessing = DEFERRED
        ComIPduType = NORMAL
        ComPduIdRef = COM_LVBM_PTEXTDCAN_100ms_FrP01_CONTROLLER_0_IAM_Rx
        ComIPduSignalRef = ILVBMMOSSts_LVBM_PTEXTDCAN_100ms_FrP01_CONTROLLER_0_IAM_Rx
        ComIPduGroupRef = Com_RxPduGroup_CONTROLLER_0_IAM
      ILVBMMOSSts_LVBM_PTEXTDCAN_100ms_FrP01_CONTROLLER_0_IAM_Rx (ComSignal):
        ComBitPosition = 63
        ComBitSize = 3
        ComHandleId = ILVBMMOSSts_LVBM_PTEXTDCAN_100ms_FrP01_CONTROLLER_0_IAM_Rx
        ComInvalidNotification = NULL_PTR
        ComRxDataTimeoutAction = NONE
        ComSignalEndianness = BIG_ENDIAN
        ComSignalInitValue = 0x0
        ComSignalLength = 0
        ComSignalType = UINT8
        ComTransferProperty = PENDING
        ComSignalDataInvalidValue = 0x0
        ComDataInvalidAction = NOTIFY
        ComTimeout = 0.0
        ComFirstTimeout = 0.0
        ComNotification = Rte_COMCbk
      ICBAD_BKPCANFD_100ms_FrP42_CONTROLLER_0_IAM_Rx (ComIPdu):
        ComIPduCancellationSupport = false
        ComIPduDirection = RECEIVE
        ComIPduHandleId = COM_RXPDU_COM_ICBAD_BKPCANFD_100ms_FrP42_CONTROLLER_0_IAM_Rx
        ComIPduSignalProcessing = DEFERRED
        ComIPduType = NORMAL
        ComPduIdRef = COM_ICBAD_BKPCANFD_100ms_FrP42_CONTROLLER_0_IAM_Rx
        ComIPduSignalRef = IParkngFuncRcm_ICBAD_BKPCANFD_100ms_FrP42_CONTROLLER_0_IAM_Rx
        ComIPduGroupRef = Com_RxPduGroup_CONTROLLER_0_IAM
      IParkngFuncRcm_ICBAD_BKPCANFD_100ms_FrP42_CONTROLLER_0_IAM_Rx (ComSignal):
        ComBitPosition = 44
        ComBitSize = 4
        ComHandleId = IParkngFuncRcm_ICBAD_BKPCANFD_100ms_FrP42_CONTROLLER_0_IAM_Rx
        ComInvalidNotification = NULL_PTR
        ComRxDataTimeoutAction = NONE
        ComSignalEndianness = BIG_ENDIAN
        ComSignalInitValue = 0x0
        ComSignalLength = 0
        ComSignalType = UINT8
        ComTransferProperty = PENDING
        ComSignalDataInvalidValue = 0x0
        ComDataInvalidAction = NOTIFY
        ComTimeout = 0.0
        ComFirstTimeout = 0.0
        ComNotification = Rte_COMCbk
      PEU_ERCANFD_100ms_FrP15_CONTROLLER_0_IAM_Rx (ComIPdu):
        ComIPduCancellationSupport = false
        ComIPduDirection = RECEIVE
        ComIPduHandleId = COM_RXPDU_COM_PEU_ERCANFD_100ms_FrP15_CONTROLLER_0_IAM_Rx
        ComIPduSignalProcessing = DEFERRED
        ComIPduType = NORMAL
        ComIPduCallout = PEU_ERCANFD_100ms_FrP15_CONTROLLER_0_IAM_Rx
        ComPduIdRef = COM_PEU_ERCANFD_100ms_FrP15_CONTROLLER_0_IAM_Rx
        ComIPduSignalGroupRef = IPEU_100ms_Group15_PEU_ERCANFD_100ms_FrP15_CONTROLLER_0_IAM_Rx
        ComIPduGroupRef = Com_RxPduGroup_CONTROLLER_0_IAM
      IPEU_100ms_Group15_PEU_ERCANFD_100ms_FrP15_CONTROLLER_0_IAM_Rx (ComSignalGroup):
        ComHandleId = IPEU_100ms_Group15_PEU_ERCANFD_100ms_FrP15_CONTROLLER_0_IAM_Rx
        ComInvalidNotification = NULL_PTR
        ComRxDataTimeoutAction = NONE
        ComTransferProperty = PENDING
        ComDataInvalidAction = NOTIFY
        ComTimeout = 0.0
        ComFirstTimeout = 0.0
        ComNotification = Rte_COMCbk
        46 x ComGroupSignal, all with ComSignalEndianness=BIG_ENDIAN, ComSignalInitValue=0x0, ComSignalLength=0, ComSignalDataInvalidValue=0x0:
          IPEU_100ms_Group15_CRC_IPEU_100ms_Group15_PEU_ERCANFD_100ms_FrP15_CONTROLLER_0_IAM_Rx: ComBitPosition=0, ComBitSize=8, ComHandleId=IPEU_100ms_Group15_PEU_ERCANFD_100ms_FrP15_CONTROLLER_0_IAM_Rx_IPEU_100ms_Group15_CRC_IPEU_100ms_Group15_PEU_ERCANFD_100ms_FrP15_CONTROLLER_0_IAM_Rx, ComSignalType=UINT8
          IPEU_100ms_Group15_RC_IPEU_100ms_Group15_PEU_ERCANFD_100ms_FrP15_CONTROLLER_0_IAM_Rx: ComBitPosition=8, ComBitSize=4, ComHandleId=IPEU_100ms_Group15_PEU_ERCANFD_100ms_FrP15_CONTROLLER_0_IAM_Rx_IPEU_100ms_Group15_RC_IPEU_100ms_Group15_PEU_ERCANFD_100ms_FrP15_CONTROLLER_0_IAM_Rx, ComSignalType=UINT8
          IHybEVMdDisb_IPEU_100ms_Group15_PEU_ERCANFD_100ms_FrP15_CONTROLLER_0_IAM_Rx: ComBitPosition=12, ComBitSize=2, ComHandleId=IPEU_100ms_Group15_PEU_ERCANFD_100ms_FrP15_CONTROLLER_0_IAM_Rx_IHybEVMdDisb_IPEU_100ms_Group15_PEU_ERCANFD_100ms_FrP15_CONTROLLER_0_IAM_Rx, ComSignalType=UINT8
          IHybEPTEVMode_IPEU_100ms_Group15_PEU_ERCANFD_100ms_FrP15_CONTROLLER_0_IAM_Rx: ComBitPosition=14, ComBitSize=2, ComHandleId=IPEU_100ms_Group15_PEU_ERCANFD_100ms_FrP15_CONTROLLER_0_IAM_Rx_IHybEPTEVMode_IPEU_100ms_Group15_PEU_ERCANFD_100ms_FrP15_CONTROLLER_0_IAM_Rx, ComSignalType=UINT8
          IHybEmmsnTestMdPCU_IPEU_100ms_Group15_PEU_ERCANFD_100ms_FrP15_CONTROLLER_0_IAM_Rx: ComBitPosition=16, ComBitSize=1, ComHandleId=IPEU_100ms_Group15_PEU_ERCANFD_100ms_FrP15_CONTROLLER_0_IAM_Rx_IHybEmmsnTestMdPCU_IPEU_100ms_Group15_PEU_ERCANFD_100ms_FrP15_CONTROLLER_0_IAM_Rx, ComSignalType=BOOLEAN
          IHybTrgtSOCUprLmt_IPEU_100ms_Group15_PEU_ERCANFD_100ms_FrP15_CONTROLLER_0_IAM_Rx: ComBitPosition=17, ComBitSize=7, ComHandleId=IPEU_100ms_Group15_PEU_ERCANFD_100ms_FrP15_CONTROLLER_0_IAM_Rx_IHybTrgtSOCUprLmt_IPEU_100ms_Group15_PEU_ERCANFD_100ms_FrP15_CONTROLLER_0_IAM_Rx, ComSignalType=UINT8
          IHybElecVehMdRcmnd_IPEU_100ms_Group15_PEU_ERCANFD_100ms_FrP15_CONTROLLER_0_IAM_Rx: ComBitPosition=24, ComBitSize=1, ComHandleId=IPEU_100ms_Group15_PEU_ERCANFD_100ms_FrP15_CONTROLLER_0_IAM_Rx_IHybElecVehMdRcmnd_IPEU_100ms_Group15_PEU_ERCANFD_100ms_FrP15_CONTROLLER_0_IAM_Rx, ComSignalType=BOOLEAN
          IHybTrgtSOCLowrLmt_IPEU_100ms_Group15_PEU_ERCANFD_100ms_FrP15_CONTROLLER_0_IAM_Rx: ComBitPosition=25, ComBitSize=7, ComHandleId=IPEU_100ms_Group15_PEU_ERCANFD_100ms_FrP15_CONTROLLER_0_IAM_Rx_IHybTrgtSOCLowrLmt_IPEU_100ms_Group15_PEU_ERCANFD_100ms_FrP15_CONTROLLER_0_IAM_Rx, ComSignalType=UINT8
          IEPTEnStFail_HCU_IPEU_100ms_Group15_PEU_ERCANFD_100ms_FrP15_CONTROLLER_0_IAM_Rx: ComBitPosition=32, ComBitSize=1, ComHandleId=IPEU_100ms_Group15_PEU_ERCANFD_100ms_FrP15_CONTROLLER_0_IAM_Rx_IEPTEnStFail_HCU_IPEU_100ms_Group15_PEU_ERCANFD_100ms_FrP15_CONTROLLER_0_IAM_Rx, ComSignalType=BOOLEAN
          IHybTrgtSOCResp_IPEU_100ms_Group15_PEU_ERCANFD_100ms_FrP15_CONTROLLER_0_IAM_Rx: ComBitPosition=33, ComBitSize=7, ComHandleId=IPEU_100ms_Group15_PEU_ERCANFD_100ms_FrP15_CONTROLLER_0_IAM_Rx_IHybTrgtSOCResp_IPEU_100ms_Group15_PEU_ERCANFD_100ms_FrP15_CONTROLLER_0_IAM_Rx, ComSignalType=UINT8
          IHybEPTFrcEVStsDsp_IPEU_100ms_Group15_PEU_ERCANFD_100ms_FrP15_CONTROLLER_0_IAM_Rx: ComBitPosition=40, ComBitSize=3, ComHandleId=IPEU_100ms_Group15_PEU_ERCANFD_100ms_FrP15_CONTROLLER_0_IAM_Rx_IHybEPTFrcEVStsDsp_IPEU_100ms_Group15_PEU_ERCANFD_100ms_FrP15_CONTROLLER_0_IAM_Rx, ComSignalType=UINT8
          IPEU_100ms_Group15_Reserved1_IPEU_100ms_Group15_PEU_ERCANFD_100ms_FrP15_CONTROLLER_0_IAM_Rx: ComBitPosition=43, ComBitSize=5, ComHandleId=IPEU_100ms_Group15_PEU_ERCANFD_100ms_FrP15_CONTROLLER_0_IAM_Rx_IPEU_100ms_Group15_Reserved1_IPEU_100ms_Group15_PEU_ERCANFD_100ms_FrP15_CONTROLLER_0_IAM_Rx, ComSignalType=UINT8
          IHybEPTParkngPwrGennMdSts_IPEU_100ms_Group15_PEU_ERCANFD_100ms_FrP15_CONTROLLER_0_IAM_Rx: ComBitPosition=48, ComBitSize=1, ComHandleId=IPEU_100ms_Group15_PEU_ERCANFD_100ms_FrP15_CONTROLLER_0_IAM_Rx_IHybEPTParkngPwrGennMdSts_IPEU_100ms_Group15_PEU_ERCANFD_100ms_FrP15_CONTROLLER_0_IAM_Rx, ComSignalType=BOOLEAN
          IHybLowSOCWrnng_IPEU_100ms_Group15_PEU_ERCANFD_100ms_FrP15_CONTROLLER_0_IAM_Rx: ComBitPosition=49, ComBitSize=2, ComHandleId=IPEU_100ms_Group15_PEU_ERCANFD_100ms_FrP15_CONTROLLER_0_IAM_Rx_IHybLowSOCWrnng_IPEU_100ms_Group15_PEU_ERCANFD_100ms_FrP15_CONTROLLER_0_IAM_Rx, ComSignalType=UINT8
          IPEU_100ms_Group15_Reserved2_IPEU_100ms_Group15_PEU_ERCANFD_100ms_FrP15_CONTROLLER_0_IAM_Rx: ComBitPosition=51, ComBitSize=5, ComHandleId=IPEU_100ms_Group15_PEU_ERCANFD_100ms_FrP15_CONTROLLER_0_IAM_Rx_IPEU_100ms_Group15_Reserved2_IPEU_100ms_Group15_PEU_ERCANFD_100ms_FrP15_CONTROLLER_0_IAM_Rx, ComSignalType=UINT8
          IPEU_100ms_Group15_Reserved3_IPEU_100ms_Group15_PEU_ERCANFD_100ms_FrP15_CONTROLLER_0_IAM_Rx: ComBitPosition=56, ComBitSize=1, ComHandleId=IPEU_100ms_Group15_PEU_ERCANFD_100ms_FrP15_CONTROLLER_0_IAM_Rx_IPEU_100ms_Group15_Reserved3_IPEU_100ms_Group15_PEU_ERCANFD_100ms_FrP15_CONTROLLER_0_IAM_Rx, ComSignalType=BOOLEAN
          IHybParkngPwrGennTrgtSOCResp_IPEU_100ms_Group15_PEU_ERCANFD_100ms_FrP15_CONTROLLER_0_IAM_Rx: ComBitPosition=57, ComBitSize=7, ComHandleId=IPEU_100ms_Group15_PEU_ERCANFD_100ms_FrP15_CONTROLLER_0_IAM_Rx_IHybParkngPwrGennTrgtSOCResp_IPEU_100ms_Group15_PEU_ERCANFD_100ms_FrP15_CONTROLLER_0_IAM_Rx, ComSignalType=UINT8
          IHybEPTEVMdExitIPKDsp_IPEU_100ms_Group15_PEU_ERCANFD_100ms_FrP15_CONTROLLER_0_IAM_Rx: ComBitPosition=64, ComBitSize=3, ComHandleId=IPEU_100ms_Group15_PEU_ERCANFD_100ms_FrP15_CONTROLLER_0_IAM_Rx_IHybEPTEVMdExitIPKDsp_IPEU_100ms_Group15_PEU_ERCANFD_100ms_FrP15_CONTROLLER_0_IAM_Rx, ComSignalType=UINT8
          IHybVehEnrgFlw_IPEU_100ms_Group15_PEU_ERCANFD_100ms_FrP15_CONTROLLER_0_IAM_Rx: ComBitPosition=67, ComBitSize=5, ComHandleId=IPEU_100ms_Group15_PEU_ERCANFD_100ms_FrP15_CONTROLLER_0_IAM_Rx_IHybVehEnrgFlw_IPEU_100ms_Group15_PEU_ERCANFD_100ms_FrP15_CONTROLLER_0_IAM_Rx, ComSignalType=UINT8
          IHybEPTEVMdNoEntRsn_IPEU_100ms_Group15_PEU_ERCANFD_100ms_FrP15_CONTROLLER_0_IAM_Rx: ComBitPosition=72, ComBitSize=3, ComHandleId=IPEU_100ms_Group15_PEU_ERCANFD_100ms_FrP15_CONTROLLER_0_IAM_Rx_IHybEPTEVMdNoEntRsn_IPEU_100ms_Group15_PEU_ERCANFD_100ms_FrP15_CONTROLLER_0_IAM_Rx, ComSignalType=UINT8
          IHybInfoDsp_IPEU_100ms_Group15_PEU_ERCANFD_100ms_FrP15_CONTROLLER_0_IAM_Rx: ComBitPosition=75, ComBitSize=5, ComHandleId=IPEU_100ms_Group15_PEU_ERCANFD_100ms_FrP15_CONTROLLER_0_IAM_Rx_IHybInfoDsp_IPEU_100ms_Group15_PEU_ERCANFD_100ms_FrP15_CONTROLLER_0_IAM_Rx, ComSignalType=UINT8
          IV2XEnEnbDspCmd_HCU_IPEU_100ms_Group15_PEU_ERCANFD_100ms_FrP15_CONTROLLER_0_IAM_Rx: ComBitPosition=80, ComBitSize=2, ComHandleId=IPEU_100ms_Group15_PEU_ERCANFD_100ms_FrP15_CONTROLLER_0_IAM_Rx_IV2XEnEnbDspCmd_HCU_IPEU_100ms_Group15_PEU_ERCANFD_100ms_FrP15_CONTROLLER_0_IAM_Rx, ComSignalType=UINT8
          IHybEPTParkngPwrGennLvlSts_IPEU_100ms_Group15_PEU_ERCANFD_100ms_FrP15_CONTROLLER_0_IAM_Rx: ComBitPosition=82, ComBitSize=2, ComHandleId=IPEU_100ms_Group15_PEU_ERCANFD_100ms_FrP15_CONTROLLER_0_IAM_Rx_IHybEPTParkngPwrGennLvlSts_IPEU_100ms_Group15_PEU_ERCANFD_100ms_FrP15_CONTROLLER_0_IAM_Rx, ComSignalType=UINT8
          IHybEPTParkngPwrGennMdNoEntRsn_IPEU_100ms_Group15_PEU_ERCANFD_100ms_FrP15_CONTROLLER_0_IAM_Rx: ComBitPosition=84, ComBitSize=4, ComHandleId=IPEU_100ms_Group15_PEU_ERCANFD_100ms_FrP15_CONTROLLER_0_IAM_Rx_IHybEPTParkngPwrGennMdNoEntRsn_IPEU_100ms_Group15_PEU_ERCANFD_100ms_FrP15_CONTROLLER_0_IAM_Rx, ComSignalType=UINT8
          IPEU_100ms_Group15_Reserved4_IPEU_100ms_Group15_PEU_ERCANFD_100ms_FrP15_CONTROLLER_0_IAM_Rx: ComBitPosition=88, ComBitSize=5, ComHandleId=IPEU_100ms_Group15_PEU_ERCANFD_100ms_FrP15_CONTROLLER_0_IAM_Rx_IPEU_100ms_Group15_Reserved4_IPEU_100ms_Group15_PEU_ERCANFD_100ms_FrP15_CONTROLLER_0_IAM_Rx, ComSignalType=UINT8
          IHybEPTPwrDMdSwSts_IPEU_100ms_Group15_PEU_ERCANFD_100ms_FrP15_CONTROLLER_0_IAM_Rx: ComBitPosition=93, ComBitSize=3, ComHandleId=IPEU_100ms_Group15_PEU_ERCANFD_100ms_FrP15_CONTROLLER_0_IAM_Rx_IHybEPTPwrDMdSwSts_IPEU_100ms_Group15_PEU_ERCANFD_100ms_FrP15_CONTROLLER_0_IAM_Rx, ComSignalType=UINT8
          IPEU_100ms_Group15_Reserved5_IPEU_100ms_Group15_PEU_ERCANFD_100ms_FrP15_CONTROLLER_0_IAM_Rx: ComBitPosition=96, ComBitSize=8, ComHandleId=IPEU_100ms_Group15_PEU_ERCANFD_100ms_FrP15_CONTROLLER_0_IAM_Rx_IPEU_100ms_Group15_Reserved5_IPEU_100ms_Group15_PEU_ERCANFD_100ms_FrP15_CONTROLLER_0_IAM_Rx, ComSignalType=UINT8
          IPEU_100ms_Group15_Reserved6_IPEU_100ms_Group15_PEU_ERCANFD_100ms_FrP15_CONTROLLER_0_IAM_Rx: ComBitPosition=104, ComBitSize=8, ComHandleId=IPEU_100ms_Group15_PEU_ERCANFD_100ms_FrP15_CONTROLLER_0_IAM_Rx_IPEU_100ms_Group15_Reserved6_IPEU_100ms_Group15_PEU_ERCANFD_100ms_FrP15_CONTROLLER_0_IAM_Rx, ComSignalType=UINT8
          IPEU_100ms_Group15_Reserved7_IPEU_100ms_Group15_PEU_ERCANFD_100ms_FrP15_CONTROLLER_0_IAM_Rx: ComBitPosition=112, ComBitSize=8, ComHandleId=IPEU_100ms_Group15_PEU_ERCANFD_100ms_FrP15_CONTROLLER_0_IAM_Rx_IPEU_100ms_Group15_Reserved7_IPEU_100ms_Group15_PEU_ERCANFD_100ms_FrP15_CONTROLLER_0_IAM_Rx, ComSignalType=UINT8
          IPEU_100ms_Group15_Reserved8_IPEU_100ms_Group15_PEU_ERCANFD_100ms_FrP15_CONTROLLER_0_IAM_Rx: ComBitPosition=120, ComBitSize=8, ComHandleId=IPEU_100ms_Group15_PEU_ERCANFD_100ms_FrP15_CONTROLLER_0_IAM_Rx_IPEU_100ms_Group15_Reserved8_IPEU_100ms_Group15_PEU_ERCANFD_100ms_FrP15_CONTROLLER_0_IAM_Rx, ComSignalType=UINT8
          IPEU_100ms_Group15_Reserved9_IPEU_100ms_Group15_PEU_ERCANFD_100ms_FrP15_CONTROLLER_0_IAM_Rx: ComBitPosition=128, ComBitSize=8, ComHandleId=IPEU_100ms_Group15_PEU_ERCANFD_100ms_FrP15_CONTROLLER_0_IAM_Rx_IPEU_100ms_Group15_Reserved9_IPEU_100ms_Group15_PEU_ERCANFD_100ms_FrP15_CONTROLLER_0_IAM_Rx, ComSignalType=UINT8
          IPEU_100ms_Group15_Reserved10_IPEU_100ms_Group15_PEU_ERCANFD_100ms_FrP15_CONTROLLER_0_IAM_Rx: ComBitPosition=136, ComBitSize=8, ComHandleId=IPEU_100ms_Group15_PEU_ERCANFD_100ms_FrP15_CONTROLLER_0_IAM_Rx_IPEU_100ms_Group15_Reserved10_IPEU_100ms_Group15_PEU_ERCANFD_100ms_FrP15_CONTROLLER_0_IAM_Rx, ComSignalType=UINT8
          IPEU_100ms_Group15_Reserved11_IPEU_100ms_Group15_PEU_ERCANFD_100ms_FrP15_CONTROLLER_0_IAM_Rx: ComBitPosition=144, ComBitSize=8, ComHandleId=IPEU_100ms_Group15_PEU_ERCANFD_100ms_FrP15_CONTROLLER_0_IAM_Rx_IPEU_100ms_Group15_Reserved11_IPEU_100ms_Group15_PEU_ERCANFD_100ms_FrP15_CONTROLLER_0_IAM_Rx, ComSignalType=UINT8
          IPEU_100ms_Group15_Reserved12_IPEU_100ms_Group15_PEU_ERCANFD_100ms_FrP15_CONTROLLER_0_IAM_Rx: ComBitPosition=152, ComBitSize=8, ComHandleId=IPEU_100ms_Group15_PEU_ERCANFD_100ms_FrP15_CONTROLLER_0_IAM_Rx_IPEU_100ms_Group15_Reserved12_IPEU_100ms_Group15_PEU_ERCANFD_100ms_FrP15_CONTROLLER_0_IAM_Rx, ComSignalType=UINT8
          IPEU_100ms_Group15_Reserved13_IPEU_100ms_Group15_PEU_ERCANFD_100ms_FrP15_CONTROLLER_0_IAM_Rx: ComBitPosition=160, ComBitSize=8, ComHandleId=IPEU_100ms_Group15_PEU_ERCANFD_100ms_FrP15_CONTROLLER_0_IAM_Rx_IPEU_100ms_Group15_Reserved13_IPEU_100ms_Group15_PEU_ERCANFD_100ms_FrP15_CONTROLLER_0_IAM_Rx, ComSignalType=UINT8
          IPEU_100ms_Group15_Reserved14_IPEU_100ms_Group15_PEU_ERCANFD_100ms_FrP15_CONTROLLER_0_IAM_Rx: ComBitPosition=168, ComBitSize=8, ComHandleId=IPEU_100ms_Group15_PEU_ERCANFD_100ms_FrP15_CONTROLLER_0_IAM_Rx_IPEU_100ms_Group15_Reserved14_IPEU_100ms_Group15_PEU_ERCANFD_100ms_FrP15_CONTROLLER_0_IAM_Rx, ComSignalType=UINT8
          IPEU_100ms_Group15_Reserved15_IPEU_100ms_Group15_PEU_ERCANFD_100ms_FrP15_CONTROLLER_0_IAM_Rx: ComBitPosition=176, ComBitSize=8, ComHandleId=IPEU_100ms_Group15_PEU_ERCANFD_100ms_FrP15_CONTROLLER_0_IAM_Rx_IPEU_100ms_Group15_Reserved15_IPEU_100ms_Group15_PEU_ERCANFD_100ms_FrP15_CONTROLLER_0_IAM_Rx, ComSignalType=UINT8
          IPEU_100ms_Group15_Reserved16_IPEU_100ms_Group15_PEU_ERCANFD_100ms_FrP15_CONTROLLER_0_IAM_Rx: ComBitPosition=184, ComBitSize=8, ComHandleId=IPEU_100ms_Group15_PEU_ERCANFD_100ms_FrP15_CONTROLLER_0_IAM_Rx_IPEU_100ms_Group15_Reserved16_IPEU_100ms_Group15_PEU_ERCANFD_100ms_FrP15_CONTROLLER_0_IAM_Rx, ComSignalType=UINT8
          IPEU_100ms_Group15_Reserved17_IPEU_100ms_Group15_PEU_ERCANFD_100ms_FrP15_CONTROLLER_0_IAM_Rx: ComBitPosition=192, ComBitSize=8, ComHandleId=IPEU_100ms_Group15_PEU_ERCANFD_100ms_FrP15_CONTROLLER_0_IAM_Rx_IPEU_100ms_Group15_Reserved17_IPEU_100ms_Group15_PEU_ERCANFD_100ms_FrP15_CONTROLLER_0_IAM_Rx, ComSignalType=UINT8
          IPEU_100ms_Group15_Reserved18_IPEU_100ms_Group15_PEU_ERCANFD_100ms_FrP15_CONTROLLER_0_IAM_Rx: ComBitPosition=200, ComBitSize=8, ComHandleId=IPEU_100ms_Group15_PEU_ERCANFD_100ms_FrP15_CONTROLLER_0_IAM_Rx_IPEU_100ms_Group15_Reserved18_IPEU_100ms_Group15_PEU_ERCANFD_100ms_FrP15_CONTROLLER_0_IAM_Rx, ComSignalType=UINT8
          IPEU_100ms_Group15_Reserved19_IPEU_100ms_Group15_PEU_ERCANFD_100ms_FrP15_CONTROLLER_0_IAM_Rx: ComBitPosition=208, ComBitSize=8, ComHandleId=IPEU_100ms_Group15_PEU_ERCANFD_100ms_FrP15_CONTROLLER_0_IAM_Rx_IPEU_100ms_Group15_Reserved19_IPEU_100ms_Group15_PEU_ERCANFD_100ms_FrP15_CONTROLLER_0_IAM_Rx, ComSignalType=UINT8
          IPEU_100ms_Group15_Reserved20_IPEU_100ms_Group15_PEU_ERCANFD_100ms_FrP15_CONTROLLER_0_IAM_Rx: ComBitPosition=216, ComBitSize=8, ComHandleId=IPEU_100ms_Group15_PEU_ERCANFD_100ms_FrP15_CONTROLLER_0_IAM_Rx_IPEU_100ms_Group15_Reserved20_IPEU_100ms_Group15_PEU_ERCANFD_100ms_FrP15_CONTROLLER_0_IAM_Rx, ComSignalType=UINT8
          IPEU_100ms_Group15_Reserved21_IPEU_100ms_Group15_PEU_ERCANFD_100ms_FrP15_CONTROLLER_0_IAM_Rx: ComBitPosition=224, ComBitSize=8, ComHandleId=IPEU_100ms_Group15_PEU_ERCANFD_100ms_FrP15_CONTROLLER_0_IAM_Rx_IPEU_100ms_Group15_Reserved21_IPEU_100ms_Group15_PEU_ERCANFD_100ms_FrP15_CONTROLLER_0_IAM_Rx, ComSignalType=UINT8
          IPEU_100ms_Group15_Reserved22_IPEU_100ms_Group15_PEU_ERCANFD_100ms_FrP15_CONTROLLER_0_IAM_Rx: ComBitPosition=232, ComBitSize=8, ComHandleId=IPEU_100ms_Group15_PEU_ERCANFD_100ms_FrP15_CONTROLLER_0_IAM_Rx_IPEU_100ms_Group15_Reserved22_IPEU_100ms_Group15_PEU_ERCANFD_100ms_FrP15_CONTROLLER_0_IAM_Rx, ComSignalType=UINT8
          IPEU_100ms_Group15_Reserved23_IPEU_100ms_Group15_PEU_ERCANFD_100ms_FrP15_CONTROLLER_0_IAM_Rx: ComBitPosition=240, ComBitSize=8, ComHandleId=IPEU_100ms_Group15_PEU_ERCANFD_100ms_FrP15_CONTROLLER_0_IAM_Rx_IPEU_100ms_Group15_Reserved23_IPEU_100ms_Group15_PEU_ERCANFD_100ms_FrP15_CONTROLLER_0_IAM_Rx, ComSignalType=UINT8
          IPEU_100ms_Group15_Reserved24_IPEU_100ms_Group15_PEU_ERCANFD_100ms_FrP15_CONTROLLER_0_IAM_Rx: ComBitPosition=248, ComBitSize=8, ComHandleId=IPEU_100ms_Group15_PEU_ERCANFD_100ms_FrP15_CONTROLLER_0_IAM_Rx_IPEU_100ms_Group15_Reserved24_IPEU_100ms_Group15_PEU_ERCANFD_100ms_FrP15_CONTROLLER_0_IAM_Rx, ComSignalType=UINT8
      IPD_BKPCANFD_100ms_FrP50_CONTROLLER_0_IAM_Rx (ComIPdu):
        ComIPduCancellationSupport = false
        ComIPduDirection = RECEIVE
        ComIPduHandleId = COM_RXPDU_COM_IPD_BKPCANFD_100ms_FrP50_CONTROLLER_0_IAM_Rx
        ComIPduSignalProcessing = DEFERRED
        ComIPduType = NORMAL
        ComPduIdRef = COM_IPD_BKPCANFD_100ms_FrP50_CONTROLLER_0_IAM_Rx
        ComIPduSignalRef = IAIParkngMsgReq_IPD_BKPCANFD_100ms_FrP50_CONTROLLER_0_IAM_Rx
        ComIPduGroupRef = Com_RxPduGroup_CONTROLLER_0_IAM
      IAIParkngMsgReq_IPD_BKPCANFD_100ms_FrP50_CONTROLLER_0_IAM_Rx (ComSignal):
        ComBitPosition = 16
        ComBitSize = 8
        ComHandleId = IAIParkngMsgReq_IPD_BKPCANFD_100ms_FrP50_CONTROLLER_0_IAM_Rx
        ComInvalidNotification = NULL_PTR
        ComRxDataTimeoutAction = NONE
        ComSignalEndianness = BIG_ENDIAN
        ComSignalInitValue = 0x0
        ComSignalLength = 0
        ComSignalType = UINT8
        ComTransferProperty = PENDING
        ComSignalDataInvalidValue = 0x0
        ComDataInvalidAction = NOTIFY
        ComTimeout = 0.0
        ComFirstTimeout = 0.0
        ComNotification = Rte_COMCbk
      ESS_PTCANFD_100ms_FrP28_CONTROLLER_0_IAM_Rx (ComIPdu):
        ComIPduCancellationSupport = false
        ComIPduDirection = RECEIVE
        ComIPduHandleId = COM_RXPDU_COM_ESS_PTCANFD_100ms_FrP28_CONTROLLER_0_IAM_Rx
        ComIPduSignalProcessing = DEFERRED
        ComIPduType = NORMAL
        ComPduIdRef = COM_ESS_PTCANFD_100ms_FrP28_CONTROLLER_0_IAM_Rx
        ComIPduSignalRef = IBMSOnbdChrgSpRsn_ESS_PTCANFD_100ms_FrP28_CONTROLLER_0_IAM_Rx
        ComIPduGroupRef = Com_RxPduGroup_CONTROLLER_0_IAM
      IBMSOnbdChrgSpRsn_ESS_PTCANFD_100ms_FrP28_CONTROLLER_0_IAM_Rx (ComSignal):
        ComBitPosition = 16
        ComBitSize = 8
        ComHandleId = IBMSOnbdChrgSpRsn_ESS_PTCANFD_100ms_FrP28_CONTROLLER_0_IAM_Rx
        ComInvalidNotification = NULL_PTR
        ComRxDataTimeoutAction = NONE
        ComSignalEndianness = BIG_ENDIAN
        ComSignalInitValue = 0x0
        ComSignalLength = 0
        ComSignalType = UINT8
        ComTransferProperty = PENDING
        ComSignalDataInvalidValue = 0x0
        ComDataInvalidAction = NOTIFY
        ComTimeout = 0.0
        ComFirstTimeout = 0.0
        ComNotification = Rte_COMCbk
      ESS_ZONE_PTCANFD_100ms_FrP16_CONTROLLER_0_IAM_Rx (ComIPdu):
        ComIPduCancellationSupport = false
        ComIPduDirection = RECEIVE
        ComIPduHandleId = COM_RXPDU_COM_ESS_ZONE_PTCANFD_100ms_FrP16_CONTROLLER_0_IAM_Rx
        ComIPduSignalProcessing = DEFERRED
        ComIPduType = NORMAL
        ComPduIdRef = COM_ESS_ZONE_PTCANFD_100ms_FrP16_CONTROLLER_0_IAM_Rx
        ComIPduSignalRef = IVehElecRngV_ESS_ZONE_PTCANFD_100ms_FrP16_CONTROLLER_0_IAM_Rx
        ComIPduSignalRef = IVehElecRng_ESS_ZONE_PTCANFD_100ms_FrP16_CONTROLLER_0_IAM_Rx
        ComIPduSignalRef = IHVOffMoSts_ESS_ZONE_PTCANFD_100ms_FrP16_CONTROLLER_0_IAM_Rx
        ComIPduGroupRef = Com_RxPduGroup_CONTROLLER_0_IAM
      3 x ComSignal, all with ComInvalidNotification=NULL_PTR, ComRxDataTimeoutAction=NONE, ComSignalEndianness=BIG_ENDIAN, ComSignalInitValue=0x0, ComSignalLength=0, ComTransferProperty=PENDING, ComSignalDataInvalidValue=0x0, ComDataInvalidAction=NOTIFY, ComTimeout=0.0, ComFirstTimeout=0.0, ComNotification=Rte_COMCbk:
        IVehElecRngV_ESS_ZONE_PTCANFD_100ms_FrP16_CONTROLLER_0_IAM_Rx: ComBitPosition=3, ComBitSize=1, ComHandleId=IVehElecRngV_ESS_ZONE_PTCANFD_100ms_FrP16_CONTROLLER_0_IAM_Rx, ComSignalType=BOOLEAN
        IVehElecRng_ESS_ZONE_PTCANFD_100ms_FrP16_CONTROLLER_0_IAM_Rx: ComBitPosition=56, ComBitSize=11, ComHandleId=IVehElecRng_ESS_ZONE_PTCANFD_100ms_FrP16_CONTROLLER_0_IAM_Rx, ComSignalType=UINT16
        IHVOffMoSts_ESS_ZONE_PTCANFD_100ms_FrP16_CONTROLLER_0_IAM_Rx: ComBitPosition=53, ComBitSize=3, ComHandleId=IHVOffMoSts_ESS_ZONE_PTCANFD_100ms_FrP16_CONTROLLER_0_IAM_Rx, ComSignalType=UINT8
      ESS_PTCANFD_100ms_FrP22_CONTROLLER_0_IAM_Rx (ComIPdu):
        ComIPduCancellationSupport = false
        ComIPduDirection = RECEIVE
        ComIPduHandleId = COM_RXPDU_COM_ESS_PTCANFD_100ms_FrP22_CONTROLLER_0_IAM_Rx
        ComIPduSignalProcessing = DEFERRED
        ComIPduType = NORMAL
        ComPduIdRef = COM_ESS_PTCANFD_100ms_FrP22_CONTROLLER_0_IAM_Rx
        ComIPduSignalRef = IBMSOfbdChrgSpRsn_ESS_PTCANFD_100ms_FrP22_CONTROLLER_0_IAM_Rx
        ComIPduSignalRef = IBMSReserChrgCtrlResp_ESS_PTCANFD_100ms_FrP22_CONTROLLER_0_IAM_Rx
        ComIPduSignalRef = IBMSReserCtrlDspCmd_ESS_PTCANFD_100ms_FrP22_CONTROLLER_0_IAM_Rx
        ComIPduSignalRef = IBMSReserSpMinuteDspCmd_ESS_PTCANFD_100ms_FrP22_CONTROLLER_0_IAM_Rx
        ComIPduSignalRef = IBMSReserStMinuteDspCmd_ESS_PTCANFD_100ms_FrP22_CONTROLLER_0_IAM_Rx
        ComIPduSignalRef = IBMSReserSpHourDspCmd_ESS_PTCANFD_100ms_FrP22_CONTROLLER_0_IAM_Rx
        ComIPduSignalRef = IBMSReserStHourDspCmd_ESS_PTCANFD_100ms_FrP22_CONTROLLER_0_IAM_Rx
        ComIPduGroupRef = Com_RxPduGroup_CONTROLLER_0_IAM
      7 x ComSignal, all with ComInvalidNotification=NULL_PTR, ComRxDataTimeoutAction=NONE, ComSignalEndianness=BIG_ENDIAN, ComSignalInitValue=0x0, ComSignalLength=0, ComSignalType=UINT8, ComTransferProperty=PENDING, ComSignalDataInvalidValue=0x0, ComDataInvalidAction=NOTIFY, ComTimeout=0.0, ComFirstTimeout=0.0, ComNotification=Rte_COMCbk:
        IBMSOfbdChrgSpRsn_ESS_PTCANFD_100ms_FrP22_CONTROLLER_0_IAM_Rx: ComBitPosition=0, ComBitSize=8, ComHandleId=IBMSOfbdChrgSpRsn_ESS_PTCANFD_100ms_FrP22_CONTROLLER_0_IAM_Rx
        IBMSReserChrgCtrlResp_ESS_PTCANFD_100ms_FrP22_CONTROLLER_0_IAM_Rx: ComBitPosition=29, ComBitSize=3, ComHandleId=IBMSReserChrgCtrlResp_ESS_PTCANFD_100ms_FrP22_CONTROLLER_0_IAM_Rx
        IBMSReserCtrlDspCmd_ESS_PTCANFD_100ms_FrP22_CONTROLLER_0_IAM_Rx: ComBitPosition=32, ComBitSize=2, ComHandleId=IBMSReserCtrlDspCmd_ESS_PTCANFD_100ms_FrP22_CONTROLLER_0_IAM_Rx
        IBMSReserSpMinuteDspCmd_ESS_PTCANFD_100ms_FrP22_CONTROLLER_0_IAM_Rx: ComBitPosition=34, ComBitSize=6, ComHandleId=IBMSReserSpMinuteDspCmd_ESS_PTCANFD_100ms_FrP22_CONTROLLER_0_IAM_Rx
        IBMSReserStMinuteDspCmd_ESS_PTCANFD_100ms_FrP22_CONTROLLER_0_IAM_Rx: ComBitPosition=41, ComBitSize=6, ComHandleId=IBMSReserStMinuteDspCmd_ESS_PTCANFD_100ms_FrP22_CONTROLLER_0_IAM_Rx
        IBMSReserSpHourDspCmd_ESS_PTCANFD_100ms_FrP22_CONTROLLER_0_IAM_Rx: ComBitPosition=48, ComBitSize=5, ComHandleId=IBMSReserSpHourDspCmd_ESS_PTCANFD_100ms_FrP22_CONTROLLER_0_IAM_Rx
        IBMSReserStHourDspCmd_ESS_PTCANFD_100ms_FrP22_CONTROLLER_0_IAM_Rx: ComBitPosition=59, ComBitSize=5, ComHandleId=IBMSReserStHourDspCmd_ESS_PTCANFD_100ms_FrP22_CONTROLLER_0_IAM_Rx
      ESS_PTCANFD_100ms_FrP20_CONTROLLER_0_IAM_Rx (ComIPdu):
        ComIPduCancellationSupport = false
        ComIPduDirection = RECEIVE
        ComIPduHandleId = COM_RXPDU_COM_ESS_PTCANFD_100ms_FrP20_CONTROLLER_0_IAM_Rx
        ComIPduSignalProcessing = DEFERRED
        ComIPduType = NORMAL
        ComIPduCallout = ESS_PTCANFD_100ms_FrP20_CONTROLLER_0_IAM_Rx
        ComPduIdRef = COM_ESS_PTCANFD_100ms_FrP20_CONTROLLER_0_IAM_Rx
        ComIPduSignalGroupRef = IESS_100ms_Group20_ESS_PTCANFD_100ms_FrP20_CONTROLLER_0_IAM_Rx
        ComIPduGroupRef = Com_RxPduGroup_CONTROLLER_0_IAM
      IESS_100ms_Group20_ESS_PTCANFD_100ms_FrP20_CONTROLLER_0_IAM_Rx (ComSignalGroup):
        ComHandleId = IESS_100ms_Group20_ESS_PTCANFD_100ms_FrP20_CONTROLLER_0_IAM_Rx
        ComInvalidNotification = NULL_PTR
        ComRxDataTimeoutAction = NONE
        ComTransferProperty = PENDING
        ComDataInvalidAction = NOTIFY
        ComTimeout = 0.0
        ComFirstTimeout = 0.0
        ComNotification = Rte_COMCbk
        14 x ComGroupSignal, all with ComSignalEndianness=BIG_ENDIAN, ComSignalInitValue=0x0, ComSignalLength=0, ComSignalDataInvalidValue=0x0:
          IESS_100ms_Group20_CRC_IESS_100ms_Group20_ESS_PTCANFD_100ms_FrP20_CONTROLLER_0_IAM_Rx: ComBitPosition=0, ComBitSize=8, ComHandleId=IESS_100ms_Group20_ESS_PTCANFD_100ms_FrP20_CONTROLLER_0_IAM_Rx_IESS_100ms_Group20_CRC_IESS_100ms_Group20_ESS_PTCANFD_100ms_FrP20_CONTROLLER_0_IAM_Rx, ComSignalType=UINT8
          IESS_100ms_Group20_RC_IESS_100ms_Group20_ESS_PTCANFD_100ms_FrP20_CONTROLLER_0_IAM_Rx: ComBitPosition=8, ComBitSize=4, ComHandleId=IESS_100ms_Group20_ESS_PTCANFD_100ms_FrP20_CONTROLLER_0_IAM_Rx_IESS_100ms_Group20_RC_IESS_100ms_Group20_ESS_PTCANFD_100ms_FrP20_CONTROLLER_0_IAM_Rx, ComSignalType=UINT8
          IESS_100ms_Group20_Reserved1_IESS_100ms_Group20_ESS_PTCANFD_100ms_FrP20_CONTROLLER_0_IAM_Rx: ComBitPosition=12, ComBitSize=4, ComHandleId=IESS_100ms_Group20_ESS_PTCANFD_100ms_FrP20_CONTROLLER_0_IAM_Rx_IESS_100ms_Group20_Reserved1_IESS_100ms_Group20_ESS_PTCANFD_100ms_FrP20_CONTROLLER_0_IAM_Rx, ComSignalType=UINT8
          IBMSCMUFlt_IESS_100ms_Group20_ESS_PTCANFD_100ms_FrP20_CONTROLLER_0_IAM_Rx: ComBitPosition=16, ComBitSize=2, ComHandleId=IESS_100ms_Group20_ESS_PTCANFD_100ms_FrP20_CONTROLLER_0_IAM_Rx_IBMSCMUFlt_IESS_100ms_Group20_ESS_PTCANFD_100ms_FrP20_CONTROLLER_0_IAM_Rx, ComSignalType=UINT8
          IBMSWrnngInfo_IESS_100ms_Group20_ESS_PTCANFD_100ms_FrP20_CONTROLLER_0_IAM_Rx: ComBitPosition=18, ComBitSize=6, ComHandleId=IESS_100ms_Group20_ESS_PTCANFD_100ms_FrP20_CONTROLLER_0_IAM_Rx_IBMSWrnngInfo_IESS_100ms_Group20_ESS_PTCANFD_100ms_FrP20_CONTROLLER_0_IAM_Rx, ComSignalType=UINT8
          IBMSCellVoltFlt_IESS_100ms_Group20_ESS_PTCANFD_100ms_FrP20_CONTROLLER_0_IAM_Rx: ComBitPosition=24, ComBitSize=2, ComHandleId=IESS_100ms_Group20_ESS_PTCANFD_100ms_FrP20_CONTROLLER_0_IAM_Rx_IBMSCellVoltFlt_IESS_100ms_Group20_ESS_PTCANFD_100ms_FrP20_CONTROLLER_0_IAM_Rx, ComSignalType=UINT8
          IESS_100ms_Group20_Reserved2_IESS_100ms_Group20_ESS_PTCANFD_100ms_FrP20_CONTROLLER_0_IAM_Rx: ComBitPosition=26, ComBitSize=6, ComHandleId=IESS_100ms_Group20_ESS_PTCANFD_100ms_FrP20_CONTROLLER_0_IAM_Rx_IESS_100ms_Group20_Reserved2_IESS_100ms_Group20_ESS_PTCANFD_100ms_FrP20_CONTROLLER_0_IAM_Rx, ComSignalType=UINT8
          IBMSPackTemFlt_IESS_100ms_Group20_ESS_PTCANFD_100ms_FrP20_CONTROLLER_0_IAM_Rx: ComBitPosition=32, ComBitSize=2, ComHandleId=IESS_100ms_Group20_ESS_PTCANFD_100ms_FrP20_CONTROLLER_0_IAM_Rx_IBMSPackTemFlt_IESS_100ms_Group20_ESS_PTCANFD_100ms_FrP20_CONTROLLER_0_IAM_Rx, ComSignalType=UINT8
          IBMSPackVoltFlt_IESS_100ms_Group20_ESS_PTCANFD_100ms_FrP20_CONTROLLER_0_IAM_Rx: ComBitPosition=34, ComBitSize=2, ComHandleId=IESS_100ms_Group20_ESS_PTCANFD_100ms_FrP20_CONTROLLER_0_IAM_Rx_IBMSPackVoltFlt_IESS_100ms_Group20_ESS_PTCANFD_100ms_FrP20_CONTROLLER_0_IAM_Rx, ComSignalType=UINT8
          IBMSPreThrmFltInd_IESS_100ms_Group20_ESS_PTCANFD_100ms_FrP20_CONTROLLER_0_IAM_Rx: ComBitPosition=36, ComBitSize=1, ComHandleId=IESS_100ms_Group20_ESS_PTCANFD_100ms_FrP20_CONTROLLER_0_IAM_Rx_IBMSPreThrmFltInd_IESS_100ms_Group20_ESS_PTCANFD_100ms_FrP20_CONTROLLER_0_IAM_Rx, ComSignalType=BOOLEAN
          IESS_100ms_Group20_Reserved3_IESS_100ms_Group20_ESS_PTCANFD_100ms_FrP20_CONTROLLER_0_IAM_Rx: ComBitPosition=37, ComBitSize=3, ComHandleId=IESS_100ms_Group20_ESS_PTCANFD_100ms_FrP20_CONTROLLER_0_IAM_Rx_IESS_100ms_Group20_Reserved3_IESS_100ms_Group20_ESS_PTCANFD_100ms_FrP20_CONTROLLER_0_IAM_Rx, ComSignalType=UINT8
          IESS_100ms_Group20_Reserved4_IESS_100ms_Group20_ESS_PTCANFD_100ms_FrP20_CONTROLLER_0_IAM_Rx: ComBitPosition=40, ComBitSize=8, ComHandleId=IESS_100ms_Group20_ESS_PTCANFD_100ms_FrP20_CONTROLLER_0_IAM_Rx_IESS_100ms_Group20_Reserved4_IESS_100ms_Group20_ESS_PTCANFD_100ms_FrP20_CONTROLLER_0_IAM_Rx, ComSignalType=UINT8
          IESS_100ms_Group20_Reserved5_IESS_100ms_Group20_ESS_PTCANFD_100ms_FrP20_CONTROLLER_0_IAM_Rx: ComBitPosition=48, ComBitSize=8, ComHandleId=IESS_100ms_Group20_ESS_PTCANFD_100ms_FrP20_CONTROLLER_0_IAM_Rx_IESS_100ms_Group20_Reserved5_IESS_100ms_Group20_ESS_PTCANFD_100ms_FrP20_CONTROLLER_0_IAM_Rx, ComSignalType=UINT8
          IESS_100ms_Group20_Reserved6_IESS_100ms_Group20_ESS_PTCANFD_100ms_FrP20_CONTROLLER_0_IAM_Rx: ComBitPosition=56, ComBitSize=8, ComHandleId=IESS_100ms_Group20_ESS_PTCANFD_100ms_FrP20_CONTROLLER_0_IAM_Rx_IESS_100ms_Group20_Reserved6_IESS_100ms_Group20_ESS_PTCANFD_100ms_FrP20_CONTROLLER_0_IAM_Rx, ComSignalType=UINT8
      RZCU_PTCANFD_100ms_FrP10_CONTROLLER_0_IAM_Rx (ComIPdu):
        ComIPduCancellationSupport = false
        ComIPduDirection = RECEIVE
        ComIPduHandleId = COM_RXPDU_COM_RZCU_PTCANFD_100ms_FrP10_CONTROLLER_0_IAM_Rx
        ComIPduSignalProcessing = DEFERRED
        ComIPduType = NORMAL
        ComIPduCallout = RZCU_PTCANFD_100ms_FrP10_CONTROLLER_0_IAM_Rx
        ComPduIdRef = COM_RZCU_PTCANFD_100ms_FrP10_CONTROLLER_0_IAM_Rx
        ComIPduSignalGroupRef = IRZCU_100ms_Group10_RZCU_PTCANFD_100ms_FrP10_CONTROLLER_0_IAM_Rx
        ComIPduGroupRef = Com_RxPduGroup_CONTROLLER_0_IAM
