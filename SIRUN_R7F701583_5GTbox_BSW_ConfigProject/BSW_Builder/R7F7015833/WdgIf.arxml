AUTOSAR XML (schema 00048)
package /R7F7015833
  module config WdgIf
    WdgIfGeneral: WdgIfDevErrorDetect=true, WdgIfVersionInfoApi=false, WdgIfNumberOfDevices=1, WdgIfIncludeHeader=Wdg_59_DriverA.h
    WdgIfInternalDevice_0 (WdgIfInternalDevice): WdgIfDeviceIndex=0, TriggerConditionFunction=Wdg_59_DriverA_SetTriggerCondition, SetModeFunction=Wdg_59_DriverA_SetMode, WdgIfDriverRef=WdgGeneral
