AUTOSAR XML (schema 00048)
package /R7F7015833
  module config EcuM
    EcuMGeneral: EcuMDevErrorDetect=false, EcuMMainFunctionPeriod=0.01, EcuMVersionInfoApi=false
    EcuMConfiguration
      EcuMCommonConfiguration: EcuMConfigConsistencyHash=123, EcuMOSResource=OsUseResScheduler, EcuMDefaultAppMode=OSDEFAULTAPPMODE
        EcuMDefaultShutdownTarget: EcuMDefaultShutdownTarget=EcuMShutdownTargetOff
        EcuMSleepMode: EcuMSleepModeId=0, EcuMSleepModeSuspend=false, EcuMWakeupSourceMask=EcuMWakeupSource_CAN, EcuMWakeupSourceMask=EcuMWakeupSource_Local
        EcuMWakeupSource_CAN (EcuMWakeupSource): EcuMCheckWakeupTimeout=0.0, EcuMValidationTimeout=3.0, EcuMWakeupSourceId=5, EcuMWakeupSourcePolling=false, EcuMComMChannelRef=ComMChannel_0
        EcuMDriverInitListOne
          CAN (EcuMDriverInitItem):
            EcuMModuleParameter = POSTBUILD_PTR
            EcuMModuleService = Can_Init
            EditModuleService = false
            EcuMModulePbConfigName = Can_GaaConfig
            EditPbConfigName = true
            IncludeHeaderFile = Can.h
            EditHeaderFile = false
            EcuMModuleRef = Can
        EcuMWakeupSource_Local (EcuMWakeupSource): EcuMCheckWakeupTimeout=0.0, EcuMValidationTimeout=3.0, EcuMWakeupSourceId=6, EcuMWakeupSourcePolling=false
        EcuMWakeupSource_Time (EcuMWakeupSource): EcuMCheckWakeupTimeout=0.0, EcuMValidationTimeout=3.0, EcuMWakeupSourceId=7, EcuMWakeupSourcePolling=false
        EcuMDriverInitListZero
          EcuMDriverInitItem_0 (EcuMDriverInitItem):
            EcuMModuleParameter = VOID
            EcuMModuleService = Dem_PreInit
            EditModuleService = false
            EcuMModulePbConfigName = Null
            EditPbConfigName = false
            IncludeHeaderFile = Dem.h
            EditHeaderFile = false
            EcuMModuleRef = Dem
      EcuMFlexConfiguration: EcuMTimerSrcSelect=OS
        EcuMFlexUserConfig: EcuMFlexUser=0
        EcuMResetMode: EcuMResetModeId=0
        4 x EcuMShutdownCause:
          ECUM_CAUSE_UNKNOWN: EcuMShutdownCauseId=0
          ECUM_CAUSE_ECU_STATE: EcuMShutdownCauseId=1
          ECUM_CAUSE_WDGM: EcuMShutdownCauseId=2
          ECUM_CAUSE_DCM: EcuMShutdownCauseId=3
        EcuMDriverInitListBswM_0 (EcuMDriverInitListBswM)
          8 x EcuMDriverInitItem, all with EcuMModuleParameter=POSTBUILD_PTR, EditModuleService=false, EditPbConfigName=false, EditHeaderFile=false:
            CanIf: EcuMModuleService=CanIf_Init, EcuMModulePbConfigName=CanIf_InitCfgSet, IncludeHeaderFile=CanIf.h, EcuMModuleRef=CanIf
            CanSM: EcuMModuleService=CanSM_Init, EcuMModulePbConfigName=CanSM_Config, IncludeHeaderFile=CanSM.h, EcuMModuleRef=CanSM
            PduR: EcuMModuleService=PduR_Init, EcuMModulePbConfigName=PduR_PBConfigData, IncludeHeaderFile=PduR.h, EcuMModuleRef=PduR
            Com: EcuMModuleService=Com_Init, EcuMModulePbConfigName=Com_PBConfigData, IncludeHeaderFile=Com.h, EcuMModuleRef=Com
            ComM: EcuMModuleService=ComM_Init, EcuMModulePbConfigName=ComM_Config, IncludeHeaderFile=ComM.h, EcuMModuleRef=ComM
            NM: EcuMModuleService=Nm_Init, EcuMModulePbConfigName=Nm_Config, IncludeHeaderFile=Nm.h, EcuMModuleRef=Nm
            CanNm: EcuMModuleService=CanNm_Init, EcuMModulePbConfigName=CanNm_Config, IncludeHeaderFile=CanNm.h, EcuMModuleRef=CanNm
            CanTp: EcuMModuleService=CanTp_Init, EcuMModulePbConfigName=CanTp_Config, IncludeHeaderFile=CanTp.h, EcuMModuleRef=CanTp
        EcuMDriverInitListBswM_Diag (EcuMDriverInitListBswM)
          Dcm (EcuMDriverInitItem):
            EcuMModuleParameter = POSTBUILD_PTR
            EcuMModuleService = Dcm_Init
            EditModuleService = false
            EcuMModulePbConfigName = Dcm_Cfg
            EditPbConfigName = false
            IncludeHeaderFile = Dcm.h
            EditHeaderFile = false
            EcuMModuleRef = Dcm
          Dem (EcuMDriverInitItem):
            EcuMModuleParameter = POSTBUILD_PTR
            EcuMModuleService = Dem_Init
            EditModuleService = false
            EcuMModulePbConfigName = DemPbCfg
            EditPbConfigName = false
            IncludeHeaderFile = Dem.h
            EditHeaderFile = false
            EcuMModuleRef = Dem
        EcuMAlarmClock_0 (EcuMAlarmClock): EcuMAlarmClockId=0, EcuMAlarmClockTimeOut=18.0, EcuMAlarmClockUser=EcuMFlexUserConfig
        EcuMGoDownAllowedUsers: EcuMGoDownAllowedUserRef=EcuMFlexUserConfig
        EcuMSetClockAllowedUsers: EcuMSetClockAllowedUserRef=EcuMFlexUserConfig
    EcuMFlexGeneral:
      EcuMAlarmClockPresent = true
      EcuMModeHandling = false
      EcuMResetLoopDetection = false
      EcuMSetProgrammableInterrupts = false
      EcuMAlarmWakeupSource = EcuMWakeupSource_Time
