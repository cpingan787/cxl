AUTOSAR XML (schema 00048)
standard types defined: std_returntype
package /AUTOSAR/BswOverviews
  bsw module description CryIf
    bsw internal behavior IB_Cryif
      exclusive area Area_CryIf
package /AUTOSAR/BswImplementations
  bsw implementation imp_Cryif: programming-language=C, sw-version=1.0.0, vendor-id=62, ar-release-version=4.8.0, behavior=IB_Cryif
