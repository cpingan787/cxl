AUTOSAR XML (schema 4-2-2)
# COPYRIGHT
# (c) 2019-2021 Renesas Electronics Corporation. All rights reserved.
package /Renesas/BswModuleDescriptions_Can
  bsw implementation Can_Impl: programming-language=C, sw-version=1.0.3, vendor-id=59, ar-release-version=4.2.2, behavior=BswInternalBehavior_0, vendor-specific-module-def=Can
    code-descriptors:
      code Can_Code: artifact-descriptors=[{short-label=Can.c, category=SWSRC}, {short-label=Can.h, category=SWHDR}]
    resource consumption ResourceConsumption
      12 x memory section:
        PRIVATE_CODE: sw-addrmethod=CODE
        PUBLIC_CODE: sw-addrmethod=CODE
        CODE_FAST: sw-addrmethod=CODE
        APPL_CODE: sw-addrmethod=CODE
        CONST_8: sw-addrmethod=CONST
        VAR_INIT_BOOLEAN: alignment=BOOLEAN, sw-addrmethod=VAR_INIT
        VAR_NO_INIT_BOOLEAN: alignment=BOOLEAN, sw-addrmethod=VAR_NO_INIT
        VAR_NO_INIT_32: alignment=32, sw-addrmethod=VAR_NO_INIT
        VAR_NO_INIT_UNSPECIFIED: alignment=UNSPECIFIED, sw-addrmethod=VAR_NO_INIT
        CONFIG_DATA_8: alignment=8, sw-addrmethod=CONFIG_DATA
        CONFIG_DATA_UNSPECIFIED: alignment=UNSPECIFIED, sw-addrmethod=CONFIG_DATA
        DBTOC_DATA_UNSPECIFIED: alignment=UNSPECIFIED, sw-addrmethod=CONFIG_DATA
      section name prefix CAN_RSCAN
  bsw module description Can: module-id=80
    provided-entrys:
      Can_RAMTest
      Can_Init
      Can_SetControllerMode
      Can_DisableControllerInterrupts
      Can_EnableControllerInterrupts
      Can_Write
      Can_GetVersionInfo
      Can_CheckWakeup
      Can_ChangeBaudrate
      Can_CheckBaudrate
      Can_SetBaudrate
      Can_CheckHWConsistency
      Can_SelfTestChannel
      Can_MainFunction_Write_{0..7}
      Can_MainFunction_Read_{0..7}
      Can_MainFunction_Write
      Can_MainFunction_Read
      Can_MainFunction_BusOff
      Can_MainFunction_Wakeup
      Can_MainFunction_Mode
      CAN_RSCAN0_RXFIFO_CAT2_ISR
      CAN_RSCAN1_RXFIFO_CAT2_ISR
      CAN_CONTROLLER{0..11}_RX_CAT2_ISR
      CAN_CONTROLLER{0..11}_TX_CAT2_ISR
      CAN_CONTROLLER{0..11}_BUSOFF_CAT2_ISR
      CAN_CONTROLLER{0..11}_WAKEUP_CAT2_ISR
      CAN_RSCAN0_RXFIFO_ISR
      CAN_RSCAN1_RXFIFO_ISR
      CAN_CONTROLLER{0..11}_RX_ISR
      CAN_CONTROLLER{0..11}_TX_ISR
      CAN_CONTROLLER{0..11}_BUSOFF_ISR
      CAN_CONTROLLER{0..11}_WAKEUP_ISR
    bsw internal behavior BswInternalBehavior_0
      exclusive area CAN_INTERRUPT_CONTROL_PROTECTION
      exclusive area CAN_RAM_DATA_PROTECTION
      exclusive area nesting order ExclusiveAreaNestingOrder_0: exclusive-area=CAN_INTERRUPT_CONTROL_PROTECTION
      exclusive area nesting order ExclusiveAreaNestingOrder_1: exclusive-area=CAN_RAM_DATA_PROTECTION
      13 x bsw called entity:
        CalledEntity_0: reentrancy-level=NON-REENTRANT, implemented-entry=Can_RAMTest
        CalledEntity_1: reentrancy-level=NON-REENTRANT, implemented-entry=Can_Init
        CalledEntity_2: can-enter-exclusive-area=[CAN_RAM_DATA_PROTECTION, CAN_INTERRUPT_CONTROL_PROTECTION], exclusive-area-nesting-order=[ExclusiveAreaNestingOrder_1, ExclusiveAreaNestingOrder_0], reentrancy-level=NON-REENTRANT, implemented-entry=Can_SetControllerMode
        CalledEntity_3: can-enter-exclusive-area=CAN_INTERRUPT_CONTROL_PROTECTION, exclusive-area-nesting-order=ExclusiveAreaNestingOrder_0, reentrancy-level=SINGLE-CORE-REENTRANT, implemented-entry=Can_DisableControllerInterrupts
        CalledEntity_4: can-enter-exclusive-area=CAN_INTERRUPT_CONTROL_PROTECTION, exclusive-area-nesting-order=ExclusiveAreaNestingOrder_0, reentrancy-level=SINGLE-CORE-REENTRANT, implemented-entry=Can_EnableControllerInterrupts
        CalledEntity_5: can-enter-exclusive-area=CAN_RAM_DATA_PROTECTION, exclusive-area-nesting-order=ExclusiveAreaNestingOrder_1, reentrancy-level=SINGLE-CORE-REENTRANT, implemented-entry=Can_Write
        CalledEntity_6: reentrancy-level=SINGLE-CORE-REENTRANT, implemented-entry=Can_GetVersionInfo
        CalledEntity_7: reentrancy-level=NON-REENTRANT, implemented-entry=Can_CheckWakeup
        CalledEntity_8: reentrancy-level=NON-REENTRANT, implemented-entry=Can_ChangeBaudrate
        CalledEntity_9: reentrancy-level=SINGLE-CORE-REENTRANT, implemented-entry=Can_CheckBaudrate
        CalledEntity_10: reentrancy-level=SINGLE-CORE-REENTRANT, implemented-entry=Can_SetBaudrate
        CalledEntity_11: reentrancy-level=SINGLE-CORE-REENTRANT, implemented-entry=Can_CheckHWConsistency
        CalledEntity_12: reentrancy-level=NON-REENTRANT, implemented-entry=Can_SelfTestChannel
      21 x bsw schedulable entity, all with reentrancy-level=NON-REENTRANT:
        SchedulableEntity_{0..7}: implemented-entry=Can_MainFunction_Write_{0..7}
        SchedulableEntity_8: implemented-entry=Can_MainFunction_Read_0
        SchedulableEntity_9: implemented-entry=Can_MainFunction_Read_1
        SchedulableEntity_10: implemented-entry=Can_MainFunction_Read_2
        SchedulableEntity_11: implemented-entry=Can_MainFunction_Read_3
        SchedulableEntity_12: implemented-entry=Can_MainFunction_Read_4
        SchedulableEntity_13: implemented-entry=Can_MainFunction_Read_5
        SchedulableEntity_14: implemented-entry=Can_MainFunction_Read_6
        SchedulableEntity_15: implemented-entry=Can_MainFunction_Read_7
        SchedulableEntity_16: implemented-entry=Can_MainFunction_Write
        SchedulableEntity_17: implemented-entry=Can_MainFunction_Read
        SchedulableEntity_18: can-enter-exclusive-area=CAN_RAM_DATA_PROTECTION, exclusive-area-nesting-order=ExclusiveAreaNestingOrder_1, implemented-entry=Can_MainFunction_BusOff
        SchedulableEntity_19: can-enter-exclusive-area=[CAN_INTERRUPT_CONTROL_PROTECTION, CAN_RAM_DATA_PROTECTION], exclusive-area-nesting-order=[ExclusiveAreaNestingOrder_0, ExclusiveAreaNestingOrder_1], implemented-entry=Can_MainFunction_Wakeup
        SchedulableEntity_20: can-enter-exclusive-area=[CAN_RAM_DATA_PROTECTION, CAN_INTERRUPT_CONTROL_PROTECTION], exclusive-area-nesting-order=[ExclusiveAreaNestingOrder_1, ExclusiveAreaNestingOrder_0], implemented-entry=Can_MainFunction_Mode
      100 x bsw interrupt entity:
        InterruptEntity_0: reentrancy-level=NON-REENTRANT, implemented-entry=CAN_RSCAN0_RXFIFO_ISR, interrupt-category=CAT-1, interrupt-source=INTRCANGRECC0
        InterruptEntity_1: reentrancy-level=NON-REENTRANT, implemented-entry=CAN_RSCAN0_RXFIFO_CAT2_ISR, interrupt-category=CAT-2, interrupt-source=INTRCANGRECC0
        InterruptEntity_2: reentrancy-level=SINGLE-CORE-REENTRANT, implemented-entry=CAN_RSCAN1_RXFIFO_ISR, interrupt-category=CAT-1, interrupt-source=INTRCANGRECC1
        InterruptEntity_3: reentrancy-level=SINGLE-CORE-REENTRANT, implemented-entry=CAN_RSCAN1_RXFIFO_CAT2_ISR, interrupt-category=CAT-2, interrupt-source=INTRCANGRECC1
        InterruptEntity_4: reentrancy-level=NON-REENTRANT, implemented-entry=CAN_CONTROLLER0_RX_ISR, interrupt-category=CAT-1, interrupt-source=INTRCAN0REC
        InterruptEntity_5: reentrancy-level=NON-REENTRANT, implemented-entry=CAN_CONTROLLER0_RX_CAT2_ISR, interrupt-category=CAT-2, interrupt-source=INTRCAN0REC
        InterruptEntity_6: reentrancy-level=NON-REENTRANT, implemented-entry=CAN_CONTROLLER1_RX_ISR, interrupt-category=CAT-1, interrupt-source=INTRCAN1REC
        InterruptEntity_7: reentrancy-level=NON-REENTRANT, implemented-entry=CAN_CONTROLLER1_RX_CAT2_ISR, interrupt-category=CAT-2, interrupt-source=INTRCAN1REC
        InterruptEntity_8: reentrancy-level=NON-REENTRANT, implemented-entry=CAN_CONTROLLER2_RX_ISR, interrupt-category=CAT-1, interrupt-source=INTRCAN2REC
        InterruptEntity_9: reentrancy-level=NON-REENTRANT, implemented-entry=CAN_CONTROLLER2_RX_CAT2_ISR, interrupt-category=CAT-2, interrupt-source=INTRCAN2REC
        InterruptEntity_10: reentrancy-level=NON-REENTRANT, implemented-entry=CAN_CONTROLLER3_RX_ISR, interrupt-category=CAT-1, interrupt-source=INTRCAN3REC
        InterruptEntity_11: reentrancy-level=NON-REENTRANT, implemented-entry=CAN_CONTROLLER3_RX_CAT2_ISR, interrupt-category=CAT-2, interrupt-source=INTRCAN3REC
        InterruptEntity_12: reentrancy-level=NON-REENTRANT, implemented-entry=CAN_CONTROLLER4_RX_ISR, interrupt-category=CAT-1, interrupt-source=INTRCAN4REC
        InterruptEntity_13: reentrancy-level=NON-REENTRANT, implemented-entry=CAN_CONTROLLER4_RX_CAT2_ISR, interrupt-category=CAT-2, interrupt-source=INTRCAN4REC
        InterruptEntity_14: reentrancy-level=NON-REENTRANT, implemented-entry=CAN_CONTROLLER5_RX_ISR, interrupt-category=CAT-1, interrupt-source=INTRCAN5REC
        InterruptEntity_15: reentrancy-level=NON-REENTRANT, implemented-entry=CAN_CONTROLLER5_RX_CAT2_ISR, interrupt-category=CAT-2, interrupt-source=INTRCAN5REC
        InterruptEntity_16: reentrancy-level=NON-REENTRANT, implemented-entry=CAN_CONTROLLER6_RX_ISR, interrupt-category=CAT-1, interrupt-source=INTRCAN6REC
        InterruptEntity_17: reentrancy-level=NON-REENTRANT, implemented-entry=CAN_CONTROLLER6_RX_CAT2_ISR, interrupt-category=CAT-2, interrupt-source=INTRCAN6REC
        InterruptEntity_18: reentrancy-level=NON-REENTRANT, implemented-entry=CAN_CONTROLLER7_RX_ISR, interrupt-category=CAT-1, interrupt-source=INTRCAN7REC
        InterruptEntity_19: reentrancy-level=NON-REENTRANT, implemented-entry=CAN_CONTROLLER7_RX_CAT2_ISR, interrupt-category=CAT-2, interrupt-source=INTRCAN7REC
        InterruptEntity_20: reentrancy-level=NON-REENTRANT, implemented-entry=CAN_CONTROLLER8_RX_ISR, interrupt-category=CAT-1, interrupt-source=INTRCAN8REC
        InterruptEntity_21: reentrancy-level=NON-REENTRANT, implemented-entry=CAN_CONTROLLER8_RX_CAT2_ISR, interrupt-category=CAT-2, interrupt-source=INTRCAN8REC
        InterruptEntity_22: reentrancy-level=NON-REENTRANT, implemented-entry=CAN_CONTROLLER9_RX_ISR, interrupt-category=CAT-1, interrupt-source=INTRCAN9REC
        InterruptEntity_23: reentrancy-level=NON-REENTRANT, implemented-entry=CAN_CONTROLLER9_RX_CAT2_ISR, interrupt-category=CAT-2, interrupt-source=INTRCAN9REC
        InterruptEntity_24: reentrancy-level=NON-REENTRANT, implemented-entry=CAN_CONTROLLER10_RX_ISR, interrupt-category=CAT-1, interrupt-source=INTRCAN10REC
        InterruptEntity_25: reentrancy-level=NON-REENTRANT, implemented-entry=CAN_CONTROLLER10_RX_CAT2_ISR, interrupt-category=CAT-2, interrupt-source=INTRCAN10REC
        InterruptEntity_26: reentrancy-level=NON-REENTRANT, implemented-entry=CAN_CONTROLLER11_RX_ISR, interrupt-category=CAT-1, interrupt-source=INTRCAN11REC
        InterruptEntity_27: reentrancy-level=NON-REENTRANT, implemented-entry=CAN_CONTROLLER11_RX_CAT2_ISR, interrupt-category=CAT-2, interrupt-source=INTRCAN11REC
        InterruptEntity_28: reentrancy-level=NON-REENTRANT, implemented-entry=CAN_CONTROLLER0_TX_ISR, interrupt-category=CAT-1, interrupt-source=INTRCAN0TRX
        InterruptEntity_29: reentrancy-level=NON-REENTRANT, implemented-entry=CAN_CONTROLLER0_TX_CAT2_ISR, interrupt-category=CAT-2, interrupt-source=INTRCAN0TRX
        InterruptEntity_30: reentrancy-level=NON-REENTRANT, implemented-entry=CAN_CONTROLLER1_TX_ISR, interrupt-category=CAT-1, interrupt-source=INTRCAN1TRX
        InterruptEntity_31: reentrancy-level=NON-REENTRANT, implemented-entry=CAN_CONTROLLER1_TX_CAT2_ISR, interrupt-category=CAT-2, interrupt-source=INTRCAN1TRX
        InterruptEntity_32: reentrancy-level=NON-REENTRANT, implemented-entry=CAN_CONTROLLER2_TX_ISR, interrupt-category=CAT-1, interrupt-source=INTRCAN2TRX
        InterruptEntity_33: reentrancy-level=NON-REENTRANT, implemented-entry=CAN_CONTROLLER2_TX_CAT2_ISR, interrupt-category=CAT-2, interrupt-source=INTRCAN2TRX
        InterruptEntity_34: reentrancy-level=NON-REENTRANT, implemented-entry=CAN_CONTROLLER3_TX_ISR, interrupt-category=CAT-1, interrupt-source=INTRCAN3TRX
        InterruptEntity_35: reentrancy-level=NON-REENTRANT, implemented-entry=CAN_CONTROLLER3_TX_CAT2_ISR, interrupt-category=CAT-2, interrupt-source=INTRCAN3TRX
        InterruptEntity_36: reentrancy-level=NON-REENTRANT, implemented-entry=CAN_CONTROLLER4_TX_ISR, interrupt-category=CAT-1, interrupt-source=INTRCAN4TRX
        InterruptEntity_37: reentrancy-level=NON-REENTRANT, implemented-entry=CAN_CONTROLLER4_TX_CAT2_ISR, interrupt-category=CAT-2, interrupt-source=INTRCAN4TRX
        InterruptEntity_38: reentrancy-level=NON-REENTRANT, implemented-entry=CAN_CONTROLLER5_TX_ISR, interrupt-category=CAT-1, interrupt-source=INTRCAN5TRX
        InterruptEntity_39: reentrancy-level=NON-REENTRANT, implemented-entry=CAN_CONTROLLER5_TX_CAT2_ISR, interrupt-category=CAT-2, interrupt-source=INTRCAN5TRX
        InterruptEntity_40: reentrancy-level=NON-REENTRANT, implemented-entry=CAN_CONTROLLER6_TX_ISR, interrupt-category=CAT-1, interrupt-source=INTRCAN6TRX
        InterruptEntity_41: reentrancy-level=NON-REENTRANT, implemented-entry=CAN_CONTROLLER6_TX_CAT2_ISR, interrupt-category=CAT-2, interrupt-source=INTRCAN6TRX
        InterruptEntity_42: reentrancy-level=NON-REENTRANT, implemented-entry=CAN_CONTROLLER7_TX_ISR, interrupt-category=CAT-1, interrupt-source=INTRCAN7TRX
        InterruptEntity_43: reentrancy-level=NON-REENTRANT, implemented-entry=CAN_CONTROLLER7_TX_CAT2_ISR, interrupt-category=CAT-2, interrupt-source=INTRCAN7TRX
        InterruptEntity_44: reentrancy-level=NON-REENTRANT, implemented-entry=CAN_CONTROLLER8_TX_ISR, interrupt-category=CAT-1, interrupt-source=INTRCAN8TRX
        InterruptEntity_45: reentrancy-level=NON-REENTRANT, implemented-entry=CAN_CONTROLLER8_TX_CAT2_ISR, interrupt-category=CAT-2, interrupt-source=INTRCAN8TRX
        InterruptEntity_46: reentrancy-level=NON-REENTRANT, implemented-entry=CAN_CONTROLLER9_TX_ISR, interrupt-category=CAT-1, interrupt-source=INTRCAN9TRX
        InterruptEntity_47: reentrancy-level=NON-REENTRANT, implemented-entry=CAN_CONTROLLER9_TX_CAT2_ISR, interrupt-category=CAT-2, interrupt-source=INTRCAN9TRX
        InterruptEntity_48: reentrancy-level=NON-REENTRANT, implemented-entry=CAN_CONTROLLER10_TX_ISR, interrupt-category=CAT-1, interrupt-source=INTRCAN10TRX
        InterruptEntity_49: reentrancy-level=NON-REENTRANT, implemented-entry=CAN_CONTROLLER10_TX_CAT2_ISR, interrupt-category=CAT-2, interrupt-source=INTRCAN10TRX
        InterruptEntity_50: reentrancy-level=NON-REENTRANT, implemented-entry=CAN_CONTROLLER11_TX_ISR, interrupt-category=CAT-1, interrupt-source=INTRCAN11TRX
        InterruptEntity_51: reentrancy-level=NON-REENTRANT, implemented-entry=CAN_CONTROLLER11_TX_CAT2_ISR, interrupt-category=CAT-2, interrupt-source=INTRCAN11TRX
        InterruptEntity_52: can-enter-exclusive-area=CAN_RAM_DATA_PROTECTION, exclusive-area-nesting-order=ExclusiveAreaNestingOrder_1, reentrancy-level=NON-REENTRANT, implemented-entry=CAN_CONTROLLER0_BUSOFF_ISR, interrupt-category=CAT-1, interrupt-source=INTRCAN0ERR
        InterruptEntity_53: can-enter-exclusive-area=CAN_RAM_DATA_PROTECTION, exclusive-area-nesting-order=ExclusiveAreaNestingOrder_1, reentrancy-level=NON-REENTRANT, implemented-entry=CAN_CONTROLLER0_BUSOFF_CAT2_ISR, interrupt-category=CAT-2, interrupt-source=INTRCAN0ERR
        InterruptEntity_54: can-enter-exclusive-area=CAN_RAM_DATA_PROTECTION, exclusive-area-nesting-order=ExclusiveAreaNestingOrder_1, reentrancy-level=NON-REENTRANT, implemented-entry=CAN_CONTROLLER1_BUSOFF_ISR, interrupt-category=CAT-1, interrupt-source=INTRCAN1ERR
        InterruptEntity_55: can-enter-exclusive-area=CAN_RAM_DATA_PROTECTION, exclusive-area-nesting-order=ExclusiveAreaNestingOrder_1, reentrancy-level=NON-REENTRANT, implemented-entry=CAN_CONTROLLER1_BUSOFF_CAT2_ISR, interrupt-category=CAT-2, interrupt-source=INTRCAN1ERR
        InterruptEntity_56: can-enter-exclusive-area=CAN_RAM_DATA_PROTECTION, exclusive-area-nesting-order=ExclusiveAreaNestingOrder_1, reentrancy-level=NON-REENTRANT, implemented-entry=CAN_CONTROLLER2_BUSOFF_ISR, interrupt-category=CAT-1, interrupt-source=INTRCAN2ERR
        InterruptEntity_57: can-enter-exclusive-area=CAN_RAM_DATA_PROTECTION, exclusive-area-nesting-order=ExclusiveAreaNestingOrder_1, reentrancy-level=NON-REENTRANT, implemented-entry=CAN_CONTROLLER2_BUSOFF_CAT2_ISR, interrupt-category=CAT-2, interrupt-source=INTRCAN2ERR
        InterruptEntity_58: can-enter-exclusive-area=CAN_RAM_DATA_PROTECTION, exclusive-area-nesting-order=ExclusiveAreaNestingOrder_1, reentrancy-level=NON-REENTRANT, implemented-entry=CAN_CONTROLLER3_BUSOFF_ISR, interrupt-category=CAT-1, interrupt-source=INTRCAN3ERR
        InterruptEntity_59: can-enter-exclusive-area=CAN_RAM_DATA_PROTECTION, exclusive-area-nesting-order=ExclusiveAreaNestingOrder_1, reentrancy-level=NON-REENTRANT, implemented-entry=CAN_CONTROLLER3_BUSOFF_CAT2_ISR, interrupt-category=CAT-2, interrupt-source=INTRCAN3ERR
        InterruptEntity_60: can-enter-exclusive-area=CAN_RAM_DATA_PROTECTION, exclusive-area-nesting-order=ExclusiveAreaNestingOrder_1, reentrancy-level=NON-REENTRANT, implemented-entry=CAN_CONTROLLER4_BUSOFF_ISR, interrupt-category=CAT-1, interrupt-source=INTRCAN4ERR
        InterruptEntity_61: can-enter-exclusive-area=CAN_RAM_DATA_PROTECTION, exclusive-area-nesting-order=ExclusiveAreaNestingOrder_1, reentrancy-level=NON-REENTRANT, implemented-entry=CAN_CONTROLLER4_BUSOFF_CAT2_ISR, interrupt-category=CAT-2, interrupt-source=INTRCAN4ERR
        InterruptEntity_62: can-enter-exclusive-area=CAN_RAM_DATA_PROTECTION, exclusive-area-nesting-order=ExclusiveAreaNestingOrder_1, reentrancy-level=NON-REENTRANT, implemented-entry=CAN_CONTROLLER5_BUSOFF_ISR, interrupt-category=CAT-1, interrupt-source=INTRCAN5ERR
        InterruptEntity_63: can-enter-exclusive-area=CAN_RAM_DATA_PROTECTION, exclusive-area-nesting-order=ExclusiveAreaNestingOrder_1, reentrancy-level=NON-REENTRANT, implemented-entry=CAN_CONTROLLER5_BUSOFF_CAT2_ISR, interrupt-category=CAT-2, interrupt-source=INTRCAN5ERR
        InterruptEntity_64: can-enter-exclusive-area=CAN_RAM_DATA_PROTECTION, exclusive-area-nesting-order=ExclusiveAreaNestingOrder_1, reentrancy-level=NON-REENTRANT, implemented-entry=CAN_CONTROLLER6_BUSOFF_ISR, interrupt-category=CAT-1, interrupt-source=INTRCAN6ERR
        InterruptEntity_65: can-enter-exclusive-area=CAN_RAM_DATA_PROTECTION, exclusive-area-nesting-order=ExclusiveAreaNestingOrder_1, reentrancy-level=NON-REENTRANT, implemented-entry=CAN_CONTROLLER6_BUSOFF_CAT2_ISR, interrupt-category=CAT-2, interrupt-source=INTRCAN6ERR
        InterruptEntity_66: can-enter-exclusive-area=CAN_RAM_DATA_PROTECTION, exclusive-area-nesting-order=ExclusiveAreaNestingOrder_1, reentrancy-level=NON-REENTRANT, implemented-entry=CAN_CONTROLLER7_BUSOFF_ISR, interrupt-category=CAT-1, interrupt-source=INTRCAN7ERR
        InterruptEntity_67: can-enter-exclusive-area=CAN_RAM_DATA_PROTECTION, exclusive-area-nesting-order=ExclusiveAreaNestingOrder_1, reentrancy-level=NON-REENTRANT, implemented-entry=CAN_CONTROLLER7_BUSOFF_CAT2_ISR, interrupt-category=CAT-2, interrupt-source=INTRCAN7ERR
        InterruptEntity_68: can-enter-exclusive-area=CAN_RAM_DATA_PROTECTION, exclusive-area-nesting-order=ExclusiveAreaNestingOrder_1, reentrancy-level=NON-REENTRANT, implemented-entry=CAN_CONTROLLER8_BUSOFF_ISR, interrupt-category=CAT-1, interrupt-source=INTRCAN8ERR
        InterruptEntity_69: can-enter-exclusive-area=CAN_RAM_DATA_PROTECTION, exclusive-area-nesting-order=ExclusiveAreaNestingOrder_1, reentrancy-level=NON-REENTRANT, implemented-entry=CAN_CONTROLLER8_BUSOFF_CAT2_ISR, interrupt-category=CAT-2, interrupt-source=INTRCAN8ERR
        InterruptEntity_70: can-enter-exclusive-area=CAN_RAM_DATA_PROTECTION, exclusive-area-nesting-order=ExclusiveAreaNestingOrder_1, reentrancy-level=NON-REENTRANT, implemented-entry=CAN_CONTROLLER9_BUSOFF_ISR, interrupt-category=CAT-1, interrupt-source=INTRCAN9ERR
        InterruptEntity_71: can-enter-exclusive-area=CAN_RAM_DATA_PROTECTION, exclusive-area-nesting-order=ExclusiveAreaNestingOrder_1, reentrancy-level=NON-REENTRANT, implemented-entry=CAN_CONTROLLER9_BUSOFF_CAT2_ISR, interrupt-category=CAT-2, interrupt-source=INTRCAN9ERR
        InterruptEntity_72: can-enter-exclusive-area=CAN_RAM_DATA_PROTECTION, exclusive-area-nesting-order=ExclusiveAreaNestingOrder_1, reentrancy-level=NON-REENTRANT, implemented-entry=CAN_CONTROLLER10_BUSOFF_ISR, interrupt-category=CAT-1, interrupt-source=INTRCAN10ERR
        InterruptEntity_73: can-enter-exclusive-area=CAN_RAM_DATA_PROTECTION, exclusive-area-nesting-order=ExclusiveAreaNestingOrder_1, reentrancy-level=NON-REENTRANT, implemented-entry=CAN_CONTROLLER10_BUSOFF_CAT2_ISR, interrupt-category=CAT-2, interrupt-source=INTRCAN10ERR
        InterruptEntity_74: can-enter-exclusive-area=CAN_RAM_DATA_PROTECTION, exclusive-area-nesting-order=ExclusiveAreaNestingOrder_1, reentrancy-level=NON-REENTRANT, implemented-entry=CAN_CONTROLLER11_BUSOFF_ISR, interrupt-category=CAT-1, interrupt-source=INTRCAN11ERR
        InterruptEntity_75: can-enter-exclusive-area=CAN_RAM_DATA_PROTECTION, exclusive-area-nesting-order=ExclusiveAreaNestingOrder_1, reentrancy-level=NON-REENTRANT, implemented-entry=CAN_CONTROLLER11_BUSOFF_CAT2_ISR, interrupt-category=CAT-2, interrupt-source=INTRCAN11ERR
        InterruptEntity_76: can-enter-exclusive-area=[CAN_INTERRUPT_CONTROL_PROTECTION, CAN_RAM_DATA_PROTECTION], exclusive-area-nesting-order=[ExclusiveAreaNestingOrder_0, ExclusiveAreaNestingOrder_1], reentrancy-level=NON-REENTRANT, implemented-entry=CAN_CONTROLLER0_WAKEUP_ISR, interrupt-category=CAT-1, interrupt-source=INTP0
        InterruptEntity_77: can-enter-exclusive-area=[CAN_INTERRUPT_CONTROL_PROTECTION, CAN_RAM_DATA_PROTECTION], exclusive-area-nesting-order=[ExclusiveAreaNestingOrder_0, ExclusiveAreaNestingOrder_1], reentrancy-level=NON-REENTRANT, implemented-entry=CAN_CONTROLLER0_WAKEUP_CAT2_ISR, interrupt-category=CAT-2, interrupt-source=INTP0
        InterruptEntity_78: can-enter-exclusive-area=[CAN_INTERRUPT_CONTROL_PROTECTION, CAN_RAM_DATA_PROTECTION], exclusive-area-nesting-order=[ExclusiveAreaNestingOrder_0, ExclusiveAreaNestingOrder_1], reentrancy-level=NON-REENTRANT, implemented-entry=CAN_CONTROLLER1_WAKEUP_ISR, interrupt-category=CAT-1, interrupt-source=INTP1
        InterruptEntity_79: can-enter-exclusive-area=[CAN_INTERRUPT_CONTROL_PROTECTION, CAN_RAM_DATA_PROTECTION], exclusive-area-nesting-order=[ExclusiveAreaNestingOrder_0, ExclusiveAreaNestingOrder_1], reentrancy-level=NON-REENTRANT, implemented-entry=CAN_CONTROLLER1_WAKEUP_CAT2_ISR, interrupt-category=CAT-2, interrupt-source=INTP1
        InterruptEntity_80: can-enter-exclusive-area=[CAN_INTERRUPT_CONTROL_PROTECTION, CAN_RAM_DATA_PROTECTION], exclusive-area-nesting-order=[ExclusiveAreaNestingOrder_0, ExclusiveAreaNestingOrder_1], reentrancy-level=NON-REENTRANT, implemented-entry=CAN_CONTROLLER2_WAKEUP_ISR, interrupt-category=CAT-1, interrupt-source=INTP2
        InterruptEntity_81: can-enter-exclusive-area=[CAN_INTERRUPT_CONTROL_PROTECTION, CAN_RAM_DATA_PROTECTION], exclusive-area-nesting-order=[ExclusiveAreaNestingOrder_0, ExclusiveAreaNestingOrder_1], reentrancy-level=NON-REENTRANT, implemented-entry=CAN_CONTROLLER2_WAKEUP_CAT2_ISR, interrupt-category=CAT-2, interrupt-source=INTP2
        InterruptEntity_82: can-enter-exclusive-area=[CAN_INTERRUPT_CONTROL_PROTECTION, CAN_RAM_DATA_PROTECTION], exclusive-area-nesting-order=[ExclusiveAreaNestingOrder_0, ExclusiveAreaNestingOrder_1], reentrancy-level=NON-REENTRANT, implemented-entry=CAN_CONTROLLER3_WAKEUP_ISR, interrupt-category=CAT-1, interrupt-source=INTP3
        InterruptEntity_83: can-enter-exclusive-area=[CAN_INTERRUPT_CONTROL_PROTECTION, CAN_RAM_DATA_PROTECTION], exclusive-area-nesting-order=[ExclusiveAreaNestingOrder_0, ExclusiveAreaNestingOrder_1], reentrancy-level=NON-REENTRANT, implemented-entry=CAN_CONTROLLER3_WAKEUP_CAT2_ISR, interrupt-category=CAT-2, interrupt-source=INTP3
        InterruptEntity_84: can-enter-exclusive-area=[CAN_INTERRUPT_CONTROL_PROTECTION, CAN_RAM_DATA_PROTECTION], exclusive-area-nesting-order=[ExclusiveAreaNestingOrder_0, ExclusiveAreaNestingOrder_1], reentrancy-level=NON-REENTRANT, implemented-entry=CAN_CONTROLLER4_WAKEUP_ISR, interrupt-category=CAT-1, interrupt-source=INTP4
        InterruptEntity_85: can-enter-exclusive-area=[CAN_INTERRUPT_CONTROL_PROTECTION, CAN_RAM_DATA_PROTECTION], exclusive-area-nesting-order=[ExclusiveAreaNestingOrder_0, ExclusiveAreaNestingOrder_1], reentrancy-level=NON-REENTRANT, implemented-entry=CAN_CONTROLLER4_WAKEUP_CAT2_ISR, interrupt-category=CAT-2, interrupt-source=INTP4
        InterruptEntity_86: can-enter-exclusive-area=[CAN_INTERRUPT_CONTROL_PROTECTION, CAN_RAM_DATA_PROTECTION], exclusive-area-nesting-order=[ExclusiveAreaNestingOrder_0, ExclusiveAreaNestingOrder_1], reentrancy-level=NON-REENTRANT, implemented-entry=CAN_CONTROLLER5_WAKEUP_ISR, interrupt-category=CAT-1, interrupt-source=INTP5
        InterruptEntity_87: can-enter-exclusive-area=[CAN_INTERRUPT_CONTROL_PROTECTION, CAN_RAM_DATA_PROTECTION], exclusive-area-nesting-order=[ExclusiveAreaNestingOrder_0, ExclusiveAreaNestingOrder_1], reentrancy-level=NON-REENTRANT, implemented-entry=CAN_CONTROLLER5_WAKEUP_CAT2_ISR, interrupt-category=CAT-2, interrupt-source=INTP5
        InterruptEntity_88: can-enter-exclusive-area=[CAN_INTERRUPT_CONTROL_PROTECTION, CAN_RAM_DATA_PROTECTION], exclusive-area-nesting-order=[ExclusiveAreaNestingOrder_0, ExclusiveAreaNestingOrder_1], reentrancy-level=NON-REENTRANT, implemented-entry=CAN_CONTROLLER6_WAKEUP_ISR, interrupt-category=CAT-1, interrupt-source=INTP6
        InterruptEntity_89: can-enter-exclusive-area=[CAN_INTERRUPT_CONTROL_PROTECTION, CAN_RAM_DATA_PROTECTION], exclusive-area-nesting-order=[ExclusiveAreaNestingOrder_0, ExclusiveAreaNestingOrder_1], reentrancy-level=NON-REENTRANT, implemented-entry=CAN_CONTROLLER6_WAKEUP_CAT2_ISR, interrupt-category=CAT-2, interrupt-source=INTP6
        InterruptEntity_90: can-enter-exclusive-area=[CAN_INTERRUPT_CONTROL_PROTECTION, CAN_RAM_DATA_PROTECTION], exclusive-area-nesting-order=[ExclusiveAreaNestingOrder_0, ExclusiveAreaNestingOrder_1], reentrancy-level=NON-REENTRANT, implemented-entry=CAN_CONTROLLER7_WAKEUP_ISR, interrupt-category=CAT-1, interrupt-source=INTP9
        InterruptEntity_91: can-enter-exclusive-area=[CAN_INTERRUPT_CONTROL_PROTECTION, CAN_RAM_DATA_PROTECTION], exclusive-area-nesting-order=[ExclusiveAreaNestingOrder_0, ExclusiveAreaNestingOrder_1], reentrancy-level=NON-REENTRANT, implemented-entry=CAN_CONTROLLER7_WAKEUP_CAT2_ISR, interrupt-category=CAT-2, interrupt-source=INTP9
        InterruptEntity_92: can-enter-exclusive-area=[CAN_INTERRUPT_CONTROL_PROTECTION, CAN_RAM_DATA_PROTECTION], exclusive-area-nesting-order=[ExclusiveAreaNestingOrder_0, ExclusiveAreaNestingOrder_1], reentrancy-level=NON-REENTRANT, implemented-entry=CAN_CONTROLLER8_WAKEUP_ISR, interrupt-category=CAT-1, interrupt-source=INTP18
        InterruptEntity_93: can-enter-exclusive-area=[CAN_INTERRUPT_CONTROL_PROTECTION, CAN_RAM_DATA_PROTECTION], exclusive-area-nesting-order=[ExclusiveAreaNestingOrder_0, ExclusiveAreaNestingOrder_1], reentrancy-level=NON-REENTRANT, implemented-entry=CAN_CONTROLLER8_WAKEUP_CAT2_ISR, interrupt-category=CAT-2, interrupt-source=INTP18
        InterruptEntity_94: can-enter-exclusive-area=[CAN_INTERRUPT_CONTROL_PROTECTION, CAN_RAM_DATA_PROTECTION], exclusive-area-nesting-order=[ExclusiveAreaNestingOrder_0, ExclusiveAreaNestingOrder_1], reentrancy-level=NON-REENTRANT, implemented-entry=CAN_CONTROLLER9_WAKEUP_ISR, interrupt-category=CAT-1, interrupt-source=INTP19
        InterruptEntity_95: can-enter-exclusive-area=[CAN_INTERRUPT_CONTROL_PROTECTION, CAN_RAM_DATA_PROTECTION], exclusive-area-nesting-order=[ExclusiveAreaNestingOrder_0, ExclusiveAreaNestingOrder_1], reentrancy-level=NON-REENTRANT, implemented-entry=CAN_CONTROLLER9_WAKEUP_CAT2_ISR, interrupt-category=CAT-2, interrupt-source=INTP19
        InterruptEntity_96: can-enter-exclusive-area=[CAN_INTERRUPT_CONTROL_PROTECTION, CAN_RAM_DATA_PROTECTION], exclusive-area-nesting-order=[ExclusiveAreaNestingOrder_0, ExclusiveAreaNestingOrder_1], reentrancy-level=NON-REENTRANT, implemented-entry=CAN_CONTROLLER10_WAKEUP_ISR, interrupt-category=CAT-1, interrupt-source=INTP20
        InterruptEntity_97: can-enter-exclusive-area=[CAN_INTERRUPT_CONTROL_PROTECTION, CAN_RAM_DATA_PROTECTION], exclusive-area-nesting-order=[ExclusiveAreaNestingOrder_0, ExclusiveAreaNestingOrder_1], reentrancy-level=NON-REENTRANT, implemented-entry=CAN_CONTROLLER10_WAKEUP_CAT2_ISR, interrupt-category=CAT-2, interrupt-source=INTP20
        InterruptEntity_98: can-enter-exclusive-area=[CAN_INTERRUPT_CONTROL_PROTECTION, CAN_RAM_DATA_PROTECTION], exclusive-area-nesting-order=[ExclusiveAreaNestingOrder_0, ExclusiveAreaNestingOrder_1], reentrancy-level=NON-REENTRANT, implemented-entry=CAN_CONTROLLER11_WAKEUP_ISR, interrupt-category=CAT-1, interrupt-source=INTP21
        InterruptEntity_99: can-enter-exclusive-area=[CAN_INTERRUPT_CONTROL_PROTECTION, CAN_RAM_DATA_PROTECTION], exclusive-area-nesting-order=[ExclusiveAreaNestingOrder_0, ExclusiveAreaNestingOrder_1], reentrancy-level=NON-REENTRANT, implemented-entry=CAN_CONTROLLER11_WAKEUP_CAT2_ISR, interrupt-category=CAT-2, interrupt-source=INTP21
      21 x bsw timing event, all with period=0:
        Evt_Can_MainFunction_Write_{0..7}: starts-on-event=SchedulableEntity_{0..7}
        Evt_Can_MainFunction_Read_0: starts-on-event=SchedulableEntity_8
        Evt_Can_MainFunction_Read_1: starts-on-event=SchedulableEntity_9
        Evt_Can_MainFunction_Read_2: starts-on-event=SchedulableEntity_10
        Evt_Can_MainFunction_Read_3: starts-on-event=SchedulableEntity_11
        Evt_Can_MainFunction_Read_4: starts-on-event=SchedulableEntity_12
        Evt_Can_MainFunction_Read_5: starts-on-event=SchedulableEntity_13
        Evt_Can_MainFunction_Read_6: starts-on-event=SchedulableEntity_14
        Evt_Can_MainFunction_Read_7: starts-on-event=SchedulableEntity_15
        Evt_Can_MainFunction_Write: starts-on-event=SchedulableEntity_16
        Evt_Can_MainFunction_Read: starts-on-event=SchedulableEntity_17
        Evt_Can_MainFunction_BusOff: starts-on-event=SchedulableEntity_18
        Evt_Can_MainFunction_Wakeup: starts-on-event=SchedulableEntity_19
        Evt_Can_MainFunction_Mode: starts-on-event=SchedulableEntity_20
  134 x bsw module entry, all with sw-service-impl-policy=STANDARD:
    Can_RAMTest: service-id=20, is-reentrant=false, is-synchronous=true, call-type=REGULAR, execution-context=TASK
    Can_Init: service-id=0, is-reentrant=false, is-synchronous=true, call-type=REGULAR, execution-context=TASK
    Can_SetControllerMode: service-id=3, is-reentrant=false, is-synchronous=false, call-type=REGULAR, execution-context=TASK
    Can_DisableControllerInterrupts: service-id=4, is-reentrant=true, is-synchronous=true, call-type=REGULAR, execution-context=TASK
    Can_EnableControllerInterrupts: service-id=5, is-reentrant=true, is-synchronous=true, call-type=REGULAR, execution-context=TASK
    Can_Write: service-id=6, is-reentrant=true, is-synchronous=true, call-type=REGULAR, execution-context=TASK
    Can_GetVersionInfo: service-id=7, is-reentrant=true, is-synchronous=true, call-type=REGULAR, execution-context=TASK
    Can_CheckWakeup: service-id=11, is-reentrant=false, is-synchronous=true, call-type=REGULAR, execution-context=TASK
    Can_ChangeBaudrate: service-id=13, is-reentrant=false, is-synchronous=true, call-type=REGULAR, execution-context=TASK
    Can_CheckBaudrate: service-id=14, is-reentrant=true, is-synchronous=true, call-type=REGULAR, execution-context=TASK
    Can_SetBaudrate: service-id=15, is-reentrant=true, is-synchronous=true, call-type=REGULAR, execution-context=TASK
    Can_CheckHWConsistency: service-id=17, is-reentrant=true, is-synchronous=true, call-type=REGULAR, execution-context=TASK
    Can_SelfTestChannel: service-id=21, is-reentrant=false, is-synchronous=true, call-type=REGULAR, execution-context=TASK
    Can_MainFunction_Write_{0..7}: is-reentrant=false, is-synchronous=true, call-type=SCHEDULED, execution-context=TASK
    Can_MainFunction_Read_{0..7}: is-reentrant=false, is-synchronous=true, call-type=SCHEDULED, execution-context=TASK
    Can_MainFunction_Write: service-id=1, is-reentrant=false, is-synchronous=true, call-type=SCHEDULED, execution-context=TASK
    Can_MainFunction_Read: service-id=8, is-reentrant=false, is-synchronous=true, call-type=SCHEDULED, execution-context=TASK
    Can_MainFunction_BusOff: service-id=9, is-reentrant=false, is-synchronous=true, call-type=SCHEDULED, execution-context=TASK
    Can_MainFunction_Wakeup: service-id=10, is-reentrant=false, is-synchronous=true, call-type=SCHEDULED, execution-context=TASK
    Can_MainFunction_Mode: service-id=12, is-reentrant=false, is-synchronous=true, call-type=SCHEDULED, execution-context=TASK
    CAN_RSCAN0_RXFIFO_ISR: is-reentrant=false, is-synchronous=true, call-type=INTERRUPT, execution-context=INTERRUPT-CAT-1
    CAN_RSCAN0_RXFIFO_CAT2_ISR: is-reentrant=false, is-synchronous=true, call-type=INTERRUPT, execution-context=INTERRUPT-CAT-2
    CAN_RSCAN1_RXFIFO_ISR: is-reentrant=false, is-synchronous=true, call-type=INTERRUPT, execution-context=INTERRUPT-CAT-1
    CAN_RSCAN1_RXFIFO_CAT2_ISR: is-reentrant=false, is-synchronous=true, call-type=INTERRUPT, execution-context=INTERRUPT-CAT-2
    CAN_CONTROLLER0_RX_ISR: is-reentrant=false, is-synchronous=true, call-type=INTERRUPT, execution-context=INTERRUPT-CAT-1
    CAN_CONTROLLER0_RX_CAT2_ISR: is-reentrant=false, is-synchronous=true, call-type=INTERRUPT, execution-context=INTERRUPT-CAT-2
    CAN_CONTROLLER1_RX_ISR: is-reentrant=false, is-synchronous=true, call-type=INTERRUPT, execution-context=INTERRUPT-CAT-1
    CAN_CONTROLLER1_RX_CAT2_ISR: is-reentrant=false, is-synchronous=true, call-type=INTERRUPT, execution-context=INTERRUPT-CAT-2
    CAN_CONTROLLER2_RX_ISR: is-reentrant=false, is-synchronous=true, call-type=INTERRUPT, execution-context=INTERRUPT-CAT-1
    CAN_CONTROLLER2_RX_CAT2_ISR: is-reentrant=false, is-synchronous=true, call-type=INTERRUPT, execution-context=INTERRUPT-CAT-2
    CAN_CONTROLLER3_RX_ISR: is-reentrant=false, is-synchronous=true, call-type=INTERRUPT, execution-context=INTERRUPT-CAT-1
    CAN_CONTROLLER3_RX_CAT2_ISR: is-reentrant=false, is-synchronous=true, call-type=INTERRUPT, execution-context=INTERRUPT-CAT-2
    CAN_CONTROLLER4_RX_ISR: is-reentrant=false, is-synchronous=true, call-type=INTERRUPT, execution-context=INTERRUPT-CAT-1
    CAN_CONTROLLER4_RX_CAT2_ISR: is-reentrant=false, is-synchronous=true, call-type=INTERRUPT, execution-context=INTERRUPT-CAT-2
    CAN_CONTROLLER5_RX_ISR: is-reentrant=false, is-synchronous=true, call-type=INTERRUPT, execution-context=INTERRUPT-CAT-1
    CAN_CONTROLLER5_RX_CAT2_ISR: is-reentrant=false, is-synchronous=true, call-type=INTERRUPT, execution-context=INTERRUPT-CAT-2
    CAN_CONTROLLER6_RX_ISR: is-reentrant=false, is-synchronous=true, call-type=INTERRUPT, execution-context=INTERRUPT-CAT-1
    CAN_CONTROLLER6_RX_CAT2_ISR: is-reentrant=false, is-synchronous=true, call-type=INTERRUPT, execution-context=INTERRUPT-CAT-2
    CAN_CONTROLLER7_RX_ISR: is-reentrant=false, is-synchronous=true, call-type=INTERRUPT, execution-context=INTERRUPT-CAT-1
    CAN_CONTROLLER7_RX_CAT2_ISR: is-reentrant=false, is-synchronous=true, call-type=INTERRUPT, execution-context=INTERRUPT-CAT-2
    CAN_CONTROLLER8_RX_ISR: is-reentrant=false, is-synchronous=true, call-type=INTERRUPT, execution-context=INTERRUPT-CAT-1
    CAN_CONTROLLER8_RX_CAT2_ISR: is-reentrant=false, is-synchronous=true, call-type=INTERRUPT, execution-context=INTERRUPT-CAT-2
    CAN_CONTROLLER9_RX_ISR: is-reentrant=false, is-synchronous=true, call-type=INTERRUPT, execution-context=INTERRUPT-CAT-1
    CAN_CONTROLLER9_RX_CAT2_ISR: is-reentrant=false, is-synchronous=true, call-type=INTERRUPT, execution-context=INTERRUPT-CAT-2
    CAN_CONTROLLER10_RX_ISR: is-reentrant=false, is-synchronous=true, call-type=INTERRUPT, execution-context=INTERRUPT-CAT-1
    CAN_CONTROLLER10_RX_CAT2_ISR: is-reentrant=false, is-synchronous=true, call-type=INTERRUPT, execution-context=INTERRUPT-CAT-2
    CAN_CONTROLLER11_RX_ISR: is-reentrant=false, is-synchronous=true, call-type=INTERRUPT, execution-context=INTERRUPT-CAT-1
    CAN_CONTROLLER11_RX_CAT2_ISR: is-reentrant=false, is-synchronous=true, call-type=INTERRUPT, execution-context=INTERRUPT-CAT-2
    CAN_CONTROLLER0_TX_ISR: is-reentrant=false, is-synchronous=true, call-type=INTERRUPT, execution-context=INTERRUPT-CAT-1
    CAN_CONTROLLER0_TX_CAT2_ISR: is-reentrant=false, is-synchronous=true, call-type=INTERRUPT, execution-context=INTERRUPT-CAT-2
    CAN_CONTROLLER1_TX_ISR: is-reentrant=false, is-synchronous=true, call-type=INTERRUPT, execution-context=INTERRUPT-CAT-1
    CAN_CONTROLLER1_TX_CAT2_ISR: is-reentrant=false, is-synchronous=true, call-type=INTERRUPT, execution-context=INTERRUPT-CAT-2
    CAN_CONTROLLER2_TX_ISR: is-reentrant=false, is-synchronous=true, call-type=INTERRUPT, execution-context=INTERRUPT-CAT-1
    CAN_CONTROLLER2_TX_CAT2_ISR: is-reentrant=false, is-synchronous=true, call-type=INTERRUPT, execution-context=INTERRUPT-CAT-2
    CAN_CONTROLLER3_TX_ISR: is-reentrant=false, is-synchronous=true, call-type=INTERRUPT, execution-context=INTERRUPT-CAT-1
    CAN_CONTROLLER3_TX_CAT2_ISR: is-reentrant=false, is-synchronous=true, call-type=INTERRUPT, execution-context=INTERRUPT-CAT-2
    CAN_CONTROLLER4_TX_ISR: is-reentrant=false, is-synchronous=true, call-type=INTERRUPT, execution-context=INTERRUPT-CAT-1
    CAN_CONTROLLER4_TX_CAT2_ISR: is-reentrant=false, is-synchronous=true, call-type=INTERRUPT, execution-context=INTERRUPT-CAT-2
    CAN_CONTROLLER5_TX_ISR: is-reentrant=false, is-synchronous=true, call-type=INTERRUPT, execution-context=INTERRUPT-CAT-1
    CAN_CONTROLLER5_TX_CAT2_ISR: is-reentrant=false, is-synchronous=true, call-type=INTERRUPT, execution-context=INTERRUPT-CAT-2
    CAN_CONTROLLER6_TX_ISR: is-reentrant=false, is-synchronous=true, call-type=INTERRUPT, execution-context=INTERRUPT-CAT-1
    CAN_CONTROLLER6_TX_CAT2_ISR: is-reentrant=false, is-synchronous=true, call-type=INTERRUPT, execution-context=INTERRUPT-CAT-2
    CAN_CONTROLLER7_TX_ISR: is-reentrant=false, is-synchronous=true, call-type=INTERRUPT, execution-context=INTERRUPT-CAT-1
    CAN_CONTROLLER7_TX_CAT2_ISR: is-reentrant=false, is-synchronous=true, call-type=INTERRUPT, execution-context=INTERRUPT-CAT-2
    CAN_CONTROLLER8_TX_ISR: is-reentrant=false, is-synchronous=true, call-type=INTERRUPT, execution-context=INTERRUPT-CAT-1
    CAN_CONTROLLER8_TX_CAT2_ISR: is-reentrant=false, is-synchronous=true, call-type=INTERRUPT, execution-context=INTERRUPT-CAT-2
    CAN_CONTROLLER9_TX_ISR: is-reentrant=false, is-synchronous=true, call-type=INTERRUPT, execution-context=INTERRUPT-CAT-1
    CAN_CONTROLLER9_TX_CAT2_ISR: is-reentrant=false, is-synchronous=true, call-type=INTERRUPT, execution-context=INTERRUPT-CAT-2
    CAN_CONTROLLER10_TX_ISR: is-reentrant=false, is-synchronous=true, call-type=INTERRUPT, execution-context=INTERRUPT-CAT-1
    CAN_CONTROLLER10_TX_CAT2_ISR: is-reentrant=false, is-synchronous=true, call-type=INTERRUPT, execution-context=INTERRUPT-CAT-2
    CAN_CONTROLLER11_TX_ISR: is-reentrant=false, is-synchronous=true, call-type=INTERRUPT, execution-context=INTERRUPT-CAT-1
    CAN_CONTROLLER11_TX_CAT2_ISR: is-reentrant=false, is-synchronous=true, call-type=INTERRUPT, execution-context=INTERRUPT-CAT-2
    CAN_CONTROLLER0_BUSOFF_ISR: is-reentrant=false, is-synchronous=true, call-type=INTERRUPT, execution-context=INTERRUPT-CAT-1
    CAN_CONTROLLER0_BUSOFF_CAT2_ISR: is-reentrant=false, is-synchronous=true, call-type=INTERRUPT, execution-context=INTERRUPT-CAT-2
    CAN_CONTROLLER1_BUSOFF_ISR: is-reentrant=false, is-synchronous=true, call-type=INTERRUPT, execution-context=INTERRUPT-CAT-1
    CAN_CONTROLLER1_BUSOFF_CAT2_ISR: is-reentrant=false, is-synchronous=true, call-type=INTERRUPT, execution-context=INTERRUPT-CAT-2
    CAN_CONTROLLER2_BUSOFF_ISR: is-reentrant=false, is-synchronous=true, call-type=INTERRUPT, execution-context=INTERRUPT-CAT-1
    CAN_CONTROLLER2_BUSOFF_CAT2_ISR: is-reentrant=false, is-synchronous=true, call-type=INTERRUPT, execution-context=INTERRUPT-CAT-2
    CAN_CONTROLLER3_BUSOFF_ISR: is-reentrant=false, is-synchronous=true, call-type=INTERRUPT, execution-context=INTERRUPT-CAT-1
    CAN_CONTROLLER3_BUSOFF_CAT2_ISR: is-reentrant=false, is-synchronous=true, call-type=INTERRUPT, execution-context=INTERRUPT-CAT-2
    CAN_CONTROLLER4_BUSOFF_ISR: is-reentrant=false, is-synchronous=true, call-type=INTERRUPT, execution-context=INTERRUPT-CAT-1
    CAN_CONTROLLER4_BUSOFF_CAT2_ISR: is-reentrant=false, is-synchronous=true, call-type=INTERRUPT, execution-context=INTERRUPT-CAT-2
    CAN_CONTROLLER5_BUSOFF_ISR: is-reentrant=false, is-synchronous=true, call-type=INTERRUPT, execution-context=INTERRUPT-CAT-1
    CAN_CONTROLLER5_BUSOFF_CAT2_ISR: is-reentrant=false, is-synchronous=true, call-type=INTERRUPT, execution-context=INTERRUPT-CAT-2
    CAN_CONTROLLER6_BUSOFF_ISR: is-reentrant=false, is-synchronous=true, call-type=INTERRUPT, execution-context=INTERRUPT-CAT-1
    CAN_CONTROLLER6_BUSOFF_CAT2_ISR: is-reentrant=false, is-synchronous=true, call-type=INTERRUPT, execution-context=INTERRUPT-CAT-2
    CAN_CONTROLLER7_BUSOFF_ISR: is-reentrant=false, is-synchronous=true, call-type=INTERRUPT, execution-context=INTERRUPT-CAT-1
    CAN_CONTROLLER7_BUSOFF_CAT2_ISR: is-reentrant=false, is-synchronous=true, call-type=INTERRUPT, execution-context=INTERRUPT-CAT-2
    CAN_CONTROLLER8_BUSOFF_ISR: is-reentrant=false, is-synchronous=true, call-type=INTERRUPT, execution-context=INTERRUPT-CAT-1
    CAN_CONTROLLER8_BUSOFF_CAT2_ISR: is-reentrant=false, is-synchronous=true, call-type=INTERRUPT, execution-context=INTERRUPT-CAT-2
    CAN_CONTROLLER9_BUSOFF_ISR: is-reentrant=false, is-synchronous=true, call-type=INTERRUPT, execution-context=INTERRUPT-CAT-1
    CAN_CONTROLLER9_BUSOFF_CAT2_ISR: is-reentrant=false, is-synchronous=true, call-type=INTERRUPT, execution-context=INTERRUPT-CAT-2
    CAN_CONTROLLER10_BUSOFF_ISR: is-reentrant=false, is-synchronous=true, call-type=INTERRUPT, execution-context=INTERRUPT-CAT-1
    CAN_CONTROLLER10_BUSOFF_CAT2_ISR: is-reentrant=false, is-synchronous=true, call-type=INTERRUPT, execution-context=INTERRUPT-CAT-2
    CAN_CONTROLLER11_BUSOFF_ISR: is-reentrant=false, is-synchronous=true, call-type=INTERRUPT, execution-context=INTERRUPT-CAT-1
    CAN_CONTROLLER11_BUSOFF_CAT2_ISR: is-reentrant=false, is-synchronous=true, call-type=INTERRUPT, execution-context=INTERRUPT-CAT-2
    CAN_CONTROLLER0_WAKEUP_ISR: is-reentrant=false, is-synchronous=true, call-type=INTERRUPT, execution-context=INTERRUPT-CAT-1
    CAN_CONTROLLER0_WAKEUP_CAT2_ISR: is-reentrant=false, is-synchronous=true, call-type=INTERRUPT, execution-context=INTERRUPT-CAT-2
    CAN_CONTROLLER1_WAKEUP_ISR: is-reentrant=false, is-synchronous=true, call-type=INTERRUPT, execution-context=INTERRUPT-CAT-1
    CAN_CONTROLLER1_WAKEUP_CAT2_ISR: is-reentrant=false, is-synchronous=true, call-type=INTERRUPT, execution-context=INTERRUPT-CAT-2
    CAN_CONTROLLER2_WAKEUP_ISR: is-reentrant=false, is-synchronous=true, call-type=INTERRUPT, execution-context=INTERRUPT-CAT-1
    CAN_CONTROLLER2_WAKEUP_CAT2_ISR: is-reentrant=false, is-synchronous=true, call-type=INTERRUPT, execution-context=INTERRUPT-CAT-2
    CAN_CONTROLLER3_WAKEUP_ISR: is-reentrant=false, is-synchronous=true, call-type=INTERRUPT, execution-context=INTERRUPT-CAT-1
    CAN_CONTROLLER3_WAKEUP_CAT2_ISR: is-reentrant=false, is-synchronous=true, call-type=INTERRUPT, execution-context=INTERRUPT-CAT-2
    CAN_CONTROLLER4_WAKEUP_ISR: is-reentrant=false, is-synchronous=true, call-type=INTERRUPT, execution-context=INTERRUPT-CAT-1
    CAN_CONTROLLER4_WAKEUP_CAT2_ISR: is-reentrant=false, is-synchronous=true, call-type=INTERRUPT, execution-context=INTERRUPT-CAT-2
    CAN_CONTROLLER5_WAKEUP_ISR: is-reentrant=false, is-synchronous=true, call-type=INTERRUPT, execution-context=INTERRUPT-CAT-1
    CAN_CONTROLLER5_WAKEUP_CAT2_ISR: is-reentrant=false, is-synchronous=true, call-type=INTERRUPT, execution-context=INTERRUPT-CAT-2
    CAN_CONTROLLER6_WAKEUP_ISR: is-reentrant=false, is-synchronous=true, call-type=INTERRUPT, execution-context=INTERRUPT-CAT-1
    CAN_CONTROLLER6_WAKEUP_CAT2_ISR: is-reentrant=false, is-synchronous=true, call-type=INTERRUPT, execution-context=INTERRUPT-CAT-2
    CAN_CONTROLLER7_WAKEUP_ISR: is-reentrant=false, is-synchronous=true, call-type=INTERRUPT, execution-context=INTERRUPT-CAT-1
    CAN_CONTROLLER7_WAKEUP_CAT2_ISR: is-reentrant=false, is-synchronous=true, call-type=INTERRUPT, execution-context=INTERRUPT-CAT-2
    CAN_CONTROLLER8_WAKEUP_ISR: is-reentrant=false, is-synchronous=true, call-type=INTERRUPT, execution-context=INTERRUPT-CAT-1
    CAN_CONTROLLER8_WAKEUP_CAT2_ISR: is-reentrant=false, is-synchronous=true, call-type=INTERRUPT, execution-context=INTERRUPT-CAT-2
    CAN_CONTROLLER9_WAKEUP_ISR: is-reentrant=false, is-synchronous=true, call-type=INTERRUPT, execution-context=INTERRUPT-CAT-1
    CAN_CONTROLLER9_WAKEUP_CAT2_ISR: is-reentrant=false, is-synchronous=true, call-type=INTERRUPT, execution-context=INTERRUPT-CAT-2
    CAN_CONTROLLER10_WAKEUP_ISR: is-reentrant=false, is-synchronous=true, call-type=INTERRUPT, execution-context=INTERRUPT-CAT-1
    CAN_CONTROLLER10_WAKEUP_CAT2_ISR: is-reentrant=false, is-synchronous=true, call-type=INTERRUPT, execution-context=INTERRUPT-CAT-2
    CAN_CONTROLLER11_WAKEUP_ISR: is-reentrant=false, is-synchronous=true, call-type=INTERRUPT, execution-context=INTERRUPT-CAT-1
    CAN_CONTROLLER11_WAKEUP_CAT2_ISR: is-reentrant=false, is-synchronous=true, call-type=INTERRUPT, execution-context=INTERRUPT-CAT-2
