[part 3 of 3: package /R7F7015833]
AUTOSAR XML (schema 00048)
package /R7F7015833  (continued)
  module config Com  (continued)
    ComConfig  (continued)
      RZCU_PTCANFD_100ms_FrP10_CONTROLLER_0_IAM_Rx (ComIPdu):
        ComIPduCancellationSupport = false
        ComIPduDirection = RECEIVE
        ComIPduHandleId = COM_RXPDU_COM_RZCU_PTCANFD_100ms_FrP10_CONTROLLER_0_IAM_Rx
        ComIPduSignalProcessing = DEFERRED
        ComIPduType = NORMAL
        ComIPduCallout = RZCU_PTCANFD_100ms_FrP10_CONTROLLER_0_IAM_Rx
        ComPduIdRef = COM_RZCU_PTCANFD_100ms_FrP10_CONTROLLER_0_IAM_Rx
        ComIPduSignalGroupRef = IRZCU_100ms_Group10_RZCU_PTCANFD_100ms_FrP10_CONTROLLER_0_IAM_Rx
        ComIPduGroupRef = Com_RxPduGroup_CONTROLLER_0_IAM
      IRZCU_100ms_Group10_RZCU_PTCANFD_100ms_FrP10_CONTROLLER_0_IAM_Rx (ComSignalGroup):
        ComHandleId = IRZCU_100ms_Group10_RZCU_PTCANFD_100ms_FrP10_CONTROLLER_0_IAM_Rx
        ComInvalidNotification = NULL_PTR
        ComRxDataTimeoutAction = NONE
        ComTransferProperty = PENDING
        ComDataInvalidAction = NOTIFY
        ComTimeout = 0.0
        ComFirstTimeout = 0.0
        ComNotification = Rte_COMCbk
        23 x ComGroupSignal, all with ComSignalEndianness=BIG_ENDIAN, ComSignalInitValue=0x0, ComSignalLength=0, ComSignalDataInvalidValue=0x0:
          IRZCU_100ms_Group10_CRC_IRZCU_100ms_Group10_RZCU_PTCANFD_100ms_FrP10_CONTROLLER_0_IAM_Rx: ComBitPosition=0, ComBitSize=8, ComHandleId=IRZCU_100ms_Group10_RZCU_PTCANFD_100ms_FrP10_CONTROLLER_0_IAM_Rx_IRZCU_100ms_Group10_CRC_IRZCU_100ms_Group10_RZCU_PTCANFD_100ms_FrP10_CONTROLLER_0_IAM_Rx, ComSignalType=UINT8
          IRZCU_100ms_Group10_RC_IRZCU_100ms_Group10_RZCU_PTCANFD_100ms_FrP10_CONTROLLER_0_IAM_Rx: ComBitPosition=8, ComBitSize=4, ComHandleId=IRZCU_100ms_Group10_RZCU_PTCANFD_100ms_FrP10_CONTROLLER_0_IAM_Rx_IRZCU_100ms_Group10_RC_IRZCU_100ms_Group10_RZCU_PTCANFD_100ms_FrP10_CONTROLLER_0_IAM_Rx, ComSignalType=UINT8
          IOfbdChrgRelaySts_IRZCU_100ms_Group10_RZCU_PTCANFD_100ms_FrP10_CONTROLLER_0_IAM_Rx: ComBitPosition=12, ComBitSize=2, ComHandleId=IRZCU_100ms_Group10_RZCU_PTCANFD_100ms_FrP10_CONTROLLER_0_IAM_Rx_IOfbdChrgRelaySts_IRZCU_100ms_Group10_RZCU_PTCANFD_100ms_FrP10_CONTROLLER_0_IAM_Rx, ComSignalType=UINT8
          IRZCU_100ms_Group10_Reserved1_IRZCU_100ms_Group10_RZCU_PTCANFD_100ms_FrP10_CONTROLLER_0_IAM_Rx: ComBitPosition=14, ComBitSize=2, ComHandleId=IRZCU_100ms_Group10_RZCU_PTCANFD_100ms_FrP10_CONTROLLER_0_IAM_Rx_IRZCU_100ms_Group10_Reserved1_IRZCU_100ms_Group10_RZCU_PTCANFD_100ms_FrP10_CONTROLLER_0_IAM_Rx, ComSignalType=UINT8
          IOfbdChrgrNgtvSktTem_IRZCU_100ms_Group10_RZCU_PTCANFD_100ms_FrP10_CONTROLLER_0_IAM_Rx: ComBitPosition=16, ComBitSize=8, ComHandleId=IRZCU_100ms_Group10_RZCU_PTCANFD_100ms_FrP10_CONTROLLER_0_IAM_Rx_IOfbdChrgrNgtvSktTem_IRZCU_100ms_Group10_RZCU_PTCANFD_100ms_FrP10_CONTROLLER_0_IAM_Rx, ComSignalType=UINT8
          IOnBdChrgrSktPstvSnsrTem_IRZCU_100ms_Group10_RZCU_PTCANFD_100ms_FrP10_CONTROLLER_0_IAM_Rx: ComBitPosition=24, ComBitSize=8, ComHandleId=IRZCU_100ms_Group10_RZCU_PTCANFD_100ms_FrP10_CONTROLLER_0_IAM_Rx_IOnBdChrgrSktPstvSnsrTem_IRZCU_100ms_Group10_RZCU_PTCANFD_100ms_FrP10_CONTROLLER_0_IAM_Rx, ComSignalType=UINT8
          IRZCU_100ms_Group10_Reserved2_IRZCU_100ms_Group10_RZCU_PTCANFD_100ms_FrP10_CONTROLLER_0_IAM_Rx: ComBitPosition=32, ComBitSize=3, ComHandleId=IRZCU_100ms_Group10_RZCU_PTCANFD_100ms_FrP10_CONTROLLER_0_IAM_Rx_IRZCU_100ms_Group10_Reserved2_IRZCU_100ms_Group10_RZCU_PTCANFD_100ms_FrP10_CONTROLLER_0_IAM_Rx, ComSignalType=UINT8
          IOnbdChrgrSktElecLckEnable_IRZCU_100ms_Group10_RZCU_PTCANFD_100ms_FrP10_CONTROLLER_0_IAM_Rx: ComBitPosition=35, ComBitSize=2, ComHandleId=IRZCU_100ms_Group10_RZCU_PTCANFD_100ms_FrP10_CONTROLLER_0_IAM_Rx_IOnbdChrgrSktElecLckEnable_IRZCU_100ms_Group10_RZCU_PTCANFD_100ms_FrP10_CONTROLLER_0_IAM_Rx, ComSignalType=UINT8
          IOnBdChrgrSktPstvSnsrTemV_IRZCU_100ms_Group10_RZCU_PTCANFD_100ms_FrP10_CONTROLLER_0_IAM_Rx: ComBitPosition=37, ComBitSize=1, ComHandleId=IRZCU_100ms_Group10_RZCU_PTCANFD_100ms_FrP10_CONTROLLER_0_IAM_Rx_IOnBdChrgrSktPstvSnsrTemV_IRZCU_100ms_Group10_RZCU_PTCANFD_100ms_FrP10_CONTROLLER_0_IAM_Rx, ComSignalType=BOOLEAN
          IOfbdChrgrNgtvSktTemV_IRZCU_100ms_Group10_RZCU_PTCANFD_100ms_FrP10_CONTROLLER_0_IAM_Rx: ComBitPosition=38, ComBitSize=1, ComHandleId=IRZCU_100ms_Group10_RZCU_PTCANFD_100ms_FrP10_CONTROLLER_0_IAM_Rx_IOfbdChrgrNgtvSktTemV_IRZCU_100ms_Group10_RZCU_PTCANFD_100ms_FrP10_CONTROLLER_0_IAM_Rx, ComSignalType=BOOLEAN
          IOfbdChrgrWkup_IRZCU_100ms_Group10_RZCU_PTCANFD_100ms_FrP10_CONTROLLER_0_IAM_Rx: ComBitPosition=39, ComBitSize=1, ComHandleId=IRZCU_100ms_Group10_RZCU_PTCANFD_100ms_FrP10_CONTROLLER_0_IAM_Rx_IOfbdChrgrWkup_IRZCU_100ms_Group10_RZCU_PTCANFD_100ms_FrP10_CONTROLLER_0_IAM_Rx, ComSignalType=BOOLEAN
          IRZCU_100ms_Group10_Reserved3_IRZCU_100ms_Group10_RZCU_PTCANFD_100ms_FrP10_CONTROLLER_0_IAM_Rx: ComBitPosition=40, ComBitSize=8, ComHandleId=IRZCU_100ms_Group10_RZCU_PTCANFD_100ms_FrP10_CONTROLLER_0_IAM_Rx_IRZCU_100ms_Group10_Reserved3_IRZCU_100ms_Group10_RZCU_PTCANFD_100ms_FrP10_CONTROLLER_0_IAM_Rx, ComSignalType=UINT8
          IOffBdChrgrPlugOn_IRZCU_100ms_Group10_RZCU_PTCANFD_100ms_FrP10_CONTROLLER_0_IAM_Rx: ComBitPosition=63, ComBitSize=2, ComHandleId=IRZCU_100ms_Group10_RZCU_PTCANFD_100ms_FrP10_CONTROLLER_0_IAM_Rx_IOffBdChrgrPlugOn_IRZCU_100ms_Group10_RZCU_PTCANFD_100ms_FrP10_CONTROLLER_0_IAM_Rx, ComSignalType=UINT8
          IOfbdRelayWeldFlt_IRZCU_100ms_Group10_RZCU_PTCANFD_100ms_FrP10_CONTROLLER_0_IAM_Rx: ComBitPosition=49, ComBitSize=1, ComHandleId=IRZCU_100ms_Group10_RZCU_PTCANFD_100ms_FrP10_CONTROLLER_0_IAM_Rx_IOfbdRelayWeldFlt_IRZCU_100ms_Group10_RZCU_PTCANFD_100ms_FrP10_CONTROLLER_0_IAM_Rx, ComSignalType=BOOLEAN
          IIMU_Signal_status_IRZCU_100ms_Group10_RZCU_PTCANFD_100ms_FrP10_CONTROLLER_0_IAM_Rx: ComBitPosition=50, ComBitSize=3, ComHandleId=IRZCU_100ms_Group10_RZCU_PTCANFD_100ms_FrP10_CONTROLLER_0_IAM_Rx_IIMU_Signal_status_IRZCU_100ms_Group10_RZCU_PTCANFD_100ms_FrP10_CONTROLLER_0_IAM_Rx, ComSignalType=UINT8
          IVCUCtrlS2Req_IRZCU_100ms_Group10_RZCU_PTCANFD_100ms_FrP10_CONTROLLER_0_IAM_Rx: ComBitPosition=53, ComBitSize=2, ComHandleId=IRZCU_100ms_Group10_RZCU_PTCANFD_100ms_FrP10_CONTROLLER_0_IAM_Rx_IVCUCtrlS2Req_IRZCU_100ms_Group10_RZCU_PTCANFD_100ms_FrP10_CONTROLLER_0_IAM_Rx, ComSignalType=UINT8
          IRZCU_100ms_Group10_Reserved4_IRZCU_100ms_Group10_RZCU_PTCANFD_100ms_FrP10_CONTROLLER_0_IAM_Rx: ComBitPosition=55, ComBitSize=1, ComHandleId=IRZCU_100ms_Group10_RZCU_PTCANFD_100ms_FrP10_CONTROLLER_0_IAM_Rx_IRZCU_100ms_Group10_Reserved4_IRZCU_100ms_Group10_RZCU_PTCANFD_100ms_FrP10_CONTROLLER_0_IAM_Rx, ComSignalType=BOOLEAN
          IOfbdChrgRelayStsV_IRZCU_100ms_Group10_RZCU_PTCANFD_100ms_FrP10_CONTROLLER_0_IAM_Rx: ComBitPosition=56, ComBitSize=1, ComHandleId=IRZCU_100ms_Group10_RZCU_PTCANFD_100ms_FrP10_CONTROLLER_0_IAM_Rx_IOfbdChrgRelayStsV_IRZCU_100ms_Group10_RZCU_PTCANFD_100ms_FrP10_CONTROLLER_0_IAM_Rx, ComSignalType=BOOLEAN
          ICstRgtnBrkLgtReq_IRZCU_100ms_Group10_RZCU_PTCANFD_100ms_FrP10_CONTROLLER_0_IAM_Rx: ComBitPosition=57, ComBitSize=1, ComHandleId=IRZCU_100ms_Group10_RZCU_PTCANFD_100ms_FrP10_CONTROLLER_0_IAM_Rx_ICstRgtnBrkLgtReq_IRZCU_100ms_Group10_RZCU_PTCANFD_100ms_FrP10_CONTROLLER_0_IAM_Rx, ComSignalType=BOOLEAN
          ICstRgtnBrkLgtReqV_IRZCU_100ms_Group10_RZCU_PTCANFD_100ms_FrP10_CONTROLLER_0_IAM_Rx: ComBitPosition=58, ComBitSize=1, ComHandleId=IRZCU_100ms_Group10_RZCU_PTCANFD_100ms_FrP10_CONTROLLER_0_IAM_Rx_ICstRgtnBrkLgtReqV_IRZCU_100ms_Group10_RZCU_PTCANFD_100ms_FrP10_CONTROLLER_0_IAM_Rx, ComSignalType=BOOLEAN
          IOnBdChrgrSktElecLckStaV_IRZCU_100ms_Group10_RZCU_PTCANFD_100ms_FrP10_CONTROLLER_0_IAM_Rx: ComBitPosition=59, ComBitSize=1, ComHandleId=IRZCU_100ms_Group10_RZCU_PTCANFD_100ms_FrP10_CONTROLLER_0_IAM_Rx_IOnBdChrgrSktElecLckStaV_IRZCU_100ms_Group10_RZCU_PTCANFD_100ms_FrP10_CONTROLLER_0_IAM_Rx, ComSignalType=BOOLEAN
          IOnBdChrgrSktElecLckSta_IRZCU_100ms_Group10_RZCU_PTCANFD_100ms_FrP10_CONTROLLER_0_IAM_Rx: ComBitPosition=60, ComBitSize=2, ComHandleId=IRZCU_100ms_Group10_RZCU_PTCANFD_100ms_FrP10_CONTROLLER_0_IAM_Rx_IOnBdChrgrSktElecLckSta_IRZCU_100ms_Group10_RZCU_PTCANFD_100ms_FrP10_CONTROLLER_0_IAM_Rx, ComSignalType=UINT8
          IOffBdChrgrPlugOnV_IRZCU_100ms_Group10_RZCU_PTCANFD_100ms_FrP10_CONTROLLER_0_IAM_Rx: ComBitPosition=62, ComBitSize=1, ComHandleId=IRZCU_100ms_Group10_RZCU_PTCANFD_100ms_FrP10_CONTROLLER_0_IAM_Rx_IOffBdChrgrPlugOnV_IRZCU_100ms_Group10_RZCU_PTCANFD_100ms_FrP10_CONTROLLER_0_IAM_Rx, ComSignalType=BOOLEAN
      ESS_PTCANFD_100ms_FrP35_CONTROLLER_0_IAM_Rx (ComIPdu):
        ComIPduCancellationSupport = false
        ComIPduDirection = RECEIVE
        ComIPduHandleId = COM_RXPDU_COM_ESS_PTCANFD_100ms_FrP35_CONTROLLER_0_IAM_Rx
        ComIPduSignalProcessing = DEFERRED
        ComIPduType = NORMAL
        ComPduIdRef = COM_ESS_PTCANFD_100ms_FrP35_CONTROLLER_0_IAM_Rx
        ComIPduSignalRef = IBMSBatPrsAlrmV_ESS_PTCANFD_100ms_FrP35_CONTROLLER_0_IAM_Rx
        ComIPduSignalRef = IBMSBatPrsFlt_ESS_PTCANFD_100ms_FrP35_CONTROLLER_0_IAM_Rx
        ComIPduSignalRef = IBMSBatPrsAlrm_ESS_PTCANFD_100ms_FrP35_CONTROLLER_0_IAM_Rx
        ComIPduGroupRef = Com_RxPduGroup_CONTROLLER_0_IAM
      3 x ComSignal, all with ComInvalidNotification=NULL_PTR, ComRxDataTimeoutAction=NONE, ComSignalEndianness=BIG_ENDIAN, ComSignalInitValue=0x0, ComSignalLength=0, ComTransferProperty=PENDING, ComSignalDataInvalidValue=0x0, ComDataInvalidAction=NOTIFY, ComTimeout=0.0, ComFirstTimeout=0.0, ComNotification=Rte_COMCbk:
        IBMSBatPrsAlrmV_ESS_PTCANFD_100ms_FrP35_CONTROLLER_0_IAM_Rx: ComBitPosition=41, ComBitSize=1, ComHandleId=IBMSBatPrsAlrmV_ESS_PTCANFD_100ms_FrP35_CONTROLLER_0_IAM_Rx, ComSignalType=BOOLEAN
        IBMSBatPrsFlt_ESS_PTCANFD_100ms_FrP35_CONTROLLER_0_IAM_Rx: ComBitPosition=42, ComBitSize=3, ComHandleId=IBMSBatPrsFlt_ESS_PTCANFD_100ms_FrP35_CONTROLLER_0_IAM_Rx, ComSignalType=UINT8
        IBMSBatPrsAlrm_ESS_PTCANFD_100ms_FrP35_CONTROLLER_0_IAM_Rx: ComBitPosition=45, ComBitSize=1, ComHandleId=IBMSBatPrsAlrm_ESS_PTCANFD_100ms_FrP35_CONTROLLER_0_IAM_Rx, ComSignalType=BOOLEAN
      LHZCU_LHBKBCANFD_100ms_FrP12_CONTROLLER_0_IAM_Rx (ComIPdu):
        ComIPduCancellationSupport = false
        ComIPduDirection = RECEIVE
        ComIPduHandleId = COM_RXPDU_COM_LHZCU_LHBKBCANFD_100ms_FrP12_CONTROLLER_0_IAM_Rx
        ComIPduSignalProcessing = DEFERRED
        ComIPduType = NORMAL
        ComPduIdRef = COM_LHZCU_LHBKBCANFD_100ms_FrP12_CONTROLLER_0_IAM_Rx
        ComIPduSignalRef = IIntrusionAlrmHisotry_LHZCU_LHBKBCANFD_100ms_FrP12_CONTROLLER_0_IAM_Rx
        ComIPduSignalRef = IIntrusionAlrmSts_LHZCU_LHBKBCANFD_100ms_FrP12_CONTROLLER_0_IAM_Rx
        ComIPduGroupRef = Com_RxPduGroup_CONTROLLER_0_IAM
      IIntrusionAlrmHisotry_LHZCU_LHBKBCANFD_100ms_FrP12_CONTROLLER_0_IAM_Rx (ComSignal):
        ComBitPosition = 60
        ComBitSize = 4
        ComHandleId = IIntrusionAlrmHisotry_LHZCU_LHBKBCANFD_100ms_FrP12_CONTROLLER_0_IAM_Rx
        ComInvalidNotification = NULL_PTR
        ComRxDataTimeoutAction = NONE
        ComSignalEndianness = BIG_ENDIAN
        ComSignalInitValue = 0x0
        ComSignalLength = 0
        ComSignalType = UINT8
        ComTransferProperty = PENDING
        ComSignalDataInvalidValue = 0x0
        ComDataInvalidAction = NOTIFY
        ComTimeout = 0.0
        ComFirstTimeout = 0.0
        ComNotification = Rte_COMCbk
      IIntrusionAlrmSts_LHZCU_LHBKBCANFD_100ms_FrP12_CONTROLLER_0_IAM_Rx (ComSignal):
        ComBitPosition = 94
        ComBitSize = 2
        ComHandleId = IIntrusionAlrmSts_LHZCU_LHBKBCANFD_100ms_FrP12_CONTROLLER_0_IAM_Rx
        ComInvalidNotification = NULL_PTR
        ComRxDataTimeoutAction = NONE
        ComSignalEndianness = BIG_ENDIAN
        ComSignalInitValue = 0x0
        ComSignalLength = 0
        ComSignalType = UINT8
        ComTransferProperty = PENDING
        ComSignalDataInvalidValue = 0x0
        ComDataInvalidAction = NOTIFY
        ComTimeout = 0.0
        ComFirstTimeout = 0.0
        ComNotification = Rte_COMCbk
      ESS_PTEXTDCAN_100ms_FrP23_CONTROLLER_0_IAM_Rx (ComIPdu):
        ComIPduCancellationSupport = false
        ComIPduDirection = RECEIVE
        ComIPduHandleId = COM_RXPDU_COM_ESS_PTEXTDCAN_100ms_FrP23_CONTROLLER_0_IAM_Rx
        ComIPduSignalProcessing = DEFERRED
        ComIPduType = NORMAL
        ComIPduCallout = ESS_PTEXTDCAN_100ms_FrP23_CONTROLLER_0_IAM_Rx
        ComPduIdRef = COM_ESS_PTEXTDCAN_100ms_FrP23_CONTROLLER_0_IAM_Rx
        ComIPduSignalGroupRef = IESS_100ms_Group23_ESS_PTEXTDCAN_100ms_FrP23_CONTROLLER_0_IAM_Rx
        ComIPduGroupRef = Com_RxPduGroup_CONTROLLER_0_IAM
      IESS_100ms_Group23_ESS_PTEXTDCAN_100ms_FrP23_CONTROLLER_0_IAM_Rx (ComSignalGroup):
        ComHandleId = IESS_100ms_Group23_ESS_PTEXTDCAN_100ms_FrP23_CONTROLLER_0_IAM_Rx
        ComInvalidNotification = NULL_PTR
        ComRxDataTimeoutAction = NONE
        ComTransferProperty = PENDING
        ComDataInvalidAction = NOTIFY
        ComTimeout = 0.0
        ComFirstTimeout = 0.0
        ComNotification = Rte_COMCbk
        12 x ComGroupSignal, all with ComSignalEndianness=BIG_ENDIAN, ComSignalInitValue=0x0, ComSignalLength=0, ComSignalDataInvalidValue=0x0:
          IESS_100ms_Group23_CRC_IESS_100ms_Group23_ESS_PTEXTDCAN_100ms_FrP23_CONTROLLER_0_IAM_Rx: ComBitPosition=0, ComBitSize=8, ComHandleId=IESS_100ms_Group23_ESS_PTEXTDCAN_100ms_FrP23_CONTROLLER_0_IAM_Rx_IESS_100ms_Group23_CRC_IESS_100ms_Group23_ESS_PTEXTDCAN_100ms_FrP23_CONTROLLER_0_IAM_Rx, ComSignalType=UINT8
          IESS_100ms_Group23_RC_IESS_100ms_Group23_ESS_PTEXTDCAN_100ms_FrP23_CONTROLLER_0_IAM_Rx: ComBitPosition=8, ComBitSize=4, ComHandleId=IESS_100ms_Group23_ESS_PTEXTDCAN_100ms_FrP23_CONTROLLER_0_IAM_Rx_IESS_100ms_Group23_RC_IESS_100ms_Group23_ESS_PTEXTDCAN_100ms_FrP23_CONTROLLER_0_IAM_Rx, ComSignalType=UINT8
          IBMSHVILClsdBkup_IESS_100ms_Group23_ESS_PTEXTDCAN_100ms_FrP23_CONTROLLER_0_IAM_Rx: ComBitPosition=12, ComBitSize=1, ComHandleId=IESS_100ms_Group23_ESS_PTEXTDCAN_100ms_FrP23_CONTROLLER_0_IAM_Rx_IBMSHVILClsdBkup_IESS_100ms_Group23_ESS_PTEXTDCAN_100ms_FrP23_CONTROLLER_0_IAM_Rx, ComSignalType=BOOLEAN
          IBMSFltLvlBkup_IESS_100ms_Group23_ESS_PTEXTDCAN_100ms_FrP23_CONTROLLER_0_IAM_Rx: ComBitPosition=13, ComBitSize=3, ComHandleId=IESS_100ms_Group23_ESS_PTEXTDCAN_100ms_FrP23_CONTROLLER_0_IAM_Rx_IBMSFltLvlBkup_IESS_100ms_Group23_ESS_PTEXTDCAN_100ms_FrP23_CONTROLLER_0_IAM_Rx, ComSignalType=UINT8
          IBMSPackSOCBkup_IESS_100ms_Group23_ESS_PTEXTDCAN_100ms_FrP23_CONTROLLER_0_IAM_Rx: ComBitPosition=24, ComBitSize=10, ComHandleId=IESS_100ms_Group23_ESS_PTEXTDCAN_100ms_FrP23_CONTROLLER_0_IAM_Rx_IBMSPackSOCBkup_IESS_100ms_Group23_ESS_PTEXTDCAN_100ms_FrP23_CONTROLLER_0_IAM_Rx, ComSignalType=UINT16
          IBMSPackSOCVBkup_IESS_100ms_Group23_ESS_PTEXTDCAN_100ms_FrP23_CONTROLLER_0_IAM_Rx: ComBitPosition=18, ComBitSize=1, ComHandleId=IESS_100ms_Group23_ESS_PTEXTDCAN_100ms_FrP23_CONTROLLER_0_IAM_Rx_IBMSPackSOCVBkup_IESS_100ms_Group23_ESS_PTEXTDCAN_100ms_FrP23_CONTROLLER_0_IAM_Rx, ComSignalType=BOOLEAN
          IBMSBscStaBkup_IESS_100ms_Group23_ESS_PTEXTDCAN_100ms_FrP23_CONTROLLER_0_IAM_Rx: ComBitPosition=19, ComBitSize=5, ComHandleId=IESS_100ms_Group23_ESS_PTEXTDCAN_100ms_FrP23_CONTROLLER_0_IAM_Rx_IBMSBscStaBkup_IESS_100ms_Group23_ESS_PTEXTDCAN_100ms_FrP23_CONTROLLER_0_IAM_Rx, ComSignalType=UINT8
          IESS_100ms_Group23_Reserved1_IESS_100ms_Group23_ESS_PTEXTDCAN_100ms_FrP23_CONTROLLER_0_IAM_Rx: ComBitPosition=32, ComBitSize=6, ComHandleId=IESS_100ms_Group23_ESS_PTEXTDCAN_100ms_FrP23_CONTROLLER_0_IAM_Rx_IESS_100ms_Group23_Reserved1_IESS_100ms_Group23_ESS_PTEXTDCAN_100ms_FrP23_CONTROLLER_0_IAM_Rx, ComSignalType=UINT8
          IBMSMainRelayStsBkup_IESS_100ms_Group23_ESS_PTEXTDCAN_100ms_FrP23_CONTROLLER_0_IAM_Rx: ComBitPosition=38, ComBitSize=2, ComHandleId=IESS_100ms_Group23_ESS_PTEXTDCAN_100ms_FrP23_CONTROLLER_0_IAM_Rx_IBMSMainRelayStsBkup_IESS_100ms_Group23_ESS_PTEXTDCAN_100ms_FrP23_CONTROLLER_0_IAM_Rx, ComSignalType=UINT8
          IBMSMainRelayReqBkup_IESS_100ms_Group23_ESS_PTEXTDCAN_100ms_FrP23_CONTROLLER_0_IAM_Rx: ComBitPosition=52, ComBitSize=12, ComHandleId=IESS_100ms_Group23_ESS_PTEXTDCAN_100ms_FrP23_CONTROLLER_0_IAM_Rx_IBMSMainRelayReqBkup_IESS_100ms_Group23_ESS_PTEXTDCAN_100ms_FrP23_CONTROLLER_0_IAM_Rx, ComSignalType=UINT16
          IESS_100ms_Group23_Reserved2_IESS_100ms_Group23_ESS_PTEXTDCAN_100ms_FrP23_CONTROLLER_0_IAM_Rx: ComBitPosition=48, ComBitSize=4, ComHandleId=IESS_100ms_Group23_ESS_PTEXTDCAN_100ms_FrP23_CONTROLLER_0_IAM_Rx_IESS_100ms_Group23_Reserved2_IESS_100ms_Group23_ESS_PTEXTDCAN_100ms_FrP23_CONTROLLER_0_IAM_Rx, ComSignalType=UINT8
          IESS_100ms_Group23_Reserved3_IESS_100ms_Group23_ESS_PTEXTDCAN_100ms_FrP23_CONTROLLER_0_IAM_Rx: ComBitPosition=56, ComBitSize=8, ComHandleId=IESS_100ms_Group23_ESS_PTEXTDCAN_100ms_FrP23_CONTROLLER_0_IAM_Rx_IESS_100ms_Group23_Reserved3_IESS_100ms_Group23_ESS_PTEXTDCAN_100ms_FrP23_CONTROLLER_0_IAM_Rx, ComSignalType=UINT8
      ESS_PTCANFD_100ms_FrP36_CONTROLLER_0_IAM_Rx (ComIPdu):
        ComIPduCancellationSupport = false
        ComIPduDirection = RECEIVE
        ComIPduHandleId = COM_RXPDU_COM_ESS_PTCANFD_100ms_FrP36_CONTROLLER_0_IAM_Rx
        ComIPduSignalProcessing = DEFERRED
        ComIPduType = NORMAL
        ComPduIdRef = COM_ESS_PTCANFD_100ms_FrP36_CONTROLLER_0_IAM_Rx
        ComIPduSignalRef = IBMSChrgTrgtSOCDspCmd_ESS_PTCANFD_100ms_FrP36_CONTROLLER_0_IAM_Rx
        ComIPduSignalRef = IBMSEstdElecRng_ESS_PTCANFD_100ms_FrP36_CONTROLLER_0_IAM_Rx
        ComIPduSignalRef = IBMSChrgSpRsn_ESS_PTCANFD_100ms_FrP36_CONTROLLER_0_IAM_Rx
        ComIPduSignalRef = IBMSEstdElecRngV_ESS_PTCANFD_100ms_FrP36_CONTROLLER_0_IAM_Rx
        ComIPduSignalRef = IBMSChrgCtrlResp_ESS_PTCANFD_100ms_FrP36_CONTROLLER_0_IAM_Rx
        ComIPduSignalRef = IBMSChrgSts_ESS_PTCANFD_100ms_FrP36_CONTROLLER_0_IAM_Rx
        ComIPduSignalRef = IBMSChrgTrgtSOCResp_ESS_PTCANFD_100ms_FrP36_CONTROLLER_0_IAM_Rx
        ComIPduGroupRef = Com_RxPduGroup_CONTROLLER_0_IAM
      7 x ComSignal, all with ComInvalidNotification=NULL_PTR, ComRxDataTimeoutAction=NONE, ComSignalEndianness=BIG_ENDIAN, ComSignalInitValue=0x0, ComSignalLength=0, ComTransferProperty=PENDING, ComSignalDataInvalidValue=0x0, ComDataInvalidAction=NOTIFY, ComTimeout=0.0, ComFirstTimeout=0.0, ComNotification=Rte_COMCbk:
        IBMSChrgTrgtSOCDspCmd_ESS_PTCANFD_100ms_FrP36_CONTROLLER_0_IAM_Rx: ComBitPosition=5, ComBitSize=3, ComHandleId=IBMSChrgTrgtSOCDspCmd_ESS_PTCANFD_100ms_FrP36_CONTROLLER_0_IAM_Rx, ComSignalType=UINT8
        IBMSEstdElecRng_ESS_PTCANFD_100ms_FrP36_CONTROLLER_0_IAM_Rx: ComBitPosition=24, ComBitSize=11, ComHandleId=IBMSEstdElecRng_ESS_PTCANFD_100ms_FrP36_CONTROLLER_0_IAM_Rx, ComSignalType=UINT16
        IBMSChrgSpRsn_ESS_PTCANFD_100ms_FrP36_CONTROLLER_0_IAM_Rx: ComBitPosition=19, ComBitSize=5, ComHandleId=IBMSChrgSpRsn_ESS_PTCANFD_100ms_FrP36_CONTROLLER_0_IAM_Rx, ComSignalType=UINT8
        IBMSEstdElecRngV_ESS_PTCANFD_100ms_FrP36_CONTROLLER_0_IAM_Rx: ComBitPosition=33, ComBitSize=1, ComHandleId=IBMSEstdElecRngV_ESS_PTCANFD_100ms_FrP36_CONTROLLER_0_IAM_Rx, ComSignalType=BOOLEAN
        IBMSChrgCtrlResp_ESS_PTCANFD_100ms_FrP36_CONTROLLER_0_IAM_Rx: ComBitPosition=34, ComBitSize=3, ComHandleId=IBMSChrgCtrlResp_ESS_PTCANFD_100ms_FrP36_CONTROLLER_0_IAM_Rx, ComSignalType=UINT8
        IBMSChrgSts_ESS_PTCANFD_100ms_FrP36_CONTROLLER_0_IAM_Rx: ComBitPosition=43, ComBitSize=5, ComHandleId=IBMSChrgSts_ESS_PTCANFD_100ms_FrP36_CONTROLLER_0_IAM_Rx, ComSignalType=UINT8
        IBMSChrgTrgtSOCResp_ESS_PTCANFD_100ms_FrP36_CONTROLLER_0_IAM_Rx: ComBitPosition=61, ComBitSize=3, ComHandleId=IBMSChrgTrgtSOCResp_ESS_PTCANFD_100ms_FrP36_CONTROLLER_0_IAM_Rx, ComSignalType=UINT8
      ICBVC_FOTASts_100ms_FrP47_CONTROLLER_0_IAM_Rx (ComIPdu):
        ComIPduCancellationSupport = false
        ComIPduDirection = RECEIVE
        ComIPduHandleId = COM_RXPDU_COM_ICBVC_FOTASts_100ms_FrP47_CONTROLLER_0_IAM_Rx
        ComIPduSignalProcessing = DEFERRED
        ComIPduType = NORMAL
        ComPduIdRef = COM_ICBVC_FOTASts_100ms_FrP47_CONTROLLER_0_IAM_Rx
        ComIPduSignalRef = IFOTAStatusValid_ICBVC_FOTASts_100ms_FrP47_CONTROLLER_0_IAM_Rx
        ComIPduSignalRef = IFOTAStatus_ICBVC_FOTASts_100ms_FrP47_CONTROLLER_0_IAM_Rx
        ComIPduSignalRef = IFOTATarget_ICBVC_FOTASts_100ms_FrP47_CONTROLLER_0_IAM_Rx
        ComIPduSignalRef = IFOTATargetValid_ICBVC_FOTASts_100ms_FrP47_CONTROLLER_0_IAM_Rx
        ComIPduGroupRef = Com_RxPduGroup_CONTROLLER_0_IAM
      4 x ComSignal, all with ComInvalidNotification=NULL_PTR, ComRxDataTimeoutAction=NONE, ComSignalEndianness=BIG_ENDIAN, ComSignalInitValue=0x0, ComSignalLength=0, ComTransferProperty=PENDING, ComSignalDataInvalidValue=0x0, ComDataInvalidAction=NOTIFY, ComTimeout=0.0, ComFirstTimeout=0.0, ComNotification=Rte_COMCbk:
        IFOTAStatusValid_ICBVC_FOTASts_100ms_FrP47_CONTROLLER_0_IAM_Rx: ComBitPosition=16, ComBitSize=1, ComHandleId=IFOTAStatusValid_ICBVC_FOTASts_100ms_FrP47_CONTROLLER_0_IAM_Rx, ComSignalType=BOOLEAN
        IFOTAStatus_ICBVC_FOTASts_100ms_FrP47_CONTROLLER_0_IAM_Rx: ComBitPosition=17, ComBitSize=4, ComHandleId=IFOTAStatus_ICBVC_FOTASts_100ms_FrP47_CONTROLLER_0_IAM_Rx, ComSignalType=UINT8
        IFOTATarget_ICBVC_FOTASts_100ms_FrP47_CONTROLLER_0_IAM_Rx: ComBitPosition=24, ComBitSize=8, ComHandleId=IFOTATarget_ICBVC_FOTASts_100ms_FrP47_CONTROLLER_0_IAM_Rx, ComSignalType=UINT8
        IFOTATargetValid_ICBVC_FOTASts_100ms_FrP47_CONTROLLER_0_IAM_Rx: ComBitPosition=39, ComBitSize=1, ComHandleId=IFOTATargetValid_ICBVC_FOTASts_100ms_FrP47_CONTROLLER_0_IAM_Rx, ComSignalType=BOOLEAN
      CCU_PTCANFD_100ms_FrP02_CONTROLLER_0_IAM_Rx (ComIPdu):
        ComIPduCancellationSupport = false
        ComIPduDirection = RECEIVE
        ComIPduHandleId = COM_RXPDU_COM_CCU_PTCANFD_100ms_FrP02_CONTROLLER_0_IAM_Rx
        ComIPduSignalProcessing = DEFERRED
        ComIPduType = NORMAL
        ComIPduCallout = CCU_PTCANFD_100ms_FrP02_CONTROLLER_0_IAM_Rx
        ComPduIdRef = COM_CCU_PTCANFD_100ms_FrP02_CONTROLLER_0_IAM_Rx
        ComIPduSignalGroupRef = ICCU_100ms_Group02_CCU_PTCANFD_100ms_FrP02_CONTROLLER_0_IAM_Rx
        ComIPduGroupRef = Com_RxPduGroup_CONTROLLER_0_IAM
      ICCU_100ms_Group02_CCU_PTCANFD_100ms_FrP02_CONTROLLER_0_IAM_Rx (ComSignalGroup):
        ComHandleId = ICCU_100ms_Group02_CCU_PTCANFD_100ms_FrP02_CONTROLLER_0_IAM_Rx
        ComInvalidNotification = NULL_PTR
        ComRxDataTimeoutAction = NONE
        ComTransferProperty = PENDING
        ComDataInvalidAction = NOTIFY
        ComTimeout = 0.0
        ComFirstTimeout = 0.0
        ComNotification = Rte_COMCbk
        14 x ComGroupSignal, all with ComSignalEndianness=BIG_ENDIAN, ComSignalInitValue=0x0, ComSignalLength=0, ComSignalDataInvalidValue=0x0:
          ICCU_100ms_Group02_CRC_ICCU_100ms_Group02_CCU_PTCANFD_100ms_FrP02_CONTROLLER_0_IAM_Rx: ComBitPosition=0, ComBitSize=8, ComHandleId=ICCU_100ms_Group02_CCU_PTCANFD_100ms_FrP02_CONTROLLER_0_IAM_Rx_ICCU_100ms_Group02_CRC_ICCU_100ms_Group02_CCU_PTCANFD_100ms_FrP02_CONTROLLER_0_IAM_Rx, ComSignalType=UINT8
          ICCU_100ms_Group02_RC_ICCU_100ms_Group02_CCU_PTCANFD_100ms_FrP02_CONTROLLER_0_IAM_Rx: ComBitPosition=8, ComBitSize=4, ComHandleId=ICCU_100ms_Group02_CCU_PTCANFD_100ms_FrP02_CONTROLLER_0_IAM_Rx_ICCU_100ms_Group02_RC_ICCU_100ms_Group02_CCU_PTCANFD_100ms_FrP02_CONTROLLER_0_IAM_Rx, ComSignalType=UINT8
          IHVDCHVILStsV_ICCU_100ms_Group02_CCU_PTCANFD_100ms_FrP02_CONTROLLER_0_IAM_Rx: ComBitPosition=12, ComBitSize=1, ComHandleId=ICCU_100ms_Group02_CCU_PTCANFD_100ms_FrP02_CONTROLLER_0_IAM_Rx_IHVDCHVILStsV_ICCU_100ms_Group02_CCU_PTCANFD_100ms_FrP02_CONTROLLER_0_IAM_Rx, ComSignalType=BOOLEAN
          IHVDCDCSta_ICCU_100ms_Group02_CCU_PTCANFD_100ms_FrP02_CONTROLLER_0_IAM_Rx: ComBitPosition=13, ComBitSize=3, ComHandleId=ICCU_100ms_Group02_CCU_PTCANFD_100ms_FrP02_CONTROLLER_0_IAM_Rx_IHVDCDCSta_ICCU_100ms_Group02_CCU_PTCANFD_100ms_FrP02_CONTROLLER_0_IAM_Rx, ComSignalType=UINT8
          IHVDCDCTem_ICCU_100ms_Group02_CCU_PTCANFD_100ms_FrP02_CONTROLLER_0_IAM_Rx: ComBitPosition=16, ComBitSize=8, ComHandleId=ICCU_100ms_Group02_CCU_PTCANFD_100ms_FrP02_CONTROLLER_0_IAM_Rx_IHVDCDCTem_ICCU_100ms_Group02_CCU_PTCANFD_100ms_FrP02_CONTROLLER_0_IAM_Rx, ComSignalType=UINT8
          ICCU_100ms_Group02_Reserved1_ICCU_100ms_Group02_CCU_PTCANFD_100ms_FrP02_CONTROLLER_0_IAM_Rx: ComBitPosition=24, ComBitSize=8, ComHandleId=ICCU_100ms_Group02_CCU_PTCANFD_100ms_FrP02_CONTROLLER_0_IAM_Rx_ICCU_100ms_Group02_Reserved1_ICCU_100ms_Group02_CCU_PTCANFD_100ms_FrP02_CONTROLLER_0_IAM_Rx, ComSignalType=UINT8
          IOnBdChrgrHVILStsVal_ICCU_100ms_Group02_CCU_PTCANFD_100ms_FrP02_CONTROLLER_0_IAM_Rx: ComBitPosition=32, ComBitSize=2, ComHandleId=ICCU_100ms_Group02_CCU_PTCANFD_100ms_FrP02_CONTROLLER_0_IAM_Rx_IOnBdChrgrHVILStsVal_ICCU_100ms_Group02_CCU_PTCANFD_100ms_FrP02_CONTROLLER_0_IAM_Rx, ComSignalType=UINT8
          IPDUHVILStsV_ICCU_100ms_Group02_CCU_PTCANFD_100ms_FrP02_CONTROLLER_0_IAM_Rx: ComBitPosition=34, ComBitSize=1, ComHandleId=ICCU_100ms_Group02_CCU_PTCANFD_100ms_FrP02_CONTROLLER_0_IAM_Rx_IPDUHVILStsV_ICCU_100ms_Group02_CCU_PTCANFD_100ms_FrP02_CONTROLLER_0_IAM_Rx, ComSignalType=BOOLEAN
          IPDUHVILSts_ICCU_100ms_Group02_CCU_PTCANFD_100ms_FrP02_CONTROLLER_0_IAM_Rx: ComBitPosition=35, ComBitSize=2, ComHandleId=ICCU_100ms_Group02_CCU_PTCANFD_100ms_FrP02_CONTROLLER_0_IAM_Rx_IPDUHVILSts_ICCU_100ms_Group02_CCU_PTCANFD_100ms_FrP02_CONTROLLER_0_IAM_Rx, ComSignalType=UINT8
          IOnBdChrgrHVILStsValV_ICCU_100ms_Group02_CCU_PTCANFD_100ms_FrP02_CONTROLLER_0_IAM_Rx: ComBitPosition=37, ComBitSize=1, ComHandleId=ICCU_100ms_Group02_CCU_PTCANFD_100ms_FrP02_CONTROLLER_0_IAM_Rx_IOnBdChrgrHVILStsValV_ICCU_100ms_Group02_CCU_PTCANFD_100ms_FrP02_CONTROLLER_0_IAM_Rx, ComSignalType=BOOLEAN
          IHVDCHVILSts_ICCU_100ms_Group02_CCU_PTCANFD_100ms_FrP02_CONTROLLER_0_IAM_Rx: ComBitPosition=38, ComBitSize=2, ComHandleId=ICCU_100ms_Group02_CCU_PTCANFD_100ms_FrP02_CONTROLLER_0_IAM_Rx_IHVDCHVILSts_ICCU_100ms_Group02_CCU_PTCANFD_100ms_FrP02_CONTROLLER_0_IAM_Rx, ComSignalType=UINT8
          ICCU_100ms_Group02_Reserved2_ICCU_100ms_Group02_CCU_PTCANFD_100ms_FrP02_CONTROLLER_0_IAM_Rx: ComBitPosition=40, ComBitSize=8, ComHandleId=ICCU_100ms_Group02_CCU_PTCANFD_100ms_FrP02_CONTROLLER_0_IAM_Rx_ICCU_100ms_Group02_Reserved2_ICCU_100ms_Group02_CCU_PTCANFD_100ms_FrP02_CONTROLLER_0_IAM_Rx, ComSignalType=UINT8
          ICCU_100ms_Group02_Reserved3_ICCU_100ms_Group02_CCU_PTCANFD_100ms_FrP02_CONTROLLER_0_IAM_Rx: ComBitPosition=48, ComBitSize=8, ComHandleId=ICCU_100ms_Group02_CCU_PTCANFD_100ms_FrP02_CONTROLLER_0_IAM_Rx_ICCU_100ms_Group02_Reserved3_ICCU_100ms_Group02_CCU_PTCANFD_100ms_FrP02_CONTROLLER_0_IAM_Rx, ComSignalType=UINT8
          ICCU_100ms_Group02_Reserved4_ICCU_100ms_Group02_CCU_PTCANFD_100ms_FrP02_CONTROLLER_0_IAM_Rx: ComBitPosition=56, ComBitSize=8, ComHandleId=ICCU_100ms_Group02_CCU_PTCANFD_100ms_FrP02_CONTROLLER_0_IAM_Rx_ICCU_100ms_Group02_Reserved4_ICCU_100ms_Group02_CCU_PTCANFD_100ms_FrP02_CONTROLLER_0_IAM_Rx, ComSignalType=UINT8
      ICBVC_RZCUCANFD_100ms_FrP45_CONTROLLER_0_IAM_Rx (ComIPdu):
        ComIPduCancellationSupport = false
        ComIPduDirection = RECEIVE
        ComIPduHandleId = COM_RXPDU_COM_ICBVC_RZCUCANFD_100ms_FrP45_CONTROLLER_0_IAM_Rx
        ComIPduSignalProcessing = DEFERRED
        ComIPduType = NORMAL
        ComPduIdRef = COM_ICBVC_RZCUCANFD_100ms_FrP45_CONTROLLER_0_IAM_Rx
        ComIPduSignalRef = IChrgTrgtSOCVal_ICBVC_RZCUCANFD_100ms_FrP45_CONTROLLER_0_IAM_Rx
        ComIPduSignalRef = IReserStMinute_ICBVC_RZCUCANFD_100ms_FrP45_CONTROLLER_0_IAM_Rx
        ComIPduSignalRef = IReserSpMinute_ICBVC_RZCUCANFD_100ms_FrP45_CONTROLLER_0_IAM_Rx
        ComIPduSignalRef = IReserChrgSts_ICBVC_RZCUCANFD_100ms_FrP45_CONTROLLER_0_IAM_Rx
        ComIPduSignalRef = IReserSpHour_ICBVC_RZCUCANFD_100ms_FrP45_CONTROLLER_0_IAM_Rx
        ComIPduSignalRef = IReserStHour_ICBVC_RZCUCANFD_100ms_FrP45_CONTROLLER_0_IAM_Rx
        ComIPduGroupRef = Com_RxPduGroup_CONTROLLER_0_IAM
      6 x ComSignal, all with ComInvalidNotification=NULL_PTR, ComRxDataTimeoutAction=NONE, ComSignalEndianness=BIG_ENDIAN, ComSignalInitValue=0x0, ComSignalLength=0, ComSignalType=UINT8, ComTransferProperty=PENDING, ComSignalDataInvalidValue=0x0, ComDataInvalidAction=NOTIFY, ComTimeout=0.0, ComFirstTimeout=0.0, ComNotification=Rte_COMCbk:
        IChrgTrgtSOCVal_ICBVC_RZCUCANFD_100ms_FrP45_CONTROLLER_0_IAM_Rx: ComBitPosition=1, ComBitSize=7, ComHandleId=IChrgTrgtSOCVal_ICBVC_RZCUCANFD_100ms_FrP45_CONTROLLER_0_IAM_Rx
        IReserStMinute_ICBVC_RZCUCANFD_100ms_FrP45_CONTROLLER_0_IAM_Rx: ComBitPosition=10, ComBitSize=6, ComHandleId=IReserStMinute_ICBVC_RZCUCANFD_100ms_FrP45_CONTROLLER_0_IAM_Rx
        IReserSpMinute_ICBVC_RZCUCANFD_100ms_FrP45_CONTROLLER_0_IAM_Rx: ComBitPosition=18, ComBitSize=6, ComHandleId=IReserSpMinute_ICBVC_RZCUCANFD_100ms_FrP45_CONTROLLER_0_IAM_Rx
        IReserChrgSts_ICBVC_RZCUCANFD_100ms_FrP45_CONTROLLER_0_IAM_Rx: ComBitPosition=32, ComBitSize=2, ComHandleId=IReserChrgSts_ICBVC_RZCUCANFD_100ms_FrP45_CONTROLLER_0_IAM_Rx
        IReserSpHour_ICBVC_RZCUCANFD_100ms_FrP45_CONTROLLER_0_IAM_Rx: ComBitPosition=61, ComBitSize=5, ComHandleId=IReserSpHour_ICBVC_RZCUCANFD_100ms_FrP45_CONTROLLER_0_IAM_Rx
        IReserStHour_ICBVC_RZCUCANFD_100ms_FrP45_CONTROLLER_0_IAM_Rx: ComBitPosition=56, ComBitSize=5, ComHandleId=IReserStHour_ICBVC_RZCUCANFD_100ms_FrP45_CONTROLLER_0_IAM_Rx
      ESS_PTCANFD_100ms_FrP15_CONTROLLER_0_IAM_Rx (ComIPdu):
        ComIPduCancellationSupport = false
        ComIPduDirection = RECEIVE
        ComIPduHandleId = COM_RXPDU_COM_ESS_PTCANFD_100ms_FrP15_CONTROLLER_0_IAM_Rx
        ComIPduSignalProcessing = DEFERRED
        ComIPduType = NORMAL
        ComPduIdRef = COM_ESS_PTCANFD_100ms_FrP15_CONTROLLER_0_IAM_Rx
        ComIPduSignalRef = IChrgngRmnngTimeV_ESS_PTCANFD_100ms_FrP15_CONTROLLER_0_IAM_Rx
        ComIPduSignalRef = IChrgngRmnngTime_ESS_PTCANFD_100ms_FrP15_CONTROLLER_0_IAM_Rx
        ComIPduSignalRef = IBMSBattNoFuChargReq_ESS_PTCANFD_100ms_FrP15_CONTROLLER_0_IAM_Rx
        ComIPduGroupRef = Com_RxPduGroup_CONTROLLER_0_IAM
      3 x ComSignal, all with ComInvalidNotification=NULL_PTR, ComRxDataTimeoutAction=NONE, ComSignalEndianness=BIG_ENDIAN, ComSignalInitValue=0x0, ComSignalLength=0, ComTransferProperty=PENDING, ComSignalDataInvalidValue=0x0, ComDataInvalidAction=NOTIFY, ComTimeout=1.0, ComFirstTimeout=1.0, ComNotification=Rte_COMCbk, ComTimeoutNotification=Rte_COMCbkRxTOut:
        IChrgngRmnngTimeV_ESS_PTCANFD_100ms_FrP15_CONTROLLER_0_IAM_Rx: ComBitPosition=2, ComBitSize=1, ComHandleId=IChrgngRmnngTimeV_ESS_PTCANFD_100ms_FrP15_CONTROLLER_0_IAM_Rx, ComSignalType=BOOLEAN
        IChrgngRmnngTime_ESS_PTCANFD_100ms_FrP15_CONTROLLER_0_IAM_Rx: ComBitPosition=40, ComBitSize=10, ComHandleId=IChrgngRmnngTime_ESS_PTCANFD_100ms_FrP15_CONTROLLER_0_IAM_Rx, ComSignalType=UINT16
        IBMSBattNoFuChargReq_ESS_PTCANFD_100ms_FrP15_CONTROLLER_0_IAM_Rx: ComBitPosition=56, ComBitSize=8, ComHandleId=IBMSBattNoFuChargReq_ESS_PTCANFD_100ms_FrP15_CONTROLLER_0_IAM_Rx, ComSignalType=UINT8
      ESS_PTCANFD_100ms_FrP32_CONTROLLER_0_IAM_Rx (ComIPdu):
        ComIPduCancellationSupport = false
        ComIPduDirection = RECEIVE
        ComIPduHandleId = COM_RXPDU_COM_ESS_PTCANFD_100ms_FrP32_CONTROLLER_0_IAM_Rx
        ComIPduSignalProcessing = DEFERRED
        ComIPduType = NORMAL
        ComIPduCallout = ESS_PTCANFD_100ms_FrP32_CONTROLLER_0_IAM_Rx
        ComPduIdRef = COM_ESS_PTCANFD_100ms_FrP32_CONTROLLER_0_IAM_Rx
        ComIPduSignalGroupRef = IESS_100ms_Group32_ESS_PTCANFD_100ms_FrP32_CONTROLLER_0_IAM_Rx
        ComIPduGroupRef = Com_RxPduGroup_CONTROLLER_0_IAM
      IESS_100ms_Group32_ESS_PTCANFD_100ms_FrP32_CONTROLLER_0_IAM_Rx (ComSignalGroup):
        ComHandleId = IESS_100ms_Group32_ESS_PTCANFD_100ms_FrP32_CONTROLLER_0_IAM_Rx
        ComInvalidNotification = NULL_PTR
        ComRxDataTimeoutAction = NONE
        ComTransferProperty = PENDING
        ComDataInvalidAction = NOTIFY
        ComTimeout = 0.0
        ComFirstTimeout = 0.0
        ComNotification = Rte_COMCbk
        9 x ComGroupSignal, all with ComSignalEndianness=BIG_ENDIAN, ComSignalInitValue=0x0, ComSignalLength=0, ComSignalDataInvalidValue=0x0:
          IESS_100ms_Group32_CRC_IESS_100ms_Group32_ESS_PTCANFD_100ms_FrP32_CONTROLLER_0_IAM_Rx: ComBitPosition=0, ComBitSize=8, ComHandleId=IESS_100ms_Group32_ESS_PTCANFD_100ms_FrP32_CONTROLLER_0_IAM_Rx_IESS_100ms_Group32_CRC_IESS_100ms_Group32_ESS_PTCANFD_100ms_FrP32_CONTROLLER_0_IAM_Rx, ComSignalType=UINT8
          IESS_100ms_Group32_RC_IESS_100ms_Group32_ESS_PTCANFD_100ms_FrP32_CONTROLLER_0_IAM_Rx: ComBitPosition=8, ComBitSize=4, ComHandleId=IESS_100ms_Group32_ESS_PTCANFD_100ms_FrP32_CONTROLLER_0_IAM_Rx_IESS_100ms_Group32_RC_IESS_100ms_Group32_ESS_PTCANFD_100ms_FrP32_CONTROLLER_0_IAM_Rx, ComSignalType=UINT8
          IESS_100ms_Group32_Reserved1_IESS_100ms_Group32_ESS_PTCANFD_100ms_FrP32_CONTROLLER_0_IAM_Rx: ComBitPosition=12, ComBitSize=4, ComHandleId=IESS_100ms_Group32_ESS_PTCANFD_100ms_FrP32_CONTROLLER_0_IAM_Rx_IESS_100ms_Group32_Reserved1_IESS_100ms_Group32_ESS_PTCANFD_100ms_FrP32_CONTROLLER_0_IAM_Rx, ComSignalType=UINT8
          IBMSBatPrsSnsrVal_IESS_100ms_Group32_ESS_PTCANFD_100ms_FrP32_CONTROLLER_0_IAM_Rx: ComBitPosition=24, ComBitSize=15, ComHandleId=IESS_100ms_Group32_ESS_PTCANFD_100ms_FrP32_CONTROLLER_0_IAM_Rx_IBMSBatPrsSnsrVal_IESS_100ms_Group32_ESS_PTCANFD_100ms_FrP32_CONTROLLER_0_IAM_Rx, ComSignalType=UINT16
          IBMSBatPrsSnsrV_IESS_100ms_Group32_ESS_PTCANFD_100ms_FrP32_CONTROLLER_0_IAM_Rx: ComBitPosition=23, ComBitSize=1, ComHandleId=IESS_100ms_Group32_ESS_PTCANFD_100ms_FrP32_CONTROLLER_0_IAM_Rx_IBMSBatPrsSnsrV_IESS_100ms_Group32_ESS_PTCANFD_100ms_FrP32_CONTROLLER_0_IAM_Rx, ComSignalType=BOOLEAN
          IESS_100ms_Group32_Reserved2_IESS_100ms_Group32_ESS_PTCANFD_100ms_FrP32_CONTROLLER_0_IAM_Rx: ComBitPosition=32, ComBitSize=8, ComHandleId=IESS_100ms_Group32_ESS_PTCANFD_100ms_FrP32_CONTROLLER_0_IAM_Rx_IESS_100ms_Group32_Reserved2_IESS_100ms_Group32_ESS_PTCANFD_100ms_FrP32_CONTROLLER_0_IAM_Rx, ComSignalType=UINT8
          IESS_100ms_Group32_Reserved3_IESS_100ms_Group32_ESS_PTCANFD_100ms_FrP32_CONTROLLER_0_IAM_Rx: ComBitPosition=40, ComBitSize=8, ComHandleId=IESS_100ms_Group32_ESS_PTCANFD_100ms_FrP32_CONTROLLER_0_IAM_Rx_IESS_100ms_Group32_Reserved3_IESS_100ms_Group32_ESS_PTCANFD_100ms_FrP32_CONTROLLER_0_IAM_Rx, ComSignalType=UINT8
          IESS_100ms_Group32_Reserved4_IESS_100ms_Group32_ESS_PTCANFD_100ms_FrP32_CONTROLLER_0_IAM_Rx: ComBitPosition=48, ComBitSize=8, ComHandleId=IESS_100ms_Group32_ESS_PTCANFD_100ms_FrP32_CONTROLLER_0_IAM_Rx_IESS_100ms_Group32_Reserved4_IESS_100ms_Group32_ESS_PTCANFD_100ms_FrP32_CONTROLLER_0_IAM_Rx, ComSignalType=UINT8
          IESS_100ms_Group32_Reserved5_IESS_100ms_Group32_ESS_PTCANFD_100ms_FrP32_CONTROLLER_0_IAM_Rx: ComBitPosition=56, ComBitSize=8, ComHandleId=IESS_100ms_Group32_ESS_PTCANFD_100ms_FrP32_CONTROLLER_0_IAM_Rx_IESS_100ms_Group32_Reserved5_IESS_100ms_Group32_ESS_PTCANFD_100ms_FrP32_CONTROLLER_0_IAM_Rx, ComSignalType=UINT8
      RHZCU_RHBKBCANFD_100ms_FrP12_CONTROLLER_0_IAM_Rx (ComIPdu):
        ComIPduCancellationSupport = false
        ComIPduDirection = RECEIVE
        ComIPduHandleId = COM_RXPDU_COM_RHZCU_RHBKBCANFD_100ms_FrP12_CONTROLLER_0_IAM_Rx
        ComIPduSignalProcessing = DEFERRED
        ComIPduType = NORMAL
        ComPduIdRef = COM_RHZCU_RHBKBCANFD_100ms_FrP12_CONTROLLER_0_IAM_Rx
        ComIPduSignalRef = IRmtHtdRrWndAbotRsn_RHZCU_RHBKBCANFD_100ms_FrP12_CONTROLLER_0_IAM_Rx
        ComIPduSignalRef = IRmtACSts_RHZCU_RHBKBCANFD_100ms_FrP12_CONTROLLER_0_IAM_Rx
        ComIPduSignalRef = IRmtACAbotRsn_RHZCU_RHBKBCANFD_100ms_FrP12_CONTROLLER_0_IAM_Rx
        ComIPduSignalRef = IRmtHtdRrWndSt_RHZCU_RHBKBCANFD_100ms_FrP12_CONTROLLER_0_IAM_Rx
        ComIPduGroupRef = Com_RxPduGroup_CONTROLLER_0_IAM
      4 x ComSignal, all with ComInvalidNotification=NULL_PTR, ComRxDataTimeoutAction=NONE, ComSignalEndianness=BIG_ENDIAN, ComSignalInitValue=0x0, ComSignalLength=0, ComTransferProperty=PENDING, ComSignalDataInvalidValue=0x0, ComDataInvalidAction=NOTIFY, ComTimeout=0.0, ComFirstTimeout=0.0, ComNotification=Rte_COMCbk:
        IRmtHtdRrWndAbotRsn_RHZCU_RHBKBCANFD_100ms_FrP12_CONTROLLER_0_IAM_Rx: ComBitPosition=4, ComBitSize=4, ComHandleId=IRmtHtdRrWndAbotRsn_RHZCU_RHBKBCANFD_100ms_FrP12_CONTROLLER_0_IAM_Rx, ComSignalType=UINT8
        IRmtACSts_RHZCU_RHBKBCANFD_100ms_FrP12_CONTROLLER_0_IAM_Rx: ComBitPosition=25, ComBitSize=3, ComHandleId=IRmtACSts_RHZCU_RHBKBCANFD_100ms_FrP12_CONTROLLER_0_IAM_Rx, ComSignalType=UINT8
        IRmtACAbotRsn_RHZCU_RHBKBCANFD_100ms_FrP12_CONTROLLER_0_IAM_Rx: ComBitPosition=28, ComBitSize=4, ComHandleId=IRmtACAbotRsn_RHZCU_RHBKBCANFD_100ms_FrP12_CONTROLLER_0_IAM_Rx, ComSignalType=UINT8
        IRmtHtdRrWndSt_RHZCU_RHBKBCANFD_100ms_FrP12_CONTROLLER_0_IAM_Rx: ComBitPosition=53, ComBitSize=1, ComHandleId=IRmtHtdRrWndSt_RHZCU_RHBKBCANFD_100ms_FrP12_CONTROLLER_0_IAM_Rx, ComSignalType=BOOLEAN
      RHZCU_RHBKBCANFD_100ms_FrP15_CONTROLLER_0_IAM_Rx (ComIPdu):
        ComIPduCancellationSupport = false
        ComIPduDirection = RECEIVE
        ComIPduHandleId = COM_RXPDU_COM_RHZCU_RHBKBCANFD_100ms_FrP15_CONTROLLER_0_IAM_Rx
        ComIPduSignalProcessing = DEFERRED
        ComIPduType = NORMAL
        ComPduIdRef = COM_RHZCU_RHBKBCANFD_100ms_FrP15_CONTROLLER_0_IAM_Rx
        ComIPduSignalRef = IACOnOffDspCmd_RHZCU_RHBKBCANFD_100ms_FrP15_CONTROLLER_0_IAM_Rx
        ComIPduGroupRef = Com_RxPduGroup_CONTROLLER_0_IAM
      IACOnOffDspCmd_RHZCU_RHBKBCANFD_100ms_FrP15_CONTROLLER_0_IAM_Rx (ComSignal):
        ComBitPosition = 43
        ComBitSize = 1
        ComHandleId = IACOnOffDspCmd_RHZCU_RHBKBCANFD_100ms_FrP15_CONTROLLER_0_IAM_Rx
        ComInvalidNotification = NULL_PTR
        ComRxDataTimeoutAction = NONE
        ComSignalEndianness = BIG_ENDIAN
        ComSignalInitValue = 0x0
        ComSignalLength = 0
        ComSignalType = BOOLEAN
        ComTransferProperty = PENDING
        ComSignalDataInvalidValue = 0x0
        ComDataInvalidAction = NOTIFY
        ComTimeout = 0.0
        ComFirstTimeout = 0.0
        ComNotification = Rte_COMCbk
      ICBVC_RZCUCANFD_100ms_FrP39_CONTROLLER_0_IAM_Rx (ComIPdu):
        ComIPduCancellationSupport = false
        ComIPduDirection = RECEIVE
        ComIPduHandleId = COM_RXPDU_COM_ICBVC_RZCUCANFD_100ms_FrP39_CONTROLLER_0_IAM_Rx
        ComIPduSignalProcessing = DEFERRED
        ComIPduType = NORMAL
        ComPduIdRef = COM_ICBVC_RZCUCANFD_100ms_FrP39_CONTROLLER_0_IAM_Rx
        ComIPduSignalRef = IRVSSts_ICBVC_RZCUCANFD_100ms_FrP39_CONTROLLER_0_IAM_Rx
        ComIPduGroupRef = Com_RxPduGroup_CONTROLLER_0_IAM
      IRVSSts_ICBVC_RZCUCANFD_100ms_FrP39_CONTROLLER_0_IAM_Rx (ComSignal):
        ComBitPosition = 45
        ComBitSize = 1
        ComHandleId = IRVSSts_ICBVC_RZCUCANFD_100ms_FrP39_CONTROLLER_0_IAM_Rx
        ComInvalidNotification = NULL_PTR
        ComRxDataTimeoutAction = NONE
        ComSignalEndianness = BIG_ENDIAN
        ComSignalInitValue = 0x0
        ComSignalLength = 0
        ComSignalType = BOOLEAN
        ComTransferProperty = PENDING
        ComSignalDataInvalidValue = 0x0
        ComDataInvalidAction = NOTIFY
        ComTimeout = 0.0
        ComFirstTimeout = 0.0
        ComNotification = Rte_COMCbk
      RZCU_LHBKBCANFD_100ms_FrP32_CONTROLLER_0_IAM_Rx (ComIPdu):
        ComIPduCancellationSupport = false
        ComIPduDirection = RECEIVE
        ComIPduHandleId = COM_RXPDU_COM_RZCU_LHBKBCANFD_100ms_FrP32_CONTROLLER_0_IAM_Rx
        ComIPduSignalProcessing = DEFERRED
        ComIPduType = NORMAL
        ComPduIdRef = COM_RZCU_LHBKBCANFD_100ms_FrP32_CONTROLLER_0_IAM_Rx
        ComIPduSignalRef = IPwrLftgtSts_RZCU_LHBKBCANFD_100ms_FrP32_CONTROLLER_0_IAM_Rx
        ComIPduSignalRef = IPwrLftgtManuClsReq_RZCU_LHBKBCANFD_100ms_FrP32_CONTROLLER_0_IAM_Rx
        ComIPduSignalRef = IPwrLftgtPosn_RZCU_LHBKBCANFD_100ms_FrP32_CONTROLLER_0_IAM_Rx
        ComIPduSignalRef = IPwrLftgtSysSts_RZCU_LHBKBCANFD_100ms_FrP32_CONTROLLER_0_IAM_Rx
        ComIPduSignalRef = IPwrLftgtPosnV_RZCU_LHBKBCANFD_100ms_FrP32_CONTROLLER_0_IAM_Rx
        ComIPduGroupRef = Com_RxPduGroup_CONTROLLER_0_IAM
      5 x ComSignal, all with ComInvalidNotification=NULL_PTR, ComRxDataTimeoutAction=NONE, ComSignalEndianness=BIG_ENDIAN, ComSignalInitValue=0x0, ComSignalLength=0, ComTransferProperty=PENDING, ComSignalDataInvalidValue=0x0, ComDataInvalidAction=NOTIFY, ComTimeout=0.0, ComFirstTimeout=0.0, ComNotification=Rte_COMCbk:
        IPwrLftgtSts_RZCU_LHBKBCANFD_100ms_FrP32_CONTROLLER_0_IAM_Rx: ComBitPosition=40, ComBitSize=3, ComHandleId=IPwrLftgtSts_RZCU_LHBKBCANFD_100ms_FrP32_CONTROLLER_0_IAM_Rx, ComSignalType=UINT8
        IPwrLftgtManuClsReq_RZCU_LHBKBCANFD_100ms_FrP32_CONTROLLER_0_IAM_Rx: ComBitPosition=43, ComBitSize=1, ComHandleId=IPwrLftgtManuClsReq_RZCU_LHBKBCANFD_100ms_FrP32_CONTROLLER_0_IAM_Rx, ComSignalType=BOOLEAN
        IPwrLftgtPosn_RZCU_LHBKBCANFD_100ms_FrP32_CONTROLLER_0_IAM_Rx: ComBitPosition=49, ComBitSize=7, ComHandleId=IPwrLftgtPosn_RZCU_LHBKBCANFD_100ms_FrP32_CONTROLLER_0_IAM_Rx, ComSignalType=UINT8
        IPwrLftgtSysSts_RZCU_LHBKBCANFD_100ms_FrP32_CONTROLLER_0_IAM_Rx: ComBitPosition=56, ComBitSize=2, ComHandleId=IPwrLftgtSysSts_RZCU_LHBKBCANFD_100ms_FrP32_CONTROLLER_0_IAM_Rx, ComSignalType=UINT8
        IPwrLftgtPosnV_RZCU_LHBKBCANFD_100ms_FrP32_CONTROLLER_0_IAM_Rx: ComBitPosition=58, ComBitSize=1, ComHandleId=IPwrLftgtPosnV_RZCU_LHBKBCANFD_100ms_FrP32_CONTROLLER_0_IAM_Rx, ComSignalType=BOOLEAN
      RHZCU_RHBKBCANFD_100ms_FrP14_CONTROLLER_0_IAM_Rx (ComIPdu):
        ComIPduCancellationSupport = false
        ComIPduDirection = RECEIVE
        ComIPduHandleId = COM_RXPDU_COM_RHZCU_RHBKBCANFD_100ms_FrP14_CONTROLLER_0_IAM_Rx
        ComIPduSignalProcessing = DEFERRED
        ComIPduType = NORMAL
        ComPduIdRef = COM_RHZCU_RHBKBCANFD_100ms_FrP14_CONTROLLER_0_IAM_Rx
        ComIPduSignalRef = IACVentSts_FrtRt_RHZCU_RHBKBCANFD_100ms_FrP14_CONTROLLER_0_IAM_Rx
        ComIPduSignalRef = IACVentSts_RrRt_RHZCU_RHBKBCANFD_100ms_FrP14_CONTROLLER_0_IAM_Rx
        ComIPduSignalRef = IACVentSts_RrLft_RHZCU_RHBKBCANFD_100ms_FrP14_CONTROLLER_0_IAM_Rx
        ComIPduSignalRef = IACVentSts_FrtLft_RHZCU_RHBKBCANFD_100ms_FrP14_CONTROLLER_0_IAM_Rx
        ComIPduGroupRef = Com_RxPduGroup_CONTROLLER_0_IAM
      4 x ComSignal, all with ComBitSize=2, ComInvalidNotification=NULL_PTR, ComRxDataTimeoutAction=NONE, ComSignalEndianness=BIG_ENDIAN, ComSignalInitValue=0x0, ComSignalLength=0, ComSignalType=UINT8, ComTransferProperty=PENDING, ComSignalDataInvalidValue=0x0, ComDataInvalidAction=NOTIFY, ComTimeout=0.0, ComFirstTimeout=0.0, ComNotification=Rte_COMCbk:
        IACVentSts_FrtRt_RHZCU_RHBKBCANFD_100ms_FrP14_CONTROLLER_0_IAM_Rx: ComBitPosition=38, ComHandleId=IACVentSts_FrtRt_RHZCU_RHBKBCANFD_100ms_FrP14_CONTROLLER_0_IAM_Rx
        IACVentSts_RrRt_RHZCU_RHBKBCANFD_100ms_FrP14_CONTROLLER_0_IAM_Rx: ComBitPosition=49, ComHandleId=IACVentSts_RrRt_RHZCU_RHBKBCANFD_100ms_FrP14_CONTROLLER_0_IAM_Rx
        IACVentSts_RrLft_RHZCU_RHBKBCANFD_100ms_FrP14_CONTROLLER_0_IAM_Rx: ComBitPosition=52, ComHandleId=IACVentSts_RrLft_RHZCU_RHBKBCANFD_100ms_FrP14_CONTROLLER_0_IAM_Rx
        IACVentSts_FrtLft_RHZCU_RHBKBCANFD_100ms_FrP14_CONTROLLER_0_IAM_Rx: ComBitPosition=54, ComHandleId=IACVentSts_FrtLft_RHZCU_RHBKBCANFD_100ms_FrP14_CONTROLLER_0_IAM_Rx
      ESS_PTEXTDCAN_100ms_FrP27_CONTROLLER_0_IAM_Rx (ComIPdu):
        ComIPduCancellationSupport = false
        ComIPduDirection = RECEIVE
        ComIPduHandleId = COM_RXPDU_COM_ESS_PTEXTDCAN_100ms_FrP27_CONTROLLER_0_IAM_Rx
        ComIPduSignalProcessing = DEFERRED
        ComIPduType = NORMAL
        ComIPduCallout = ESS_PTEXTDCAN_100ms_FrP27_CONTROLLER_0_IAM_Rx
        ComPduIdRef = COM_ESS_PTEXTDCAN_100ms_FrP27_CONTROLLER_0_IAM_Rx
        ComIPduSignalGroupRef = IESS_100ms_Group27_ESS_PTEXTDCAN_100ms_FrP27_CONTROLLER_0_IAM_Rx
        ComIPduGroupRef = Com_RxPduGroup_CONTROLLER_0_IAM
      IESS_100ms_Group27_ESS_PTEXTDCAN_100ms_FrP27_CONTROLLER_0_IAM_Rx (ComSignalGroup):
        ComHandleId = IESS_100ms_Group27_ESS_PTEXTDCAN_100ms_FrP27_CONTROLLER_0_IAM_Rx
        ComInvalidNotification = NULL_PTR
        ComRxDataTimeoutAction = NONE
        ComTransferProperty = PENDING
        ComDataInvalidAction = NOTIFY
        ComTimeout = 0.0
        ComFirstTimeout = 0.0
        ComNotification = Rte_COMCbk
        11 x ComGroupSignal, all with ComSignalEndianness=BIG_ENDIAN, ComSignalInitValue=0x0, ComSignalLength=0, ComSignalDataInvalidValue=0x0:
          IESS_100ms_Group27_CRC_IESS_100ms_Group27_ESS_PTEXTDCAN_100ms_FrP27_CONTROLLER_0_IAM_Rx: ComBitPosition=0, ComBitSize=8, ComHandleId=IESS_100ms_Group27_ESS_PTEXTDCAN_100ms_FrP27_CONTROLLER_0_IAM_Rx_IESS_100ms_Group27_CRC_IESS_100ms_Group27_ESS_PTEXTDCAN_100ms_FrP27_CONTROLLER_0_IAM_Rx, ComSignalType=UINT8
          IESS_100ms_Group27_RC_IESS_100ms_Group27_ESS_PTEXTDCAN_100ms_FrP27_CONTROLLER_0_IAM_Rx: ComBitPosition=8, ComBitSize=4, ComHandleId=IESS_100ms_Group27_ESS_PTEXTDCAN_100ms_FrP27_CONTROLLER_0_IAM_Rx_IESS_100ms_Group27_RC_IESS_100ms_Group27_ESS_PTEXTDCAN_100ms_FrP27_CONTROLLER_0_IAM_Rx, ComSignalType=UINT8
          IESS_100ms_Group27_Reserved1_IESS_100ms_Group27_ESS_PTEXTDCAN_100ms_FrP27_CONTROLLER_0_IAM_Rx: ComBitPosition=12, ComBitSize=4, ComHandleId=IESS_100ms_Group27_ESS_PTEXTDCAN_100ms_FrP27_CONTROLLER_0_IAM_Rx_IESS_100ms_Group27_Reserved1_IESS_100ms_Group27_ESS_PTEXTDCAN_100ms_FrP27_CONTROLLER_0_IAM_Rx, ComSignalType=UINT8
          IESS_100ms_Group27_Reserved2_IESS_100ms_Group27_ESS_PTEXTDCAN_100ms_FrP27_CONTROLLER_0_IAM_Rx: ComBitPosition=16, ComBitSize=2, ComHandleId=IESS_100ms_Group27_ESS_PTEXTDCAN_100ms_FrP27_CONTROLLER_0_IAM_Rx_IESS_100ms_Group27_Reserved2_IESS_100ms_Group27_ESS_PTEXTDCAN_100ms_FrP27_CONTROLLER_0_IAM_Rx, ComSignalType=UINT8
          IBMSWrnngInfoBkup_IESS_100ms_Group27_ESS_PTEXTDCAN_100ms_FrP27_CONTROLLER_0_IAM_Rx: ComBitPosition=18, ComBitSize=6, ComHandleId=IESS_100ms_Group27_ESS_PTEXTDCAN_100ms_FrP27_CONTROLLER_0_IAM_Rx_IBMSWrnngInfoBkup_IESS_100ms_Group27_ESS_PTEXTDCAN_100ms_FrP27_CONTROLLER_0_IAM_Rx, ComSignalType=UINT8
          IESS_100ms_Group27_Reserved3_IESS_100ms_Group27_ESS_PTEXTDCAN_100ms_FrP27_CONTROLLER_0_IAM_Rx: ComBitPosition=24, ComBitSize=8, ComHandleId=IESS_100ms_Group27_ESS_PTEXTDCAN_100ms_FrP27_CONTROLLER_0_IAM_Rx_IESS_100ms_Group27_Reserved3_IESS_100ms_Group27_ESS_PTEXTDCAN_100ms_FrP27_CONTROLLER_0_IAM_Rx, ComSignalType=UINT8
          IESS_100ms_Group27_Reserved4_IESS_100ms_Group27_ESS_PTEXTDCAN_100ms_FrP27_CONTROLLER_0_IAM_Rx: ComBitPosition=32, ComBitSize=7, ComHandleId=IESS_100ms_Group27_ESS_PTEXTDCAN_100ms_FrP27_CONTROLLER_0_IAM_Rx_IESS_100ms_Group27_Reserved4_IESS_100ms_Group27_ESS_PTEXTDCAN_100ms_FrP27_CONTROLLER_0_IAM_Rx, ComSignalType=UINT8
          IBMSPreThrmFltIndBkup_IESS_100ms_Group27_ESS_PTEXTDCAN_100ms_FrP27_CONTROLLER_0_IAM_Rx: ComBitPosition=39, ComBitSize=1, ComHandleId=IESS_100ms_Group27_ESS_PTEXTDCAN_100ms_FrP27_CONTROLLER_0_IAM_Rx_IBMSPreThrmFltIndBkup_IESS_100ms_Group27_ESS_PTEXTDCAN_100ms_FrP27_CONTROLLER_0_IAM_Rx, ComSignalType=BOOLEAN
          IESS_100ms_Group27_Reserved5_IESS_100ms_Group27_ESS_PTEXTDCAN_100ms_FrP27_CONTROLLER_0_IAM_Rx: ComBitPosition=40, ComBitSize=8, ComHandleId=IESS_100ms_Group27_ESS_PTEXTDCAN_100ms_FrP27_CONTROLLER_0_IAM_Rx_IESS_100ms_Group27_Reserved5_IESS_100ms_Group27_ESS_PTEXTDCAN_100ms_FrP27_CONTROLLER_0_IAM_Rx, ComSignalType=UINT8
          IESS_100ms_Group27_Reserved6_IESS_100ms_Group27_ESS_PTEXTDCAN_100ms_FrP27_CONTROLLER_0_IAM_Rx: ComBitPosition=48, ComBitSize=8, ComHandleId=IESS_100ms_Group27_ESS_PTEXTDCAN_100ms_FrP27_CONTROLLER_0_IAM_Rx_IESS_100ms_Group27_Reserved6_IESS_100ms_Group27_ESS_PTEXTDCAN_100ms_FrP27_CONTROLLER_0_IAM_Rx, ComSignalType=UINT8
          IESS_100ms_Group27_Reserved7_IESS_100ms_Group27_ESS_PTEXTDCAN_100ms_FrP27_CONTROLLER_0_IAM_Rx: ComBitPosition=56, ComBitSize=8, ComHandleId=IESS_100ms_Group27_ESS_PTEXTDCAN_100ms_FrP27_CONTROLLER_0_IAM_Rx_IESS_100ms_Group27_Reserved7_IESS_100ms_Group27_ESS_PTEXTDCAN_100ms_FrP27_CONTROLLER_0_IAM_Rx, ComSignalType=UINT8
      ICBAD_BKPCANFD_100ms_FrP36_CONTROLLER_0_IAM_Rx (ComIPdu):
        ComIPduCancellationSupport = false
        ComIPduDirection = RECEIVE
        ComIPduHandleId = COM_RXPDU_COM_ICBAD_BKPCANFD_100ms_FrP36_CONTROLLER_0_IAM_Rx
        ComIPduSignalProcessing = DEFERRED
        ComIPduType = NORMAL
        ComPduIdRef = COM_ICBAD_BKPCANFD_100ms_FrP36_CONTROLLER_0_IAM_Rx
        ComIPduSignalRef = IIPDStsResp_ICBAD_BKPCANFD_100ms_FrP36_CONTROLLER_0_IAM_Rx
        ComIPduGroupRef = Com_RxPduGroup_CONTROLLER_0_IAM
      IIPDStsResp_ICBAD_BKPCANFD_100ms_FrP36_CONTROLLER_0_IAM_Rx (ComSignal):
        ComBitPosition = 10
        ComBitSize = 2
        ComHandleId = IIPDStsResp_ICBAD_BKPCANFD_100ms_FrP36_CONTROLLER_0_IAM_Rx
        ComInvalidNotification = NULL_PTR
        ComRxDataTimeoutAction = NONE
        ComSignalEndianness = BIG_ENDIAN
        ComSignalInitValue = 0x0
        ComSignalLength = 0
        ComSignalType = UINT8
        ComTransferProperty = PENDING
        ComSignalDataInvalidValue = 0x0
        ComDataInvalidAction = NOTIFY
        ComTimeout = 0.0
        ComFirstTimeout = 0.0
        ComNotification = Rte_COMCbk
      PEU_ERCANFD_100ms_FrP11_CONTROLLER_0_IAM_Rx (ComIPdu):
        ComIPduCancellationSupport = false
        ComIPduDirection = RECEIVE
        ComIPduHandleId = COM_RXPDU_COM_PEU_ERCANFD_100ms_FrP11_CONTROLLER_0_IAM_Rx
        ComIPduSignalProcessing = DEFERRED
        ComIPduType = NORMAL
        ComPduIdRef = COM_PEU_ERCANFD_100ms_FrP11_CONTROLLER_0_IAM_Rx
        ComIPduSignalRef = ISAMInvtrCrntHiPre_PEU_PEU_ERCANFD_100ms_FrP11_CONTROLLER_0_IAM_Rx
        ComIPduSignalRef = ISAMInvtrOvTemAlrm_PEU_PEU_ERCANFD_100ms_FrP11_CONTROLLER_0_IAM_Rx
        ComIPduSignalRef = IEDUOilPmpMotBusCrnt_PEU_PEU_ERCANFD_100ms_FrP11_CONTROLLER_0_IAM_Rx
        ComIPduSignalRef = ISAMOvSpdAlrm_PEU_PEU_ERCANFD_100ms_FrP11_CONTROLLER_0_IAM_Rx
        ComIPduSignalRef = ISAMOvCrntAlrm_PEU_PEU_ERCANFD_100ms_FrP11_CONTROLLER_0_IAM_Rx
        ComIPduSignalRef = ISAMStrOvTemAlrm_PEU_PEU_ERCANFD_100ms_FrP11_CONTROLLER_0_IAM_Rx
        ComIPduGroupRef = Com_RxPduGroup_CONTROLLER_0_IAM
      6 x ComSignal, all with ComInvalidNotification=NULL_PTR, ComRxDataTimeoutAction=NONE, ComSignalEndianness=BIG_ENDIAN, ComSignalInitValue=0x0, ComSignalLength=0, ComTransferProperty=PENDING, ComSignalDataInvalidValue=0x0, ComDataInvalidAction=NOTIFY, ComTimeout=0.0, ComFirstTimeout=0.0, ComNotification=Rte_COMCbk:
        ISAMInvtrCrntHiPre_PEU_PEU_ERCANFD_100ms_FrP11_CONTROLLER_0_IAM_Rx: ComBitPosition=41, ComBitSize=15, ComHandleId=ISAMInvtrCrntHiPre_PEU_PEU_ERCANFD_100ms_FrP11_CONTROLLER_0_IAM_Rx, ComSignalType=UINT16
        ISAMInvtrOvTemAlrm_PEU_PEU_ERCANFD_100ms_FrP11_CONTROLLER_0_IAM_Rx: ComBitPosition=40, ComBitSize=1, ComHandleId=ISAMInvtrOvTemAlrm_PEU_PEU_ERCANFD_100ms_FrP11_CONTROLLER_0_IAM_Rx, ComSignalType=BOOLEAN
        IEDUOilPmpMotBusCrnt_PEU_PEU_ERCANFD_100ms_FrP11_CONTROLLER_0_IAM_Rx: ComBitPosition=48, ComBitSize=8, ComHandleId=IEDUOilPmpMotBusCrnt_PEU_PEU_ERCANFD_100ms_FrP11_CONTROLLER_0_IAM_Rx, ComSignalType=UINT8
        ISAMOvSpdAlrm_PEU_PEU_ERCANFD_100ms_FrP11_CONTROLLER_0_IAM_Rx: ComBitPosition=59, ComBitSize=1, ComHandleId=ISAMOvSpdAlrm_PEU_PEU_ERCANFD_100ms_FrP11_CONTROLLER_0_IAM_Rx, ComSignalType=BOOLEAN
        ISAMOvCrntAlrm_PEU_PEU_ERCANFD_100ms_FrP11_CONTROLLER_0_IAM_Rx: ComBitPosition=60, ComBitSize=1, ComHandleId=ISAMOvCrntAlrm_PEU_PEU_ERCANFD_100ms_FrP11_CONTROLLER_0_IAM_Rx, ComSignalType=BOOLEAN
        ISAMStrOvTemAlrm_PEU_PEU_ERCANFD_100ms_FrP11_CONTROLLER_0_IAM_Rx: ComBitPosition=61, ComBitSize=1, ComHandleId=ISAMStrOvTemAlrm_PEU_PEU_ERCANFD_100ms_FrP11_CONTROLLER_0_IAM_Rx, ComSignalType=BOOLEAN
      ICB_BKBCANFD_100ms_FrP221_CONTROLLER_0_IAM_Rx (ComIPdu):
        ComIPduCancellationSupport = false
        ComIPduDirection = RECEIVE
        ComIPduHandleId = COM_RXPDU_COM_ICB_BKBCANFD_100ms_FrP221_CONTROLLER_0_IAM_Rx
        ComIPduSignalProcessing = DEFERRED
        ComIPduType = NORMAL
        ComPduIdRef = COM_ICB_BKBCANFD_100ms_FrP221_CONTROLLER_0_IAM_Rx
        ComIPduSignalRef = ILbl{1..3}FrgrLife_ICB_BKBCANFD_100ms_FrP221_CONTROLLER_0_IAM_Rx
        ComIPduSignalRef = ILbl{1..3}FrgrAvlbl_ICB_BKBCANFD_100ms_FrP221_CONTROLLER_0_IAM_Rx
        ComIPduSignalRef = ILbl1FrgrExpiryFlg_ICB_BKBCANFD_100ms_FrP221_CONTROLLER_0_IAM_Rx
        ComIPduSignalRef = ILbl3FrgrExpiryFlg_ICB_BKBCANFD_100ms_FrP221_CONTROLLER_0_IAM_Rx
        ComIPduSignalRef = ILbl2FrgrExpiryFlg_ICB_BKBCANFD_100ms_FrP221_CONTROLLER_0_IAM_Rx
        ComIPduGroupRef = Com_RxPduGroup_CONTROLLER_0_IAM
      9 x ComSignal, all with ComInvalidNotification=NULL_PTR, ComRxDataTimeoutAction=NONE, ComSignalEndianness=BIG_ENDIAN, ComSignalInitValue=0x0, ComSignalLength=0, ComTransferProperty=PENDING, ComSignalDataInvalidValue=0x0, ComDataInvalidAction=NOTIFY, ComTimeout=0.0, ComFirstTimeout=0.0, ComNotification=Rte_COMCbk:
        ILbl1FrgrLife_ICB_BKBCANFD_100ms_FrP221_CONTROLLER_0_IAM_Rx: ComBitPosition=16, ComBitSize=8, ComHandleId=ILbl1FrgrLife_ICB_BKBCANFD_100ms_FrP221_CONTROLLER_0_IAM_Rx, ComSignalType=UINT8
        ILbl2FrgrLife_ICB_BKBCANFD_100ms_FrP221_CONTROLLER_0_IAM_Rx: ComBitPosition=24, ComBitSize=8, ComHandleId=ILbl2FrgrLife_ICB_BKBCANFD_100ms_FrP221_CONTROLLER_0_IAM_Rx, ComSignalType=UINT8
        ILbl3FrgrLife_ICB_BKBCANFD_100ms_FrP221_CONTROLLER_0_IAM_Rx: ComBitPosition=32, ComBitSize=8, ComHandleId=ILbl3FrgrLife_ICB_BKBCANFD_100ms_FrP221_CONTROLLER_0_IAM_Rx, ComSignalType=UINT8
        ILbl1FrgrAvlbl_ICB_BKBCANFD_100ms_FrP221_CONTROLLER_0_IAM_Rx: ComBitPosition=40, ComBitSize=8, ComHandleId=ILbl1FrgrAvlbl_ICB_BKBCANFD_100ms_FrP221_CONTROLLER_0_IAM_Rx, ComSignalType=UINT8
        ILbl2FrgrAvlbl_ICB_BKBCANFD_100ms_FrP221_CONTROLLER_0_IAM_Rx: ComBitPosition=48, ComBitSize=8, ComHandleId=ILbl2FrgrAvlbl_ICB_BKBCANFD_100ms_FrP221_CONTROLLER_0_IAM_Rx, ComSignalType=UINT8
        ILbl3FrgrAvlbl_ICB_BKBCANFD_100ms_FrP221_CONTROLLER_0_IAM_Rx: ComBitPosition=56, ComBitSize=8, ComHandleId=ILbl3FrgrAvlbl_ICB_BKBCANFD_100ms_FrP221_CONTROLLER_0_IAM_Rx, ComSignalType=UINT8
        ILbl1FrgrExpiryFlg_ICB_BKBCANFD_100ms_FrP221_CONTROLLER_0_IAM_Rx: ComBitPosition=104, ComBitSize=1, ComHandleId=ILbl1FrgrExpiryFlg_ICB_BKBCANFD_100ms_FrP221_CONTROLLER_0_IAM_Rx, ComSignalType=BOOLEAN
        ILbl3FrgrExpiryFlg_ICB_BKBCANFD_100ms_FrP221_CONTROLLER_0_IAM_Rx: ComBitPosition=126, ComBitSize=1, ComHandleId=ILbl3FrgrExpiryFlg_ICB_BKBCANFD_100ms_FrP221_CONTROLLER_0_IAM_Rx, ComSignalType=BOOLEAN
        ILbl2FrgrExpiryFlg_ICB_BKBCANFD_100ms_FrP221_CONTROLLER_0_IAM_Rx: ComBitPosition=127, ComBitSize=1, ComHandleId=ILbl2FrgrExpiryFlg_ICB_BKBCANFD_100ms_FrP221_CONTROLLER_0_IAM_Rx, ComSignalType=BOOLEAN
      RHZCU_RHBKBCANFD_100ms_FrP13_CONTROLLER_0_IAM_Rx (ComIPdu):
        ComIPduCancellationSupport = false
        ComIPduDirection = RECEIVE
        ComIPduHandleId = COM_RXPDU_COM_RHZCU_RHBKBCANFD_100ms_FrP13_CONTROLLER_0_IAM_Rx
        ComIPduSignalProcessing = DEFERRED
        ComIPduType = NORMAL
        ComPduIdRef = COM_RHZCU_RHBKBCANFD_100ms_FrP13_CONTROLLER_0_IAM_Rx
        ComIPduSignalRef = IACFrtInCarTem_RHZCU_RHBKBCANFD_100ms_FrP13_CONTROLLER_0_IAM_Rx
        ComIPduGroupRef = Com_RxPduGroup_CONTROLLER_0_IAM
      IACFrtInCarTem_RHZCU_RHBKBCANFD_100ms_FrP13_CONTROLLER_0_IAM_Rx (ComSignal):
        ComBitPosition = 56
        ComBitSize = 8
        ComHandleId = IACFrtInCarTem_RHZCU_RHBKBCANFD_100ms_FrP13_CONTROLLER_0_IAM_Rx
        ComInvalidNotification = NULL_PTR
        ComRxDataTimeoutAction = NONE
        ComSignalEndianness = BIG_ENDIAN
        ComSignalInitValue = 0x0
        ComSignalLength = 0
        ComSignalType = UINT8
        ComTransferProperty = PENDING
        ComSignalDataInvalidValue = 0x0
        ComDataInvalidAction = NOTIFY
        ComTimeout = 0.0
        ComFirstTimeout = 0.0
        ComNotification = Rte_COMCbk
      ICBVC_RZCUCANFD_100ms_FrP80_CONTROLLER_0_IAM_Rx (ComIPdu):
        ComIPduCancellationSupport = false
        ComIPduDirection = RECEIVE
        ComIPduHandleId = COM_RXPDU_COM_ICBVC_RZCUCANFD_100ms_FrP80_CONTROLLER_0_IAM_Rx
        ComIPduSignalProcessing = DEFERRED
        ComIPduType = NORMAL
        ComIPduCallout = ICBVC_RZCUCANFD_100ms_FrP80_CONTROLLER_0_IAM_Rx
        ComPduIdRef = COM_ICBVC_RZCUCANFD_100ms_FrP80_CONTROLLER_0_IAM_Rx
        ComIPduSignalGroupRef = IICBVC_100ms_Group80_ICBVC_RZCUCANFD_100ms_FrP80_CONTROLLER_0_IAM_Rx
        ComIPduGroupRef = Com_RxPduGroup_CONTROLLER_0_IAM
      IICBVC_100ms_Group80_ICBVC_RZCUCANFD_100ms_FrP80_CONTROLLER_0_IAM_Rx (ComSignalGroup):
        ComHandleId = IICBVC_100ms_Group80_ICBVC_RZCUCANFD_100ms_FrP80_CONTROLLER_0_IAM_Rx
        ComInvalidNotification = NULL_PTR
        ComRxDataTimeoutAction = NONE
        ComTransferProperty = PENDING
        ComDataInvalidAction = NOTIFY
        ComTimeout = 0.0
        ComFirstTimeout = 0.0
        ComNotification = Rte_COMCbk
        11 x ComGroupSignal, all with ComSignalEndianness=BIG_ENDIAN, ComSignalInitValue=0x0, ComSignalLength=0, ComSignalDataInvalidValue=0x0:
          IICBVC_100ms_Group80_CRC_IICBVC_100ms_Group80_ICBVC_RZCUCANFD_100ms_FrP80_CONTROLLER_0_IAM_Rx: ComBitPosition=0, ComBitSize=8, ComHandleId=IICBVC_100ms_Group80_ICBVC_RZCUCANFD_100ms_FrP80_CONTROLLER_0_IAM_Rx_IICBVC_100ms_Group80_CRC_IICBVC_100ms_Group80_ICBVC_RZCUCANFD_100ms_FrP80_CONTROLLER_0_IAM_Rx, ComSignalType=UINT8
          IICBVC_100ms_Group80_RC_IICBVC_100ms_Group80_ICBVC_RZCUCANFD_100ms_FrP80_CONTROLLER_0_IAM_Rx: ComBitPosition=8, ComBitSize=4, ComHandleId=IICBVC_100ms_Group80_ICBVC_RZCUCANFD_100ms_FrP80_CONTROLLER_0_IAM_Rx_IICBVC_100ms_Group80_RC_IICBVC_100ms_Group80_ICBVC_RZCUCANFD_100ms_FrP80_CONTROLLER_0_IAM_Rx, ComSignalType=UINT8
          IVehDrvngMd_IICBVC_100ms_Group80_ICBVC_RZCUCANFD_100ms_FrP80_CONTROLLER_0_IAM_Rx: ComBitPosition=12, ComBitSize=4, ComHandleId=IICBVC_100ms_Group80_ICBVC_RZCUCANFD_100ms_FrP80_CONTROLLER_0_IAM_Rx_IVehDrvngMd_IICBVC_100ms_Group80_ICBVC_RZCUCANFD_100ms_FrP80_CONTROLLER_0_IAM_Rx, ComSignalType=UINT8
          IVehOdo_IICBVC_100ms_Group80_ICBVC_RZCUCANFD_100ms_FrP80_CONTROLLER_0_IAM_Rx: ComBitPosition=32, ComBitSize=24, ComHandleId=IICBVC_100ms_Group80_ICBVC_RZCUCANFD_100ms_FrP80_CONTROLLER_0_IAM_Rx_IVehOdo_IICBVC_100ms_Group80_ICBVC_RZCUCANFD_100ms_FrP80_CONTROLLER_0_IAM_Rx, ComSignalType=UINT32
          IICBVC_100ms_Group80_Reserved1_IICBVC_100ms_Group80_ICBVC_RZCUCANFD_100ms_FrP80_CONTROLLER_0_IAM_Rx: ComBitPosition=40, ComBitSize=4, ComHandleId=IICBVC_100ms_Group80_ICBVC_RZCUCANFD_100ms_FrP80_CONTROLLER_0_IAM_Rx_IICBVC_100ms_Group80_Reserved1_IICBVC_100ms_Group80_ICBVC_RZCUCANFD_100ms_FrP80_CONTROLLER_0_IAM_Rx, ComSignalType=UINT8
          IVehLdShedLvl_IICBVC_100ms_Group80_ICBVC_RZCUCANFD_100ms_FrP80_CONTROLLER_0_IAM_Rx: ComBitPosition=44, ComBitSize=3, ComHandleId=IICBVC_100ms_Group80_ICBVC_RZCUCANFD_100ms_FrP80_CONTROLLER_0_IAM_Rx_IVehLdShedLvl_IICBVC_100ms_Group80_ICBVC_RZCUCANFD_100ms_FrP80_CONTROLLER_0_IAM_Rx, ComSignalType=UINT8
          IVehOdoV_IICBVC_100ms_Group80_ICBVC_RZCUCANFD_100ms_FrP80_CONTROLLER_0_IAM_Rx: ComBitPosition=47, ComBitSize=1, ComHandleId=IICBVC_100ms_Group80_ICBVC_RZCUCANFD_100ms_FrP80_CONTROLLER_0_IAM_Rx_IVehOdoV_IICBVC_100ms_Group80_ICBVC_RZCUCANFD_100ms_FrP80_CONTROLLER_0_IAM_Rx, ComSignalType=BOOLEAN
          IICBVC_100ms_Group80_Reserved2_IICBVC_100ms_Group80_ICBVC_RZCUCANFD_100ms_FrP80_CONTROLLER_0_IAM_Rx: ComBitPosition=48, ComBitSize=8, ComHandleId=IICBVC_100ms_Group80_ICBVC_RZCUCANFD_100ms_FrP80_CONTROLLER_0_IAM_Rx_IICBVC_100ms_Group80_Reserved2_IICBVC_100ms_Group80_ICBVC_RZCUCANFD_100ms_FrP80_CONTROLLER_0_IAM_Rx, ComSignalType=UINT8
          IFrtPsngAirbagSwStsReqV_Sfty_IICBVC_100ms_Group80_ICBVC_RZCUCANFD_100ms_FrP80_CONTROLLER_0_IAM_Rx: ComBitPosition=56, ComBitSize=1, ComHandleId=IICBVC_100ms_Group80_ICBVC_RZCUCANFD_100ms_FrP80_CONTROLLER_0_IAM_Rx_IFrtPsngAirbagSwStsReqV_Sfty_IICBVC_100ms_Group80_ICBVC_RZCUCANFD_100ms_FrP80_CONTROLLER_0_IAM_Rx, ComSignalType=BOOLEAN
          IFrtPsngAirbagSwStsReq_Sfty_IICBVC_100ms_Group80_ICBVC_RZCUCANFD_100ms_FrP80_CONTROLLER_0_IAM_Rx: ComBitPosition=57, ComBitSize=1, ComHandleId=IICBVC_100ms_Group80_ICBVC_RZCUCANFD_100ms_FrP80_CONTROLLER_0_IAM_Rx_IFrtPsngAirbagSwStsReq_Sfty_IICBVC_100ms_Group80_ICBVC_RZCUCANFD_100ms_FrP80_CONTROLLER_0_IAM_Rx, ComSignalType=BOOLEAN
          IICBVC_100ms_Group80_Reserved3_IICBVC_100ms_Group80_ICBVC_RZCUCANFD_100ms_FrP80_CONTROLLER_0_IAM_Rx: ComBitPosition=58, ComBitSize=6, ComHandleId=IICBVC_100ms_Group80_ICBVC_RZCUCANFD_100ms_FrP80_CONTROLLER_0_IAM_Rx_IICBVC_100ms_Group80_Reserved3_IICBVC_100ms_Group80_ICBVC_RZCUCANFD_100ms_FrP80_CONTROLLER_0_IAM_Rx, ComSignalType=UINT8
      ESS_PTEXTDCAN_100ms_FrP24_CONTROLLER_0_IAM_Rx (ComIPdu):
        ComIPduCancellationSupport = false
        ComIPduDirection = RECEIVE
        ComIPduHandleId = COM_RXPDU_COM_ESS_PTEXTDCAN_100ms_FrP24_CONTROLLER_0_IAM_Rx
        ComIPduSignalProcessing = DEFERRED
        ComIPduType = NORMAL
        ComPduIdRef = COM_ESS_PTEXTDCAN_100ms_FrP24_CONTROLLER_0_IAM_Rx
        ComIPduSignalRef = IBMSBatPrsAlrmBkup_ESS_PTEXTDCAN_100ms_FrP24_CONTROLLER_0_IAM_Rx
        ComIPduSignalRef = IBMSBatPrsAlrmVBkup_ESS_PTEXTDCAN_100ms_FrP24_CONTROLLER_0_IAM_Rx
        ComIPduGroupRef = Com_RxPduGroup_CONTROLLER_0_IAM
      IBMSBatPrsAlrmBkup_ESS_PTEXTDCAN_100ms_FrP24_CONTROLLER_0_IAM_Rx (ComSignal):
        ComBitPosition = 60
        ComBitSize = 1
        ComHandleId = IBMSBatPrsAlrmBkup_ESS_PTEXTDCAN_100ms_FrP24_CONTROLLER_0_IAM_Rx
        ComInvalidNotification = NULL_PTR
        ComRxDataTimeoutAction = NONE
        ComSignalEndianness = BIG_ENDIAN
        ComSignalInitValue = 0x0
        ComSignalLength = 0
        ComSignalType = BOOLEAN
        ComTransferProperty = PENDING
        ComSignalDataInvalidValue = 0x0
        ComDataInvalidAction = NOTIFY
        ComTimeout = 0.0
        ComFirstTimeout = 0.0
        ComNotification = Rte_COMCbk
      IBMSBatPrsAlrmVBkup_ESS_PTEXTDCAN_100ms_FrP24_CONTROLLER_0_IAM_Rx (ComSignal):
        ComBitPosition = 61
        ComBitSize = 1
        ComHandleId = IBMSBatPrsAlrmVBkup_ESS_PTEXTDCAN_100ms_FrP24_CONTROLLER_0_IAM_Rx
        ComInvalidNotification = NULL_PTR
        ComRxDataTimeoutAction = NONE
        ComSignalEndianness = BIG_ENDIAN
        ComSignalInitValue = 0x0
        ComSignalLength = 0
        ComSignalType = BOOLEAN
        ComTransferProperty = PENDING
        ComSignalDataInvalidValue = 0x0
        ComDataInvalidAction = NOTIFY
        ComTimeout = 0.0
        ComFirstTimeout = 0.0
        ComNotification = Rte_COMCbk
      RZCU_RZCUCANFD_100ms_FrP82_CONTROLLER_0_IAM_Rx (ComIPdu):
        ComIPduCancellationSupport = false
        ComIPduDirection = RECEIVE
        ComIPduHandleId = COM_RXPDU_COM_RZCU_RZCUCANFD_100ms_FrP82_CONTROLLER_0_IAM_Rx
        ComIPduSignalProcessing = DEFERRED
        ComIPduType = NORMAL
        ComPduIdRef = COM_RZCU_RZCUCANFD_100ms_FrP82_CONTROLLER_0_IAM_Rx
        ComIPduSignalRef = IFICMReserChrgSts_RZCU_RZCUCANFD_100ms_FrP82_CONTROLLER_0_IAM_Rx
        ComIPduGroupRef = Com_RxPduGroup_CONTROLLER_0_IAM
      IFICMReserChrgSts_RZCU_RZCUCANFD_100ms_FrP82_CONTROLLER_0_IAM_Rx (ComSignal):
        ComBitPosition = 40
        ComBitSize = 2
        ComHandleId = IFICMReserChrgSts_RZCU_RZCUCANFD_100ms_FrP82_CONTROLLER_0_IAM_Rx
        ComInvalidNotification = NULL_PTR
        ComRxDataTimeoutAction = NONE
        ComSignalEndianness = BIG_ENDIAN
        ComSignalInitValue = 0x0
        ComSignalLength = 0
        ComSignalType = UINT8
        ComTransferProperty = PENDING
        ComSignalDataInvalidValue = 0x0
        ComDataInvalidAction = NOTIFY
        ComTimeout = 0.0
        ComFirstTimeout = 0.0
        ComNotification = Rte_COMCbk
      RHZCU_RHBKBCANFD_100ms_FrP19_CONTROLLER_0_IAM_Rx (ComIPdu):
        ComIPduCancellationSupport = false
        ComIPduDirection = RECEIVE
        ComIPduHandleId = COM_RXPDU_COM_RHZCU_RHBKBCANFD_100ms_FrP19_CONTROLLER_0_IAM_Rx
        ComIPduSignalProcessing = DEFERRED
        ComIPduType = NORMAL
        ComPduIdRef = COM_RHZCU_RHBKBCANFD_100ms_FrP19_CONTROLLER_0_IAM_Rx
        ComIPduSignalRef = IRmtACRmningTime_RHZCU_RHBKBCANFD_100ms_FrP19_CONTROLLER_0_IAM_Rx
        ComIPduSignalRef = IRmtBattWarmSts_RHZCU_RHBKBCANFD_100ms_FrP19_CONTROLLER_0_IAM_Rx
        ComIPduSignalRef = IRmtBattWarmAbotRsn_RHZCU_RHBKBCANFD_100ms_FrP19_CONTROLLER_0_IAM_Rx
        ComIPduGroupRef = Com_RxPduGroup_CONTROLLER_0_IAM
      3 x ComSignal, all with ComInvalidNotification=NULL_PTR, ComRxDataTimeoutAction=NONE, ComSignalEndianness=BIG_ENDIAN, ComSignalInitValue=0x0, ComSignalLength=0, ComSignalType=UINT8, ComTransferProperty=PENDING, ComSignalDataInvalidValue=0x0, ComDataInvalidAction=NOTIFY, ComTimeout=0.0, ComFirstTimeout=0.0, ComNotification=Rte_COMCbk:
        IRmtACRmningTime_RHZCU_RHBKBCANFD_100ms_FrP19_CONTROLLER_0_IAM_Rx: ComBitPosition=16, ComBitSize=8, ComHandleId=IRmtACRmningTime_RHZCU_RHBKBCANFD_100ms_FrP19_CONTROLLER_0_IAM_Rx
        IRmtBattWarmSts_RHZCU_RHBKBCANFD_100ms_FrP19_CONTROLLER_0_IAM_Rx: ComBitPosition=24, ComBitSize=3, ComHandleId=IRmtBattWarmSts_RHZCU_RHBKBCANFD_100ms_FrP19_CONTROLLER_0_IAM_Rx
        IRmtBattWarmAbotRsn_RHZCU_RHBKBCANFD_100ms_FrP19_CONTROLLER_0_IAM_Rx: ComBitPosition=36, ComBitSize=4, ComHandleId=IRmtBattWarmAbotRsn_RHZCU_RHBKBCANFD_100ms_FrP19_CONTROLLER_0_IAM_Rx
      LVBM_PTEXTDCAN_100ms_FrP04_CONTROLLER_0_IAM_Rx (ComIPdu):
        ComIPduCancellationSupport = false
        ComIPduDirection = RECEIVE
        ComIPduHandleId = COM_RXPDU_COM_LVBM_PTEXTDCAN_100ms_FrP04_CONTROLLER_0_IAM_Rx
        ComIPduSignalProcessing = DEFERRED
        ComIPduType = NORMAL
        ComIPduCallout = LVBM_PTEXTDCAN_100ms_FrP04_CONTROLLER_0_IAM_Rx
        ComPduIdRef = COM_LVBM_PTEXTDCAN_100ms_FrP04_CONTROLLER_0_IAM_Rx
        ComIPduSignalGroupRef = ILVBM_100ms_Group01_LVBM_PTEXTDCAN_100ms_FrP04_CONTROLLER_0_IAM_Rx
        ComIPduGroupRef = Com_RxPduGroup_CONTROLLER_0_IAM
      ILVBM_100ms_Group01_LVBM_PTEXTDCAN_100ms_FrP04_CONTROLLER_0_IAM_Rx (ComSignalGroup):
        ComHandleId = ILVBM_100ms_Group01_LVBM_PTEXTDCAN_100ms_FrP04_CONTROLLER_0_IAM_Rx
        ComInvalidNotification = NULL_PTR
        ComRxDataTimeoutAction = NONE
        ComTransferProperty = PENDING
        ComDataInvalidAction = NOTIFY
        ComTimeout = 0.0
        ComFirstTimeout = 0.0
        ComNotification = Rte_COMCbk
        12 x ComGroupSignal, all with ComSignalEndianness=BIG_ENDIAN, ComSignalInitValue=0x0, ComSignalLength=0, ComSignalType=UINT8, ComSignalDataInvalidValue=0x0:
          ILVBM_Group03_CRC_ILVBM_100ms_Group01_LVBM_PTEXTDCAN_100ms_FrP04_CONTROLLER_0_IAM_Rx: ComBitPosition=0, ComBitSize=8, ComHandleId=ILVBM_100ms_Group01_LVBM_PTEXTDCAN_100ms_FrP04_CONTROLLER_0_IAM_Rx_ILVBM_Group03_CRC_ILVBM_100ms_Group01_LVBM_PTEXTDCAN_100ms_FrP04_CONTROLLER_0_IAM_Rx
          ILVBM_Group03_RC_ILVBM_100ms_Group01_LVBM_PTEXTDCAN_100ms_FrP04_CONTROLLER_0_IAM_Rx: ComBitPosition=8, ComBitSize=4, ComHandleId=ILVBM_100ms_Group01_LVBM_PTEXTDCAN_100ms_FrP04_CONTROLLER_0_IAM_Rx_ILVBM_Group03_RC_ILVBM_100ms_Group01_LVBM_PTEXTDCAN_100ms_FrP04_CONTROLLER_0_IAM_Rx
          ILVBM_100ms_Group01_Reserved1_ILVBM_100ms_Group01_LVBM_PTEXTDCAN_100ms_FrP04_CONTROLLER_0_IAM_Rx: ComBitPosition=12, ComBitSize=4, ComHandleId=ILVBM_100ms_Group01_LVBM_PTEXTDCAN_100ms_FrP04_CONTROLLER_0_IAM_Rx_ILVBM_100ms_Group01_Reserved1_ILVBM_100ms_Group01_LVBM_PTEXTDCAN_100ms_FrP04_CONTROLLER_0_IAM_Rx
          ILVBM_100ms_Group01_Reserved2_ILVBM_100ms_Group01_LVBM_PTEXTDCAN_100ms_FrP04_CONTROLLER_0_IAM_Rx: ComBitPosition=16, ComBitSize=8, ComHandleId=ILVBM_100ms_Group01_LVBM_PTEXTDCAN_100ms_FrP04_CONTROLLER_0_IAM_Rx_ILVBM_100ms_Group01_Reserved2_ILVBM_100ms_Group01_LVBM_PTEXTDCAN_100ms_FrP04_CONTROLLER_0_IAM_Rx
          ILVBM_100ms_Group01_Reserved3_ILVBM_100ms_Group01_LVBM_PTEXTDCAN_100ms_FrP04_CONTROLLER_0_IAM_Rx: ComBitPosition=24, ComBitSize=8, ComHandleId=ILVBM_100ms_Group01_LVBM_PTEXTDCAN_100ms_FrP04_CONTROLLER_0_IAM_Rx_ILVBM_100ms_Group01_Reserved3_ILVBM_100ms_Group01_LVBM_PTEXTDCAN_100ms_FrP04_CONTROLLER_0_IAM_Rx
          ILVBM_100ms_Group01_Reserved4_ILVBM_100ms_Group01_LVBM_PTEXTDCAN_100ms_FrP04_CONTROLLER_0_IAM_Rx: ComBitPosition=32, ComBitSize=8, ComHandleId=ILVBM_100ms_Group01_LVBM_PTEXTDCAN_100ms_FrP04_CONTROLLER_0_IAM_Rx_ILVBM_100ms_Group01_Reserved4_ILVBM_100ms_Group01_LVBM_PTEXTDCAN_100ms_FrP04_CONTROLLER_0_IAM_Rx
          ILVBM_100ms_Group01_Reserved5_ILVBM_100ms_Group01_LVBM_PTEXTDCAN_100ms_FrP04_CONTROLLER_0_IAM_Rx: ComBitPosition=40, ComBitSize=8, ComHandleId=ILVBM_100ms_Group01_LVBM_PTEXTDCAN_100ms_FrP04_CONTROLLER_0_IAM_Rx_ILVBM_100ms_Group01_Reserved5_ILVBM_100ms_Group01_LVBM_PTEXTDCAN_100ms_FrP04_CONTROLLER_0_IAM_Rx
          ILVBM_100ms_Group01_Reserved6_ILVBM_100ms_Group01_LVBM_PTEXTDCAN_100ms_FrP04_CONTROLLER_0_IAM_Rx: ComBitPosition=48, ComBitSize=2, ComHandleId=ILVBM_100ms_Group01_LVBM_PTEXTDCAN_100ms_FrP04_CONTROLLER_0_IAM_Rx_ILVBM_100ms_Group01_Reserved6_ILVBM_100ms_Group01_LVBM_PTEXTDCAN_100ms_FrP04_CONTROLLER_0_IAM_Rx
          ILVBMAlrmSts_ILVBM_100ms_Group01_LVBM_PTEXTDCAN_100ms_FrP04_CONTROLLER_0_IAM_Rx: ComBitPosition=50, ComBitSize=6, ComHandleId=ILVBM_100ms_Group01_LVBM_PTEXTDCAN_100ms_FrP04_CONTROLLER_0_IAM_Rx_ILVBMAlrmSts_ILVBM_100ms_Group01_LVBM_PTEXTDCAN_100ms_FrP04_CONTROLLER_0_IAM_Rx
          ILVBM_100ms_Group01_Reserved7_ILVBM_100ms_Group01_LVBM_PTEXTDCAN_100ms_FrP04_CONTROLLER_0_IAM_Rx: ComBitPosition=56, ComBitSize=2, ComHandleId=ILVBM_100ms_Group01_LVBM_PTEXTDCAN_100ms_FrP04_CONTROLLER_0_IAM_Rx_ILVBM_100ms_Group01_Reserved7_ILVBM_100ms_Group01_LVBM_PTEXTDCAN_100ms_FrP04_CONTROLLER_0_IAM_Rx
          ILVBMHdwrFltSts_ILVBM_100ms_Group01_LVBM_PTEXTDCAN_100ms_FrP04_CONTROLLER_0_IAM_Rx: ComBitPosition=58, ComBitSize=3, ComHandleId=ILVBM_100ms_Group01_LVBM_PTEXTDCAN_100ms_FrP04_CONTROLLER_0_IAM_Rx_ILVBMHdwrFltSts_ILVBM_100ms_Group01_LVBM_PTEXTDCAN_100ms_FrP04_CONTROLLER_0_IAM_Rx
          ILVBMFltLvl_ILVBM_100ms_Group01_LVBM_PTEXTDCAN_100ms_FrP04_CONTROLLER_0_IAM_Rx: ComBitPosition=61, ComBitSize=3, ComHandleId=ILVBM_100ms_Group01_LVBM_PTEXTDCAN_100ms_FrP04_CONTROLLER_0_IAM_Rx_ILVBMFltLvl_ILVBM_100ms_Group01_LVBM_PTEXTDCAN_100ms_FrP04_CONTROLLER_0_IAM_Rx
      TC_PTCANFD_100ms_FrP05_CONTROLLER_0_IAM_Rx (ComIPdu):
        ComIPduCancellationSupport = false
        ComIPduDirection = RECEIVE
        ComIPduHandleId = COM_RXPDU_COM_TC_PTCANFD_100ms_FrP05_CONTROLLER_0_IAM_Rx
        ComIPduSignalProcessing = DEFERRED
        ComIPduType = NORMAL
        ComPduIdRef = COM_TC_PTCANFD_100ms_FrP05_CONTROLLER_0_IAM_Rx
        ComIPduSignalRef = ITMInvtrTem_TC_PTCANFD_100ms_FrP05_CONTROLLER_0_IAM_Rx
        ComIPduSignalRef = ITMStrOvTemAlrm_TC_PTCANFD_100ms_FrP05_CONTROLLER_0_IAM_Rx
        ComIPduSignalRef = ITMSttrTem_TC_PTCANFD_100ms_FrP05_CONTROLLER_0_IAM_Rx
        ComIPduSignalRef = ITMOvSpdAlrm_TC_PTCANFD_100ms_FrP05_CONTROLLER_0_IAM_Rx
        ComIPduSignalRef = ITMInvtrOvTemAlrm_TC_PTCANFD_100ms_FrP05_CONTROLLER_0_IAM_Rx
        ComIPduSignalRef = ITMOvCrntAlrm_TC_PTCANFD_100ms_FrP05_CONTROLLER_0_IAM_Rx
        ComIPduGroupRef = Com_RxPduGroup_CONTROLLER_0_IAM
      6 x ComSignal, all with ComInvalidNotification=NULL_PTR, ComRxDataTimeoutAction=NONE, ComSignalEndianness=BIG_ENDIAN, ComSignalInitValue=0x0, ComSignalLength=0, ComTransferProperty=PENDING, ComSignalDataInvalidValue=0x0, ComDataInvalidAction=NOTIFY, ComTimeout=0.0, ComFirstTimeout=0.0, ComNotification=Rte_COMCbk:
        ITMInvtrTem_TC_PTCANFD_100ms_FrP05_CONTROLLER_0_IAM_Rx: ComBitPosition=16, ComBitSize=8, ComHandleId=ITMInvtrTem_TC_PTCANFD_100ms_FrP05_CONTROLLER_0_IAM_Rx, ComSignalType=UINT8
        ITMStrOvTemAlrm_TC_PTCANFD_100ms_FrP05_CONTROLLER_0_IAM_Rx: ComBitPosition=24, ComBitSize=1, ComHandleId=ITMStrOvTemAlrm_TC_PTCANFD_100ms_FrP05_CONTROLLER_0_IAM_Rx, ComSignalType=BOOLEAN
        ITMSttrTem_TC_PTCANFD_100ms_FrP05_CONTROLLER_0_IAM_Rx: ComBitPosition=32, ComBitSize=8, ComHandleId=ITMSttrTem_TC_PTCANFD_100ms_FrP05_CONTROLLER_0_IAM_Rx, ComSignalType=UINT8
        ITMOvSpdAlrm_TC_PTCANFD_100ms_FrP05_CONTROLLER_0_IAM_Rx: ComBitPosition=41, ComBitSize=1, ComHandleId=ITMOvSpdAlrm_TC_PTCANFD_100ms_FrP05_CONTROLLER_0_IAM_Rx, ComSignalType=BOOLEAN
        ITMInvtrOvTemAlrm_TC_PTCANFD_100ms_FrP05_CONTROLLER_0_IAM_Rx: ComBitPosition=42, ComBitSize=1, ComHandleId=ITMInvtrOvTemAlrm_TC_PTCANFD_100ms_FrP05_CONTROLLER_0_IAM_Rx, ComSignalType=BOOLEAN
        ITMOvCrntAlrm_TC_PTCANFD_100ms_FrP05_CONTROLLER_0_IAM_Rx: ComBitPosition=43, ComBitSize=1, ComHandleId=ITMOvCrntAlrm_TC_PTCANFD_100ms_FrP05_CONTROLLER_0_IAM_Rx, ComSignalType=BOOLEAN
      RZCU_PTCANFD_100ms_FrP12_CONTROLLER_0_IAM_Rx (ComIPdu):
        ComIPduCancellationSupport = false
        ComIPduDirection = RECEIVE
        ComIPduHandleId = COM_RXPDU_COM_RZCU_PTCANFD_100ms_FrP12_CONTROLLER_0_IAM_Rx
        ComIPduSignalProcessing = DEFERRED
        ComIPduType = NORMAL
        ComIPduCallout = RZCU_PTCANFD_100ms_FrP12_CONTROLLER_0_IAM_Rx
        ComPduIdRef = COM_RZCU_PTCANFD_100ms_FrP12_CONTROLLER_0_IAM_Rx
        ComIPduSignalGroupRef = IRZCU_100ms_Group12_RZCU_PTCANFD_100ms_FrP12_CONTROLLER_0_IAM_Rx
        ComIPduGroupRef = Com_RxPduGroup_CONTROLLER_0_IAM
      IRZCU_100ms_Group12_RZCU_PTCANFD_100ms_FrP12_CONTROLLER_0_IAM_Rx (ComSignalGroup):
        ComHandleId = IRZCU_100ms_Group12_RZCU_PTCANFD_100ms_FrP12_CONTROLLER_0_IAM_Rx
        ComInvalidNotification = NULL_PTR
        ComRxDataTimeoutAction = NONE
        ComTransferProperty = PENDING
        ComDataInvalidAction = NOTIFY
        ComTimeout = 0.0
        ComFirstTimeout = 0.0
        ComNotification = Rte_COMCbk
        12 x ComGroupSignal, all with ComSignalEndianness=BIG_ENDIAN, ComSignalInitValue=0x0, ComSignalLength=0, ComSignalDataInvalidValue=0x0:
          IRZCU_100ms_Group12_CRC_IRZCU_100ms_Group12_RZCU_PTCANFD_100ms_FrP12_CONTROLLER_0_IAM_Rx: ComBitPosition=0, ComBitSize=8, ComHandleId=IRZCU_100ms_Group12_RZCU_PTCANFD_100ms_FrP12_CONTROLLER_0_IAM_Rx_IRZCU_100ms_Group12_CRC_IRZCU_100ms_Group12_RZCU_PTCANFD_100ms_FrP12_CONTROLLER_0_IAM_Rx, ComSignalType=UINT8
          IRZCU_100ms_Group12_RC_IRZCU_100ms_Group12_RZCU_PTCANFD_100ms_FrP12_CONTROLLER_0_IAM_Rx: ComBitPosition=8, ComBitSize=4, ComHandleId=IRZCU_100ms_Group12_RZCU_PTCANFD_100ms_FrP12_CONTROLLER_0_IAM_Rx_IRZCU_100ms_Group12_RC_IRZCU_100ms_Group12_RZCU_PTCANFD_100ms_FrP12_CONTROLLER_0_IAM_Rx, ComSignalType=UINT8
          IVCUBatPrsAlrmV_IRZCU_100ms_Group12_RZCU_PTCANFD_100ms_FrP12_CONTROLLER_0_IAM_Rx: ComBitPosition=12, ComBitSize=1, ComHandleId=IRZCU_100ms_Group12_RZCU_PTCANFD_100ms_FrP12_CONTROLLER_0_IAM_Rx_IVCUBatPrsAlrmV_IRZCU_100ms_Group12_RZCU_PTCANFD_100ms_FrP12_CONTROLLER_0_IAM_Rx, ComSignalType=BOOLEAN
          IVCUBatPrsAlrm_IRZCU_100ms_Group12_RZCU_PTCANFD_100ms_FrP12_CONTROLLER_0_IAM_Rx: ComBitPosition=13, ComBitSize=1, ComHandleId=IRZCU_100ms_Group12_RZCU_PTCANFD_100ms_FrP12_CONTROLLER_0_IAM_Rx_IVCUBatPrsAlrm_IRZCU_100ms_Group12_RZCU_PTCANFD_100ms_FrP12_CONTROLLER_0_IAM_Rx, ComSignalType=BOOLEAN
          IHVEstbCond_IRZCU_100ms_Group12_RZCU_PTCANFD_100ms_FrP12_CONTROLLER_0_IAM_Rx: ComBitPosition=14, ComBitSize=2, ComHandleId=IRZCU_100ms_Group12_RZCU_PTCANFD_100ms_FrP12_CONTROLLER_0_IAM_Rx_IHVEstbCond_IRZCU_100ms_Group12_RZCU_PTCANFD_100ms_FrP12_CONTROLLER_0_IAM_Rx, ComSignalType=UINT8
          IRZCU_100ms_Group12_Reserved1_IRZCU_100ms_Group12_RZCU_PTCANFD_100ms_FrP12_CONTROLLER_0_IAM_Rx: ComBitPosition=16, ComBitSize=6, ComHandleId=IRZCU_100ms_Group12_RZCU_PTCANFD_100ms_FrP12_CONTROLLER_0_IAM_Rx_IRZCU_100ms_Group12_Reserved1_IRZCU_100ms_Group12_RZCU_PTCANFD_100ms_FrP12_CONTROLLER_0_IAM_Rx, ComSignalType=UINT8
          IVMCExtrePssMdInd_IRZCU_100ms_Group12_RZCU_PTCANFD_100ms_FrP12_CONTROLLER_0_IAM_Rx: ComBitPosition=22, ComBitSize=2, ComHandleId=IRZCU_100ms_Group12_RZCU_PTCANFD_100ms_FrP12_CONTROLLER_0_IAM_Rx_IVMCExtrePssMdInd_IRZCU_100ms_Group12_RZCU_PTCANFD_100ms_FrP12_CONTROLLER_0_IAM_Rx, ComSignalType=UINT8
          IRZCU_100ms_Group12_Reserved2_IRZCU_100ms_Group12_RZCU_PTCANFD_100ms_FrP12_CONTROLLER_0_IAM_Rx: ComBitPosition=24, ComBitSize=8, ComHandleId=IRZCU_100ms_Group12_RZCU_PTCANFD_100ms_FrP12_CONTROLLER_0_IAM_Rx_IRZCU_100ms_Group12_Reserved2_IRZCU_100ms_Group12_RZCU_PTCANFD_100ms_FrP12_CONTROLLER_0_IAM_Rx, ComSignalType=UINT8
          IRZCU_100ms_Group12_Reserved3_IRZCU_100ms_Group12_RZCU_PTCANFD_100ms_FrP12_CONTROLLER_0_IAM_Rx: ComBitPosition=32, ComBitSize=8, ComHandleId=IRZCU_100ms_Group12_RZCU_PTCANFD_100ms_FrP12_CONTROLLER_0_IAM_Rx_IRZCU_100ms_Group12_Reserved3_IRZCU_100ms_Group12_RZCU_PTCANFD_100ms_FrP12_CONTROLLER_0_IAM_Rx, ComSignalType=UINT8
          IRZCU_100ms_Group12_Reserved4_IRZCU_100ms_Group12_RZCU_PTCANFD_100ms_FrP12_CONTROLLER_0_IAM_Rx: ComBitPosition=40, ComBitSize=8, ComHandleId=IRZCU_100ms_Group12_RZCU_PTCANFD_100ms_FrP12_CONTROLLER_0_IAM_Rx_IRZCU_100ms_Group12_Reserved4_IRZCU_100ms_Group12_RZCU_PTCANFD_100ms_FrP12_CONTROLLER_0_IAM_Rx, ComSignalType=UINT8
          IRZCU_100ms_Group12_Reserved5_IRZCU_100ms_Group12_RZCU_PTCANFD_100ms_FrP12_CONTROLLER_0_IAM_Rx: ComBitPosition=48, ComBitSize=8, ComHandleId=IRZCU_100ms_Group12_RZCU_PTCANFD_100ms_FrP12_CONTROLLER_0_IAM_Rx_IRZCU_100ms_Group12_Reserved5_IRZCU_100ms_Group12_RZCU_PTCANFD_100ms_FrP12_CONTROLLER_0_IAM_Rx, ComSignalType=UINT8
          IRZCU_100ms_Group12_Reserved6_IRZCU_100ms_Group12_RZCU_PTCANFD_100ms_FrP12_CONTROLLER_0_IAM_Rx: ComBitPosition=56, ComBitSize=8, ComHandleId=IRZCU_100ms_Group12_RZCU_PTCANFD_100ms_FrP12_CONTROLLER_0_IAM_Rx_IRZCU_100ms_Group12_Reserved6_IRZCU_100ms_Group12_RZCU_PTCANFD_100ms_FrP12_CONTROLLER_0_IAM_Rx, ComSignalType=UINT8
      ICBVC_INFOCANFD_250ms_FrP52_CONTROLLER_0_IAM_Rx (ComIPdu):
        ComIPduCancellationSupport = false
        ComIPduDirection = RECEIVE
        ComIPduHandleId = COM_RXPDU_COM_ICBVC_INFOCANFD_250ms_FrP52_CONTROLLER_0_IAM_Rx
        ComIPduSignalProcessing = DEFERRED
        ComIPduType = NORMAL
        ComPduIdRef = COM_ICBVC_INFOCANFD_250ms_FrP52_CONTROLLER_0_IAM_Rx
        ComIPduSignalRef = IOtsdAirTemCrVal_ICBVC_INFOCANFD_250ms_FrP52_CONTROLLER_0_IAM_Rx
        ComIPduGroupRef = Com_RxPduGroup_CONTROLLER_0_IAM
      IOtsdAirTemCrVal_ICBVC_INFOCANFD_250ms_FrP52_CONTROLLER_0_IAM_Rx (ComSignal):
        ComBitPosition = 56
        ComBitSize = 8
        ComHandleId = IOtsdAirTemCrVal_ICBVC_INFOCANFD_250ms_FrP52_CONTROLLER_0_IAM_Rx
        ComInvalidNotification = NULL_PTR
        ComRxDataTimeoutAction = NONE
        ComSignalEndianness = BIG_ENDIAN
        ComSignalInitValue = 0x0
        ComSignalLength = 0
        ComSignalType = UINT8
        ComTransferProperty = PENDING
        ComSignalDataInvalidValue = 0x0
        ComDataInvalidAction = NOTIFY
        ComTimeout = 0.0
        ComFirstTimeout = 0.0
        ComNotification = Rte_COMCbk
      ICB_RZCUCANFD_100ms_FrP144_CONTROLLER_0_IAM_Rx (ComIPdu):
        ComIPduCancellationSupport = false
        ComIPduDirection = RECEIVE
        ComIPduHandleId = COM_RXPDU_COM_ICB_RZCUCANFD_100ms_FrP144_CONTROLLER_0_IAM_Rx
        ComIPduSignalProcessing = DEFERRED
        ComIPduType = NORMAL
        ComPduIdRef = COM_ICB_RZCUCANFD_100ms_FrP144_CONTROLLER_0_IAM_Rx
        ComIPduSignalRef = ISecRowRSeatVentLvl_ICB_RZCUCANFD_100ms_FrP144_CONTROLLER_0_IAM_Rx
        ComIPduSignalRef = ISecRowRSeatHeatLvl_ICB_RZCUCANFD_100ms_FrP144_CONTROLLER_0_IAM_Rx
        ComIPduSignalRef = ISecRowLSeatVentLvl_ICB_RZCUCANFD_100ms_FrP144_CONTROLLER_0_IAM_Rx
        ComIPduSignalRef = ISecRowLSeatHeatLvl_ICB_RZCUCANFD_100ms_FrP144_CONTROLLER_0_IAM_Rx
        ComIPduSignalRef = IFRSeatVentLvl_ICB_RZCUCANFD_100ms_FrP144_CONTROLLER_0_IAM_Rx
        ComIPduSignalRef = IFRSeatHeatLvl_ICB_RZCUCANFD_100ms_FrP144_CONTROLLER_0_IAM_Rx
        ComIPduSignalRef = IFLSeatVentLvl_ICB_RZCUCANFD_100ms_FrP144_CONTROLLER_0_IAM_Rx
        ComIPduSignalRef = IFLSeatHeatLvl_ICB_RZCUCANFD_100ms_FrP144_CONTROLLER_0_IAM_Rx
        ComIPduSignalRef = ISWHtngReqDspCmd_ICB_RZCUCANFD_100ms_FrP144_CONTROLLER_0_IAM_Rx
        ComIPduSignalRef = IRmtSlientUnlckSts_ICB_RZCUCANFD_100ms_FrP144_CONTROLLER_0_IAM_Rx
        ComIPduSignalRef = IRRWndOpenSts_ICB_RZCUCANFD_100ms_FrP144_CONTROLLER_0_IAM_Rx
        ComIPduSignalRef = IDrvrSeatHeatCtrlSts_ICB_RZCUCANFD_100ms_FrP144_CONTROLLER_0_IAM_Rx
        ComIPduSignalRef = IDrvrSeatVentCtrlSts_ICB_RZCUCANFD_100ms_FrP144_CONTROLLER_0_IAM_Rx
        ComIPduSignalRef = IPsngSeatHeatCtrlSts_ICB_RZCUCANFD_100ms_FrP144_CONTROLLER_0_IAM_Rx
        ComIPduSignalRef = IPsngSeatVentCtrlSts_ICB_RZCUCANFD_100ms_FrP144_CONTROLLER_0_IAM_Rx
        ComIPduSignalRef = ISecRowLSeatHeatCtrlSts_ICB_RZCUCANFD_100ms_FrP144_CONTROLLER_0_IAM_Rx
        ComIPduSignalRef = ISecRowLSeatVentCtrlSts_ICB_RZCUCANFD_100ms_FrP144_CONTROLLER_0_IAM_Rx
        ComIPduSignalRef = ISecRowRSeatHeatCtrlSts_ICB_RZCUCANFD_100ms_FrP144_CONTROLLER_0_IAM_Rx
        ComIPduSignalRef = ISecRowRSeatVentCtrlSts_ICB_RZCUCANFD_100ms_FrP144_CONTROLLER_0_IAM_Rx
        ComIPduSignalRef = IFLWndOpenSts_ICB_RZCUCANFD_100ms_FrP144_CONTROLLER_0_IAM_Rx
        ComIPduSignalRef = IThrdRowRSeatHeatCtrlSts_ICB_RZCUCANFD_100ms_FrP144_CONTROLLER_0_IAM_Rx
        ComIPduSignalRef = IThrdRowRSeatVentCtrlSts_ICB_RZCUCANFD_100ms_FrP144_CONTROLLER_0_IAM_Rx
        ComIPduSignalRef = IFRWndOpenSts_ICB_RZCUCANFD_100ms_FrP144_CONTROLLER_0_IAM_Rx
        ComIPduSignalRef = IThrdRowLSeatHeatCtrlSts_ICB_RZCUCANFD_100ms_FrP144_CONTROLLER_0_IAM_Rx
        ComIPduSignalRef = IThrdRowLSeatVentCtrlSts_ICB_RZCUCANFD_100ms_FrP144_CONTROLLER_0_IAM_Rx
        ComIPduSignalRef = IRLWndOpenSts_ICB_RZCUCANFD_100ms_FrP144_CONTROLLER_0_IAM_Rx
        ComIPduSignalRef = IStrgWhlHeatCtrlSts_ICB_RZCUCANFD_100ms_FrP144_CONTROLLER_0_IAM_Rx
        ComIPduSignalRef = IAltngChrgCrntDspCmd_ICB_RZCUCANFD_100ms_FrP144_CONTROLLER_0_IAM_Rx
        ComIPduSignalRef = IChrgTrgtSOCDspCmd_ICB_RZCUCANFD_100ms_FrP144_CONTROLLER_0_IAM_Rx
        ComIPduSignalRef = IRRWinPosnSts_ICB_RZCUCANFD_100ms_FrP144_CONTROLLER_0_IAM_Rx
        ComIPduSignalRef = IRLWinPosnSts_ICB_RZCUCANFD_100ms_FrP144_CONTROLLER_0_IAM_Rx
        ComIPduSignalRef = IFRWinPosnSts_ICB_RZCUCANFD_100ms_FrP144_CONTROLLER_0_IAM_Rx
        ComIPduSignalRef = IFLWinPosnSts_ICB_RZCUCANFD_100ms_FrP144_CONTROLLER_0_IAM_Rx
        ComIPduSignalRef = IThrdRowLSeatHeatLvl_ICB_RZCUCANFD_100ms_FrP144_CONTROLLER_0_IAM_Rx
        ComIPduSignalRef = IThrdRowLSeatVentLvl_ICB_RZCUCANFD_100ms_FrP144_CONTROLLER_0_IAM_Rx
        ComIPduSignalRef = IThrdRowRSeatHeatLvl_ICB_RZCUCANFD_100ms_FrP144_CONTROLLER_0_IAM_Rx
        ComIPduSignalRef = IThrdRowRSeatVentLvl_ICB_RZCUCANFD_100ms_FrP144_CONTROLLER_0_IAM_Rx
        ComIPduGroupRef = Com_RxPduGroup_CONTROLLER_0_IAM
      37 x ComSignal, all with ComInvalidNotification=NULL_PTR, ComRxDataTimeoutAction=NONE, ComSignalEndianness=BIG_ENDIAN, ComSignalInitValue=0x0, ComSignalLength=0, ComTransferProperty=PENDING, ComSignalDataInvalidValue=0x0, ComDataInvalidAction=NOTIFY, ComTimeout=0.0, ComFirstTimeout=0.0, ComNotification=Rte_COMCbk:
        ISecRowRSeatVentLvl_ICB_RZCUCANFD_100ms_FrP144_CONTROLLER_0_IAM_Rx: ComBitPosition=8, ComBitSize=2, ComHandleId=ISecRowRSeatVentLvl_ICB_RZCUCANFD_100ms_FrP144_CONTROLLER_0_IAM_Rx, ComSignalType=UINT8
        ISecRowRSeatHeatLvl_ICB_RZCUCANFD_100ms_FrP144_CONTROLLER_0_IAM_Rx: ComBitPosition=10, ComBitSize=2, ComHandleId=ISecRowRSeatHeatLvl_ICB_RZCUCANFD_100ms_FrP144_CONTROLLER_0_IAM_Rx, ComSignalType=UINT8
        ISecRowLSeatVentLvl_ICB_RZCUCANFD_100ms_FrP144_CONTROLLER_0_IAM_Rx: ComBitPosition=12, ComBitSize=2, ComHandleId=ISecRowLSeatVentLvl_ICB_RZCUCANFD_100ms_FrP144_CONTROLLER_0_IAM_Rx, ComSignalType=UINT8
        ISecRowLSeatHeatLvl_ICB_RZCUCANFD_100ms_FrP144_CONTROLLER_0_IAM_Rx: ComBitPosition=14, ComBitSize=2, ComHandleId=ISecRowLSeatHeatLvl_ICB_RZCUCANFD_100ms_FrP144_CONTROLLER_0_IAM_Rx, ComSignalType=UINT8
        IFRSeatVentLvl_ICB_RZCUCANFD_100ms_FrP144_CONTROLLER_0_IAM_Rx: ComBitPosition=16, ComBitSize=2, ComHandleId=IFRSeatVentLvl_ICB_RZCUCANFD_100ms_FrP144_CONTROLLER_0_IAM_Rx, ComSignalType=UINT8
        IFRSeatHeatLvl_ICB_RZCUCANFD_100ms_FrP144_CONTROLLER_0_IAM_Rx: ComBitPosition=18, ComBitSize=2, ComHandleId=IFRSeatHeatLvl_ICB_RZCUCANFD_100ms_FrP144_CONTROLLER_0_IAM_Rx, ComSignalType=UINT8
        IFLSeatVentLvl_ICB_RZCUCANFD_100ms_FrP144_CONTROLLER_0_IAM_Rx: ComBitPosition=20, ComBitSize=2, ComHandleId=IFLSeatVentLvl_ICB_RZCUCANFD_100ms_FrP144_CONTROLLER_0_IAM_Rx, ComSignalType=UINT8
        IFLSeatHeatLvl_ICB_RZCUCANFD_100ms_FrP144_CONTROLLER_0_IAM_Rx: ComBitPosition=22, ComBitSize=2, ComHandleId=IFLSeatHeatLvl_ICB_RZCUCANFD_100ms_FrP144_CONTROLLER_0_IAM_Rx, ComSignalType=UINT8
        ISWHtngReqDspCmd_ICB_RZCUCANFD_100ms_FrP144_CONTROLLER_0_IAM_Rx: ComBitPosition=24, ComBitSize=3, ComHandleId=ISWHtngReqDspCmd_ICB_RZCUCANFD_100ms_FrP144_CONTROLLER_0_IAM_Rx, ComSignalType=UINT8
        IRmtSlientUnlckSts_ICB_RZCUCANFD_100ms_FrP144_CONTROLLER_0_IAM_Rx: ComBitPosition=33, ComBitSize=1, ComHandleId=IRmtSlientUnlckSts_ICB_RZCUCANFD_100ms_FrP144_CONTROLLER_0_IAM_Rx, ComSignalType=BOOLEAN
        IRRWndOpenSts_ICB_RZCUCANFD_100ms_FrP144_CONTROLLER_0_IAM_Rx: ComBitPosition=40, ComBitSize=2, ComHandleId=IRRWndOpenSts_ICB_RZCUCANFD_100ms_FrP144_CONTROLLER_0_IAM_Rx, ComSignalType=UINT8
        IDrvrSeatHeatCtrlSts_ICB_RZCUCANFD_100ms_FrP144_CONTROLLER_0_IAM_Rx: ComBitPosition=50, ComBitSize=3, ComHandleId=IDrvrSeatHeatCtrlSts_ICB_RZCUCANFD_100ms_FrP144_CONTROLLER_0_IAM_Rx, ComSignalType=UINT8
        IDrvrSeatVentCtrlSts_ICB_RZCUCANFD_100ms_FrP144_CONTROLLER_0_IAM_Rx: ComBitPosition=53, ComBitSize=3, ComHandleId=IDrvrSeatVentCtrlSts_ICB_RZCUCANFD_100ms_FrP144_CONTROLLER_0_IAM_Rx, ComSignalType=UINT8
        IPsngSeatHeatCtrlSts_ICB_RZCUCANFD_100ms_FrP144_CONTROLLER_0_IAM_Rx: ComBitPosition=58, ComBitSize=3, ComHandleId=IPsngSeatHeatCtrlSts_ICB_RZCUCANFD_100ms_FrP144_CONTROLLER_0_IAM_Rx, ComSignalType=UINT8
        IPsngSeatVentCtrlSts_ICB_RZCUCANFD_100ms_FrP144_CONTROLLER_0_IAM_Rx: ComBitPosition=61, ComBitSize=3, ComHandleId=IPsngSeatVentCtrlSts_ICB_RZCUCANFD_100ms_FrP144_CONTROLLER_0_IAM_Rx, ComSignalType=UINT8
        ISecRowLSeatHeatCtrlSts_ICB_RZCUCANFD_100ms_FrP144_CONTROLLER_0_IAM_Rx: ComBitPosition=66, ComBitSize=3, ComHandleId=ISecRowLSeatHeatCtrlSts_ICB_RZCUCANFD_100ms_FrP144_CONTROLLER_0_IAM_Rx, ComSignalType=UINT8
        ISecRowLSeatVentCtrlSts_ICB_RZCUCANFD_100ms_FrP144_CONTROLLER_0_IAM_Rx: ComBitPosition=69, ComBitSize=3, ComHandleId=ISecRowLSeatVentCtrlSts_ICB_RZCUCANFD_100ms_FrP144_CONTROLLER_0_IAM_Rx, ComSignalType=UINT8
        ISecRowRSeatHeatCtrlSts_ICB_RZCUCANFD_100ms_FrP144_CONTROLLER_0_IAM_Rx: ComBitPosition=74, ComBitSize=3, ComHandleId=ISecRowRSeatHeatCtrlSts_ICB_RZCUCANFD_100ms_FrP144_CONTROLLER_0_IAM_Rx, ComSignalType=UINT8
        ISecRowRSeatVentCtrlSts_ICB_RZCUCANFD_100ms_FrP144_CONTROLLER_0_IAM_Rx: ComBitPosition=77, ComBitSize=3, ComHandleId=ISecRowRSeatVentCtrlSts_ICB_RZCUCANFD_100ms_FrP144_CONTROLLER_0_IAM_Rx, ComSignalType=UINT8
        IFLWndOpenSts_ICB_RZCUCANFD_100ms_FrP144_CONTROLLER_0_IAM_Rx: ComBitPosition=80, ComBitSize=2, ComHandleId=IFLWndOpenSts_ICB_RZCUCANFD_100ms_FrP144_CONTROLLER_0_IAM_Rx, ComSignalType=UINT8
        IThrdRowRSeatHeatCtrlSts_ICB_RZCUCANFD_100ms_FrP144_CONTROLLER_0_IAM_Rx: ComBitPosition=82, ComBitSize=3, ComHandleId=IThrdRowRSeatHeatCtrlSts_ICB_RZCUCANFD_100ms_FrP144_CONTROLLER_0_IAM_Rx, ComSignalType=UINT8
        IThrdRowRSeatVentCtrlSts_ICB_RZCUCANFD_100ms_FrP144_CONTROLLER_0_IAM_Rx: ComBitPosition=85, ComBitSize=3, ComHandleId=IThrdRowRSeatVentCtrlSts_ICB_RZCUCANFD_100ms_FrP144_CONTROLLER_0_IAM_Rx, ComSignalType=UINT8
        IFRWndOpenSts_ICB_RZCUCANFD_100ms_FrP144_CONTROLLER_0_IAM_Rx: ComBitPosition=88, ComBitSize=2, ComHandleId=IFRWndOpenSts_ICB_RZCUCANFD_100ms_FrP144_CONTROLLER_0_IAM_Rx, ComSignalType=UINT8
        IThrdRowLSeatHeatCtrlSts_ICB_RZCUCANFD_100ms_FrP144_CONTROLLER_0_IAM_Rx: ComBitPosition=90, ComBitSize=3, ComHandleId=IThrdRowLSeatHeatCtrlSts_ICB_RZCUCANFD_100ms_FrP144_CONTROLLER_0_IAM_Rx, ComSignalType=UINT8
        IThrdRowLSeatVentCtrlSts_ICB_RZCUCANFD_100ms_FrP144_CONTROLLER_0_IAM_Rx: ComBitPosition=93, ComBitSize=3, ComHandleId=IThrdRowLSeatVentCtrlSts_ICB_RZCUCANFD_100ms_FrP144_CONTROLLER_0_IAM_Rx, ComSignalType=UINT8
        IRLWndOpenSts_ICB_RZCUCANFD_100ms_FrP144_CONTROLLER_0_IAM_Rx: ComBitPosition=96, ComBitSize=2, ComHandleId=IRLWndOpenSts_ICB_RZCUCANFD_100ms_FrP144_CONTROLLER_0_IAM_Rx, ComSignalType=UINT8
        IStrgWhlHeatCtrlSts_ICB_RZCUCANFD_100ms_FrP144_CONTROLLER_0_IAM_Rx: ComBitPosition=98, ComBitSize=3, ComHandleId=IStrgWhlHeatCtrlSts_ICB_RZCUCANFD_100ms_FrP144_CONTROLLER_0_IAM_Rx, ComSignalType=UINT8
        IAltngChrgCrntDspCmd_ICB_RZCUCANFD_100ms_FrP144_CONTROLLER_0_IAM_Rx: ComBitPosition=101, ComBitSize=3, ComHandleId=IAltngChrgCrntDspCmd_ICB_RZCUCANFD_100ms_FrP144_CONTROLLER_0_IAM_Rx, ComSignalType=UINT8
        IChrgTrgtSOCDspCmd_ICB_RZCUCANFD_100ms_FrP144_CONTROLLER_0_IAM_Rx: ComBitPosition=105, ComBitSize=7, ComHandleId=IChrgTrgtSOCDspCmd_ICB_RZCUCANFD_100ms_FrP144_CONTROLLER_0_IAM_Rx, ComSignalType=UINT8
        IRRWinPosnSts_ICB_RZCUCANFD_100ms_FrP144_CONTROLLER_0_IAM_Rx: ComBitPosition=144, ComBitSize=8, ComHandleId=IRRWinPosnSts_ICB_RZCUCANFD_100ms_FrP144_CONTROLLER_0_IAM_Rx, ComSignalType=UINT8
        IRLWinPosnSts_ICB_RZCUCANFD_100ms_FrP144_CONTROLLER_0_IAM_Rx: ComBitPosition=152, ComBitSize=8, ComHandleId=IRLWinPosnSts_ICB_RZCUCANFD_100ms_FrP144_CONTROLLER_0_IAM_Rx, ComSignalType=UINT8
        IFRWinPosnSts_ICB_RZCUCANFD_100ms_FrP144_CONTROLLER_0_IAM_Rx: ComBitPosition=160, ComBitSize=8, ComHandleId=IFRWinPosnSts_ICB_RZCUCANFD_100ms_FrP144_CONTROLLER_0_IAM_Rx, ComSignalType=UINT8
        IFLWinPosnSts_ICB_RZCUCANFD_100ms_FrP144_CONTROLLER_0_IAM_Rx: ComBitPosition=168, ComBitSize=8, ComHandleId=IFLWinPosnSts_ICB_RZCUCANFD_100ms_FrP144_CONTROLLER_0_IAM_Rx, ComSignalType=UINT8
        IThrdRowLSeatHeatLvl_ICB_RZCUCANFD_100ms_FrP144_CONTROLLER_0_IAM_Rx: ComBitPosition=194, ComBitSize=2, ComHandleId=IThrdRowLSeatHeatLvl_ICB_RZCUCANFD_100ms_FrP144_CONTROLLER_0_IAM_Rx, ComSignalType=UINT8
        IThrdRowLSeatVentLvl_ICB_RZCUCANFD_100ms_FrP144_CONTROLLER_0_IAM_Rx: ComBitPosition=196, ComBitSize=2, ComHandleId=IThrdRowLSeatVentLvl_ICB_RZCUCANFD_100ms_FrP144_CONTROLLER_0_IAM_Rx, ComSignalType=UINT8
        IThrdRowRSeatHeatLvl_ICB_RZCUCANFD_100ms_FrP144_CONTROLLER_0_IAM_Rx: ComBitPosition=198, ComBitSize=2, ComHandleId=IThrdRowRSeatHeatLvl_ICB_RZCUCANFD_100ms_FrP144_CONTROLLER_0_IAM_Rx, ComSignalType=UINT8
        IThrdRowRSeatVentLvl_ICB_RZCUCANFD_100ms_FrP144_CONTROLLER_0_IAM_Rx: ComBitPosition=242, ComBitSize=2, ComHandleId=IThrdRowRSeatVentLvl_ICB_RZCUCANFD_100ms_FrP144_CONTROLLER_0_IAM_Rx, ComSignalType=UINT8
      SDM_CHCANFD_100ms_FrP03_CONTROLLER_0_IAM_Rx (ComIPdu):
        ComIPduCancellationSupport = false
        ComIPduDirection = RECEIVE
        ComIPduHandleId = COM_RXPDU_COM_SDM_CHCANFD_100ms_FrP03_CONTROLLER_0_IAM_Rx
        ComIPduSignalProcessing = DEFERRED
        ComIPduType = NORMAL
        ComPduIdRef = COM_SDM_CHCANFD_100ms_FrP03_CONTROLLER_0_IAM_Rx
        ComIPduSignalRef = ISeatOccptnNum_SDM_CHCANFD_100ms_FrP03_CONTROLLER_0_IAM_Rx
        ComIPduGroupRef = Com_RxPduGroup_CONTROLLER_0_IAM
      ISeatOccptnNum_SDM_CHCANFD_100ms_FrP03_CONTROLLER_0_IAM_Rx (ComSignal):
        ComBitPosition = 5
        ComBitSize = 3
        ComHandleId = ISeatOccptnNum_SDM_CHCANFD_100ms_FrP03_CONTROLLER_0_IAM_Rx
        ComInvalidNotification = NULL_PTR
        ComRxDataTimeoutAction = NONE
        ComSignalEndianness = BIG_ENDIAN
        ComSignalInitValue = 0x0
        ComSignalLength = 0
        ComSignalType = UINT8
        ComTransferProperty = PENDING
        ComSignalDataInvalidValue = 0x0
        ComDataInvalidAction = NOTIFY
        ComTimeout = 0.0
        ComFirstTimeout = 0.0
        ComNotification = Rte_COMCbk
      RZCU_IMCU_SFCANFD_100ms_FrP26_CONTROLLER_0_IAM_Rx (ComIPdu):
        ComIPduCancellationSupport = false
        ComIPduDirection = RECEIVE
        ComIPduHandleId = COM_RXPDU_COM_RZCU_IMCU_SFCANFD_100ms_FrP26_CONTROLLER_0_IAM_Rx
        ComIPduSignalProcessing = DEFERRED
        ComIPduType = NORMAL
        ComIPduCallout = RZCU_IMCU_SFCANFD_100ms_FrP26_CONTROLLER_0_IAM_Rx
        ComPduIdRef = COM_RZCU_IMCU_SFCANFD_100ms_FrP26_CONTROLLER_0_IAM_Rx
        ComIPduSignalGroupRef = IIMCU_100ms_VCUSecyWrnng_Group01_RZCU_IMCU_SFCANFD_100ms_FrP26_CONTROLLER_0_IAM_Rx
        ComIPduGroupRef = Com_RxPduGroup_CONTROLLER_0_IAM
      IIMCU_100ms_VCUSecyWrnng_Group01_RZCU_IMCU_SFCANFD_100ms_FrP26_CONTROLLER_0_IAM_Rx (ComSignalGroup):
        ComHandleId = IIMCU_100ms_VCUSecyWrnng_Group01_RZCU_IMCU_SFCANFD_100ms_FrP26_CONTROLLER_0_IAM_Rx
        ComInvalidNotification = NULL_PTR
        ComRxDataTimeoutAction = NONE
        ComTransferProperty = PENDING
        ComDataInvalidAction = NOTIFY
        ComTimeout = 0.0
        ComFirstTimeout = 0.0
        ComNotification = Rte_COMCbk
        10 x ComGroupSignal, all with ComSignalEndianness=BIG_ENDIAN, ComSignalInitValue=0x0, ComSignalLength=0, ComSignalType=UINT8, ComSignalDataInvalidValue=0x0:
          IIMCU_100ms_VCUSecyWrnng_Group01_IIMCU_100ms_VCUSecyWrnng_Group01_RZCU_IMCU_SFCANFD_100ms_FrP26_CONTROLLER_0_IAM_Rx: ComBitPosition=0, ComBitSize=8, ComHandleId=IIMCU_100ms_VCUSecyWrnng_Group01_RZCU_IMCU_SFCANFD_100ms_FrP26_CONTROLLER_0_IAM_Rx_IIMCU_100ms_VCUSecyWrnng_Group01_IIMCU_100ms_VCUSecyWrnng_Group01_RZCU_IMCU_SFCANFD_100ms_FrP26_CONTROLLER_0_IAM_Rx
          IIMCU_100ms_VCUSecyWrnng_Gr_0000_IIMCU_100ms_VCUSecyWrnng_Group01_RZCU_IMCU_SFCANFD_100ms_FrP26_CONTROLLER_0_IAM_Rx: ComBitPosition=8, ComBitSize=4, ComHandleId=IIMCU_100ms_VCUSecyWrnng_Group01_RZCU_IMCU_SFCANFD_100ms_FrP26_CONTROLLER_0_IAM_Rx_IIMCU_100ms_VCUSecyWrnng_Gr_0000_IIMCU_100ms_VCUSecyWrnng_Group01_RZCU_IMCU_SFCANFD_100ms_FrP26_CONTROLLER_0_IAM_Rx
          IIMCU_100ms_VCUSecyWrnng_Gr_0001_IIMCU_100ms_VCUSecyWrnng_Group01_RZCU_IMCU_SFCANFD_100ms_FrP26_CONTROLLER_0_IAM_Rx: ComBitPosition=12, ComBitSize=4, ComHandleId=IIMCU_100ms_VCUSecyWrnng_Group01_RZCU_IMCU_SFCANFD_100ms_FrP26_CONTROLLER_0_IAM_Rx_IIMCU_100ms_VCUSecyWrnng_Gr_0001_IIMCU_100ms_VCUSecyWrnng_Group01_RZCU_IMCU_SFCANFD_100ms_FrP26_CONTROLLER_0_IAM_Rx
          IIMCU_100ms_VCUSecyWrnng_Gr_0002_IIMCU_100ms_VCUSecyWrnng_Group01_RZCU_IMCU_SFCANFD_100ms_FrP26_CONTROLLER_0_IAM_Rx: ComBitPosition=16, ComBitSize=2, ComHandleId=IIMCU_100ms_VCUSecyWrnng_Group01_RZCU_IMCU_SFCANFD_100ms_FrP26_CONTROLLER_0_IAM_Rx_IIMCU_100ms_VCUSecyWrnng_Gr_0002_IIMCU_100ms_VCUSecyWrnng_Group01_RZCU_IMCU_SFCANFD_100ms_FrP26_CONTROLLER_0_IAM_Rx
          IVCUSecyWrnngInfo_IIMCU_100ms_VCUSecyWrnng_Group01_RZCU_IMCU_SFCANFD_100ms_FrP26_CONTROLLER_0_IAM_Rx: ComBitPosition=18, ComBitSize=6, ComHandleId=IIMCU_100ms_VCUSecyWrnng_Group01_RZCU_IMCU_SFCANFD_100ms_FrP26_CONTROLLER_0_IAM_Rx_IVCUSecyWrnngInfo_IIMCU_100ms_VCUSecyWrnng_Group01_RZCU_IMCU_SFCANFD_100ms_FrP26_CONTROLLER_0_IAM_Rx
          IIMCU_100ms_VCUSecyWrnng_Gr_0003_IIMCU_100ms_VCUSecyWrnng_Group01_RZCU_IMCU_SFCANFD_100ms_FrP26_CONTROLLER_0_IAM_Rx: ComBitPosition=24, ComBitSize=8, ComHandleId=IIMCU_100ms_VCUSecyWrnng_Group01_RZCU_IMCU_SFCANFD_100ms_FrP26_CONTROLLER_0_IAM_Rx_IIMCU_100ms_VCUSecyWrnng_Gr_0003_IIMCU_100ms_VCUSecyWrnng_Group01_RZCU_IMCU_SFCANFD_100ms_FrP26_CONTROLLER_0_IAM_Rx
          IIMCU_100ms_VCUSecyWrnng_Gr_0004_IIMCU_100ms_VCUSecyWrnng_Group01_RZCU_IMCU_SFCANFD_100ms_FrP26_CONTROLLER_0_IAM_Rx: ComBitPosition=32, ComBitSize=8, ComHandleId=IIMCU_100ms_VCUSecyWrnng_Group01_RZCU_IMCU_SFCANFD_100ms_FrP26_CONTROLLER_0_IAM_Rx_IIMCU_100ms_VCUSecyWrnng_Gr_0004_IIMCU_100ms_VCUSecyWrnng_Group01_RZCU_IMCU_SFCANFD_100ms_FrP26_CONTROLLER_0_IAM_Rx
          IIMCU_100ms_VCUSecyWrnng_Gr_0005_IIMCU_100ms_VCUSecyWrnng_Group01_RZCU_IMCU_SFCANFD_100ms_FrP26_CONTROLLER_0_IAM_Rx: ComBitPosition=40, ComBitSize=8, ComHandleId=IIMCU_100ms_VCUSecyWrnng_Group01_RZCU_IMCU_SFCANFD_100ms_FrP26_CONTROLLER_0_IAM_Rx_IIMCU_100ms_VCUSecyWrnng_Gr_0005_IIMCU_100ms_VCUSecyWrnng_Group01_RZCU_IMCU_SFCANFD_100ms_FrP26_CONTROLLER_0_IAM_Rx
          IIMCU_100ms_VCUSecyWrnng_Gr_0006_IIMCU_100ms_VCUSecyWrnng_Group01_RZCU_IMCU_SFCANFD_100ms_FrP26_CONTROLLER_0_IAM_Rx: ComBitPosition=48, ComBitSize=8, ComHandleId=IIMCU_100ms_VCUSecyWrnng_Group01_RZCU_IMCU_SFCANFD_100ms_FrP26_CONTROLLER_0_IAM_Rx_IIMCU_100ms_VCUSecyWrnng_Gr_0006_IIMCU_100ms_VCUSecyWrnng_Group01_RZCU_IMCU_SFCANFD_100ms_FrP26_CONTROLLER_0_IAM_Rx
          IIMCU_100ms_VCUSecyWrnng_Gr_0007_IIMCU_100ms_VCUSecyWrnng_Group01_RZCU_IMCU_SFCANFD_100ms_FrP26_CONTROLLER_0_IAM_Rx: ComBitPosition=56, ComBitSize=8, ComHandleId=IIMCU_100ms_VCUSecyWrnng_Group01_RZCU_IMCU_SFCANFD_100ms_FrP26_CONTROLLER_0_IAM_Rx_IIMCU_100ms_VCUSecyWrnng_Gr_0007_IIMCU_100ms_VCUSecyWrnng_Group01_RZCU_IMCU_SFCANFD_100ms_FrP26_CONTROLLER_0_IAM_Rx
      ICBVC_CONNCANFD_200ms_FrP157_CONTROLLER_0_IAM_Rx (ComIPdu):
        ComIPduCancellationSupport = false
        ComIPduDirection = RECEIVE
        ComIPduHandleId = COM_RXPDU_COM_ICBVC_CONNCANFD_200ms_FrP157_CONTROLLER_0_IAM_Rx
        ComIPduSignalProcessing = DEFERRED
        ComIPduType = NORMAL
        ComPduIdRef = COM_ICBVC_CONNCANFD_200ms_FrP157_CONTROLLER_0_IAM_Rx
        ComIPduSignalRef = IFridgePowerActrSts_ICBVC_CONNCANFD_200ms_FrP157_CONTROLLER_0_IAM_Rx
        ComIPduSignalRef = IFridgeAbnormalActrSts_ICBVC_CONNCANFD_200ms_FrP157_CONTROLLER_0_IAM_Rx
        ComIPduSignalRef = IHldFdgeAftLckSetInfo_ICBVC_CONNCANFD_200ms_FrP157_CONTROLLER_0_IAM_Rx
        ComIPduSignalRef = IFridgeFailureActrSts_ICBVC_CONNCANFD_200ms_FrP157_CONTROLLER_0_IAM_Rx
        ComIPduSignalRef = IFridgeDoorOpenActrSts_ICBVC_CONNCANFD_200ms_FrP157_CONTROLLER_0_IAM_Rx
        ComIPduSignalRef = IHldFdgeAftLckWorkSts_ICBVC_CONNCANFD_200ms_FrP157_CONTROLLER_0_IAM_Rx
        ComIPduSignalRef = IFridgeModeActrSts_ICBVC_CONNCANFD_200ms_FrP157_CONTROLLER_0_IAM_Rx
        ComIPduSignalRef = IHldFdgeAftLckAutoOffRsn_ICBVC_CONNCANFD_200ms_FrP157_CONTROLLER_0_IAM_Rx
        ComIPduSignalRef = IHldFdgeAftLckTiSetInfo_ICBVC_CONNCANFD_200ms_FrP157_CONTROLLER_0_IAM_Rx
        ComIPduSignalRef = IHldFdgeAftLckTempSetInfo_ICBVC_CONNCANFD_200ms_FrP157_CONTROLLER_0_IAM_Rx
        ComIPduSignalRef = IFridgeActualTempActrSts_ICBVC_CONNCANFD_200ms_FrP157_CONTROLLER_0_IAM_Rx
        ComIPduSignalRef = IFridgeSetTempActrSts_ICBVC_CONNCANFD_200ms_FrP157_CONTROLLER_0_IAM_Rx
        ComIPduSignalRef = IHldFdgeAftLckRmnngTi_ICBVC_CONNCANFD_200ms_FrP157_CONTROLLER_0_IAM_Rx
        ComIPduGroupRef = Com_RxPduGroup_CONTROLLER_0_IAM
      13 x ComSignal, all with ComInvalidNotification=NULL_PTR, ComRxDataTimeoutAction=NONE, ComSignalEndianness=BIG_ENDIAN, ComSignalInitValue=0x0, ComSignalLength=0, ComTransferProperty=PENDING, ComSignalDataInvalidValue=0x0, ComDataInvalidAction=NOTIFY, ComTimeout=0.0, ComFirstTimeout=0.0, ComNotification=Rte_COMCbk:
        IFridgePowerActrSts_ICBVC_CONNCANFD_200ms_FrP157_CONTROLLER_0_IAM_Rx: ComBitPosition=51, ComBitSize=2, ComHandleId=IFridgePowerActrSts_ICBVC_CONNCANFD_200ms_FrP157_CONTROLLER_0_IAM_Rx, ComSignalType=UINT8
        IFridgeAbnormalActrSts_ICBVC_CONNCANFD_200ms_FrP157_CONTROLLER_0_IAM_Rx: ComBitPosition=53, ComBitSize=3, ComHandleId=IFridgeAbnormalActrSts_ICBVC_CONNCANFD_200ms_FrP157_CONTROLLER_0_IAM_Rx, ComSignalType=UINT8
        IHldFdgeAftLckSetInfo_ICBVC_CONNCANFD_200ms_FrP157_CONTROLLER_0_IAM_Rx: ComBitPosition=57, ComBitSize=3, ComHandleId=IHldFdgeAftLckSetInfo_ICBVC_CONNCANFD_200ms_FrP157_CONTROLLER_0_IAM_Rx, ComSignalType=UINT8
        IFridgeFailureActrSts_ICBVC_CONNCANFD_200ms_FrP157_CONTROLLER_0_IAM_Rx: ComBitPosition=60, ComBitSize=4, ComHandleId=IFridgeFailureActrSts_ICBVC_CONNCANFD_200ms_FrP157_CONTROLLER_0_IAM_Rx, ComSignalType=UINT8
        IFridgeDoorOpenActrSts_ICBVC_CONNCANFD_200ms_FrP157_CONTROLLER_0_IAM_Rx: ComBitPosition=64, ComBitSize=2, ComHandleId=IFridgeDoorOpenActrSts_ICBVC_CONNCANFD_200ms_FrP157_CONTROLLER_0_IAM_Rx, ComSignalType=UINT8
        IHldFdgeAftLckWorkSts_ICBVC_CONNCANFD_200ms_FrP157_CONTROLLER_0_IAM_Rx: ComBitPosition=66, ComBitSize=3, ComHandleId=IHldFdgeAftLckWorkSts_ICBVC_CONNCANFD_200ms_FrP157_CONTROLLER_0_IAM_Rx, ComSignalType=UINT8
        IFridgeModeActrSts_ICBVC_CONNCANFD_200ms_FrP157_CONTROLLER_0_IAM_Rx: ComBitPosition=69, ComBitSize=3, ComHandleId=IFridgeModeActrSts_ICBVC_CONNCANFD_200ms_FrP157_CONTROLLER_0_IAM_Rx, ComSignalType=UINT8
        IHldFdgeAftLckAutoOffRsn_ICBVC_CONNCANFD_200ms_FrP157_CONTROLLER_0_IAM_Rx: ComBitPosition=72, ComBitSize=8, ComHandleId=IHldFdgeAftLckAutoOffRsn_ICBVC_CONNCANFD_200ms_FrP157_CONTROLLER_0_IAM_Rx, ComSignalType=UINT8
        IHldFdgeAftLckTiSetInfo_ICBVC_CONNCANFD_200ms_FrP157_CONTROLLER_0_IAM_Rx: ComBitPosition=80, ComBitSize=8, ComHandleId=IHldFdgeAftLckTiSetInfo_ICBVC_CONNCANFD_200ms_FrP157_CONTROLLER_0_IAM_Rx, ComSignalType=UINT8
        IHldFdgeAftLckTempSetInfo_ICBVC_CONNCANFD_200ms_FrP157_CONTROLLER_0_IAM_Rx: ComBitPosition=88, ComBitSize=8, ComHandleId=IHldFdgeAftLckTempSetInfo_ICBVC_CONNCANFD_200ms_FrP157_CONTROLLER_0_IAM_Rx, ComSignalType=UINT8
        IFridgeActualTempActrSts_ICBVC_CONNCANFD_200ms_FrP157_CONTROLLER_0_IAM_Rx: ComBitPosition=96, ComBitSize=8, ComHandleId=IFridgeActualTempActrSts_ICBVC_CONNCANFD_200ms_FrP157_CONTROLLER_0_IAM_Rx, ComSignalType=UINT8
        IFridgeSetTempActrSts_ICBVC_CONNCANFD_200ms_FrP157_CONTROLLER_0_IAM_Rx: ComBitPosition=104, ComBitSize=8, ComHandleId=IFridgeSetTempActrSts_ICBVC_CONNCANFD_200ms_FrP157_CONTROLLER_0_IAM_Rx, ComSignalType=UINT8
        IHldFdgeAftLckRmnngTi_ICBVC_CONNCANFD_200ms_FrP157_CONTROLLER_0_IAM_Rx: ComBitPosition=120, ComBitSize=16, ComHandleId=IHldFdgeAftLckRmnngTi_ICBVC_CONNCANFD_200ms_FrP157_CONTROLLER_0_IAM_Rx, ComSignalType=UINT16
      ESS_PTCANFD_200ms_FrP42_CONTROLLER_0_IAM_Rx (ComIPdu):
        ComIPduCancellationSupport = false
        ComIPduDirection = RECEIVE
        ComIPduHandleId = COM_RXPDU_COM_ESS_PTCANFD_200ms_FrP42_CONTROLLER_0_IAM_Rx
        ComIPduSignalProcessing = DEFERRED
        ComIPduType = NORMAL
        ComPduIdRef = COM_ESS_PTCANFD_200ms_FrP42_CONTROLLER_0_IAM_Rx
        ComIPduSignalRef = IBMSRptBatCodeIndx_ESS_PTCANFD_200ms_FrP42_CONTROLLER_0_IAM_Rx
        ComIPduSignalRef = IBMSRptBatCodeAsc{1..7}_ESS_PTCANFD_200ms_FrP42_CONTROLLER_0_IAM_Rx
        ComIPduGroupRef = Com_RxPduGroup_CONTROLLER_0_IAM
      8 x ComSignal, all with ComBitSize=8, ComInvalidNotification=NULL_PTR, ComRxDataTimeoutAction=NONE, ComSignalEndianness=BIG_ENDIAN, ComSignalInitValue=0x0, ComSignalLength=0, ComSignalType=UINT8, ComTransferProperty=PENDING, ComSignalDataInvalidValue=0x0, ComDataInvalidAction=NOTIFY, ComTimeout=0.0, ComFirstTimeout=0.0, ComNotification=Rte_COMCbk:
        IBMSRptBatCodeIndx_ESS_PTCANFD_200ms_FrP42_CONTROLLER_0_IAM_Rx: ComBitPosition=0, ComHandleId=IBMSRptBatCodeIndx_ESS_PTCANFD_200ms_FrP42_CONTROLLER_0_IAM_Rx
        IBMSRptBatCodeAsc1_ESS_PTCANFD_200ms_FrP42_CONTROLLER_0_IAM_Rx: ComBitPosition=8, ComHandleId=IBMSRptBatCodeAsc1_ESS_PTCANFD_200ms_FrP42_CONTROLLER_0_IAM_Rx
        IBMSRptBatCodeAsc2_ESS_PTCANFD_200ms_FrP42_CONTROLLER_0_IAM_Rx: ComBitPosition=16, ComHandleId=IBMSRptBatCodeAsc2_ESS_PTCANFD_200ms_FrP42_CONTROLLER_0_IAM_Rx
        IBMSRptBatCodeAsc3_ESS_PTCANFD_200ms_FrP42_CONTROLLER_0_IAM_Rx: ComBitPosition=24, ComHandleId=IBMSRptBatCodeAsc3_ESS_PTCANFD_200ms_FrP42_CONTROLLER_0_IAM_Rx
        IBMSRptBatCodeAsc4_ESS_PTCANFD_200ms_FrP42_CONTROLLER_0_IAM_Rx: ComBitPosition=32, ComHandleId=IBMSRptBatCodeAsc4_ESS_PTCANFD_200ms_FrP42_CONTROLLER_0_IAM_Rx
        IBMSRptBatCodeAsc5_ESS_PTCANFD_200ms_FrP42_CONTROLLER_0_IAM_Rx: ComBitPosition=40, ComHandleId=IBMSRptBatCodeAsc5_ESS_PTCANFD_200ms_FrP42_CONTROLLER_0_IAM_Rx
        IBMSRptBatCodeAsc6_ESS_PTCANFD_200ms_FrP42_CONTROLLER_0_IAM_Rx: ComBitPosition=48, ComHandleId=IBMSRptBatCodeAsc6_ESS_PTCANFD_200ms_FrP42_CONTROLLER_0_IAM_Rx
        IBMSRptBatCodeAsc7_ESS_PTCANFD_200ms_FrP42_CONTROLLER_0_IAM_Rx: ComBitPosition=56, ComHandleId=IBMSRptBatCodeAsc7_ESS_PTCANFD_200ms_FrP42_CONTROLLER_0_IAM_Rx
      ESS_PTCANFD_200ms_FrP39_CONTROLLER_0_IAM_Rx (ComIPdu):
        ComIPduCancellationSupport = false
        ComIPduDirection = RECEIVE
        ComIPduHandleId = COM_RXPDU_COM_ESS_PTCANFD_200ms_FrP39_CONTROLLER_0_IAM_Rx
        ComIPduSignalProcessing = DEFERRED
        ComIPduType = NORMAL
        ComPduIdRef = COM_ESS_PTCANFD_200ms_FrP39_CONTROLLER_0_IAM_Rx
        ComIPduSignalRef = IBMSCellVolSumNum_ESS_PTCANFD_200ms_FrP39_CONTROLLER_0_IAM_Rx
        ComIPduSignalRef = IBMSCellTemSumNum_ESS_PTCANFD_200ms_FrP39_CONTROLLER_0_IAM_Rx
        ComIPduSignalRef = IBMSBusbarTemSumNum_ESS_PTCANFD_200ms_FrP39_CONTROLLER_0_IAM_Rx
        ComIPduGroupRef = Com_RxPduGroup_CONTROLLER_0_IAM
      3 x ComSignal, all with ComBitSize=8, ComInvalidNotification=NULL_PTR, ComRxDataTimeoutAction=NONE, ComSignalEndianness=BIG_ENDIAN, ComSignalInitValue=0x0, ComSignalLength=0, ComSignalType=UINT8, ComTransferProperty=PENDING, ComSignalDataInvalidValue=0x0, ComDataInvalidAction=NOTIFY, ComTimeout=0.0, ComFirstTimeout=0.0, ComNotification=Rte_COMCbk:
        IBMSCellVolSumNum_ESS_PTCANFD_200ms_FrP39_CONTROLLER_0_IAM_Rx: ComBitPosition=16, ComHandleId=IBMSCellVolSumNum_ESS_PTCANFD_200ms_FrP39_CONTROLLER_0_IAM_Rx
        IBMSCellTemSumNum_ESS_PTCANFD_200ms_FrP39_CONTROLLER_0_IAM_Rx: ComBitPosition=24, ComHandleId=IBMSCellTemSumNum_ESS_PTCANFD_200ms_FrP39_CONTROLLER_0_IAM_Rx
        IBMSBusbarTemSumNum_ESS_PTCANFD_200ms_FrP39_CONTROLLER_0_IAM_Rx: ComBitPosition=32, ComHandleId=IBMSBusbarTemSumNum_ESS_PTCANFD_200ms_FrP39_CONTROLLER_0_IAM_Rx
      ICBAD_BKPCANFD_100ms_FrP38_CONTROLLER_0_IAM_Rx (ComIPdu):
        ComIPduCancellationSupport = false
        ComIPduDirection = RECEIVE
        ComIPduHandleId = COM_RXPDU_COM_ICBAD_BKPCANFD_100ms_FrP38_CONTROLLER_0_IAM_Rx
        ComIPduSignalProcessing = DEFERRED
        ComIPduType = NORMAL
        ComPduIdRef = COM_ICBAD_BKPCANFD_100ms_FrP38_CONTROLLER_0_IAM_Rx
        ComIPduSignalRef = INOAMsgIndcr_ICBAD_BKPCANFD_100ms_FrP38_CONTROLLER_0_IAM_Rx
        ComIPduSignalRef = INOALaneChag_ICBAD_BKPCANFD_100ms_FrP38_CONTROLLER_0_IAM_Rx
        ComIPduGroupRef = Com_RxPduGroup_CONTROLLER_0_IAM
      INOAMsgIndcr_ICBAD_BKPCANFD_100ms_FrP38_CONTROLLER_0_IAM_Rx (ComSignal):
        ComBitPosition = 83
        ComBitSize = 5
        ComHandleId = INOAMsgIndcr_ICBAD_BKPCANFD_100ms_FrP38_CONTROLLER_0_IAM_Rx
        ComInvalidNotification = NULL_PTR
        ComRxDataTimeoutAction = NONE
        ComSignalEndianness = BIG_ENDIAN
        ComSignalInitValue = 0x0
        ComSignalLength = 0
        ComSignalType = UINT8
        ComTransferProperty = PENDING
        ComSignalDataInvalidValue = 0x0
        ComDataInvalidAction = NOTIFY
        ComTimeout = 0.0
        ComFirstTimeout = 0.0
        ComNotification = Rte_COMCbk
      INOALaneChag_ICBAD_BKPCANFD_100ms_FrP38_CONTROLLER_0_IAM_Rx (ComSignal):
        ComBitPosition = 115
        ComBitSize = 5
        ComHandleId = INOALaneChag_ICBAD_BKPCANFD_100ms_FrP38_CONTROLLER_0_IAM_Rx
        ComInvalidNotification = NULL_PTR
        ComRxDataTimeoutAction = NONE
        ComSignalEndianness = BIG_ENDIAN
        ComSignalInitValue = 0x0
        ComSignalLength = 0
        ComSignalType = UINT8
        ComTransferProperty = PENDING
        ComSignalDataInvalidValue = 0x0
        ComDataInvalidAction = NOTIFY
        ComTimeout = 0.0
        ComFirstTimeout = 0.0
        ComNotification = Rte_COMCbk
      CCU_PTEXTDCAN_100ms_FrP06_CONTROLLER_0_IAM_Rx (ComIPdu):
        ComIPduCancellationSupport = false
        ComIPduDirection = RECEIVE
        ComIPduHandleId = COM_RXPDU_COM_CCU_PTEXTDCAN_100ms_FrP06_CONTROLLER_0_IAM_Rx
        ComIPduSignalProcessing = DEFERRED
        ComIPduType = NORMAL
        ComPduIdRef = COM_CCU_PTEXTDCAN_100ms_FrP06_CONTROLLER_0_IAM_Rx
        ComIPduSignalRef = IHVDCDCStaBkup_CCU_PTEXTDCAN_100ms_FrP06_CONTROLLER_0_IAM_Rx
        ComIPduSignalRef = IHVDCDCTemBkup_CCU_PTEXTDCAN_100ms_FrP06_CONTROLLER_0_IAM_Rx
        ComIPduGroupRef = Com_RxPduGroup_CONTROLLER_0_IAM
      IHVDCDCStaBkup_CCU_PTEXTDCAN_100ms_FrP06_CONTROLLER_0_IAM_Rx (ComSignal):
        ComBitPosition = 16
        ComBitSize = 3
        ComHandleId = IHVDCDCStaBkup_CCU_PTEXTDCAN_100ms_FrP06_CONTROLLER_0_IAM_Rx
        ComInvalidNotification = NULL_PTR
        ComRxDataTimeoutAction = NONE
        ComSignalEndianness = BIG_ENDIAN
        ComSignalInitValue = 0x0
        ComSignalLength = 0
        ComSignalType = UINT8
        ComTransferProperty = PENDING
        ComSignalDataInvalidValue = 0x0
        ComDataInvalidAction = NOTIFY
        ComTimeout = 0.0
        ComFirstTimeout = 0.0
        ComNotification = Rte_COMCbk
      IHVDCDCTemBkup_CCU_PTEXTDCAN_100ms_FrP06_CONTROLLER_0_IAM_Rx (ComSignal):
        ComBitPosition = 48
        ComBitSize = 8
        ComHandleId = IHVDCDCTemBkup_CCU_PTEXTDCAN_100ms_FrP06_CONTROLLER_0_IAM_Rx
        ComInvalidNotification = NULL_PTR
        ComRxDataTimeoutAction = NONE
        ComSignalEndianness = BIG_ENDIAN
        ComSignalInitValue = 0x0
        ComSignalLength = 0
        ComSignalType = UINT8
        ComTransferProperty = PENDING
        ComSignalDataInvalidValue = 0x0
        ComDataInvalidAction = NOTIFY
        ComTimeout = 0.0
        ComFirstTimeout = 0.0
        ComNotification = Rte_COMCbk
      RZCU_PTEXTDCAN_100ms_FrP21_CONTROLLER_0_IAM_Rx (ComIPdu):
        ComIPduCancellationSupport = false
        ComIPduDirection = RECEIVE
        ComIPduHandleId = COM_RXPDU_COM_RZCU_PTEXTDCAN_100ms_FrP21_CONTROLLER_0_IAM_Rx
        ComIPduSignalProcessing = DEFERRED
        ComIPduType = NORMAL
        ComIPduCallout = RZCU_PTEXTDCAN_100ms_FrP21_CONTROLLER_0_IAM_Rx
        ComPduIdRef = COM_RZCU_PTEXTDCAN_100ms_FrP21_CONTROLLER_0_IAM_Rx
        ComIPduSignalGroupRef = IRZCU_100ms_Group21_RZCU_PTEXTDCAN_100ms_FrP21_CONTROLLER_0_IAM_Rx
        ComIPduGroupRef = Com_RxPduGroup_CONTROLLER_0_IAM
      IRZCU_100ms_Group21_RZCU_PTEXTDCAN_100ms_FrP21_CONTROLLER_0_IAM_Rx (ComSignalGroup):
        ComHandleId = IRZCU_100ms_Group21_RZCU_PTEXTDCAN_100ms_FrP21_CONTROLLER_0_IAM_Rx
        ComInvalidNotification = NULL_PTR
        ComRxDataTimeoutAction = NONE
        ComTransferProperty = PENDING
        ComDataInvalidAction = NOTIFY
        ComTimeout = 0.0
        ComFirstTimeout = 0.0
        ComNotification = Rte_COMCbk
        14 x ComGroupSignal, all with ComSignalEndianness=BIG_ENDIAN, ComSignalInitValue=0x0, ComSignalLength=0, ComSignalDataInvalidValue=0x0:
          IRZCU_100ms_Group21_CRC_IRZCU_100ms_Group21_RZCU_PTEXTDCAN_100ms_FrP21_CONTROLLER_0_IAM_Rx: ComBitPosition=0, ComBitSize=8, ComHandleId=IRZCU_100ms_Group21_RZCU_PTEXTDCAN_100ms_FrP21_CONTROLLER_0_IAM_Rx_IRZCU_100ms_Group21_CRC_IRZCU_100ms_Group21_RZCU_PTEXTDCAN_100ms_FrP21_CONTROLLER_0_IAM_Rx, ComSignalType=UINT8
          IRZCU_100ms_Group21_RC_IRZCU_100ms_Group21_RZCU_PTEXTDCAN_100ms_FrP21_CONTROLLER_0_IAM_Rx: ComBitPosition=8, ComBitSize=4, ComHandleId=IRZCU_100ms_Group21_RZCU_PTEXTDCAN_100ms_FrP21_CONTROLLER_0_IAM_Rx_IRZCU_100ms_Group21_RC_IRZCU_100ms_Group21_RZCU_PTEXTDCAN_100ms_FrP21_CONTROLLER_0_IAM_Rx, ComSignalType=UINT8
          IRZCU_100ms_Group21_Reserved1_IRZCU_100ms_Group21_RZCU_PTEXTDCAN_100ms_FrP21_CONTROLLER_0_IAM_Rx: ComBitPosition=12, ComBitSize=2, ComHandleId=IRZCU_100ms_Group21_RZCU_PTEXTDCAN_100ms_FrP21_CONTROLLER_0_IAM_Rx_IRZCU_100ms_Group21_Reserved1_IRZCU_100ms_Group21_RZCU_PTEXTDCAN_100ms_FrP21_CONTROLLER_0_IAM_Rx, ComSignalType=UINT8
          IOffBdChrgrPlugOnBkup_IRZCU_100ms_Group21_RZCU_PTEXTDCAN_100ms_FrP21_CONTROLLER_0_IAM_Rx: ComBitPosition=14, ComBitSize=2, ComHandleId=IRZCU_100ms_Group21_RZCU_PTEXTDCAN_100ms_FrP21_CONTROLLER_0_IAM_Rx_IOffBdChrgrPlugOnBkup_IRZCU_100ms_Group21_RZCU_PTEXTDCAN_100ms_FrP21_CONTROLLER_0_IAM_Rx, ComSignalType=UINT8
          IRZCU_100ms_Group21_Reserved2_IRZCU_100ms_Group21_RZCU_PTEXTDCAN_100ms_FrP21_CONTROLLER_0_IAM_Rx: ComBitPosition=16, ComBitSize=8, ComHandleId=IRZCU_100ms_Group21_RZCU_PTEXTDCAN_100ms_FrP21_CONTROLLER_0_IAM_Rx_IRZCU_100ms_Group21_Reserved2_IRZCU_100ms_Group21_RZCU_PTEXTDCAN_100ms_FrP21_CONTROLLER_0_IAM_Rx, ComSignalType=UINT8
          IRZCU_100ms_Group21_Reserved3_IRZCU_100ms_Group21_RZCU_PTEXTDCAN_100ms_FrP21_CONTROLLER_0_IAM_Rx: ComBitPosition=24, ComBitSize=8, ComHandleId=IRZCU_100ms_Group21_RZCU_PTEXTDCAN_100ms_FrP21_CONTROLLER_0_IAM_Rx_IRZCU_100ms_Group21_Reserved3_IRZCU_100ms_Group21_RZCU_PTEXTDCAN_100ms_FrP21_CONTROLLER_0_IAM_Rx, ComSignalType=UINT8
          IRZCU_100ms_Group21_Reserved4_IRZCU_100ms_Group21_RZCU_PTEXTDCAN_100ms_FrP21_CONTROLLER_0_IAM_Rx: ComBitPosition=32, ComBitSize=8, ComHandleId=IRZCU_100ms_Group21_RZCU_PTEXTDCAN_100ms_FrP21_CONTROLLER_0_IAM_Rx_IRZCU_100ms_Group21_Reserved4_IRZCU_100ms_Group21_RZCU_PTEXTDCAN_100ms_FrP21_CONTROLLER_0_IAM_Rx, ComSignalType=UINT8
          IRZCU_100ms_Group21_Reserved6_IRZCU_100ms_Group21_RZCU_PTEXTDCAN_100ms_FrP21_CONTROLLER_0_IAM_Rx: ComBitPosition=40, ComBitSize=4, ComHandleId=IRZCU_100ms_Group21_RZCU_PTEXTDCAN_100ms_FrP21_CONTROLLER_0_IAM_Rx_IRZCU_100ms_Group21_Reserved6_IRZCU_100ms_Group21_RZCU_PTEXTDCAN_100ms_FrP21_CONTROLLER_0_IAM_Rx, ComSignalType=UINT8
          IEmgyPwrdwnReq_IRZCU_100ms_Group21_RZCU_PTEXTDCAN_100ms_FrP21_CONTROLLER_0_IAM_Rx: ComBitPosition=44, ComBitSize=2, ComHandleId=IRZCU_100ms_Group21_RZCU_PTEXTDCAN_100ms_FrP21_CONTROLLER_0_IAM_Rx_IEmgyPwrdwnReq_IRZCU_100ms_Group21_RZCU_PTEXTDCAN_100ms_FrP21_CONTROLLER_0_IAM_Rx, ComSignalType=UINT8
          IRZCU_100ms_Group21_Reserved5_IRZCU_100ms_Group21_RZCU_PTEXTDCAN_100ms_FrP21_CONTROLLER_0_IAM_Rx: ComBitPosition=46, ComBitSize=1, ComHandleId=IRZCU_100ms_Group21_RZCU_PTEXTDCAN_100ms_FrP21_CONTROLLER_0_IAM_Rx_IRZCU_100ms_Group21_Reserved5_IRZCU_100ms_Group21_RZCU_PTEXTDCAN_100ms_FrP21_CONTROLLER_0_IAM_Rx, ComSignalType=BOOLEAN
          IOffBdChrgrPlugOnVBkup_IRZCU_100ms_Group21_RZCU_PTEXTDCAN_100ms_FrP21_CONTROLLER_0_IAM_Rx: ComBitPosition=47, ComBitSize=1, ComHandleId=IRZCU_100ms_Group21_RZCU_PTEXTDCAN_100ms_FrP21_CONTROLLER_0_IAM_Rx_IOffBdChrgrPlugOnVBkup_IRZCU_100ms_Group21_RZCU_PTEXTDCAN_100ms_FrP21_CONTROLLER_0_IAM_Rx, ComSignalType=BOOLEAN
          IRZCU_100ms_Group21_Reserved7_IRZCU_100ms_Group21_RZCU_PTEXTDCAN_100ms_FrP21_CONTROLLER_0_IAM_Rx: ComBitPosition=48, ComBitSize=8, ComHandleId=IRZCU_100ms_Group21_RZCU_PTEXTDCAN_100ms_FrP21_CONTROLLER_0_IAM_Rx_IRZCU_100ms_Group21_Reserved7_IRZCU_100ms_Group21_RZCU_PTEXTDCAN_100ms_FrP21_CONTROLLER_0_IAM_Rx, ComSignalType=UINT8
          IOffBdPlugOnRepBkup_IRZCU_100ms_Group21_RZCU_PTEXTDCAN_100ms_FrP21_CONTROLLER_0_IAM_Rx: ComBitPosition=56, ComBitSize=7, ComHandleId=IRZCU_100ms_Group21_RZCU_PTEXTDCAN_100ms_FrP21_CONTROLLER_0_IAM_Rx_IOffBdPlugOnRepBkup_IRZCU_100ms_Group21_RZCU_PTEXTDCAN_100ms_FrP21_CONTROLLER_0_IAM_Rx, ComSignalType=UINT8
          IRZCU_100ms_Group21_Reserved8_IRZCU_100ms_Group21_RZCU_PTEXTDCAN_100ms_FrP21_CONTROLLER_0_IAM_Rx: ComBitPosition=63, ComBitSize=1, ComHandleId=IRZCU_100ms_Group21_RZCU_PTEXTDCAN_100ms_FrP21_CONTROLLER_0_IAM_Rx_IRZCU_100ms_Group21_Reserved8_IRZCU_100ms_Group21_RZCU_PTEXTDCAN_100ms_FrP21_CONTROLLER_0_IAM_Rx, ComSignalType=BOOLEAN
      TC_PTCANFD_20ms_FrP08_CONTROLLER_0_IAM_Rx (ComIPdu):
        ComIPduCancellationSupport = false
        ComIPduDirection = RECEIVE
        ComIPduHandleId = COM_RXPDU_COM_TC_PTCANFD_20ms_FrP08_CONTROLLER_0_IAM_Rx
        ComIPduSignalProcessing = DEFERRED
        ComIPduType = NORMAL
        ComPduIdRef = COM_TC_PTCANFD_20ms_FrP08_CONTROLLER_0_IAM_Rx
        ComIPduSignalRef = ITMInvtrCrntHiPre_TC_PTCANFD_20ms_FrP08_CONTROLLER_0_IAM_Rx
        ComIPduSignalRef = ITMActuToqHiPre_TC_PTCANFD_20ms_FrP08_CONTROLLER_0_IAM_Rx
        ComIPduGroupRef = Com_RxPduGroup_CONTROLLER_0_IAM
      ITMInvtrCrntHiPre_TC_PTCANFD_20ms_FrP08_CONTROLLER_0_IAM_Rx (ComSignal):
        ComBitPosition = 9
        ComBitSize = 15
        ComHandleId = ITMInvtrCrntHiPre_TC_PTCANFD_20ms_FrP08_CONTROLLER_0_IAM_Rx
        ComInvalidNotification = NULL_PTR
        ComRxDataTimeoutAction = NONE
        ComSignalEndianness = BIG_ENDIAN
        ComSignalInitValue = 0x0
        ComSignalLength = 0
        ComSignalType = UINT16
        ComTransferProperty = PENDING
        ComSignalDataInvalidValue = 0x0
        ComDataInvalidAction = NOTIFY
        ComTimeout = 0.0
        ComFirstTimeout = 0.0
        ComNotification = Rte_COMCbk
      ITMActuToqHiPre_TC_PTCANFD_20ms_FrP08_CONTROLLER_0_IAM_Rx (ComSignal):
        ComBitPosition = 24
        ComBitSize = 16
        ComHandleId = ITMActuToqHiPre_TC_PTCANFD_20ms_FrP08_CONTROLLER_0_IAM_Rx
        ComInvalidNotification = NULL_PTR
        ComRxDataTimeoutAction = NONE
        ComSignalEndianness = BIG_ENDIAN
        ComSignalInitValue = 0x0
        ComSignalLength = 0
        ComSignalType = UINT16
        ComTransferProperty = PENDING
        ComSignalDataInvalidValue = 0x0
        ComDataInvalidAction = NOTIFY
        ComTimeout = 0.0
        ComFirstTimeout = 0.0
        ComNotification = Rte_COMCbk
      LHZCU_LHBKBCANFDF_400ms_FrP18_CONTROLLER_0_IAM_Rx (ComIPdu):
        ComIPduCancellationSupport = false
        ComIPduDirection = RECEIVE
        ComIPduHandleId = COM_RXPDU_COM_LHZCU_LHBKBCANFDF_400ms_FrP18_CONTROLLER_0_IAM_Rx
        ComIPduSignalProcessing = DEFERRED
        ComIPduType = NORMAL
        ComPduIdRef = COM_LHZCU_LHBKBCANFDF_400ms_FrP18_CONTROLLER_0_IAM_Rx
        ComIPduSignalRef = IFRTireSts_SVW_LHZCU_LHBKBCANFDF_400ms_FrP18_CONTROLLER_0_IAM_Rx
        ComIPduSignalRef = IFLTireSts_SVW_LHZCU_LHBKBCANFDF_400ms_FrP18_CONTROLLER_0_IAM_Rx
        ComIPduSignalRef = IRRTireSts_SVW_LHZCU_LHBKBCANFDF_400ms_FrP18_CONTROLLER_0_IAM_Rx
        ComIPduSignalRef = IRLTireSts_SVW_LHZCU_LHBKBCANFDF_400ms_FrP18_CONTROLLER_0_IAM_Rx
        ComIPduGroupRef = Com_RxPduGroup_CONTROLLER_0_IAM
      4 x ComSignal, all with ComBitSize=4, ComInvalidNotification=NULL_PTR, ComRxDataTimeoutAction=NONE, ComSignalEndianness=BIG_ENDIAN, ComSignalInitValue=0x0, ComSignalLength=0, ComSignalType=UINT8, ComTransferProperty=PENDING, ComSignalDataInvalidValue=0x0, ComDataInvalidAction=NOTIFY, ComTimeout=0.0, ComFirstTimeout=0.0, ComNotification=Rte_COMCbk:
        IFRTireSts_SVW_LHZCU_LHBKBCANFDF_400ms_FrP18_CONTROLLER_0_IAM_Rx: ComBitPosition=16, ComHandleId=IFRTireSts_SVW_LHZCU_LHBKBCANFDF_400ms_FrP18_CONTROLLER_0_IAM_Rx
        IFLTireSts_SVW_LHZCU_LHBKBCANFDF_400ms_FrP18_CONTROLLER_0_IAM_Rx: ComBitPosition=20, ComHandleId=IFLTireSts_SVW_LHZCU_LHBKBCANFDF_400ms_FrP18_CONTROLLER_0_IAM_Rx
        IRRTireSts_SVW_LHZCU_LHBKBCANFDF_400ms_FrP18_CONTROLLER_0_IAM_Rx: ComBitPosition=24, ComHandleId=IRRTireSts_SVW_LHZCU_LHBKBCANFDF_400ms_FrP18_CONTROLLER_0_IAM_Rx
        IRLTireSts_SVW_LHZCU_LHBKBCANFDF_400ms_FrP18_CONTROLLER_0_IAM_Rx: ComBitPosition=28, ComHandleId=IRLTireSts_SVW_LHZCU_LHBKBCANFDF_400ms_FrP18_CONTROLLER_0_IAM_Rx
      ICBVC_RZCUCANFD_200ms_FrP79_CONTROLLER_0_IAM_Rx (ComIPdu):
        ComIPduCancellationSupport = false
        ComIPduDirection = RECEIVE
        ComIPduHandleId = COM_RXPDU_COM_ICBVC_RZCUCANFD_200ms_FrP79_CONTROLLER_0_IAM_Rx
        ComIPduSignalProcessing = DEFERRED
        ComIPduType = NORMAL
        ComIPduCallout = ICBVC_RZCUCANFD_200ms_FrP79_CONTROLLER_0_IAM_Rx
        ComPduIdRef = COM_ICBVC_RZCUCANFD_200ms_FrP79_CONTROLLER_0_IAM_Rx
        ComIPduSignalGroupRef = IICBVC_200ms_Group79_ICBVC_RZCUCANFD_200ms_FrP79_CONTROLLER_0_IAM_Rx
        ComIPduGroupRef = Com_RxPduGroup_CONTROLLER_0_IAM
      IICBVC_200ms_Group79_ICBVC_RZCUCANFD_200ms_FrP79_CONTROLLER_0_IAM_Rx (ComSignalGroup):
        ComHandleId = IICBVC_200ms_Group79_ICBVC_RZCUCANFD_200ms_FrP79_CONTROLLER_0_IAM_Rx
        ComInvalidNotification = NULL_PTR
        ComRxDataTimeoutAction = NONE
        ComTransferProperty = PENDING
        ComDataInvalidAction = NOTIFY
        ComTimeout = 0.0
        ComFirstTimeout = 0.0
        ComNotification = Rte_COMCbk
        9 x ComGroupSignal, all with ComSignalEndianness=BIG_ENDIAN, ComSignalInitValue=0x0, ComSignalLength=0, ComSignalDataInvalidValue=0x0:
          IICBVC_200ms_Group79_CRC_IICBVC_200ms_Group79_ICBVC_RZCUCANFD_200ms_FrP79_CONTROLLER_0_IAM_Rx: ComBitPosition=0, ComBitSize=8, ComHandleId=IICBVC_200ms_Group79_ICBVC_RZCUCANFD_200ms_FrP79_CONTROLLER_0_IAM_Rx_IICBVC_200ms_Group79_CRC_IICBVC_200ms_Group79_ICBVC_RZCUCANFD_200ms_FrP79_CONTROLLER_0_IAM_Rx, ComSignalType=UINT8
          IICBVC_200ms_Group79_RC_IICBVC_200ms_Group79_ICBVC_RZCUCANFD_200ms_FrP79_CONTROLLER_0_IAM_Rx: ComBitPosition=8, ComBitSize=4, ComHandleId=IICBVC_200ms_Group79_ICBVC_RZCUCANFD_200ms_FrP79_CONTROLLER_0_IAM_Rx_IICBVC_200ms_Group79_RC_IICBVC_200ms_Group79_ICBVC_RZCUCANFD_200ms_FrP79_CONTROLLER_0_IAM_Rx, ComSignalType=UINT8
          IICBVC_200ms_Group79_Reserved1_IICBVC_200ms_Group79_ICBVC_RZCUCANFD_200ms_FrP79_CONTROLLER_0_IAM_Rx: ComBitPosition=12, ComBitSize=1, ComHandleId=IICBVC_200ms_Group79_ICBVC_RZCUCANFD_200ms_FrP79_CONTROLLER_0_IAM_Rx_IICBVC_200ms_Group79_Reserved1_IICBVC_200ms_Group79_ICBVC_RZCUCANFD_200ms_FrP79_CONTROLLER_0_IAM_Rx, ComSignalType=BOOLEAN
          IOdoPriyPrcsV_IICBVC_200ms_Group79_ICBVC_RZCUCANFD_200ms_FrP79_CONTROLLER_0_IAM_Rx: ComBitPosition=13, ComBitSize=1, ComHandleId=IICBVC_200ms_Group79_ICBVC_RZCUCANFD_200ms_FrP79_CONTROLLER_0_IAM_Rx_IOdoPriyPrcsV_IICBVC_200ms_Group79_ICBVC_RZCUCANFD_200ms_FrP79_CONTROLLER_0_IAM_Rx, ComSignalType=BOOLEAN
          IEPTNotReadyReq_IICBVC_200ms_Group79_ICBVC_RZCUCANFD_200ms_FrP79_CONTROLLER_0_IAM_Rx: ComBitPosition=14, ComBitSize=1, ComHandleId=IICBVC_200ms_Group79_ICBVC_RZCUCANFD_200ms_FrP79_CONTROLLER_0_IAM_Rx_IEPTNotReadyReq_IICBVC_200ms_Group79_ICBVC_RZCUCANFD_200ms_FrP79_CONTROLLER_0_IAM_Rx, ComSignalType=BOOLEAN
          IClstrDspdAirbagWrnng_IICBVC_200ms_Group79_ICBVC_RZCUCANFD_200ms_FrP79_CONTROLLER_0_IAM_Rx: ComBitPosition=15, ComBitSize=1, ComHandleId=IICBVC_200ms_Group79_ICBVC_RZCUCANFD_200ms_FrP79_CONTROLLER_0_IAM_Rx_IClstrDspdAirbagWrnng_IICBVC_200ms_Group79_ICBVC_RZCUCANFD_200ms_FrP79_CONTROLLER_0_IAM_Rx, ComSignalType=BOOLEAN
          IICBVC_200ms_Group79_Reserved2_IICBVC_200ms_Group79_ICBVC_RZCUCANFD_200ms_FrP79_CONTROLLER_0_IAM_Rx: ComBitPosition=16, ComBitSize=8, ComHandleId=IICBVC_200ms_Group79_ICBVC_RZCUCANFD_200ms_FrP79_CONTROLLER_0_IAM_Rx_IICBVC_200ms_Group79_Reserved2_IICBVC_200ms_Group79_ICBVC_RZCUCANFD_200ms_FrP79_CONTROLLER_0_IAM_Rx, ComSignalType=UINT8
          IICBVC_200ms_Group79_Reserved3_IICBVC_200ms_Group79_ICBVC_RZCUCANFD_200ms_FrP79_CONTROLLER_0_IAM_Rx: ComBitPosition=24, ComBitSize=8, ComHandleId=IICBVC_200ms_Group79_ICBVC_RZCUCANFD_200ms_FrP79_CONTROLLER_0_IAM_Rx_IICBVC_200ms_Group79_Reserved3_IICBVC_200ms_Group79_ICBVC_RZCUCANFD_200ms_FrP79_CONTROLLER_0_IAM_Rx, ComSignalType=UINT8
          IOdoPriyPrcs_IICBVC_200ms_Group79_ICBVC_RZCUCANFD_200ms_FrP79_CONTROLLER_0_IAM_Rx: ComBitPosition=56, ComBitSize=32, ComHandleId=IICBVC_200ms_Group79_ICBVC_RZCUCANFD_200ms_FrP79_CONTROLLER_0_IAM_Rx_IOdoPriyPrcs_IICBVC_200ms_Group79_ICBVC_RZCUCANFD_200ms_FrP79_CONTROLLER_0_IAM_Rx, ComSignalType=UINT32
      ICBVC_CONNCANFD_Event_FrS145_CONTROLLER_0_IAM_Rx (ComIPdu):
        ComIPduCancellationSupport = false
        ComIPduDirection = RECEIVE
        ComIPduHandleId = COM_RXPDU_COM_ICBVC_CONNCANFD_Event_FrS145_CONTROLLER_0_IAM_Rx
        ComIPduSignalProcessing = DEFERRED
        ComIPduType = NORMAL
        ComPduIdRef = COM_ICBVC_CONNCANFD_Event_FrS145_CONTROLLER_0_IAM_Rx
        ComIPduSignalRef = IRmtDrvrSeatHeatCmpResp_ICBVC_CONNCANFD_Event_FrS145_CONTROLLER_0_IAM_Rx
        ComIPduSignalRef = IRmtPsngSeatHeatCmpResp_ICBVC_CONNCANFD_Event_FrS145_CONTROLLER_0_IAM_Rx
        ComIPduSignalRef = IRmtDrvrSeatVentCmpResp_ICBVC_CONNCANFD_Event_FrS145_CONTROLLER_0_IAM_Rx
        ComIPduSignalRef = IRmtSecRowLSeatHeatCmpResp_ICBVC_CONNCANFD_Event_FrS145_CONTROLLER_0_IAM_Rx
        ComIPduSignalRef = IRmtPsngSeatVentCmpResp_ICBVC_CONNCANFD_Event_FrS145_CONTROLLER_0_IAM_Rx
        ComIPduSignalRef = IRmtSecRowRSeatHeatCmpResp_ICBVC_CONNCANFD_Event_FrS145_CONTROLLER_0_IAM_Rx
        ComIPduSignalRef = IRmtSecRowLSeatVentCmpResp_ICBVC_CONNCANFD_Event_FrS145_CONTROLLER_0_IAM_Rx
        ComIPduSignalRef = IRmtThrdRowRSeatHeatCmpResp_ICBVC_CONNCANFD_Event_FrS145_CONTROLLER_0_IAM_Rx
        ComIPduSignalRef = IRmtSecRowRSeatVentCmpResp_ICBVC_CONNCANFD_Event_FrS145_CONTROLLER_0_IAM_Rx
        ComIPduSignalRef = IRmtThrdRowLSeatHeatCmpResp_ICBVC_CONNCANFD_Event_FrS145_CONTROLLER_0_IAM_Rx
        ComIPduSignalRef = IRmtThrdRowRSeatVentCmpResp_ICBVC_CONNCANFD_Event_FrS145_CONTROLLER_0_IAM_Rx
        ComIPduSignalRef = IRmtACCompResp_ICBVC_CONNCANFD_Event_FrS145_CONTROLLER_0_IAM_Rx
        ComIPduSignalRef = IRmtThrdRowLSeatVentCmpResp_ICBVC_CONNCANFD_Event_FrS145_CONTROLLER_0_IAM_Rx
        ComIPduSignalRef = IRmtStrgWhlHeatCmpResp_ICBVC_CONNCANFD_Event_FrS145_CONTROLLER_0_IAM_Rx
        ComIPduSignalRef = IRmtBattWarmCompResp_ICBVC_CONNCANFD_Event_FrS145_CONTROLLER_0_IAM_Rx
        ComIPduSignalRef = IRVSAbotRsn_ICBVC_CONNCANFD_Event_FrS145_CONTROLLER_0_IAM_Rx
        ComIPduSignalRef = IRmtCtrlPwrLftgtCmpResp_ICBVC_CONNCANFD_Event_FrS145_CONTROLLER_0_IAM_Rx
        ComIPduGroupRef = Com_RxPduGroup_CONTROLLER_0_IAM
      17 x ComSignal, all with ComInvalidNotification=NULL_PTR, ComRxDataTimeoutAction=NONE, ComSignalEndianness=BIG_ENDIAN, ComSignalInitValue=0x0, ComSignalLength=0, ComSignalType=UINT8, ComTransferProperty=TRIGGERED, ComSignalDataInvalidValue=0x0, ComDataInvalidAction=NOTIFY, ComTimeout=0.0, ComFirstTimeout=0.0, ComNotification=Rte_COMCbk:
        IRmtDrvrSeatHeatCmpResp_ICBVC_CONNCANFD_Event_FrS145_CONTROLLER_0_IAM_Rx: ComBitPosition=12, ComBitSize=4, ComHandleId=IRmtDrvrSeatHeatCmpResp_ICBVC_CONNCANFD_Event_FrS145_CONTROLLER_0_IAM_Rx
        IRmtPsngSeatHeatCmpResp_ICBVC_CONNCANFD_Event_FrS145_CONTROLLER_0_IAM_Rx: ComBitPosition=16, ComBitSize=4, ComHandleId=IRmtPsngSeatHeatCmpResp_ICBVC_CONNCANFD_Event_FrS145_CONTROLLER_0_IAM_Rx
        IRmtDrvrSeatVentCmpResp_ICBVC_CONNCANFD_Event_FrS145_CONTROLLER_0_IAM_Rx: ComBitPosition=20, ComBitSize=4, ComHandleId=IRmtDrvrSeatVentCmpResp_ICBVC_CONNCANFD_Event_FrS145_CONTROLLER_0_IAM_Rx
        IRmtSecRowLSeatHeatCmpResp_ICBVC_CONNCANFD_Event_FrS145_CONTROLLER_0_IAM_Rx: ComBitPosition=24, ComBitSize=4, ComHandleId=IRmtSecRowLSeatHeatCmpResp_ICBVC_CONNCANFD_Event_FrS145_CONTROLLER_0_IAM_Rx
        IRmtPsngSeatVentCmpResp_ICBVC_CONNCANFD_Event_FrS145_CONTROLLER_0_IAM_Rx: ComBitPosition=28, ComBitSize=4, ComHandleId=IRmtPsngSeatVentCmpResp_ICBVC_CONNCANFD_Event_FrS145_CONTROLLER_0_IAM_Rx
        IRmtSecRowRSeatHeatCmpResp_ICBVC_CONNCANFD_Event_FrS145_CONTROLLER_0_IAM_Rx: ComBitPosition=32, ComBitSize=4, ComHandleId=IRmtSecRowRSeatHeatCmpResp_ICBVC_CONNCANFD_Event_FrS145_CONTROLLER_0_IAM_Rx
        IRmtSecRowLSeatVentCmpResp_ICBVC_CONNCANFD_Event_FrS145_CONTROLLER_0_IAM_Rx: ComBitPosition=36, ComBitSize=4, ComHandleId=IRmtSecRowLSeatVentCmpResp_ICBVC_CONNCANFD_Event_FrS145_CONTROLLER_0_IAM_Rx
        IRmtThrdRowRSeatHeatCmpResp_ICBVC_CONNCANFD_Event_FrS145_CONTROLLER_0_IAM_Rx: ComBitPosition=40, ComBitSize=4, ComHandleId=IRmtThrdRowRSeatHeatCmpResp_ICBVC_CONNCANFD_Event_FrS145_CONTROLLER_0_IAM_Rx
        IRmtSecRowRSeatVentCmpResp_ICBVC_CONNCANFD_Event_FrS145_CONTROLLER_0_IAM_Rx: ComBitPosition=44, ComBitSize=4, ComHandleId=IRmtSecRowRSeatVentCmpResp_ICBVC_CONNCANFD_Event_FrS145_CONTROLLER_0_IAM_Rx
        IRmtThrdRowLSeatHeatCmpResp_ICBVC_CONNCANFD_Event_FrS145_CONTROLLER_0_IAM_Rx: ComBitPosition=48, ComBitSize=4, ComHandleId=IRmtThrdRowLSeatHeatCmpResp_ICBVC_CONNCANFD_Event_FrS145_CONTROLLER_0_IAM_Rx
        IRmtThrdRowRSeatVentCmpResp_ICBVC_CONNCANFD_Event_FrS145_CONTROLLER_0_IAM_Rx: ComBitPosition=52, ComBitSize=4, ComHandleId=IRmtThrdRowRSeatVentCmpResp_ICBVC_CONNCANFD_Event_FrS145_CONTROLLER_0_IAM_Rx
        IRmtACCompResp_ICBVC_CONNCANFD_Event_FrS145_CONTROLLER_0_IAM_Rx: ComBitPosition=56, ComBitSize=4, ComHandleId=IRmtACCompResp_ICBVC_CONNCANFD_Event_FrS145_CONTROLLER_0_IAM_Rx
        IRmtThrdRowLSeatVentCmpResp_ICBVC_CONNCANFD_Event_FrS145_CONTROLLER_0_IAM_Rx: ComBitPosition=60, ComBitSize=4, ComHandleId=IRmtThrdRowLSeatVentCmpResp_ICBVC_CONNCANFD_Event_FrS145_CONTROLLER_0_IAM_Rx
        IRmtStrgWhlHeatCmpResp_ICBVC_CONNCANFD_Event_FrS145_CONTROLLER_0_IAM_Rx: ComBitPosition=64, ComBitSize=4, ComHandleId=IRmtStrgWhlHeatCmpResp_ICBVC_CONNCANFD_Event_FrS145_CONTROLLER_0_IAM_Rx
        IRmtBattWarmCompResp_ICBVC_CONNCANFD_Event_FrS145_CONTROLLER_0_IAM_Rx: ComBitPosition=68, ComBitSize=4, ComHandleId=IRmtBattWarmCompResp_ICBVC_CONNCANFD_Event_FrS145_CONTROLLER_0_IAM_Rx
        IRVSAbotRsn_ICBVC_CONNCANFD_Event_FrS145_CONTROLLER_0_IAM_Rx: ComBitPosition=72, ComBitSize=4, ComHandleId=IRVSAbotRsn_ICBVC_CONNCANFD_Event_FrS145_CONTROLLER_0_IAM_Rx
        IRmtCtrlPwrLftgtCmpResp_ICBVC_CONNCANFD_Event_FrS145_CONTROLLER_0_IAM_Rx: ComBitPosition=77, ComBitSize=3, ComHandleId=IRmtCtrlPwrLftgtCmpResp_ICBVC_CONNCANFD_Event_FrS145_CONTROLLER_0_IAM_Rx
      LHZCU_LHBDCANFD_Event_FrS48_CONTROLLER_0_IAM_Rx (ComIPdu):
        ComIPduCancellationSupport = false
        ComIPduDirection = RECEIVE
        ComIPduHandleId = COM_RXPDU_COM_LHZCU_LHBDCANFD_Event_FrS48_CONTROLLER_0_IAM_Rx
        ComIPduSignalProcessing = DEFERRED
        ComIPduType = NORMAL
        ComPduIdRef = COM_LHZCU_LHBDCANFD_Event_FrS48_CONTROLLER_0_IAM_Rx
        ComIPduSignalRef = IRmtKeyVldResp_LHZCU_LHBDCANFD_Event_FrS48_CONTROLLER_0_IAM_Rx
        ComIPduSignalRef = IRmtFindMyCarFailedReason_LHZCU_LHBDCANFD_Event_FrS48_CONTROLLER_0_IAM_Rx
        ComIPduGroupRef = Com_RxPduGroup_CONTROLLER_0_IAM
      IRmtKeyVldResp_LHZCU_LHBDCANFD_Event_FrS48_CONTROLLER_0_IAM_Rx (ComSignal):
        ComBitPosition = 32
        ComBitSize = 2
        ComHandleId = IRmtKeyVldResp_LHZCU_LHBDCANFD_Event_FrS48_CONTROLLER_0_IAM_Rx
        ComInvalidNotification = NULL_PTR
        ComRxDataTimeoutAction = NONE
        ComSignalEndianness = BIG_ENDIAN
        ComSignalInitValue = 0x0
        ComSignalLength = 0
        ComSignalType = UINT8
        ComTransferProperty = TRIGGERED
        ComSignalDataInvalidValue = 0x0
        ComDataInvalidAction = NOTIFY
        ComTimeout = 0.0
        ComFirstTimeout = 0.0
        ComNotification = Rte_COMCbk
      IRmtFindMyCarFailedReason_LHZCU_LHBDCANFD_Event_FrS48_CONTROLLER_0_IAM_Rx (ComSignal):
        ComBitPosition = 52
        ComBitSize = 4
        ComHandleId = IRmtFindMyCarFailedReason_LHZCU_LHBDCANFD_Event_FrS48_CONTROLLER_0_IAM_Rx
        ComInvalidNotification = NULL_PTR
        ComRxDataTimeoutAction = NONE
        ComSignalEndianness = BIG_ENDIAN
        ComSignalInitValue = 0x0
        ComSignalLength = 0
        ComSignalType = UINT8
        ComTransferProperty = TRIGGERED
        ComSignalDataInvalidValue = 0x0
        ComDataInvalidAction = NOTIFY
        ComTimeout = 0.0
        ComFirstTimeout = 0.0
        ComNotification = Rte_COMCbk
      LHZCU_LHBDCANFD_Event_FrS49_CONTROLLER_0_IAM_Rx (ComIPdu):
        ComIPduCancellationSupport = false
        ComIPduDirection = RECEIVE
        ComIPduHandleId = COM_RXPDU_COM_LHZCU_LHBDCANFD_Event_FrS49_CONTROLLER_0_IAM_Rx
        ComIPduSignalProcessing = DEFERRED
        ComIPduType = NORMAL
        ComPduIdRef = COM_LHZCU_LHBDCANFD_Event_FrS49_CONTROLLER_0_IAM_Rx
        ComIPduSignalRef = IRmtKeyVldExecutionResp_LHZCU_LHBDCANFD_Event_FrS49_CONTROLLER_0_IAM_Rx
        ComIPduSignalRef = IRmtFindMyCarExecutionResp_LHZCU_LHBDCANFD_Event_FrS49_CONTROLLER_0_IAM_Rx
        ComIPduGroupRef = Com_RxPduGroup_CONTROLLER_0_IAM
      IRmtKeyVldExecutionResp_LHZCU_LHBDCANFD_Event_FrS49_CONTROLLER_0_IAM_Rx (ComSignal):
        ComBitPosition = 34
        ComBitSize = 1
        ComHandleId = IRmtKeyVldExecutionResp_LHZCU_LHBDCANFD_Event_FrS49_CONTROLLER_0_IAM_Rx
        ComInvalidNotification = NULL_PTR
        ComRxDataTimeoutAction = NONE
        ComSignalEndianness = BIG_ENDIAN
        ComSignalInitValue = 0x0
        ComSignalLength = 0
        ComSignalType = BOOLEAN
        ComTransferProperty = TRIGGERED
        ComSignalDataInvalidValue = 0x0
        ComDataInvalidAction = NOTIFY
        ComTimeout = 0.0
        ComFirstTimeout = 0.0
        ComNotification = Rte_COMCbk
      IRmtFindMyCarExecutionResp_LHZCU_LHBDCANFD_Event_FrS49_CONTROLLER_0_IAM_Rx (ComSignal):
        ComBitPosition = 46
        ComBitSize = 2
        ComHandleId = IRmtFindMyCarExecutionResp_LHZCU_LHBDCANFD_Event_FrS49_CONTROLLER_0_IAM_Rx
        ComInvalidNotification = NULL_PTR
        ComRxDataTimeoutAction = NONE
        ComSignalEndianness = BIG_ENDIAN
        ComSignalInitValue = 0x0
        ComSignalLength = 0
        ComSignalType = UINT8
        ComTransferProperty = TRIGGERED
        ComSignalDataInvalidValue = 0x0
        ComDataInvalidAction = NOTIFY
        ComTimeout = 0.0
        ComFirstTimeout = 0.0
        ComNotification = Rte_COMCbk
      ICBVC_RHBKBCANFD_500ms_FrP67_CONTROLLER_0_IAM_Rx (ComIPdu):
        ComIPduCancellationSupport = false
        ComIPduDirection = RECEIVE
        ComIPduHandleId = COM_RXPDU_COM_ICBVC_RHBKBCANFD_500ms_FrP67_CONTROLLER_0_IAM_Rx
        ComIPduSignalProcessing = DEFERRED
        ComIPduType = NORMAL
        ComPduIdRef = COM_ICBVC_RHBKBCANFD_500ms_FrP67_CONTROLLER_0_IAM_Rx
        ComIPduSignalRef = IAvgFuelCsumpPrcs_ICBVC_RHBKBCANFD_500ms_FrP67_CONTROLLER_0_IAM_Rx
        ComIPduSignalRef = IAvgFuelCsumpPrcsV_ICBVC_RHBKBCANFD_500ms_FrP67_CONTROLLER_0_IAM_Rx
        ComIPduSignalRef = IAvgFuelCsumpV_ICBVC_RHBKBCANFD_500ms_FrP67_CONTROLLER_0_IAM_Rx
        ComIPduSignalRef = IAvgFuelCsump_ICBVC_RHBKBCANFD_500ms_FrP67_CONTROLLER_0_IAM_Rx
        ComIPduGroupRef = Com_RxPduGroup_CONTROLLER_0_IAM
      4 x ComSignal, all with ComInvalidNotification=NULL_PTR, ComRxDataTimeoutAction=NONE, ComSignalEndianness=BIG_ENDIAN, ComSignalInitValue=0x0, ComSignalLength=0, ComTransferProperty=PENDING, ComSignalDataInvalidValue=0x0, ComDataInvalidAction=NOTIFY, ComTimeout=0.0, ComFirstTimeout=0.0, ComNotification=Rte_COMCbk:
        IAvgFuelCsumpPrcs_ICBVC_RHBKBCANFD_500ms_FrP67_CONTROLLER_0_IAM_Rx: ComBitPosition=24, ComBitSize=16, ComHandleId=IAvgFuelCsumpPrcs_ICBVC_RHBKBCANFD_500ms_FrP67_CONTROLLER_0_IAM_Rx, ComSignalType=UINT16
        IAvgFuelCsumpPrcsV_ICBVC_RHBKBCANFD_500ms_FrP67_CONTROLLER_0_IAM_Rx: ComBitPosition=41, ComBitSize=1, ComHandleId=IAvgFuelCsumpPrcsV_ICBVC_RHBKBCANFD_500ms_FrP67_CONTROLLER_0_IAM_Rx, ComSignalType=BOOLEAN
        IAvgFuelCsumpV_ICBVC_RHBKBCANFD_500ms_FrP67_CONTROLLER_0_IAM_Rx: ComBitPosition=42, ComBitSize=1, ComHandleId=IAvgFuelCsumpV_ICBVC_RHBKBCANFD_500ms_FrP67_CONTROLLER_0_IAM_Rx, ComSignalType=BOOLEAN
        IAvgFuelCsump_ICBVC_RHBKBCANFD_500ms_FrP67_CONTROLLER_0_IAM_Rx: ComBitPosition=48, ComBitSize=8, ComHandleId=IAvgFuelCsump_ICBVC_RHBKBCANFD_500ms_FrP67_CONTROLLER_0_IAM_Rx, ComSignalType=UINT8
      ZXD_CONNCANFD_Event_FrS220_CONTROLLER_0_IAM_Rx (ComIPdu):
        ComIPduCancellationSupport = false
        ComIPduDirection = RECEIVE
        ComIPduHandleId = COM_RXPDU_COM_ZXD_CONNCANFD_Event_FrS220_CONTROLLER_0_IAM_Rx
        ComIPduSignalProcessing = DEFERRED
        ComIPduType = NORMAL
        ComPduIdRef = COM_ZXD_CONNCANFD_Event_FrS220_CONTROLLER_0_IAM_Rx
        ComIPduSignalRef = IRRWndOpenAppRmn_ZXD_CONNCANFD_Event_FrS220_CONTROLLER_0_IAM_Rx
        ComIPduSignalRef = IRLWndOpenAppRmn_ZXD_CONNCANFD_Event_FrS220_CONTROLLER_0_IAM_Rx
        ComIPduSignalRef = IFRWndOpenAppRmn_ZXD_CONNCANFD_Event_FrS220_CONTROLLER_0_IAM_Rx
        ComIPduSignalRef = IFLWndOpenAppRmn_ZXD_CONNCANFD_Event_FrS220_CONTROLLER_0_IAM_Rx
        ComIPduSignalRef = IRainClsWndAppMsg_ZXD_CONNCANFD_Event_FrS220_CONTROLLER_0_IAM_Rx
        ComIPduGroupRef = Com_RxPduGroup_CONTROLLER_0_IAM
      5 x ComSignal, all with ComInvalidNotification=NULL_PTR, ComRxDataTimeoutAction=NONE, ComSignalEndianness=BIG_ENDIAN, ComSignalInitValue=0x0, ComSignalLength=0, ComTransferProperty=TRIGGERED, ComSignalDataInvalidValue=0x0, ComDataInvalidAction=NOTIFY, ComTimeout=0.0, ComFirstTimeout=0.0, ComNotification=Rte_COMCbk:
        IRRWndOpenAppRmn_ZXD_CONNCANFD_Event_FrS220_CONTROLLER_0_IAM_Rx: ComBitPosition=12, ComBitSize=1, ComHandleId=IRRWndOpenAppRmn_ZXD_CONNCANFD_Event_FrS220_CONTROLLER_0_IAM_Rx, ComSignalType=BOOLEAN
        IRLWndOpenAppRmn_ZXD_CONNCANFD_Event_FrS220_CONTROLLER_0_IAM_Rx: ComBitPosition=13, ComBitSize=1, ComHandleId=IRLWndOpenAppRmn_ZXD_CONNCANFD_Event_FrS220_CONTROLLER_0_IAM_Rx, ComSignalType=BOOLEAN
        IFRWndOpenAppRmn_ZXD_CONNCANFD_Event_FrS220_CONTROLLER_0_IAM_Rx: ComBitPosition=14, ComBitSize=1, ComHandleId=IFRWndOpenAppRmn_ZXD_CONNCANFD_Event_FrS220_CONTROLLER_0_IAM_Rx, ComSignalType=BOOLEAN
        IFLWndOpenAppRmn_ZXD_CONNCANFD_Event_FrS220_CONTROLLER_0_IAM_Rx: ComBitPosition=15, ComBitSize=1, ComHandleId=IFLWndOpenAppRmn_ZXD_CONNCANFD_Event_FrS220_CONTROLLER_0_IAM_Rx, ComSignalType=BOOLEAN
        IRainClsWndAppMsg_ZXD_CONNCANFD_Event_FrS220_CONTROLLER_0_IAM_Rx: ComBitPosition=21, ComBitSize=3, ComHandleId=IRainClsWndAppMsg_ZXD_CONNCANFD_Event_FrS220_CONTROLLER_0_IAM_Rx, ComSignalType=UINT8
      ICBVC_RZCUCANFD_200ms_FrP50_CONTROLLER_0_IAM_Rx (ComIPdu):
        ComIPduCancellationSupport = false
        ComIPduDirection = RECEIVE
        ComIPduHandleId = COM_RXPDU_COM_ICBVC_RZCUCANFD_200ms_FrP50_CONTROLLER_0_IAM_Rx
        ComIPduSignalProcessing = DEFERRED
        ComIPduType = NORMAL
        ComPduIdRef = COM_ICBVC_RZCUCANFD_200ms_FrP50_CONTROLLER_0_IAM_Rx
        ComIPduSignalRef = IVehTiPblshYear_ICBVC_RZCUCANFD_200ms_FrP50_CONTROLLER_0_IAM_Rx
        ComIPduSignalRef = IVehTiPblshMth_ICBVC_RZCUCANFD_200ms_FrP50_CONTROLLER_0_IAM_Rx
        ComIPduSignalRef = IVehTiPblshDay_ICBVC_RZCUCANFD_200ms_FrP50_CONTROLLER_0_IAM_Rx
        ComIPduSignalRef = IVehTiPblshHr_ICBVC_RZCUCANFD_200ms_FrP50_CONTROLLER_0_IAM_Rx
        ComIPduSignalRef = IVehTiPblshMins_ICBVC_RZCUCANFD_200ms_FrP50_CONTROLLER_0_IAM_Rx
        ComIPduSignalRef = IVehTiPblshSec_ICBVC_RZCUCANFD_200ms_FrP50_CONTROLLER_0_IAM_Rx
        ComIPduGroupRef = Com_RxPduGroup_CONTROLLER_0_IAM
      6 x ComSignal, all with ComInvalidNotification=NULL_PTR, ComRxDataTimeoutAction=NONE, ComSignalEndianness=BIG_ENDIAN, ComSignalInitValue=0x0, ComSignalLength=0, ComSignalType=UINT8, ComTransferProperty=PENDING, ComSignalDataInvalidValue=0x0, ComDataInvalidAction=NOTIFY, ComTimeout=0.0, ComFirstTimeout=0.0, ComNotification=Rte_COMCbk:
        IVehTiPblshYear_ICBVC_RZCUCANFD_200ms_FrP50_CONTROLLER_0_IAM_Rx: ComBitPosition=0, ComBitSize=8, ComHandleId=IVehTiPblshYear_ICBVC_RZCUCANFD_200ms_FrP50_CONTROLLER_0_IAM_Rx
        IVehTiPblshMth_ICBVC_RZCUCANFD_200ms_FrP50_CONTROLLER_0_IAM_Rx: ComBitPosition=8, ComBitSize=4, ComHandleId=IVehTiPblshMth_ICBVC_RZCUCANFD_200ms_FrP50_CONTROLLER_0_IAM_Rx
        IVehTiPblshDay_ICBVC_RZCUCANFD_200ms_FrP50_CONTROLLER_0_IAM_Rx: ComBitPosition=16, ComBitSize=5, ComHandleId=IVehTiPblshDay_ICBVC_RZCUCANFD_200ms_FrP50_CONTROLLER_0_IAM_Rx
        IVehTiPblshHr_ICBVC_RZCUCANFD_200ms_FrP50_CONTROLLER_0_IAM_Rx: ComBitPosition=24, ComBitSize=5, ComHandleId=IVehTiPblshHr_ICBVC_RZCUCANFD_200ms_FrP50_CONTROLLER_0_IAM_Rx
        IVehTiPblshMins_ICBVC_RZCUCANFD_200ms_FrP50_CONTROLLER_0_IAM_Rx: ComBitPosition=32, ComBitSize=6, ComHandleId=IVehTiPblshMins_ICBVC_RZCUCANFD_200ms_FrP50_CONTROLLER_0_IAM_Rx
        IVehTiPblshSec_ICBVC_RZCUCANFD_200ms_FrP50_CONTROLLER_0_IAM_Rx: ComBitPosition=40, ComBitSize=6, ComHandleId=IVehTiPblshSec_ICBVC_RZCUCANFD_200ms_FrP50_CONTROLLER_0_IAM_Rx
      ICB_CONNCANFD_Event_FrS67_CONTROLLER_0_IAM_Rx (ComIPdu):
        ComIPduCancellationSupport = false
        ComIPduDirection = RECEIVE
        ComIPduHandleId = COM_RXPDU_COM_ICB_CONNCANFD_Event_FrS67_CONTROLLER_0_IAM_Rx
        ComIPduSignalProcessing = DEFERRED
        ComIPduType = NORMAL
        ComPduIdRef = COM_ICB_CONNCANFD_Event_FrS67_CONTROLLER_0_IAM_Rx
        ComIPduSignalRef = IIdentityChlg_ICB_CONNCANFD_Event_FrS67_CONTROLLER_0_IAM_Rx
        ComIPduGroupRef = Com_RxPduGroup_CONTROLLER_0_IAM
      IIdentityChlg_ICB_CONNCANFD_Event_FrS67_CONTROLLER_0_IAM_Rx (ComSignal):
        ComBitPosition = 120
        ComBitSize = 64
        ComHandleId = IIdentityChlg_ICB_CONNCANFD_Event_FrS67_CONTROLLER_0_IAM_Rx
        ComInvalidNotification = NULL_PTR
        ComRxDataTimeoutAction = NONE
        ComSignalEndianness = BIG_ENDIAN
        ComSignalInitValue = 0x0
        ComSignalLength = 0
        ComSignalType = UINT64
        ComTransferProperty = TRIGGERED
        ComSignalDataInvalidValue = 0x0
        ComDataInvalidAction = NOTIFY
        ComTimeout = 0.0
        ComFirstTimeout = 0.0
        ComNotification = Rte_COMCbk
      synthesized_ICBVC_SecOC_SyncMsg__CONTROLLER_0_IAM_Rx (ComIPdu):
        ComIPduCancellationSupport = false
        ComIPduDirection = RECEIVE
        ComIPduHandleId = COM_RXPDU_COM_synthesized_ICBVC_SecOC_SyncMsg__CONTROLLER_0_IAM_Rx
        ComIPduSignalProcessing = DEFERRED
        ComIPduType = NORMAL
        ComPduIdRef = COM_synthesized_ICBVC_SecOC_SyncMsg__CONTROLLER_0_IAM_Rx
        ComIPduSignalRef = SecuredIPdu_ICC_SecOC_SyncMsg_CO_synthesized_ICBVC_SecOC_SyncMsg__CONTROLLER_0_IAM_Rx
        ComIPduGroupRef = Com_RxPduGroup_CONTROLLER_0_IAM
      SecuredIPdu_ICC_SecOC_SyncMsg_CO_synthesized_ICBVC_SecOC_SyncMsg__CONTROLLER_0_IAM_Rx (ComSignal):
        ComBitPosition = 56
        ComBitSize = 64
        ComHandleId = SecuredIPdu_ICC_SecOC_SyncMsg_CO_synthesized_ICBVC_SecOC_SyncMsg__CONTROLLER_0_IAM_Rx
        ComInvalidNotification = NULL_PTR
        ComRxDataTimeoutAction = NONE
        ComSignalEndianness = BIG_ENDIAN
        ComSignalInitValue = 0x0
        ComSignalLength = 0
        ComSignalType = SINT64
        ComTransferProperty = TRIGGERED
        ComSignalDataInvalidValue = 0x0
        ComDataInvalidAction = NOTIFY
        ComTimeout = 0.0
        ComFirstTimeout = 0.0
        ComNotification = Rte_COMCbk
      RHZCU_BKBCANFD_Event_FrS37_CONTROLLER_0_IAM_Rx (ComIPdu):
        ComIPduCancellationSupport = false
        ComIPduDirection = RECEIVE
        ComIPduHandleId = COM_RXPDU_COM_RHZCU_BKBCANFD_Event_FrS37_CONTROLLER_0_IAM_Rx
        ComIPduSignalProcessing = DEFERRED
        ComIPduType = NORMAL
        ComPduIdRef = COM_RHZCU_BKBCANFD_Event_FrS37_CONTROLLER_0_IAM_Rx
        ComIPduSignalRef = IRmtHtdRrWndResp_RHZCU_BKBCANFD_Event_FrS37_CONTROLLER_0_IAM_Rx
        ComIPduGroupRef = Com_RxPduGroup_CONTROLLER_0_IAM
      IRmtHtdRrWndResp_RHZCU_BKBCANFD_Event_FrS37_CONTROLLER_0_IAM_Rx (ComSignal):
        ComBitPosition = 13
        ComBitSize = 3
        ComHandleId = IRmtHtdRrWndResp_RHZCU_BKBCANFD_Event_FrS37_CONTROLLER_0_IAM_Rx
        ComInvalidNotification = NULL_PTR
        ComRxDataTimeoutAction = NONE
        ComSignalEndianness = BIG_ENDIAN
        ComSignalInitValue = 0x0
        ComSignalLength = 0
        ComSignalType = UINT8
        ComTransferProperty = TRIGGERED
        ComSignalDataInvalidValue = 0x0
        ComDataInvalidAction = NOTIFY
        ComTimeout = 0.0
        ComFirstTimeout = 0.0
        ComNotification = Rte_COMCbk
      ESS_PTCANFD_Event_FrS452_CONTROLLER_0_IAM_Rx (ComIPdu):
        ComIPduCancellationSupport = false
        ComIPduDirection = RECEIVE
        ComIPduHandleId = COM_RXPDU_COM_ESS_PTCANFD_Event_FrS452_CONTROLLER_0_IAM_Rx
        ComIPduSignalProcessing = DEFERRED
        ComIPduType = NORMAL
        ComPduIdRef = COM_ESS_PTCANFD_Event_FrS452_CONTROLLER_0_IAM_Rx
        ComIPduSignalRef = IRmtDisChrgCtrlResp_ESS_PTCANFD_Event_FrS452_CONTROLLER_0_IAM_Rx
        ComIPduSignalRef = IRmtChrgCtrlResp_ESS_PTCANFD_Event_FrS452_CONTROLLER_0_IAM_Rx
        ComIPduGroupRef = Com_RxPduGroup_CONTROLLER_0_IAM
      IRmtDisChrgCtrlResp_ESS_PTCANFD_Event_FrS452_CONTROLLER_0_IAM_Rx (ComSignal):
        ComBitPosition = 58
        ComBitSize = 3
        ComHandleId = IRmtDisChrgCtrlResp_ESS_PTCANFD_Event_FrS452_CONTROLLER_0_IAM_Rx
        ComInvalidNotification = NULL_PTR
        ComRxDataTimeoutAction = NONE
        ComSignalEndianness = BIG_ENDIAN
        ComSignalInitValue = 0x0
        ComSignalLength = 0
        ComSignalType = UINT8
        ComTransferProperty = TRIGGERED
        ComSignalDataInvalidValue = 0x0
        ComDataInvalidAction = NOTIFY
        ComTimeout = 0.0
        ComFirstTimeout = 0.0
        ComNotification = Rte_COMCbk
      IRmtChrgCtrlResp_ESS_PTCANFD_Event_FrS452_CONTROLLER_0_IAM_Rx (ComSignal):
        ComBitPosition = 61
        ComBitSize = 3
        ComHandleId = IRmtChrgCtrlResp_ESS_PTCANFD_Event_FrS452_CONTROLLER_0_IAM_Rx
        ComInvalidNotification = NULL_PTR
        ComRxDataTimeoutAction = NONE
        ComSignalEndianness = BIG_ENDIAN
        ComSignalInitValue = 0x0
        ComSignalLength = 0
        ComSignalType = UINT8
        ComTransferProperty = TRIGGERED
        ComSignalDataInvalidValue = 0x0
        ComDataInvalidAction = NOTIFY
        ComTimeout = 0.0
        ComFirstTimeout = 0.0
        ComNotification = Rte_COMCbk
      IPD_BKPCANFD_Event_FrS35_CONTROLLER_0_IAM_Rx (ComIPdu):
        ComIPduCancellationSupport = false
        ComIPduDirection = RECEIVE
        ComIPduHandleId = COM_RXPDU_COM_IPD_BKPCANFD_Event_FrS35_CONTROLLER_0_IAM_Rx
        ComIPduSignalProcessing = DEFERRED
        ComIPduType = NORMAL
        ComPduIdRef = COM_IPD_BKPCANFD_Event_FrS35_CONTROLLER_0_IAM_Rx
        ComIPduSignalRef = IAIParkngSpcIDrespIAM_IPD_BKPCANFD_Event_FrS35_CONTROLLER_0_IAM_Rx
        ComIPduSignalRef = IAIParkngRespIAM_IPD_BKPCANFD_Event_FrS35_CONTROLLER_0_IAM_Rx
        ComIPduGroupRef = Com_RxPduGroup_CONTROLLER_0_IAM
      IAIParkngSpcIDrespIAM_IPD_BKPCANFD_Event_FrS35_CONTROLLER_0_IAM_Rx (ComSignal):
        ComBitPosition = 40
        ComBitSize = 8
        ComHandleId = IAIParkngSpcIDrespIAM_IPD_BKPCANFD_Event_FrS35_CONTROLLER_0_IAM_Rx
        ComInvalidNotification = NULL_PTR
        ComRxDataTimeoutAction = NONE
        ComSignalEndianness = BIG_ENDIAN
        ComSignalInitValue = 0x0
        ComSignalLength = 0
        ComSignalType = UINT8
        ComTransferProperty = TRIGGERED
        ComSignalDataInvalidValue = 0x0
        ComDataInvalidAction = NOTIFY
        ComTimeout = 0.0
        ComFirstTimeout = 0.0
        ComNotification = Rte_COMCbk
      IAIParkngRespIAM_IPD_BKPCANFD_Event_FrS35_CONTROLLER_0_IAM_Rx (ComSignal):
        ComBitPosition = 56
        ComBitSize = 8
        ComHandleId = IAIParkngRespIAM_IPD_BKPCANFD_Event_FrS35_CONTROLLER_0_IAM_Rx
        ComInvalidNotification = NULL_PTR
        ComRxDataTimeoutAction = NONE
        ComSignalEndianness = BIG_ENDIAN
        ComSignalInitValue = 0x0
        ComSignalLength = 0
        ComSignalType = UINT8
        ComTransferProperty = TRIGGERED
        ComSignalDataInvalidValue = 0x0
        ComDataInvalidAction = NOTIFY
        ComTimeout = 0.0
        ComFirstTimeout = 0.0
        ComNotification = Rte_COMCbk
      CCU_PTCANFD_500ms_FrP13_CONTROLLER_0_IAM_Rx (ComIPdu):
        ComIPduCancellationSupport = false
        ComIPduDirection = RECEIVE
        ComIPduHandleId = COM_RXPDU_COM_CCU_PTCANFD_500ms_FrP13_CONTROLLER_0_IAM_Rx
        ComIPduSignalProcessing = DEFERRED
        ComIPduType = NORMAL
        ComPduIdRef = COM_CCU_PTCANFD_500ms_FrP13_CONTROLLER_0_IAM_Rx
        ComIPduSignalRef = IDCStsAlrm_GB_CCU_PTCANFD_500ms_FrP13_CONTROLLER_0_IAM_Rx
        ComIPduSignalRef = IDCOvTemAlrm_GB_CCU_PTCANFD_500ms_FrP13_CONTROLLER_0_IAM_Rx
        ComIPduGroupRef = Com_RxPduGroup_CONTROLLER_0_IAM
      IDCStsAlrm_GB_CCU_PTCANFD_500ms_FrP13_CONTROLLER_0_IAM_Rx (ComSignal):
        ComBitPosition = 14
        ComBitSize = 1
        ComHandleId = IDCStsAlrm_GB_CCU_PTCANFD_500ms_FrP13_CONTROLLER_0_IAM_Rx
        ComInvalidNotification = NULL_PTR
        ComRxDataTimeoutAction = NONE
        ComSignalEndianness = BIG_ENDIAN
        ComSignalInitValue = 0x0
        ComSignalLength = 0
        ComSignalType = BOOLEAN
        ComTransferProperty = PENDING
        ComSignalDataInvalidValue = 0x0
        ComDataInvalidAction = NOTIFY
        ComTimeout = 0.0
        ComFirstTimeout = 0.0
        ComNotification = Rte_COMCbk
      IDCOvTemAlrm_GB_CCU_PTCANFD_500ms_FrP13_CONTROLLER_0_IAM_Rx (ComSignal):
        ComBitPosition = 15
        ComBitSize = 1
        ComHandleId = IDCOvTemAlrm_GB_CCU_PTCANFD_500ms_FrP13_CONTROLLER_0_IAM_Rx
        ComInvalidNotification = NULL_PTR
        ComRxDataTimeoutAction = NONE
        ComSignalEndianness = BIG_ENDIAN
        ComSignalInitValue = 0x0
        ComSignalLength = 0
        ComSignalType = BOOLEAN
        ComTransferProperty = PENDING
        ComSignalDataInvalidValue = 0x0
        ComDataInvalidAction = NOTIFY
        ComTimeout = 0.0
        ComFirstTimeout = 0.0
        ComNotification = Rte_COMCbk
      ESS_PTCANFD_500ms_FrP60_CONTROLLER_0_IAM_Rx (ComIPdu):
        ComIPduCancellationSupport = false
        ComIPduDirection = RECEIVE
        ComIPduHandleId = COM_RXPDU_COM_ESS_PTCANFD_500ms_FrP60_CONTROLLER_0_IAM_Rx
        ComIPduSignalProcessing = DEFERRED
        ComIPduType = NORMAL
        ComPduIdRef = COM_ESS_PTCANFD_500ms_FrP60_CONTROLLER_0_IAM_Rx
        ComIPduSignalRef = IBMSTemDiffAlrm_GB_ESS_PTCANFD_500ms_FrP60_CONTROLLER_0_IAM_Rx
        ComIPduSignalRef = IBMSChrgSts_GB_ESS_PTCANFD_500ms_FrP60_CONTROLLER_0_IAM_Rx
        ComIPduSignalRef = IBMSPkgSOCJmpAlrm_GB_ESS_PTCANFD_500ms_FrP60_CONTROLLER_0_IAM_Rx
        ComIPduSignalRef = IBMSPkgSOCHghAlrm_GB_ESS_PTCANFD_500ms_FrP60_CONTROLLER_0_IAM_Rx
        ComIPduSignalRef = IBMSCellUndVolAlrm_GB_ESS_PTCANFD_500ms_FrP60_CONTROLLER_0_IAM_Rx
        ComIPduSignalRef = IBMSCellOvVolAlrm_GB_ESS_PTCANFD_500ms_FrP60_CONTROLLER_0_IAM_Rx
        ComIPduSignalRef = IBMSPkgSOCLwAlrm_GB_ESS_PTCANFD_500ms_FrP60_CONTROLLER_0_IAM_Rx
        ComIPduSignalRef = IBMSUndVolAlrm_GB_ESS_PTCANFD_500ms_FrP60_CONTROLLER_0_IAM_Rx
        ComIPduSignalRef = IBMSOvVolAlrm_GB_ESS_PTCANFD_500ms_FrP60_CONTROLLER_0_IAM_Rx
        ComIPduSignalRef = IBMSOvTemAlrm_GB_ESS_PTCANFD_500ms_FrP60_CONTROLLER_0_IAM_Rx
        ComIPduSignalRef = IBMSPkgHghChrgAlrm_GB_ESS_PTCANFD_500ms_FrP60_CONTROLLER_0_IAM_Rx
        ComIPduSignalRef = IBMSHVILAlrm_GB_ESS_PTCANFD_500ms_FrP60_CONTROLLER_0_IAM_Rx
        ComIPduSignalRef = IBMSInsltnAlrm_GB_ESS_PTCANFD_500ms_FrP60_CONTROLLER_0_IAM_Rx
        ComIPduSignalRef = IBMSCellDiffAlrm_GB_ESS_PTCANFD_500ms_FrP60_CONTROLLER_0_IAM_Rx
        ComIPduSignalRef = IBMSPkgMsmtchAlrm_GB_ESS_PTCANFD_500ms_FrP60_CONTROLLER_0_IAM_Rx
        ComIPduGroupRef = Com_RxPduGroup_CONTROLLER_0_IAM
      15 x ComSignal, all with ComInvalidNotification=NULL_PTR, ComRxDataTimeoutAction=NONE, ComSignalEndianness=BIG_ENDIAN, ComSignalInitValue=0x0, ComSignalLength=0, ComTransferProperty=PENDING, ComSignalDataInvalidValue=0x0, ComDataInvalidAction=NOTIFY, ComTimeout=0.0, ComFirstTimeout=0.0, ComNotification=Rte_COMCbk:
        IBMSTemDiffAlrm_GB_ESS_PTCANFD_500ms_FrP60_CONTROLLER_0_IAM_Rx: ComBitPosition=12, ComBitSize=1, ComHandleId=IBMSTemDiffAlrm_GB_ESS_PTCANFD_500ms_FrP60_CONTROLLER_0_IAM_Rx, ComSignalType=BOOLEAN
        IBMSChrgSts_GB_ESS_PTCANFD_500ms_FrP60_CONTROLLER_0_IAM_Rx: ComBitPosition=16, ComBitSize=8, ComHandleId=IBMSChrgSts_GB_ESS_PTCANFD_500ms_FrP60_CONTROLLER_0_IAM_Rx, ComSignalType=UINT8
        IBMSPkgSOCJmpAlrm_GB_ESS_PTCANFD_500ms_FrP60_CONTROLLER_0_IAM_Rx: ComBitPosition=24, ComBitSize=1, ComHandleId=IBMSPkgSOCJmpAlrm_GB_ESS_PTCANFD_500ms_FrP60_CONTROLLER_0_IAM_Rx, ComSignalType=BOOLEAN
        IBMSPkgSOCHghAlrm_GB_ESS_PTCANFD_500ms_FrP60_CONTROLLER_0_IAM_Rx: ComBitPosition=25, ComBitSize=1, ComHandleId=IBMSPkgSOCHghAlrm_GB_ESS_PTCANFD_500ms_FrP60_CONTROLLER_0_IAM_Rx, ComSignalType=BOOLEAN
        IBMSCellUndVolAlrm_GB_ESS_PTCANFD_500ms_FrP60_CONTROLLER_0_IAM_Rx: ComBitPosition=26, ComBitSize=1, ComHandleId=IBMSCellUndVolAlrm_GB_ESS_PTCANFD_500ms_FrP60_CONTROLLER_0_IAM_Rx, ComSignalType=BOOLEAN
        IBMSCellOvVolAlrm_GB_ESS_PTCANFD_500ms_FrP60_CONTROLLER_0_IAM_Rx: ComBitPosition=27, ComBitSize=1, ComHandleId=IBMSCellOvVolAlrm_GB_ESS_PTCANFD_500ms_FrP60_CONTROLLER_0_IAM_Rx, ComSignalType=BOOLEAN
        IBMSPkgSOCLwAlrm_GB_ESS_PTCANFD_500ms_FrP60_CONTROLLER_0_IAM_Rx: ComBitPosition=28, ComBitSize=1, ComHandleId=IBMSPkgSOCLwAlrm_GB_ESS_PTCANFD_500ms_FrP60_CONTROLLER_0_IAM_Rx, ComSignalType=BOOLEAN
        IBMSUndVolAlrm_GB_ESS_PTCANFD_500ms_FrP60_CONTROLLER_0_IAM_Rx: ComBitPosition=29, ComBitSize=1, ComHandleId=IBMSUndVolAlrm_GB_ESS_PTCANFD_500ms_FrP60_CONTROLLER_0_IAM_Rx, ComSignalType=BOOLEAN
        IBMSOvVolAlrm_GB_ESS_PTCANFD_500ms_FrP60_CONTROLLER_0_IAM_Rx: ComBitPosition=30, ComBitSize=1, ComHandleId=IBMSOvVolAlrm_GB_ESS_PTCANFD_500ms_FrP60_CONTROLLER_0_IAM_Rx, ComSignalType=BOOLEAN
        IBMSOvTemAlrm_GB_ESS_PTCANFD_500ms_FrP60_CONTROLLER_0_IAM_Rx: ComBitPosition=31, ComBitSize=1, ComHandleId=IBMSOvTemAlrm_GB_ESS_PTCANFD_500ms_FrP60_CONTROLLER_0_IAM_Rx, ComSignalType=BOOLEAN
        IBMSPkgHghChrgAlrm_GB_ESS_PTCANFD_500ms_FrP60_CONTROLLER_0_IAM_Rx: ComBitPosition=35, ComBitSize=1, ComHandleId=IBMSPkgHghChrgAlrm_GB_ESS_PTCANFD_500ms_FrP60_CONTROLLER_0_IAM_Rx, ComSignalType=BOOLEAN
        IBMSHVILAlrm_GB_ESS_PTCANFD_500ms_FrP60_CONTROLLER_0_IAM_Rx: ComBitPosition=36, ComBitSize=1, ComHandleId=IBMSHVILAlrm_GB_ESS_PTCANFD_500ms_FrP60_CONTROLLER_0_IAM_Rx, ComSignalType=BOOLEAN
        IBMSInsltnAlrm_GB_ESS_PTCANFD_500ms_FrP60_CONTROLLER_0_IAM_Rx: ComBitPosition=37, ComBitSize=1, ComHandleId=IBMSInsltnAlrm_GB_ESS_PTCANFD_500ms_FrP60_CONTROLLER_0_IAM_Rx, ComSignalType=BOOLEAN
        IBMSCellDiffAlrm_GB_ESS_PTCANFD_500ms_FrP60_CONTROLLER_0_IAM_Rx: ComBitPosition=38, ComBitSize=1, ComHandleId=IBMSCellDiffAlrm_GB_ESS_PTCANFD_500ms_FrP60_CONTROLLER_0_IAM_Rx, ComSignalType=BOOLEAN
        IBMSPkgMsmtchAlrm_GB_ESS_PTCANFD_500ms_FrP60_CONTROLLER_0_IAM_Rx: ComBitPosition=39, ComBitSize=1, ComHandleId=IBMSPkgMsmtchAlrm_GB_ESS_PTCANFD_500ms_FrP60_CONTROLLER_0_IAM_Rx, ComSignalType=BOOLEAN
      ICBVC_CONNCANFD_Event_FrS139_CONTROLLER_0_IAM_Rx (ComIPdu):
        ComIPduCancellationSupport = false
        ComIPduDirection = RECEIVE
        ComIPduHandleId = COM_RXPDU_COM_ICBVC_CONNCANFD_Event_FrS139_CONTROLLER_0_IAM_Rx
        ComIPduSignalProcessing = DEFERRED
        ComIPduType = NORMAL
        ComPduIdRef = COM_ICBVC_CONNCANFD_Event_FrS139_CONTROLLER_0_IAM_Rx
        ComIPduSignalRef = IRVSStopRsp_ICBVC_CONNCANFD_Event_FrS139_CONTROLLER_0_IAM_Rx
        ComIPduSignalRef = IRmtDrvrSeatHeatResp_ICBVC_CONNCANFD_Event_FrS139_CONTROLLER_0_IAM_Rx
        ComIPduSignalRef = IRmtHldFdgeAftLckSetResp_ICBVC_CONNCANFD_Event_FrS139_CONTROLLER_0_IAM_Rx
        ComIPduSignalRef = IRmtCtrlPwrLftgtResp_ICBVC_CONNCANFD_Event_FrS139_CONTROLLER_0_IAM_Rx
        ComIPduSignalRef = IRmtPsngSeatHeatResp_ICBVC_CONNCANFD_Event_FrS139_CONTROLLER_0_IAM_Rx
        ComIPduSignalRef = IRmtDrvrSeatVentResp_ICBVC_CONNCANFD_Event_FrS139_CONTROLLER_0_IAM_Rx
        ComIPduSignalRef = IRmtSecRowLSeatHeatResp_ICBVC_CONNCANFD_Event_FrS139_CONTROLLER_0_IAM_Rx
        ComIPduSignalRef = IRmtPsngSeatVentResp_ICBVC_CONNCANFD_Event_FrS139_CONTROLLER_0_IAM_Rx
        ComIPduSignalRef = IRmtSecRowRSeatHeatResp_ICBVC_CONNCANFD_Event_FrS139_CONTROLLER_0_IAM_Rx
        ComIPduSignalRef = IRmtSecRowLSeatVentResp_ICBVC_CONNCANFD_Event_FrS139_CONTROLLER_0_IAM_Rx
        ComIPduSignalRef = IRmtThrdRowRSeatHeatResp_ICBVC_CONNCANFD_Event_FrS139_CONTROLLER_0_IAM_Rx
        ComIPduSignalRef = IRmtSecRowRSeatVentResp_ICBVC_CONNCANFD_Event_FrS139_CONTROLLER_0_IAM_Rx
        ComIPduSignalRef = IRmtExtrLckCtrlResultInfo_ICBVC_CONNCANFD_Event_FrS139_CONTROLLER_0_IAM_Rx
        ComIPduSignalRef = IRmtThrdRowLSeatHeatResp_ICBVC_CONNCANFD_Event_FrS139_CONTROLLER_0_IAM_Rx
        ComIPduSignalRef = IRmtThrdRowRSeatVentResp_ICBVC_CONNCANFD_Event_FrS139_CONTROLLER_0_IAM_Rx
        ComIPduSignalRef = IRmtACResp_ICBVC_CONNCANFD_Event_FrS139_CONTROLLER_0_IAM_Rx
        ComIPduSignalRef = IRmtThrdRowLSeatVentResp_ICBVC_CONNCANFD_Event_FrS139_CONTROLLER_0_IAM_Rx
        ComIPduSignalRef = IRmtStrgWhlHeatResp_ICBVC_CONNCANFD_Event_FrS139_CONTROLLER_0_IAM_Rx
        ComIPduSignalRef = IRmtBattWarmResp_ICBVC_CONNCANFD_Event_FrS139_CONTROLLER_0_IAM_Rx
        ComIPduSignalRef = IRmtChrgTrgtSOCResp_ICBVC_CONNCANFD_Event_FrS139_CONTROLLER_0_IAM_Rx
        ComIPduSignalRef = IRmtAltngChrgCrntResp_ICBVC_CONNCANFD_Event_FrS139_CONTROLLER_0_IAM_Rx
        ComIPduSignalRef = IRmtFridgeResp_ICBVC_CONNCANFD_Event_FrS139_CONTROLLER_0_IAM_Rx
        ComIPduSignalRef = IRmtReserChrgCtrlResp_ICBVC_CONNCANFD_Event_FrS139_CONTROLLER_0_IAM_Rx
        ComIPduSignalRef = IRmtCtrlWinResp_ICBVC_CONNCANFD_Event_FrS139_CONTROLLER_0_IAM_Rx
        ComIPduSignalRef = IRVSStartRsp_ICBVC_CONNCANFD_Event_FrS139_CONTROLLER_0_IAM_Rx
        ComIPduGroupRef = Com_RxPduGroup_CONTROLLER_0_IAM
      25 x ComSignal, all with ComInvalidNotification=NULL_PTR, ComRxDataTimeoutAction=NONE, ComSignalEndianness=BIG_ENDIAN, ComSignalInitValue=0x0, ComSignalLength=0, ComTransferProperty=TRIGGERED, ComSignalDataInvalidValue=0x0, ComDataInvalidAction=NOTIFY, ComTimeout=0.0, ComFirstTimeout=0.0, ComNotification=Rte_COMCbk:
        IRVSStopRsp_ICBVC_CONNCANFD_Event_FrS139_CONTROLLER_0_IAM_Rx: ComBitPosition=12, ComBitSize=1, ComHandleId=IRVSStopRsp_ICBVC_CONNCANFD_Event_FrS139_CONTROLLER_0_IAM_Rx, ComSignalType=BOOLEAN
        IRmtDrvrSeatHeatResp_ICBVC_CONNCANFD_Event_FrS139_CONTROLLER_0_IAM_Rx: ComBitPosition=13, ComBitSize=3, ComHandleId=IRmtDrvrSeatHeatResp_ICBVC_CONNCANFD_Event_FrS139_CONTROLLER_0_IAM_Rx, ComSignalType=UINT8
        IRmtHldFdgeAftLckSetResp_ICBVC_CONNCANFD_Event_FrS139_CONTROLLER_0_IAM_Rx: ComBitPosition=17, ComBitSize=3, ComHandleId=IRmtHldFdgeAftLckSetResp_ICBVC_CONNCANFD_Event_FrS139_CONTROLLER_0_IAM_Rx, ComSignalType=UINT8
        IRmtCtrlPwrLftgtResp_ICBVC_CONNCANFD_Event_FrS139_CONTROLLER_0_IAM_Rx: ComBitPosition=20, ComBitSize=4, ComHandleId=IRmtCtrlPwrLftgtResp_ICBVC_CONNCANFD_Event_FrS139_CONTROLLER_0_IAM_Rx, ComSignalType=UINT8
        IRmtPsngSeatHeatResp_ICBVC_CONNCANFD_Event_FrS139_CONTROLLER_0_IAM_Rx: ComBitPosition=26, ComBitSize=3, ComHandleId=IRmtPsngSeatHeatResp_ICBVC_CONNCANFD_Event_FrS139_CONTROLLER_0_IAM_Rx, ComSignalType=UINT8
        IRmtDrvrSeatVentResp_ICBVC_CONNCANFD_Event_FrS139_CONTROLLER_0_IAM_Rx: ComBitPosition=29, ComBitSize=3, ComHandleId=IRmtDrvrSeatVentResp_ICBVC_CONNCANFD_Event_FrS139_CONTROLLER_0_IAM_Rx, ComSignalType=UINT8
        IRmtSecRowLSeatHeatResp_ICBVC_CONNCANFD_Event_FrS139_CONTROLLER_0_IAM_Rx: ComBitPosition=34, ComBitSize=3, ComHandleId=IRmtSecRowLSeatHeatResp_ICBVC_CONNCANFD_Event_FrS139_CONTROLLER_0_IAM_Rx, ComSignalType=UINT8
        IRmtPsngSeatVentResp_ICBVC_CONNCANFD_Event_FrS139_CONTROLLER_0_IAM_Rx: ComBitPosition=37, ComBitSize=3, ComHandleId=IRmtPsngSeatVentResp_ICBVC_CONNCANFD_Event_FrS139_CONTROLLER_0_IAM_Rx, ComSignalType=UINT8
        IRmtSecRowRSeatHeatResp_ICBVC_CONNCANFD_Event_FrS139_CONTROLLER_0_IAM_Rx: ComBitPosition=42, ComBitSize=3, ComHandleId=IRmtSecRowRSeatHeatResp_ICBVC_CONNCANFD_Event_FrS139_CONTROLLER_0_IAM_Rx, ComSignalType=UINT8
        IRmtSecRowLSeatVentResp_ICBVC_CONNCANFD_Event_FrS139_CONTROLLER_0_IAM_Rx: ComBitPosition=45, ComBitSize=3, ComHandleId=IRmtSecRowLSeatVentResp_ICBVC_CONNCANFD_Event_FrS139_CONTROLLER_0_IAM_Rx, ComSignalType=UINT8
        IRmtThrdRowRSeatHeatResp_ICBVC_CONNCANFD_Event_FrS139_CONTROLLER_0_IAM_Rx: ComBitPosition=50, ComBitSize=3, ComHandleId=IRmtThrdRowRSeatHeatResp_ICBVC_CONNCANFD_Event_FrS139_CONTROLLER_0_IAM_Rx, ComSignalType=UINT8
        IRmtSecRowRSeatVentResp_ICBVC_CONNCANFD_Event_FrS139_CONTROLLER_0_IAM_Rx: ComBitPosition=53, ComBitSize=3, ComHandleId=IRmtSecRowRSeatVentResp_ICBVC_CONNCANFD_Event_FrS139_CONTROLLER_0_IAM_Rx, ComSignalType=UINT8
        IRmtExtrLckCtrlResultInfo_ICBVC_CONNCANFD_Event_FrS139_CONTROLLER_0_IAM_Rx: ComBitPosition=56, ComBitSize=8, ComHandleId=IRmtExtrLckCtrlResultInfo_ICBVC_CONNCANFD_Event_FrS139_CONTROLLER_0_IAM_Rx, ComSignalType=UINT8
        IRmtThrdRowLSeatHeatResp_ICBVC_CONNCANFD_Event_FrS139_CONTROLLER_0_IAM_Rx: ComBitPosition=66, ComBitSize=3, ComHandleId=IRmtThrdRowLSeatHeatResp_ICBVC_CONNCANFD_Event_FrS139_CONTROLLER_0_IAM_Rx, ComSignalType=UINT8
        IRmtThrdRowRSeatVentResp_ICBVC_CONNCANFD_Event_FrS139_CONTROLLER_0_IAM_Rx: ComBitPosition=69, ComBitSize=3, ComHandleId=IRmtThrdRowRSeatVentResp_ICBVC_CONNCANFD_Event_FrS139_CONTROLLER_0_IAM_Rx, ComSignalType=UINT8
        IRmtACResp_ICBVC_CONNCANFD_Event_FrS139_CONTROLLER_0_IAM_Rx: ComBitPosition=74, ComBitSize=3, ComHandleId=IRmtACResp_ICBVC_CONNCANFD_Event_FrS139_CONTROLLER_0_IAM_Rx, ComSignalType=UINT8
        IRmtThrdRowLSeatVentResp_ICBVC_CONNCANFD_Event_FrS139_CONTROLLER_0_IAM_Rx: ComBitPosition=77, ComBitSize=3, ComHandleId=IRmtThrdRowLSeatVentResp_ICBVC_CONNCANFD_Event_FrS139_CONTROLLER_0_IAM_Rx, ComSignalType=UINT8
        IRmtStrgWhlHeatResp_ICBVC_CONNCANFD_Event_FrS139_CONTROLLER_0_IAM_Rx: ComBitPosition=82, ComBitSize=3, ComHandleId=IRmtStrgWhlHeatResp_ICBVC_CONNCANFD_Event_FrS139_CONTROLLER_0_IAM_Rx, ComSignalType=UINT8
        IRmtBattWarmResp_ICBVC_CONNCANFD_Event_FrS139_CONTROLLER_0_IAM_Rx: ComBitPosition=85, ComBitSize=3, ComHandleId=IRmtBattWarmResp_ICBVC_CONNCANFD_Event_FrS139_CONTROLLER_0_IAM_Rx, ComSignalType=UINT8
        IRmtChrgTrgtSOCResp_ICBVC_CONNCANFD_Event_FrS139_CONTROLLER_0_IAM_Rx: ComBitPosition=90, ComBitSize=3, ComHandleId=IRmtChrgTrgtSOCResp_ICBVC_CONNCANFD_Event_FrS139_CONTROLLER_0_IAM_Rx, ComSignalType=UINT8
        IRmtAltngChrgCrntResp_ICBVC_CONNCANFD_Event_FrS139_CONTROLLER_0_IAM_Rx: ComBitPosition=93, ComBitSize=3, ComHandleId=IRmtAltngChrgCrntResp_ICBVC_CONNCANFD_Event_FrS139_CONTROLLER_0_IAM_Rx, ComSignalType=UINT8
        IRmtFridgeResp_ICBVC_CONNCANFD_Event_FrS139_CONTROLLER_0_IAM_Rx: ComBitPosition=96, ComBitSize=5, ComHandleId=IRmtFridgeResp_ICBVC_CONNCANFD_Event_FrS139_CONTROLLER_0_IAM_Rx, ComSignalType=UINT8
        IRmtReserChrgCtrlResp_ICBVC_CONNCANFD_Event_FrS139_CONTROLLER_0_IAM_Rx: ComBitPosition=101, ComBitSize=3, ComHandleId=IRmtReserChrgCtrlResp_ICBVC_CONNCANFD_Event_FrS139_CONTROLLER_0_IAM_Rx, ComSignalType=UINT8
        IRmtCtrlWinResp_ICBVC_CONNCANFD_Event_FrS139_CONTROLLER_0_IAM_Rx: ComBitPosition=104, ComBitSize=8, ComHandleId=IRmtCtrlWinResp_ICBVC_CONNCANFD_Event_FrS139_CONTROLLER_0_IAM_Rx, ComSignalType=UINT8
        IRVSStartRsp_ICBVC_CONNCANFD_Event_FrS139_CONTROLLER_0_IAM_Rx: ComBitPosition=112, ComBitSize=8, ComHandleId=IRVSStartRsp_ICBVC_CONNCANFD_Event_FrS139_CONTROLLER_0_IAM_Rx, ComSignalType=UINT8
      SDM_SFCANFD_Event_FrS13_CONTROLLER_0_IAM_Rx (ComIPdu):
        ComIPduCancellationSupport = false
        ComIPduDirection = RECEIVE
        ComIPduHandleId = COM_RXPDU_COM_SDM_SFCANFD_Event_FrS13_CONTROLLER_0_IAM_Rx
        ComIPduSignalProcessing = DEFERRED
        ComIPduType = NORMAL
        ComPduIdRef = COM_SDM_SFCANFD_Event_FrS13_CONTROLLER_0_IAM_Rx
        ComIPduSignalRef = IVehCrshTypForeCall_SDM_SFCANFD_Event_FrS13_CONTROLLER_0_IAM_Rx
        ComIPduGroupRef = Com_RxPduGroup_CONTROLLER_0_IAM
      IVehCrshTypForeCall_SDM_SFCANFD_Event_FrS13_CONTROLLER_0_IAM_Rx (ComSignal):
        ComBitPosition = 61
        ComBitSize = 3
        ComHandleId = IVehCrshTypForeCall_SDM_SFCANFD_Event_FrS13_CONTROLLER_0_IAM_Rx
        ComInvalidNotification = NULL_PTR
        ComRxDataTimeoutAction = NONE
        ComSignalEndianness = BIG_ENDIAN
        ComSignalInitValue = 0x0
        ComSignalLength = 0
        ComSignalType = UINT8
        ComTransferProperty = TRIGGERED
        ComSignalDataInvalidValue = 0x0
        ComDataInvalidAction = NOTIFY
        ComTimeout = 0.0
        ComFirstTimeout = 0.0
        ComNotification = Rte_COMCbk
      SDM_SFCANFD_Event_FrS12_CONTROLLER_0_IAM_Rx (ComIPdu):
        ComIPduCancellationSupport = false
        ComIPduDirection = RECEIVE
        ComIPduHandleId = COM_RXPDU_COM_SDM_SFCANFD_Event_FrS12_CONTROLLER_0_IAM_Rx
        ComIPduSignalProcessing = DEFERRED
        ComIPduType = NORMAL
        ComPduIdRef = COM_SDM_SFCANFD_Event_FrS12_CONTROLLER_0_IAM_Rx
        ComIPduSignalRef = ILatDeltaVelForeCall_SDM_SFCANFD_Event_FrS12_CONTROLLER_0_IAM_Rx
        ComIPduSignalRef = ILongtDeltaVelForeCall_SDM_SFCANFD_Event_FrS12_CONTROLLER_0_IAM_Rx
        ComIPduGroupRef = Com_RxPduGroup_CONTROLLER_0_IAM
      ILatDeltaVelForeCall_SDM_SFCANFD_Event_FrS12_CONTROLLER_0_IAM_Rx (ComSignal):
        ComBitPosition = 88
        ComBitSize = 64
        ComHandleId = ILatDeltaVelForeCall_SDM_SFCANFD_Event_FrS12_CONTROLLER_0_IAM_Rx
        ComInvalidNotification = NULL_PTR
        ComRxDataTimeoutAction = NONE
        ComSignalEndianness = BIG_ENDIAN
        ComSignalInitValue = 0x0
        ComSignalLength = 0
        ComSignalType = UINT64
        ComTransferProperty = TRIGGERED
        ComSignalDataInvalidValue = 0x0
        ComDataInvalidAction = NOTIFY
        ComTimeout = 0.0
        ComFirstTimeout = 0.0
        ComNotification = Rte_COMCbk
      ILongtDeltaVelForeCall_SDM_SFCANFD_Event_FrS12_CONTROLLER_0_IAM_Rx (ComSignal):
        ComBitPosition = 152
        ComBitSize = 64
        ComHandleId = ILongtDeltaVelForeCall_SDM_SFCANFD_Event_FrS12_CONTROLLER_0_IAM_Rx
        ComInvalidNotification = NULL_PTR
        ComRxDataTimeoutAction = NONE
        ComSignalEndianness = BIG_ENDIAN
        ComSignalInitValue = 0x0
        ComSignalLength = 0
        ComSignalType = UINT64
        ComTransferProperty = TRIGGERED
        ComSignalDataInvalidValue = 0x0
        ComDataInvalidAction = NOTIFY
        ComTimeout = 0.0
        ComFirstTimeout = 0.0
        ComNotification = Rte_COMCbk
      ICB_CONNCANFD_EvtInfo_CONTROLLER_0_IAM_Rx (ComIPdu):
        ComIPduCancellationSupport = false
        ComIPduDirection = RECEIVE
        ComIPduHandleId = COM_RXPDU_COM_ICB_CONNCANFD_EvtInfo_CONTROLLER_0_IAM_Rx
        ComIPduSignalProcessing = DEFERRED
        ComIPduType = NORMAL
        ComPduIdRef = COM_ICB_CONNCANFD_EvtInfo_CONTROLLER_0_IAM_Rx
        ComIPduSignalRef = IEvtPotclSigGW_ICB_CONNCANFD_EvtInfo_CONTROLLER_0_IAM_Rx
        ComIPduGroupRef = Com_RxPduGroup_CONTROLLER_0_IAM
      IEvtPotclSigGW_ICB_CONNCANFD_EvtInfo_CONTROLLER_0_IAM_Rx (ComSignal):
        ComBitPosition = 56
        ComBitSize = 64
        ComHandleId = IEvtPotclSigGW_ICB_CONNCANFD_EvtInfo_CONTROLLER_0_IAM_Rx
        ComInvalidNotification = NULL_PTR
        ComRxDataTimeoutAction = NONE
        ComSignalEndianness = BIG_ENDIAN
        ComSignalInitValue = 0x0
        ComSignalLength = 0
        ComSignalType = UINT64
        ComTransferProperty = TRIGGERED
        ComSignalDataInvalidValue = 0x0
        ComDataInvalidAction = NOTIFY
        ComTimeout = 0.0
        ComFirstTimeout = 0.0
        ComNotification = Rte_COMCbk
      ESS_PTCANFD_EvtInfo_CONTROLLER_0_IAM_Rx (ComIPdu):
        ComIPduCancellationSupport = false
        ComIPduDirection = RECEIVE
        ComIPduHandleId = COM_RXPDU_COM_ESS_PTCANFD_EvtInfo_CONTROLLER_0_IAM_Rx
        ComIPduSignalProcessing = DEFERRED
        ComIPduType = NORMAL
        ComPduIdRef = COM_ESS_PTCANFD_EvtInfo_CONTROLLER_0_IAM_Rx
        ComIPduSignalRef = IEvtPotclSigBMS{1..8}_ESS_PTCANFD_EvtInfo_CONTROLLER_0_IAM_Rx
        ComIPduGroupRef = Com_RxPduGroup_CONTROLLER_0_IAM
      8 x ComSignal, all with ComBitSize=64, ComInvalidNotification=NULL_PTR, ComRxDataTimeoutAction=NONE, ComSignalEndianness=BIG_ENDIAN, ComSignalInitValue=0x0, ComSignalLength=0, ComSignalType=UINT64, ComTransferProperty=TRIGGERED, ComSignalDataInvalidValue=0x0, ComDataInvalidAction=NOTIFY, ComTimeout=0.0, ComFirstTimeout=0.0, ComNotification=Rte_COMCbk:
        IEvtPotclSigBMS1_ESS_PTCANFD_EvtInfo_CONTROLLER_0_IAM_Rx: ComBitPosition=56, ComHandleId=IEvtPotclSigBMS1_ESS_PTCANFD_EvtInfo_CONTROLLER_0_IAM_Rx
        IEvtPotclSigBMS2_ESS_PTCANFD_EvtInfo_CONTROLLER_0_IAM_Rx: ComBitPosition=120, ComHandleId=IEvtPotclSigBMS2_ESS_PTCANFD_EvtInfo_CONTROLLER_0_IAM_Rx
        IEvtPotclSigBMS3_ESS_PTCANFD_EvtInfo_CONTROLLER_0_IAM_Rx: ComBitPosition=184, ComHandleId=IEvtPotclSigBMS3_ESS_PTCANFD_EvtInfo_CONTROLLER_0_IAM_Rx
        IEvtPotclSigBMS4_ESS_PTCANFD_EvtInfo_CONTROLLER_0_IAM_Rx: ComBitPosition=248, ComHandleId=IEvtPotclSigBMS4_ESS_PTCANFD_EvtInfo_CONTROLLER_0_IAM_Rx
        IEvtPotclSigBMS5_ESS_PTCANFD_EvtInfo_CONTROLLER_0_IAM_Rx: ComBitPosition=312, ComHandleId=IEvtPotclSigBMS5_ESS_PTCANFD_EvtInfo_CONTROLLER_0_IAM_Rx
        IEvtPotclSigBMS6_ESS_PTCANFD_EvtInfo_CONTROLLER_0_IAM_Rx: ComBitPosition=376, ComHandleId=IEvtPotclSigBMS6_ESS_PTCANFD_EvtInfo_CONTROLLER_0_IAM_Rx
        IEvtPotclSigBMS7_ESS_PTCANFD_EvtInfo_CONTROLLER_0_IAM_Rx: ComBitPosition=440, ComHandleId=IEvtPotclSigBMS7_ESS_PTCANFD_EvtInfo_CONTROLLER_0_IAM_Rx
        IEvtPotclSigBMS8_ESS_PTCANFD_EvtInfo_CONTROLLER_0_IAM_Rx: ComBitPosition=504, ComHandleId=IEvtPotclSigBMS8_ESS_PTCANFD_EvtInfo_CONTROLLER_0_IAM_Rx
      DIAG_DTCInfo_ECM_CONTROLLER_0_IAM_Rx (ComIPdu):
        ComIPduCancellationSupport = false
        ComIPduDirection = RECEIVE
        ComIPduHandleId = COM_RXPDU_COM_DIAG_DTCInfo_ECM_CONTROLLER_0_IAM_Rx
        ComIPduSignalProcessing = DEFERRED
        ComIPduType = NORMAL
        ComPduIdRef = COM_DIAG_DTCInfo_ECM_CONTROLLER_0_IAM_Rx
        ComIPduSignalRef = IDTCInfomationECM_DIAG_DTCInfo_ECM_CONTROLLER_0_IAM_Rx
        ComIPduGroupRef = Com_RxPduGroup_CONTROLLER_0_IAM
      IDTCInfomationECM_DIAG_DTCInfo_ECM_CONTROLLER_0_IAM_Rx (ComSignal):
        ComBitPosition = 48
        ComBitSize = 56
        ComHandleId = IDTCInfomationECM_DIAG_DTCInfo_ECM_CONTROLLER_0_IAM_Rx
        ComInvalidNotification = NULL_PTR
        ComRxDataTimeoutAction = NONE
        ComSignalEndianness = BIG_ENDIAN
        ComSignalInitValue = 0x0
        ComSignalLength = 0
        ComSignalType = UINT64
        ComTransferProperty = PENDING
        ComSignalDataInvalidValue = 0x0
        ComDataInvalidAction = NOTIFY
        ComTimeout = 0.0
        ComFirstTimeout = 0.0
        ComNotification = Rte_COMCbk
      DIAG_DTCInfo_PEU_CONTROLLER_0_IAM_Rx (ComIPdu):
        ComIPduCancellationSupport = false
        ComIPduDirection = RECEIVE
        ComIPduHandleId = COM_RXPDU_COM_DIAG_DTCInfo_PEU_CONTROLLER_0_IAM_Rx
        ComIPduSignalProcessing = DEFERRED
        ComIPduType = NORMAL
        ComPduIdRef = COM_DIAG_DTCInfo_PEU_CONTROLLER_0_IAM_Rx
        ComIPduSignalRef = IDTCInfomationPEU_DIAG_DTCInfo_PEU_CONTROLLER_0_IAM_Rx
        ComIPduGroupRef = Com_RxPduGroup_CONTROLLER_0_IAM
      IDTCInfomationPEU_DIAG_DTCInfo_PEU_CONTROLLER_0_IAM_Rx (ComSignal):
        ComBitPosition = 48
        ComBitSize = 56
        ComHandleId = IDTCInfomationPEU_DIAG_DTCInfo_PEU_CONTROLLER_0_IAM_Rx
        ComInvalidNotification = NULL_PTR
        ComRxDataTimeoutAction = NONE
        ComSignalEndianness = BIG_ENDIAN
        ComSignalInitValue = 0x0
        ComSignalLength = 0
        ComSignalType = UINT64
        ComTransferProperty = PENDING
        ComSignalDataInvalidValue = 0x0
        ComDataInvalidAction = NOTIFY
        ComTimeout = 0.0
        ComFirstTimeout = 0.0
        ComNotification = Rte_COMCbk
      DIAG_DTCInfo_ESS_CONTROLLER_0_IAM_Rx (ComIPdu):
        ComIPduCancellationSupport = false
        ComIPduDirection = RECEIVE
        ComIPduHandleId = COM_RXPDU_COM_DIAG_DTCInfo_ESS_CONTROLLER_0_IAM_Rx
        ComIPduSignalProcessing = DEFERRED
        ComIPduType = NORMAL
        ComPduIdRef = COM_DIAG_DTCInfo_ESS_CONTROLLER_0_IAM_Rx
        ComIPduSignalRef = IDTCInfomationESS_DIAG_DTCInfo_ESS_CONTROLLER_0_IAM_Rx
        ComIPduGroupRef = Com_RxPduGroup_CONTROLLER_0_IAM
      IDTCInfomationESS_DIAG_DTCInfo_ESS_CONTROLLER_0_IAM_Rx (ComSignal):
        ComBitPosition = 48
        ComBitSize = 56
        ComHandleId = IDTCInfomationESS_DIAG_DTCInfo_ESS_CONTROLLER_0_IAM_Rx
        ComInvalidNotification = NULL_PTR
        ComRxDataTimeoutAction = NONE
        ComSignalEndianness = BIG_ENDIAN
        ComSignalInitValue = 0x0
        ComSignalLength = 0
        ComSignalType = UINT64
        ComTransferProperty = PENDING
        ComSignalDataInvalidValue = 0x0
        ComDataInvalidAction = NOTIFY
        ComTimeout = 0.0
        ComFirstTimeout = 0.0
        ComNotification = Rte_COMCbk
      DIAG_DTCInfo_TC_CONTROLLER_0_IAM_Rx (ComIPdu):
        ComIPduCancellationSupport = false
        ComIPduDirection = RECEIVE
        ComIPduHandleId = COM_RXPDU_COM_DIAG_DTCInfo_TC_CONTROLLER_0_IAM_Rx
        ComIPduSignalProcessing = DEFERRED
        ComIPduType = NORMAL
        ComPduIdRef = COM_DIAG_DTCInfo_TC_CONTROLLER_0_IAM_Rx
        ComIPduSignalRef = IDTCInfomationTC_DIAG_DTCInfo_TC_CONTROLLER_0_IAM_Rx
        ComIPduGroupRef = Com_RxPduGroup_CONTROLLER_0_IAM
      IDTCInfomationTC_DIAG_DTCInfo_TC_CONTROLLER_0_IAM_Rx (ComSignal):
        ComBitPosition = 48
        ComBitSize = 56
        ComHandleId = IDTCInfomationTC_DIAG_DTCInfo_TC_CONTROLLER_0_IAM_Rx
        ComInvalidNotification = NULL_PTR
        ComRxDataTimeoutAction = NONE
        ComSignalEndianness = BIG_ENDIAN
        ComSignalInitValue = 0x0
        ComSignalLength = 0
        ComSignalType = UINT64
        ComTransferProperty = PENDING
        ComSignalDataInvalidValue = 0x0
        ComDataInvalidAction = NOTIFY
        ComTimeout = 0.0
        ComFirstTimeout = 0.0
        ComNotification = Rte_COMCbk
      PDU_COM_NMUSERDATA_IAM (ComIPdu):
        ComIPduCancellationSupport = false
        ComIPduDirection = SEND
        ComIPduHandleId = COM_TXPDU_Com_NmUserDataPdu_IAM
        ComIPduSignalProcessing = DEFERRED
        ComIPduType = NORMAL
        ComPduIdRef = Com_NmUserDataPdu_IAM
        ComIPduSignalRef = IIAM_NKI_CONNCANFD_IAM_CONNCANFD_NM_CONTROLLER_0_IAM_Tx
        ComIPduSignalRef = IIAM_NOI_CONNCANFD_IAM_CONNCANFD_NM_CONTROLLER_0_IAM_Tx
        ComIPduSignalRef = IIAM_NWI_CONNCANFD_IAM_CONNCANFD_NM_CONTROLLER_0_IAM_Tx
        ComIPduSignalRef = IIAM_NM_RMSSta_CONNCANFD_IAM_CONNCANFD_NM_CONTROLLER_0_IAM_Tx
        ComIPduSignalRef = IIAM_NM_NOSSta_CONNCANFD_IAM_CONNCANFD_NM_CONTROLLER_0_IAM_Tx
        ComIPduSignalRef = IIAM_NM_NOStoRMS_CONNCANFD_IAM_CONNCANFD_NM_CONTROLLER_0_IAM_Tx
        ComIPduSignalRef = IIAM_NM_RSStoRMS_CONNCANFD_IAM_CONNCANFD_NM_CONTROLLER_0_IAM_Tx
        ComIPduSignalRef = IIAM_NM_RSStoNOS_CONNCANFD_IAM_CONNCANFD_NM_CONTROLLER_0_IAM_Tx
        ComIPduSignalRef = IIAM_NM_RMStoNOS_CONNCANFD_IAM_CONNCANFD_NM_CONTROLLER_0_IAM_Tx
        ComIPduSignalRef = IIAM_NM_PBSMtoRMS_CONNCANFD_IAM_CONNCANFD_NM_CONTROLLER_0_IAM_Tx
        ComIPduSignalRef = IIAM_NM_BSMtoRMS_CONNCANFD_IAM_CONNCANFD_NM_CONTROLLER_0_IAM_Tx
        ComTxIPdu: ComMinimumDelayTime=0.0, ComTxIPduUnusedAreasDefault=0
          ComTxModeTrue
            ComTxMode: ComTxModeMode=NONE, ComTxModeNumberOfRepetitions=0, ComTxModeRepetitionPeriod=0.0, ComTxModeTimeOffset=0.0, ComTxModeTimePeriod=0.0
      11 x ComSignal, all with ComInvalidNotification=NULL_PTR, ComRxDataTimeoutAction=NONE, ComSignalInitValue=0x0, ComSignalLength=0, ComTransferProperty=PENDING, ComSignalDataInvalidValue=0x0, ComDataInvalidAction=NOTIFY, ComTimeout=0.0, ComFirstTimeout=0.0, ComNotification=Rte_COMCbkTAck:
        IIAM_NKI_CONNCANFD_IAM_CONNCANFD_NM_CONTROLLER_0_IAM_Tx: ComBitPosition=40, ComBitSize=16, ComHandleId=IIAM_NKI_CONNCANFD_IAM_CONNCANFD_NM_CONTROLLER_0_IAM_Tx, ComSignalEndianness=BIG_ENDIAN, ComSignalType=UINT16
        IIAM_NOI_CONNCANFD_IAM_CONNCANFD_NM_CONTROLLER_0_IAM_Tx: ComBitPosition=24, ComBitSize=16, ComHandleId=IIAM_NOI_CONNCANFD_IAM_CONNCANFD_NM_CONTROLLER_0_IAM_Tx, ComSignalEndianness=BIG_ENDIAN, ComSignalType=UINT16
        IIAM_NWI_CONNCANFD_IAM_CONNCANFD_NM_CONTROLLER_0_IAM_Tx: ComBitPosition=8, ComBitSize=8, ComHandleId=IIAM_NWI_CONNCANFD_IAM_CONNCANFD_NM_CONTROLLER_0_IAM_Tx, ComSignalEndianness=BIG_ENDIAN, ComSignalType=UINT8
        IIAM_NM_RMSSta_CONNCANFD_IAM_CONNCANFD_NM_CONTROLLER_0_IAM_Tx: ComBitPosition=7, ComBitSize=1, ComHandleId=IIAM_NM_RMSSta_CONNCANFD_IAM_CONNCANFD_NM_CONTROLLER_0_IAM_Tx, ComSignalEndianness=LITTLE_ENDIAN, ComSignalType=BOOLEAN
        IIAM_NM_NOSSta_CONNCANFD_IAM_CONNCANFD_NM_CONTROLLER_0_IAM_Tx: ComBitPosition=6, ComBitSize=1, ComHandleId=IIAM_NM_NOSSta_CONNCANFD_IAM_CONNCANFD_NM_CONTROLLER_0_IAM_Tx, ComSignalEndianness=BIG_ENDIAN, ComSignalType=BOOLEAN
        IIAM_NM_NOStoRMS_CONNCANFD_IAM_CONNCANFD_NM_CONTROLLER_0_IAM_Tx: ComBitPosition=5, ComBitSize=1, ComHandleId=IIAM_NM_NOStoRMS_CONNCANFD_IAM_CONNCANFD_NM_CONTROLLER_0_IAM_Tx, ComSignalEndianness=BIG_ENDIAN, ComSignalType=BOOLEAN
        IIAM_NM_RSStoRMS_CONNCANFD_IAM_CONNCANFD_NM_CONTROLLER_0_IAM_Tx: ComBitPosition=4, ComBitSize=1, ComHandleId=IIAM_NM_RSStoRMS_CONNCANFD_IAM_CONNCANFD_NM_CONTROLLER_0_IAM_Tx, ComSignalEndianness=BIG_ENDIAN, ComSignalType=BOOLEAN
        IIAM_NM_RSStoNOS_CONNCANFD_IAM_CONNCANFD_NM_CONTROLLER_0_IAM_Tx: ComBitPosition=3, ComBitSize=1, ComHandleId=IIAM_NM_RSStoNOS_CONNCANFD_IAM_CONNCANFD_NM_CONTROLLER_0_IAM_Tx, ComSignalEndianness=BIG_ENDIAN, ComSignalType=BOOLEAN
        IIAM_NM_RMStoNOS_CONNCANFD_IAM_CONNCANFD_NM_CONTROLLER_0_IAM_Tx: ComBitPosition=2, ComBitSize=1, ComHandleId=IIAM_NM_RMStoNOS_CONNCANFD_IAM_CONNCANFD_NM_CONTROLLER_0_IAM_Tx, ComSignalEndianness=BIG_ENDIAN, ComSignalType=BOOLEAN
        IIAM_NM_PBSMtoRMS_CONNCANFD_IAM_CONNCANFD_NM_CONTROLLER_0_IAM_Tx: ComBitPosition=1, ComBitSize=1, ComHandleId=IIAM_NM_PBSMtoRMS_CONNCANFD_IAM_CONNCANFD_NM_CONTROLLER_0_IAM_Tx, ComSignalEndianness=BIG_ENDIAN, ComSignalType=BOOLEAN
        IIAM_NM_BSMtoRMS_CONNCANFD_IAM_CONNCANFD_NM_CONTROLLER_0_IAM_Tx: ComBitPosition=0, ComBitSize=1, ComHandleId=IIAM_NM_BSMtoRMS_CONNCANFD_IAM_CONNCANFD_NM_CONTROLLER_0_IAM_Tx, ComSignalEndianness=BIG_ENDIAN, ComSignalType=BOOLEAN
      Com_TxPduGroup_CONTROLLER_0_IAM (ComIPduGroup): ComIPduGroupHandleId=Com_TxPduGroup_CONTROLLER_0_IAM
      9 x ComIPdu, all with ComIPduCancellationSupport=false, ComIPduDirection=SEND, ComIPduSignalProcessing=DEFERRED, ComIPduType=NORMAL, ComIPduGroupRef=Com_TxPduGroup_CONTROLLER_0_IAM:
        IAM_CONNCANFD_100ms_ConFrP02_CONTROLLER_0_IAM_Tx_PDU07: ComIPduHandleId=COM_TXPDU_Com_Contained_Tx_0x377_Pdu07, ComIPduCallout=IAM_CONNCANFD_100ms_ConFrP02_CONTROLLER_0_IAM_Tx_PDU07, ComPduIdRef=Com_Contained_Tx_0x377_Pdu07, ComIPduSignalRef=IDownVelocityRTK_IAM_CONNCANFD_100ms_ConFrP02_CONTROLLER_0_IAM_Tx, ComIPduSignalRef=IVeldownsigma_IAM_CONNCANFD_100ms_ConFrP02_CONTROLLER_0_IAM_Tx, ComIPduSignalRef=IBaseLineLen_IAM_CONNCANFD_100ms_ConFrP02_CONTROLLER_0_IAM_Tx, ComIPduSignalRef=IPositionAttitudeStatus_IAM_CONNCANFD_100ms_ConFrP02_CONTROLLER_0_IAM_Tx, ComIPduSignalRef=IDiffAgeInfo_IAM_CONNCANFD_100ms_ConFrP02_CONTROLLER_0_IAM_Tx
          ComTxIPdu: ComMinimumDelayTime=0.0, ComTxIPduUnusedAreasDefault=0
            ComTxModeTrue
              ComTxMode: ComTxModeMode=PERIODIC, ComTxModeNumberOfRepetitions=0, ComTxModeRepetitionPeriod=0.0, ComTxModeTimeOffset=0.0, ComTxModeTimePeriod=0.1
        IAM_CONNCANFD_100ms_ConFrP02_CONTROLLER_0_IAM_Tx_PDU08: ComIPduHandleId=COM_TXPDU_Com_Contained_Tx_0x377_Pdu08, ComIPduCallout=IAM_CONNCANFD_100ms_ConFrP02_CONTROLLER_0_IAM_Tx_PDU08, ComPduIdRef=Com_Contained_Tx_0x377_Pdu08, ComIPduSignalGroupRef=IIAM_100ms_Group08_IAM_CONNCANFD_100ms_ConFrP02_CONTROLLER_0_IAM_Tx
          ComTxIPdu: ComMinimumDelayTime=0.0, ComTxIPduUnusedAreasDefault=0
            ComTxModeTrue
              ComTxMode: ComTxModeMode=PERIODIC, ComTxModeNumberOfRepetitions=0, ComTxModeRepetitionPeriod=0.0, ComTxModeTimeOffset=0.0, ComTxModeTimePeriod=0.1
        IAM_CONNCANFD_100ms_ConFrP03_CONTROLLER_0_IAM_Tx_Pdu34: ComIPduHandleId=COM_TXPDU_Com_Contained_Tx_0x36A_Pdu34, ComIPduCallout=IAM_CONNCANFD_100ms_ConFrP03_CONTROLLER_0_IAM_Tx_Pdu34, ComPduIdRef=Com_Contained_Tx_0x36A_Pdu34, ComIPduSignalGroupRef=IIAM_ZONE_100ms_Group34_IAM_CONNCANFD_100ms_ConFrP03_CONTROLLER_0_IAM_Tx
          ComTxIPdu: ComMinimumDelayTime=0.0, ComTxIPduUnusedAreasDefault=0
            ComTxModeTrue
              ComTxMode: ComTxModeMode=PERIODIC, ComTxModeNumberOfRepetitions=0, ComTxModeRepetitionPeriod=0.0, ComTxModeTimeOffset=0.0, ComTxModeTimePeriod=0.1
        IAM_CONNCANFD_100ms_ConFrP03_CONTROLLER_0_IAM_Tx_Pdu35: ComIPduHandleId=COM_TXPDU_Com_Contained_Tx_0x36A_Pdu35, ComIPduCallout=IAM_CONNCANFD_100ms_ConFrP03_CONTROLLER_0_IAM_Tx_Pdu35, ComPduIdRef=Com_Contained_Tx_0x36A_Pdu35, ComIPduSignalGroupRef=IIAM_ZONE_100ms_Group35_IAM_CONNCANFD_100ms_ConFrP03_CONTROLLER_0_IAM_Tx
          ComTxIPdu: ComMinimumDelayTime=0.0, ComTxIPduUnusedAreasDefault=0
            ComTxModeTrue
              ComTxMode: ComTxModeMode=PERIODIC, ComTxModeNumberOfRepetitions=0, ComTxModeRepetitionPeriod=0.0, ComTxModeTimeOffset=0.0, ComTxModeTimePeriod=0.1
        IAM_CONNCANFD_100ms_ConFrP03_CONTROLLER_0_IAM_Tx_Pdu39: ComIPduHandleId=COM_TXPDU_Com_Contained_Tx_0x36A_Pdu39, ComIPduCallout=IAM_CONNCANFD_100ms_ConFrP03_CONTROLLER_0_IAM_Tx_Pdu39, ComPduIdRef=Com_Contained_Tx_0x36A_Pdu39, ComIPduSignalRef=IEmgcCallTrigd_IAM_CONNCANFD_100ms_ConFrP03_CONTROLLER_0_IAM_Tx, ComIPduSignalRef=IEmgcCallFlrSts_IAM_CONNCANFD_100ms_ConFrP03_CONTROLLER_0_IAM_Tx
          ComTxIPdu: ComMinimumDelayTime=0.0, ComTxIPduUnusedAreasDefault=0
            ComTxModeTrue
              ComTxMode: ComTxModeMode=PERIODIC, ComTxModeNumberOfRepetitions=0, ComTxModeRepetitionPeriod=0.0, ComTxModeTimeOffset=0.0, ComTxModeTimePeriod=0.1
        IAM_CONNCANFD_100ms_ConFrP03_CONTROLLER_0_IAM_Tx_Pdu40: ComIPduHandleId=COM_TXPDU_Com_Contained_Tx_0x36A_Pdu40, ComIPduCallout=IAM_CONNCANFD_100ms_ConFrP03_CONTROLLER_0_IAM_Tx_Pdu40, ComPduIdRef=Com_Contained_Tx_0x36A_Pdu40, ComIPduSignalGroupRef=IIAM_ZONE_100ms_Group40_IAM_CONNCANFD_100ms_ConFrP03_CONTROLLER_0_IAM_Tx
          ComTxIPdu: ComMinimumDelayTime=0.0, ComTxIPduUnusedAreasDefault=0
            ComTxModeTrue
              ComTxMode: ComTxModeMode=PERIODIC, ComTxModeNumberOfRepetitions=0, ComTxModeRepetitionPeriod=0.0, ComTxModeTimeOffset=0.0, ComTxModeTimePeriod=0.1
        IAM_CONNCANFD_100ms_ConFrP41_CONTROLLER_0_IAM_Tx_Pdu04: ComIPduHandleId=COM_TXPDU_Com_Contained_Tx_0x3A2_Pdu04, ComIPduCallout=IAM_CONNCANFD_100ms_ConFrP41_CONTROLLER_0_IAM_Tx_Pdu04, ComPduIdRef=Com_Contained_Tx_0x3A2_Pdu04, ComIPduSignalRef=ITgtRembParkngChosenSpcID_IAM_CONNCANFD_100ms_ConFrP41_CONTROLLER_0_IAM_Tx, ComIPduSignalRef=ITrfcInfoSignDist_IAM_CONNCANFD_100ms_ConFrP41_CONTROLLER_0_IAM_Tx, ComIPduSignalRef=ITrfcWrnngSignDist_IAM_CONNCANFD_100ms_ConFrP41_CONTROLLER_0_IAM_Tx, ComIPduSignalRef=ITrfcForbidDist_IAM_CONNCANFD_100ms_ConFrP41_CONTROLLER_0_IAM_Tx, ComIPduSignalRef=ICellularRSSI_IAM_CONNCANFD_100ms_ConFrP41_CONTROLLER_0_IAM_Tx
          ComTxIPdu: ComMinimumDelayTime=0.0, ComTxIPduUnusedAreasDefault=0
            ComTxModeTrue
              ComTxMode: ComTxModeMode=PERIODIC, ComTxModeNumberOfRepetitions=0, ComTxModeRepetitionPeriod=0.0, ComTxModeTimeOffset=0.0, ComTxModeTimePeriod=0.1
        IAM_CONNCANFD_100ms_ConFrP41_CONTROLLER_0_IAM_Tx_Pdu41: ComIPduHandleId=COM_TXPDU_Com_Contained_Tx_0x3A2_Pdu41, ComIPduCallout=IAM_CONNCANFD_100ms_ConFrP41_CONTROLLER_0_IAM_Tx_Pdu41, ComPduIdRef=Com_Contained_Tx_0x3A2_Pdu41, ComIPduSignalRef=ITBOXReserSpMinute_IAM_CONNCANFD_100ms_ConFrP41_CONTROLLER_0_IAM_Tx, ComIPduSignalRef=ITBOXReserSpHour_IAM_CONNCANFD_100ms_ConFrP41_CONTROLLER_0_IAM_Tx, ComIPduSignalRef=ITBOXReserStMinute_IAM_CONNCANFD_100ms_ConFrP41_CONTROLLER_0_IAM_Tx, ComIPduSignalRef=ITBOXV2XReq_IAM_CONNCANFD_100ms_ConFrP41_CONTROLLER_0_IAM_Tx, ComIPduSignalRef=ITBOXV2XSpSOCReq_IAM_CONNCANFD_100ms_ConFrP41_CONTROLLER_0_IAM_Tx, ComIPduSignalRef=ITBOXReserStTimeV_IAM_CONNCANFD_100ms_ConFrP41_CONTROLLER_0_IAM_Tx, ComIPduSignalRef=ITBOXSprOfbdChrgReq_IAM_CONNCANFD_100ms_ConFrP41_CONTROLLER_0_IAM_Tx, ComIPduSignalRef=ITBOXReserCtrlReq_IAM_CONNCANFD_100ms_ConFrP41_CONTROLLER_0_IAM_Tx, ComIPduSignalRef=ITBOXReserStHour_IAM_CONNCANFD_100ms_ConFrP41_CONTROLLER_0_IAM_Tx, ComIPduSignalRef=ITBOXChrgTrgtSOCReq_IAM_CONNCANFD_100ms_ConFrP41_CONTROLLER_0_IAM_Tx, ComIPduSignalRef=ITBOXChrgCtrlReq_IAM_CONNCANFD_100ms_ConFrP41_CONTROLLER_0_IAM_Tx, ComIPduSignalRef=ITBOXEleccLckCtrlReq_IAM_CONNCANFD_100ms_ConFrP41_CONTROLLER_0_IAM_Tx
          ComTxIPdu: ComMinimumDelayTime=0.0, ComTxIPduUnusedAreasDefault=0
            ComTxModeTrue
              ComTxMode: ComTxModeMode=PERIODIC, ComTxModeNumberOfRepetitions=0, ComTxModeRepetitionPeriod=0.0, ComTxModeTimeOffset=0.0, ComTxModeTimePeriod=0.1
        IAM_CONNCANFD_100ms_ConFrP41_CONTROLLER_0_IAM_Tx_Pdu57: ComIPduHandleId=COM_TXPDU_Com_Contained_Tx_0x3A2_Pdu57, ComIPduCallout=IAM_CONNCANFD_100ms_ConFrP41_CONTROLLER_0_IAM_Tx_Pdu57, ComPduIdRef=Com_Contained_Tx_0x3A2_Pdu57, ComIPduSignalGroupRef=IIAM_ZONE_100ms_Group57_IAM_CONNCANFD_100ms_ConFrP41_CONTROLLER_0_IAM_Tx
          ComTxIPdu: ComMinimumDelayTime=0.0, ComTxIPduUnusedAreasDefault=0
            ComTxModeTrue
              ComTxMode: ComTxModeMode=PERIODIC, ComTxModeNumberOfRepetitions=0, ComTxModeRepetitionPeriod=0.0, ComTxModeTimeOffset=0.0, ComTxModeTimePeriod=0.1
