AUTOSAR XML (schema 4-2-2)
package /Renesas/EcucDefs_Can
  ecuc value collection ECUConfiguration: ecuc-values=EcuM0
  module config EcuM0: definition=EcuM, implementation-config-variant=VARIANT-POST-BUILD
    EcuMConfiguration0 (EcuMConfiguration)
      EcuMCommonConfiguration0 (EcuMCommonConfiguration): EcuMConfigConsistencyHash=, EcuMDefaultAppMode=, EcuMOSResource=
        EcuMDefaultShutdownTarget0 (EcuMDefaultShutdownTarget): EcuMDefaultState=, EcuMDefaultSleepModeRef=
        EcuMSleepMode0 (EcuMSleepMode): EcuMSleepModeId=, EcuMSleepModeSuspend=, EcuMSleepModeMcuModeRef=, EcuMSleepModeCanMModeRef=, EcuMWakeupSourceMask=
        9 x EcuMWakeupSource, all with EcuMValidationTimeout=, EcuMWakeupSourcePolling=0, EcuMComMChannelRef=, EcuMResetReasonRef=:
          EcuMWakeupSource_1: EcuMWakeupSourceId=5
          EcuMWakeupSource_9: EcuMWakeupSourceId=6
          EcuMWakeupSource_8: EcuMWakeupSourceId=7
          EcuMWakeupSource_7: EcuMWakeupSourceId=8
          EcuMWakeupSource_6: EcuMWakeupSourceId=8
          EcuMWakeupSource_5: EcuMWakeupSourceId=8
          EcuMWakeupSource_4: EcuMWakeupSourceId=8
          EcuMWakeupSource_3: EcuMWakeupSourceId=6
          EcuMWakeupSource_2: EcuMWakeupSourceId=8
    EcuMGeneral0 (EcuMGeneral): EcuMDevErrorDetect=0, EcuMEnableDefBehaviour=, EcuMIncludeDem=, EcuMIncludeDet=, EcuMMainFunctionPeriod=, EcuMVersionInfoApi=
