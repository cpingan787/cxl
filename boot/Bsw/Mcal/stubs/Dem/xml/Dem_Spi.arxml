AUTOSAR XML (schema 4-2-2)
package /ActiveEcuC
  module config Dem: implementation-config-variant=VARIANT-PRE-COMPILE
    DemConfigSet
      8 x DemEventParameter, all with DemEventKind=(unset), DemMaxNumberFreezeFrameRecords=(unset), DemDTCClassRef=(unset), DemExtendedDataClassRef=(unset), DemFreezeFrameClassRef=(unset), DemFreezeFrameRecNumClassRef=(unset):
        DemEventParameter: DemEventId=1
          DemEventClass:
            DemAgingAllowed = true
            DemAgingCycleCounterThreshold = (unset)
            DemConsiderPtoStatus = true
            DemEventDestination = (unset)
            DemEventFailureCycleCounterThreshold = (unset)
            DemEventOBDReadinessGroup = (unset)
            DemEventPriority = (unset)
            DemEventSignificance = (unset)
            DemFFPrestorageSupported = true
            DemAgingCycleRef = (unset)
            DemEnableConditionGroupRef = (unset)
            DemEventFailureCycleRef = (unset)
            DemOperationCycleRef = (unset)
            DemStorageConditionGroupRef = (unset)
            DemDebounceAlgorithmClass
        DemEventParameter_002: DemEventId=3
          DemEventClass:
            DemAgingAllowed = true
            DemAgingCycleCounterThreshold = (unset)
            DemConsiderPtoStatus = true
            DemEventDestination = (unset)
            DemEventFailureCycleCounterThreshold = (unset)
            DemEventOBDReadinessGroup = (unset)
            DemEventPriority = (unset)
            DemEventSignificance = (unset)
            DemFFPrestorageSupported = true
            DemAgingCycleRef = (unset)
            DemEnableConditionGroupRef = (unset)
            DemEventFailureCycleRef = (unset)
            DemOperationCycleRef = (unset)
            DemStorageConditionGroupRef = (unset)
            DemDebounceAlgorithmClass
        DemEventParameter_001: DemEventId=2
          DemEventClass:
            DemAgingAllowed = true
            DemAgingCycleCounterThreshold = (unset)
            DemConsiderPtoStatus = true
            DemEventDestination = (unset)
            DemEventFailureCycleCounterThreshold = (unset)
            DemEventOBDReadinessGroup = (unset)
            DemEventPriority = (unset)
            DemEventSignificance = (unset)
            DemFFPrestorageSupported = true
            DemAgingCycleRef = (unset)
            DemEnableConditionGroupRef = (unset)
            DemEventFailureCycleRef = (unset)
            DemOperationCycleRef = (unset)
            DemStorageConditionGroupRef = (unset)
            DemDebounceAlgorithmClass
        DemEventParameter_003: DemEventId=4
          DemEventClass:
            DemAgingAllowed = true
            DemAgingCycleCounterThreshold = (unset)
            DemConsiderPtoStatus = true
            DemEventDestination = (unset)
            DemEventFailureCycleCounterThreshold = (unset)
            DemEventOBDReadinessGroup = (unset)
            DemEventPriority = (unset)
            DemEventSignificance = (unset)
            DemFFPrestorageSupported = true
            DemAgingCycleRef = (unset)
            DemEnableConditionGroupRef = (unset)
            DemEventFailureCycleRef = (unset)
            DemOperationCycleRef = (unset)
            DemStorageConditionGroupRef = (unset)
            DemDebounceAlgorithmClass
        DemEventParameter_004: DemEventId=5
          DemEventClass:
            DemAgingAllowed = true
            DemAgingCycleCounterThreshold = (unset)
            DemConsiderPtoStatus = true
            DemEventDestination = (unset)
            DemEventFailureCycleCounterThreshold = (unset)
            DemEventOBDReadinessGroup = (unset)
            DemEventPriority = (unset)
            DemEventSignificance = (unset)
            DemFFPrestorageSupported = true
            DemAgingCycleRef = (unset)
            DemEnableConditionGroupRef = (unset)
            DemEventFailureCycleRef = (unset)
            DemOperationCycleRef = (unset)
            DemStorageConditionGroupRef = (unset)
            DemDebounceAlgorithmClass
        DemEventParameter_005: DemEventId=6
          DemEventClass:
            DemAgingAllowed = true
            DemAgingCycleCounterThreshold = (unset)
            DemConsiderPtoStatus = true
            DemEventDestination = (unset)
            DemEventFailureCycleCounterThreshold = (unset)
            DemEventOBDReadinessGroup = (unset)
            DemEventPriority = (unset)
            DemEventSignificance = (unset)
            DemFFPrestorageSupported = true
            DemAgingCycleRef = (unset)
            DemEnableConditionGroupRef = (unset)
            DemEventFailureCycleRef = (unset)
            DemOperationCycleRef = (unset)
            DemStorageConditionGroupRef = (unset)
            DemDebounceAlgorithmClass
        DemEventParameter_006: DemEventId=7
          DemEventClass:
            DemAgingAllowed = true
            DemAgingCycleCounterThreshold = (unset)
            DemConsiderPtoStatus = true
            DemEventDestination = (unset)
            DemEventFailureCycleCounterThreshold = (unset)
            DemEventOBDReadinessGroup = (unset)
            DemEventPriority = (unset)
            DemEventSignificance = (unset)
            DemFFPrestorageSupported = true
            DemAgingCycleRef = (unset)
            DemEnableConditionGroupRef = (unset)
            DemEventFailureCycleRef = (unset)
            DemOperationCycleRef = (unset)
            DemStorageConditionGroupRef = (unset)
            DemDebounceAlgorithmClass
        DemEventParameter_007: DemEventId=8
          DemEventClass:
            DemAgingAllowed = true
            DemAgingCycleCounterThreshold = (unset)
            DemConsiderPtoStatus = true
            DemEventDestination = (unset)
            DemEventFailureCycleCounterThreshold = (unset)
            DemEventOBDReadinessGroup = (unset)
            DemEventPriority = (unset)
            DemEventSignificance = (unset)
            DemFFPrestorageSupported = true
            DemAgingCycleRef = (unset)
            DemEnableConditionGroupRef = (unset)
            DemEventFailureCycleRef = (unset)
            DemOperationCycleRef = (unset)
            DemStorageConditionGroupRef = (unset)
            DemDebounceAlgorithmClass
    DemGeneral:
      DemAgingCycleCounterProcessing = (unset)
      DemBswErrorBufferSize = (unset)
      DemClearDTCBehavior = (unset)
      DemDTCSuppressionSupport = true
      DemDebounceCounterBasedSupport = true
      DemDebounceTimeBasedSupport = true
      DemDevErrorDetect = false
      DemDtcStatusAvailabilityMask = (unset)
      DemEnableConditionSupport = true
      DemEventCombinationSupport = (unset)
      DemEventDisplacementSupport = true
      DemExtendedDataCapture = (unset)
      DemFreezeFrameCapture = (unset)
      DemHeaderFileInclusion = (unset)
      DemImmediateNvStorageLimit = (unset)
      DemMaxNumberEventEntryMirror = (unset)
      DemMaxNumberEventEntryPermanent = (unset)
      DemMaxNumberEventEntryPrimary = (unset)
      DemMaxNumberEventEntrySecondary = (unset)
      DemMaxNumberPrestoredFF = (unset)
      DemOBDSupport = true
      DemOccurrenceCounterProcessing = (unset)
      DemOperationCycleStatusStorage = true
      DemPTOSupport = true
      DemStatusBitStorageTestFailed = true
      DemStorageConditionSupport = true
      DemTaskTime = (unset)
      DemTriggerDcmReports = true
      DemTriggerDltReports = true
      DemTriggerFiMReports = true
      DemTriggerMonitorInitBeforeClearOk = true
      DemTypeOfDTCSupported = (unset)
      DemTypeOfFreezeFrameRecordNumeration = (unset)
      DemVersionInfoApi = true
      DemMILIndicatorRef = (unset)
      DemOperationCycle: DemOperationCycleType=(unset)
