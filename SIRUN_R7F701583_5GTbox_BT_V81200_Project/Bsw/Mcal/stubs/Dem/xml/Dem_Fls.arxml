AUTOSAR XML (schema 4-2-2)
package /AUTOSAR/EcucDefs
  ecuc value collection ECUConfiguration: ecuc-values=Dem0
  module config Dem0: definition=Dem, implementation-config-variant=VARIANT-PRE-COMPILE
    DemConfigSet0 (DemConfigSet)
      8 x DemEventParameter, all with DemEventKind=, DemMaxNumberFreezeFrameRecords=, DemDTCClassRef=, DemExtendedDataClassRef=, DemFreezeFrameClassRef=, DemFreezeFrameRecNumClassRef=:
        DemEventParameter0: DemEventId=1
        DemEventParameter1: DemEventId=2
        DemEventParameter2: DemEventId=3
        DemEventParameter4: DemEventId=5
        DemEventParameter3: DemEventId=4
        DemEventParameter5: DemEventId=6
        DemEventParameter6: DemEventId=7
        DemEventParameter7: DemEventId=8
    DemGeneral0 (DemGeneral):
      DemAgingCycleCounterProcessing = 
      DemBswErrorBufferSize = 
      DemClearDTCBehavior = 
      DemDTCSuppressionSupport = 
      DemDebounceCounterBasedSupport = 
      DemDebounceTimeBasedSupport = 
      DemDevErrorDetect = 0
      DemDtcStatusAvailabilityMask = 
      DemEnableConditionSupport = 
      DemEventCombinationSupport = 
      DemEventDisplacementSupport = 
      DemExtendedDataCapture = 
      DemFreezeFrameCapture = 
      DemHeaderFileInclusion = 
      DemImmediateNvStorageLimit = 
      DemMaxNumberEventEntryMirror = 
      DemMaxNumberEventEntryPermanent = 
      DemMaxNumberEventEntryPrimary = 
      DemMaxNumberEventEntrySecondary = 
      DemMaxNumberPrestoredFF = 
      DemOBDSupport = 
      DemOccurrenceCounterProcessing = 
      DemOperationCycleProcessing = 
      DemOperationCycleStatusStorage = 
      DemPTOSupport = 
      DemStatusBitHandlingTestFailedSinceLastClear = 
      DemStatusBitStorageTestFailed = 
      DemStorageConditionSupport = 
      DemTaskTime = 
      DemTriggerDcmReports = 
      DemTriggerDltReports = 
      DemTriggerFiMReports = 
      DemTriggerMonitorInitBeforeClearOk = 
      DemTypeOfDTCSupported = 
      DemTypeOfFreezeFrameRecordNumeration = 
      DemVersionInfoApi = 
      DemMILIndicatorRef = 
