AUTOSAR XML (schema 4-2-2)
package /AUTOSAR/EcucDefs_Lin
  ecuc value collection ECUConfiguration: ecuc-values=Dem0
  module config Dem0: definition=Dem, implementation-config-variant=VARIANT-PRE-COMPILE
    DemConfigSet0 (DemConfigSet)
      6 x DemEventParameter, all with DemEventKind=, DemMaxNumberFreezeFrameRecords=, DemDTCClassRef=, DemExtendedDataClassRef=, DemFreezeFrameClassRef=, DemFreezeFrameRecNumClassRef=:
        DemEventParameter0: DemEventId=1
        DemEventParameter1: DemEventId=2
        DemEventParameter2: DemEventId=3
        DemEventParameter4: DemEventId=5
        DemEventParameter3: DemEventId=4
        DemEventParameter5: DemEventId=6
    DemGeneral0 (DemGeneral):
      DemAgingCycleCounterProcessing = 
      DemBswErrorBufferSize = 
      DemClearDTCBehavior = 
      DemDTCSuppressionSupport = 
      DemDebounceCounterBasedSupport = 
      DemDebounceTimeBasedSupport = 
      DemDevErrorDetect = 0
      DemDtcStatusAvailabilityMask = 
      DemEnableConditionSupport = 
      DemEventCombinationSupport = 
      DemEventDisplacementSupport = 
      DemExtendedDataCapture = 
      DemFreezeFrameCapture = 
      DemHeaderFileInclusion = 
      DemImmediateNvStorageLimit = 
      DemMaxNumberEventEntryMirror = 
      DemMaxNumberEventEntryPermanent = 
      DemMaxNumberEventEntryPrimary = 
      DemMaxNumberEventEntrySecondary = 
      DemMaxNumberPrestoredFF = 
      DemOBDSupport = 
      DemOccurrenceCounterProcessing = 
      DemOperationCycleStatusStorage = 
      DemPTOSupport = 
      DemStatusBitStorageTestFailed = 
      DemStorageConditionSupport = 
      DemTaskTime = 
      DemTriggerDcmReports = 
      DemTriggerDltReports = 
      DemTriggerFiMReports = 
      DemTriggerMonitorInitBeforeClearOk = 
      DemTypeOfDTCSupported = 
      DemTypeOfFreezeFrameRecordNumeration = 
      DemVersionInfoApi = 
      DemMILIndicatorRef = 
      DemOperationCycle0 (DemOperationCycle): DemOperationCycleType=
