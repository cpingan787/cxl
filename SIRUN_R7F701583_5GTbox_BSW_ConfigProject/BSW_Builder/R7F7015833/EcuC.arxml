AUTOSAR XML (schema 00048)
package /R7F7015833
  module config EcuC
    EcuCGeneral: ByteOrder=LITTLE_ENDIAN
    EcucConfigSet
      EcucPduCollection: PduIdTypeEnum=UINT16, PduLengthTypeEnum=UINT16
        361 x Pdu:
          COM_DIAG_DTCInfo_IAM_CONTROLLER_0_IAM_Tx: PduLength=8
          CANIF_DIAG_DTCInfo_IAM_CONTROLLER_0_IAM_Tx: PduLength=8
          COM_IAM_BKPCANFD_1000ms_FrP60_CONTROLLER_0_IAM_Tx: PduLength=8
          CANIF_IAM_BKPCANFD_1000ms_FrP60_CONTROLLER_0_IAM_Tx: PduLength=8
          COM_IAM_BKPCANFD_1000ms_FrP61_CONTROLLER_0_IAM_Tx: PduLength=8
          CANIF_IAM_BKPCANFD_1000ms_FrP61_CONTROLLER_0_IAM_Tx: PduLength=8
          COM_IAM_BKPCANFD_1000ms_FrP62_CONTROLLER_0_IAM_Tx: PduLength=8
          CANIF_IAM_BKPCANFD_1000ms_FrP62_CONTROLLER_0_IAM_Tx: PduLength=8
          COM_IAM_BKPCANFD_1000ms_FrP63_CONTROLLER_0_IAM_Tx: PduLength=8
          CANIF_IAM_BKPCANFD_1000ms_FrP63_CONTROLLER_0_IAM_Tx: PduLength=8
          COM_IAM_BKPCANFD_1000ms_FrP64_CONTROLLER_0_IAM_Tx: PduLength=8
          CANIF_IAM_BKPCANFD_1000ms_FrP64_CONTROLLER_0_IAM_Tx: PduLength=8
          COM_IAM_BKPCANFD_1000ms_FrP65_CONTROLLER_0_IAM_Tx: PduLength=8
          CANIF_IAM_BKPCANFD_1000ms_FrP65_CONTROLLER_0_IAM_Tx: PduLength=8
          COM_IAM_BKPCANFD_1000ms_FrP66_CONTROLLER_0_IAM_Tx: PduLength=8
          CANIF_IAM_BKPCANFD_1000ms_FrP66_CONTROLLER_0_IAM_Tx: PduLength=8
          COM_IAM_CONNCAN_100ms_FrP18_CONTROLLER_0_IAM_Tx: PduLength=8
          CANIF_IAM_CONNCAN_100ms_FrP18_CONTROLLER_0_IAM_Tx: PduLength=8
          COM_IAM_CONNCAN_200ms_FrP01_CONTROLLER_0_IAM_Tx: PduLength=8
          CANIF_IAM_CONNCAN_200ms_FrP01_CONTROLLER_0_IAM_Tx: PduLength=8
          COM_IAM_CONNCAN_200ms_FrP02_CONTROLLER_0_IAM_Tx: PduLength=8
          CANIF_IAM_CONNCAN_200ms_FrP02_CONTROLLER_0_IAM_Tx: PduLength=8
          COM_IAM_CONNCAN_Event_FrS20_CONTROLLER_0_IAM_Tx: PduLength=20
          CANIF_IAM_CONNCAN_Event_FrS20_CONTROLLER_0_IAM_Tx: PduLength=20
          COM_IAM_CONNCAN_Event_FrS21_CONTROLLER_0_IAM_Tx: PduLength=8
          CANIF_IAM_CONNCAN_Event_FrS21_CONTROLLER_0_IAM_Tx: PduLength=8
          COM_IAM_CONNCANFD_100ms_FrP19_CONTROLLER_0_IAM_Tx: PduLength=32
          CANIF_IAM_CONNCANFD_100ms_FrP19_CONTROLLER_0_IAM_Tx: PduLength=32
          COM_IAM_CONNCANFD_Event_FrS04_CONTROLLER_0_IAM_Tx: PduLength=16
          CANIF_IAM_CONNCANFD_Event_FrS04_CONTROLLER_0_IAM_Tx: PduLength=16
          COM_IAM_CONNCANFD_Event_FrS42_CONTROLLER_0_IAM_Tx: PduLength=12
          CANIF_IAM_CONNCANFD_Event_FrS42_CONTROLLER_0_IAM_Tx: PduLength=12
          COM_IAM_CONNCANFD_Event_FrS43_CONTROLLER_0_IAM_Tx: PduLength=32
          CANIF_IAM_CONNCANFD_Event_FrS43_CONTROLLER_0_IAM_Tx: PduLength=32
          COM_IAM_CONNCANFD_Event_FrS44_CONTROLLER_0_IAM_Tx: PduLength=8
          CANIF_IAM_CONNCANFD_Event_FrS44_CONTROLLER_0_IAM_Tx: PduLength=8
          COM_IAM_CONNCANFD_EvtInfo_CONTROLLER_0_IAM_Tx: PduLength=8
          CANIF_IAM_CONNCANFD_EvtInfo_CONTROLLER_0_IAM_Tx: PduLength=8
          COM_IAM_SecOC_ComKeyResp_CONTROLLER_0_IAM_Tx: PduLength=8
          CANIF_IAM_SecOC_ComKeyResp_CONTROLLER_0_IAM_Tx: PduLength=8
          COM_IAM_SecOC_Log_CONTROLLER_0_IAM_Tx: PduLength=8
          CANIF_IAM_SecOC_Log_CONTROLLER_0_IAM_Tx: PduLength=8
          COM_IAM_ZONE_CONNCANFD_100ms_FrP56_CONTROLLER_0_IAM_Tx: PduLength=8
          CANIF_IAM_ZONE_CONNCANFD_100ms_FrP56_CONTROLLER_0_IAM_Tx: PduLength=8
          COM_TBOX_CONNCAN_20ms_FrP02_CONTROLLER_0_IAM_Tx: PduLength=8
          CANIF_TBOX_CONNCAN_20ms_FrP02_CONTROLLER_0_IAM_Tx: PduLength=8
          COM_IAM_BKPCANFD_1000ms_FrP49_CONTROLLER_0_IAM_Tx: PduLength=8
          CANIF_IAM_BKPCANFD_1000ms_FrP49_CONTROLLER_0_IAM_Tx: PduLength=8
          COM_IAM_BKPCANFD_1000ms_FrP55_CONTROLLER_0_IAM_Tx: PduLength=8
          CANIF_IAM_BKPCANFD_1000ms_FrP55_CONTROLLER_0_IAM_Tx: PduLength=8
          COM_IAM_BKPCANFD_1000ms_FrP58_CONTROLLER_0_IAM_Tx: PduLength=8
          CANIF_IAM_BKPCANFD_1000ms_FrP58_CONTROLLER_0_IAM_Tx: PduLength=8
          COM_IAM_BKPCANFD_1000ms_FrP59_CONTROLLER_0_IAM_Tx: PduLength=8
          CANIF_IAM_BKPCANFD_1000ms_FrP59_CONTROLLER_0_IAM_Tx: PduLength=8
          COM_synthesized_IAM_ZONE_CONNCANFD_E_CONTROLLER_0_IAM_Tx: PduLength=16
          CANIF_synthesized_IAM_ZONE_CONNCANFD_E_CONTROLLER_0_IAM_Tx: PduLength=20
          COM_synthesized_IAM_ZONE_CONNCA_0000_CONTROLLER_0_IAM_Tx: PduLength=48
          CANIF_synthesized_IAM_ZONE_CONNCA_0000_CONTROLLER_0_IAM_Tx: PduLength=52
          COM_synthesized_IAM_ZONE_CONNCA_0001_CONTROLLER_0_IAM_Tx: PduLength=48
          CANIF_synthesized_IAM_ZONE_CONNCA_0001_CONTROLLER_0_IAM_Tx: PduLength=52
          COM_synthesized_IAM_BKPCANFD_20ms_Fr_CONTROLLER_0_IAM_Tx: PduLength=8
          CANIF_synthesized_IAM_BKPCANFD_20ms_Fr_CONTROLLER_0_IAM_Tx: PduLength=12
          COM_Diag_CONNCANFD_PhyResp_IAM_CONTROLLER_0_IAM_Tx: PduLength=64
          CANIF_Diag_CONNCANFD_PhyResp_IAM_CONTROLLER_0_IAM_Tx: PduLength=64
          COM_SDM_SFCANFD_Event_FrS14_CONTROLLER_0_IAM_Rx: PduLength=8
          CANIF_SDM_SFCANFD_Event_FrS14_CONTROLLER_0_IAM_Rx: PduLength=8
          COM_ICBAD_BKPCANFD_Event_FrS04_CONTROLLER_0_IAM_Rx: PduLength=48
          CANIF_ICBAD_BKPCANFD_Event_FrS04_CONTROLLER_0_IAM_Rx: PduLength=48
          COM_ICBAD_BKPCANFD_Event_FrS05_CONTROLLER_0_IAM_Rx: PduLength=48
          CANIF_ICBAD_BKPCANFD_Event_FrS05_CONTROLLER_0_IAM_Rx: PduLength=48
          COM_ICBVC_SecOC_ComKeyReq_CONTROLLER_0_IAM_Rx: PduLength=8
          CANIF_ICBVC_SecOC_ComKeyReq_CONTROLLER_0_IAM_Rx: PduLength=8
          COM_ICBAD_ZONE_CHCANFD_20ms_FrP13_CONTROLLER_0_IAM_Rx: PduLength=8
          CANIF_ICBAD_ZONE_CHCANFD_20ms_FrP13_CONTROLLER_0_IAM_Rx: PduLength=8
          COM_TC_ZONE_PTCANFD_10ms_FrP01_CONTROLLER_0_IAM_Rx: PduLength=8
          CANIF_TC_ZONE_PTCANFD_10ms_FrP01_CONTROLLER_0_IAM_Rx: PduLength=8
          COM_ICM_INFOCANFD_EvtInfo_CONTROLLER_0_IAM_Rx: PduLength=8
          CANIF_ICM_INFOCANFD_EvtInfo_CONTROLLER_0_IAM_Rx: PduLength=8
          COM_AMP_INFOCAN_EvtInfo_CONTROLLER_0_IAM_Rx: PduLength=8
          CANIF_AMP_INFOCAN_EvtInfo_CONTROLLER_0_IAM_Rx: PduLength=8
          COM_ECM_ERCANFD_10ms_FrP00_CONTROLLER_0_IAM_Rx: PduLength=8
          CANIF_ECM_ERCANFD_10ms_FrP00_CONTROLLER_0_IAM_Rx: PduLength=8
          COM_LHZCU_LHBKBCANFD_10ms_FrP01_CONTROLLER_0_IAM_Rx: PduLength=8
          CANIF_LHZCU_LHBKBCANFD_10ms_FrP01_CONTROLLER_0_IAM_Rx: PduLength=8
          COM_RZCU_PTCANFD_10ms_FrP01_CONTROLLER_0_IAM_Rx: PduLength=8
          CANIF_RZCU_PTCANFD_10ms_FrP01_CONTROLLER_0_IAM_Rx: PduLength=8
          COM_IBS_CHCANFD_10ms_FrP04_CONTROLLER_0_IAM_Rx: PduLength=8
          CANIF_IBS_CHCANFD_10ms_FrP04_CONTROLLER_0_IAM_Rx: PduLength=8
          COM_PEU_PTCANFD_10ms_FrP04_SigGWtoCO_CONTROLLER_0_IAM_Rx: PduLength=16
          CANIF_PEU_PTCANFD_10ms_FrP04_SigGWtoCO_CONTROLLER_0_IAM_Rx: PduLength=16
          COM_DLP_BDCAN_EvtInfo_CONTROLLER_0_IAM_Rx: PduLength=8
          CANIF_DLP_BDCAN_EvtInfo_CONTROLLER_0_IAM_Rx: PduLength=8
          COM_PEU_PTCANFD_5ms_FrP02_SigGwTOCON_CONTROLLER_0_IAM_Rx: PduLength=8
          CANIF_PEU_PTCANFD_5ms_FrP02_SigGwTOCON_CONTROLLER_0_IAM_Rx: PduLength=8
          COM_TC_PTCANFD_10ms_FrP01_SigGWTORZC_CONTROLLER_0_IAM_Rx: PduLength=16
          CANIF_TC_PTCANFD_10ms_FrP01_SigGWTORZC_CONTROLLER_0_IAM_Rx: PduLength=16
          COM_RZCU_RZCUCANFD_10ms_FrP22_NoSecO_CONTROLLER_0_IAM_Rx: PduLength=12
          CANIF_RZCU_RZCUCANFD_10ms_FrP22_NoSecO_CONTROLLER_0_IAM_Rx: PduLength=12
          COM_ESS_PTCANFD_20ms_FrP01_CONTROLLER_0_IAM_Rx: PduLength=8
          CANIF_ESS_PTCANFD_20ms_FrP01_CONTROLLER_0_IAM_Rx: PduLength=8
          COM_ESS_PTCANFD_20ms_FrP02_CONTROLLER_0_IAM_Rx: PduLength=8
          CANIF_ESS_PTCANFD_20ms_FrP02_CONTROLLER_0_IAM_Rx: PduLength=8
          COM_ICBAD_CHCANFD_20ms_FrP08_CONTROLLER_0_IAM_Rx: PduLength=8
          CANIF_ICBAD_CHCANFD_20ms_FrP08_CONTROLLER_0_IAM_Rx: PduLength=8
          COM_PEU_ERCANFD_20ms_FrP33_CONTROLLER_0_IAM_Rx: PduLength=12
          CANIF_PEU_ERCANFD_20ms_FrP33_CONTROLLER_0_IAM_Rx: PduLength=12
          COM_SDM_CHCANFD_20ms_FrP01_CONTROLLER_0_IAM_Rx: PduLength=8
          CANIF_SDM_CHCANFD_20ms_FrP01_CONTROLLER_0_IAM_Rx: PduLength=8
          COM_ICBVC_RZCUCANFD_20ms_FrP00_CONTROLLER_0_IAM_Rx: PduLength=8
          CANIF_ICBVC_RZCUCANFD_20ms_FrP00_CONTROLLER_0_IAM_Rx: PduLength=8
          COM_PEU_PTCANFD_100ms_FrP03_CONTROLLER_0_IAM_Rx: PduLength=8
          CANIF_PEU_PTCANFD_100ms_FrP03_CONTROLLER_0_IAM_Rx: PduLength=8
          COM_ICBAD_BKPCANFD_20ms_FrP07_CONTROLLER_0_IAM_Rx: PduLength=8
          CANIF_ICBAD_BKPCANFD_20ms_FrP07_CONTROLLER_0_IAM_Rx: PduLength=8
          COM_SDM_CHCANFD_20ms_FrP02_CONTROLLER_0_IAM_Rx: PduLength=8
          CANIF_SDM_CHCANFD_20ms_FrP02_CONTROLLER_0_IAM_Rx: PduLength=8
          COM_RZCU_PTCANFD_20ms_FrP06_CONTROLLER_0_IAM_Rx: PduLength=8
          CANIF_RZCU_PTCANFD_20ms_FrP06_CONTROLLER_0_IAM_Rx: PduLength=8
          COM_IBS_CHCANFD_20ms_FrP07_CONTROLLER_0_IAM_Rx: PduLength=8
          CANIF_IBS_CHCANFD_20ms_FrP07_CONTROLLER_0_IAM_Rx: PduLength=8
          COM_ICBAD_RZCUCANFD_20ms_FrP12_CONTROLLER_0_IAM_Rx: PduLength=8
          CANIF_ICBAD_RZCUCANFD_20ms_FrP12_CONTROLLER_0_IAM_Rx: PduLength=8
          COM_IBS_CHCANFD_20ms_FrP11_CONTROLLER_0_IAM_Rx: PduLength=8
          CANIF_IBS_CHCANFD_20ms_FrP11_CONTROLLER_0_IAM_Rx: PduLength=8
          COM_ESS_PTCANFD_20ms_FrP04_CONTROLLER_0_IAM_Rx: PduLength=8
          CANIF_ESS_PTCANFD_20ms_FrP04_CONTROLLER_0_IAM_Rx: PduLength=8
          COM_ICBVC_RZCUCANFD_20ms_FrP03_CONTROLLER_0_IAM_Rx: PduLength=8
          CANIF_ICBVC_RZCUCANFD_20ms_FrP03_CONTROLLER_0_IAM_Rx: PduLength=8
          COM_PEU_PTCANFD_50ms_FrP05_CONTROLLER_0_IAM_Rx: PduLength=16
          CANIF_PEU_PTCANFD_50ms_FrP05_CONTROLLER_0_IAM_Rx: PduLength=16
          COM_ESS_PTCANFD_50ms_FrP14_CONTROLLER_0_IAM_Rx: PduLength=8
          CANIF_ESS_PTCANFD_50ms_FrP14_CONTROLLER_0_IAM_Rx: PduLength=8
          COM_ESS_PTCANFD_100ms_FrP29_CONTROLLER_0_IAM_Rx: PduLength=8
          CANIF_ESS_PTCANFD_100ms_FrP29_CONTROLLER_0_IAM_Rx: PduLength=8
          COM_ESS_PTCANFD_100ms_FrP26_CONTROLLER_0_IAM_Rx: PduLength=8
          CANIF_ESS_PTCANFD_100ms_FrP26_CONTROLLER_0_IAM_Rx: PduLength=8
          COM_ESS_PTCANFD_50ms_FrP06_CONTROLLER_0_IAM_Rx: PduLength=8
          CANIF_ESS_PTCANFD_50ms_FrP06_CONTROLLER_0_IAM_Rx: PduLength=8
          COM_ESS_PTCANFD_50ms_FrP07_CONTROLLER_0_IAM_Rx: PduLength=8
          CANIF_ESS_PTCANFD_50ms_FrP07_CONTROLLER_0_IAM_Rx: PduLength=8
          COM_ESS_PTCANFD_50ms_FrP09_CONTROLLER_0_IAM_Rx: PduLength=8
          CANIF_ESS_PTCANFD_50ms_FrP09_CONTROLLER_0_IAM_Rx: PduLength=8
          COM_ESS_PTCANFD_50ms_FrP13_CONTROLLER_0_IAM_Rx: PduLength=8
          CANIF_ESS_PTCANFD_50ms_FrP13_CONTROLLER_0_IAM_Rx: PduLength=8
          COM_ESS_PTCANFD_50ms_FrP08_CONTROLLER_0_IAM_Rx: PduLength=8
          CANIF_ESS_PTCANFD_50ms_FrP08_CONTROLLER_0_IAM_Rx: PduLength=8
          COM_ESS_PTCANFD_100ms_FrP21_CONTROLLER_0_IAM_Rx: PduLength=8
          CANIF_ESS_PTCANFD_100ms_FrP21_CONTROLLER_0_IAM_Rx: PduLength=8
          COM_RZCU_LHBKBCANFD_50ms_FrP37_CONTROLLER_0_IAM_Rx: PduLength=8
          CANIF_RZCU_LHBKBCANFD_50ms_FrP37_CONTROLLER_0_IAM_Rx: PduLength=8
          COM_LHZCU_LHBKBCANFD_50ms_FrP04_CONTROLLER_0_IAM_Rx: PduLength=8
          CANIF_LHZCU_LHBKBCANFD_50ms_FrP04_CONTROLLER_0_IAM_Rx: PduLength=8
          COM_LHZCU_BKBCANFD_50ms_FrP24_CONTROLLER_0_IAM_Rx: PduLength=20
          CANIF_LHZCU_BKBCANFD_50ms_FrP24_CONTROLLER_0_IAM_Rx: PduLength=20
          COM_LHZCU_LHBKBCANFD_50ms_FrP06_CONTROLLER_0_IAM_Rx: PduLength=8
          CANIF_LHZCU_LHBKBCANFD_50ms_FrP06_CONTROLLER_0_IAM_Rx: PduLength=8
          COM_ESS_PTEXTDCAN_100ms_FrP33_CONTROLLER_0_IAM_Rx: PduLength=8
          CANIF_ESS_PTEXTDCAN_100ms_FrP33_CONTROLLER_0_IAM_Rx: PduLength=8
          COM_PEU_ERCANFD_50ms_FrP10_CONTROLLER_0_IAM_Rx: PduLength=16
          CANIF_PEU_ERCANFD_50ms_FrP10_CONTROLLER_0_IAM_Rx: PduLength=16
          COM_LVBM_PTEXTDCAN_100ms_FrP01_CONTROLLER_0_IAM_Rx: PduLength=8
          CANIF_LVBM_PTEXTDCAN_100ms_FrP01_CONTROLLER_0_IAM_Rx: PduLength=8
          COM_ICBAD_BKPCANFD_100ms_FrP42_CONTROLLER_0_IAM_Rx: PduLength=8
          CANIF_ICBAD_BKPCANFD_100ms_FrP42_CONTROLLER_0_IAM_Rx: PduLength=8
          COM_PEU_ERCANFD_100ms_FrP15_CONTROLLER_0_IAM_Rx: PduLength=32
          CANIF_PEU_ERCANFD_100ms_FrP15_CONTROLLER_0_IAM_Rx: PduLength=32
          COM_IPD_BKPCANFD_100ms_FrP50_CONTROLLER_0_IAM_Rx: PduLength=32
          CANIF_IPD_BKPCANFD_100ms_FrP50_CONTROLLER_0_IAM_Rx: PduLength=32
          COM_ESS_PTCANFD_100ms_FrP28_CONTROLLER_0_IAM_Rx: PduLength=8
          CANIF_ESS_PTCANFD_100ms_FrP28_CONTROLLER_0_IAM_Rx: PduLength=8
          COM_ESS_ZONE_PTCANFD_100ms_FrP16_CONTROLLER_0_IAM_Rx: PduLength=8
          CANIF_ESS_ZONE_PTCANFD_100ms_FrP16_CONTROLLER_0_IAM_Rx: PduLength=8
          COM_ESS_PTCANFD_100ms_FrP22_CONTROLLER_0_IAM_Rx: PduLength=8
          CANIF_ESS_PTCANFD_100ms_FrP22_CONTROLLER_0_IAM_Rx: PduLength=8
          COM_ESS_PTCANFD_100ms_FrP20_CONTROLLER_0_IAM_Rx: PduLength=8
          CANIF_ESS_PTCANFD_100ms_FrP20_CONTROLLER_0_IAM_Rx: PduLength=8
          COM_RZCU_PTCANFD_100ms_FrP10_CONTROLLER_0_IAM_Rx: PduLength=8
          CANIF_RZCU_PTCANFD_100ms_FrP10_CONTROLLER_0_IAM_Rx: PduLength=8
          COM_ESS_PTCANFD_100ms_FrP35_CONTROLLER_0_IAM_Rx: PduLength=8
          CANIF_ESS_PTCANFD_100ms_FrP35_CONTROLLER_0_IAM_Rx: PduLength=8
          COM_LHZCU_LHBKBCANFD_100ms_FrP12_CONTROLLER_0_IAM_Rx: PduLength=20
          CANIF_LHZCU_LHBKBCANFD_100ms_FrP12_CONTROLLER_0_IAM_Rx: PduLength=20
          COM_ESS_PTEXTDCAN_100ms_FrP23_CONTROLLER_0_IAM_Rx: PduLength=8
          CANIF_ESS_PTEXTDCAN_100ms_FrP23_CONTROLLER_0_IAM_Rx: PduLength=8
          COM_ESS_PTCANFD_100ms_FrP36_CONTROLLER_0_IAM_Rx: PduLength=8
          CANIF_ESS_PTCANFD_100ms_FrP36_CONTROLLER_0_IAM_Rx: PduLength=8
          COM_ICBVC_FOTASts_100ms_FrP47_CONTROLLER_0_IAM_Rx: PduLength=8
          CANIF_ICBVC_FOTASts_100ms_FrP47_CONTROLLER_0_IAM_Rx: PduLength=8
          COM_CCU_PTCANFD_100ms_FrP02_CONTROLLER_0_IAM_Rx: PduLength=8
          CANIF_CCU_PTCANFD_100ms_FrP02_CONTROLLER_0_IAM_Rx: PduLength=8
          COM_ICBVC_RZCUCANFD_100ms_FrP45_CONTROLLER_0_IAM_Rx: PduLength=8
          CANIF_ICBVC_RZCUCANFD_100ms_FrP45_CONTROLLER_0_IAM_Rx: PduLength=8
          COM_ESS_PTCANFD_100ms_FrP15_CONTROLLER_0_IAM_Rx: PduLength=8
          CANIF_ESS_PTCANFD_100ms_FrP15_CONTROLLER_0_IAM_Rx: PduLength=8
          COM_ESS_PTCANFD_100ms_FrP32_CONTROLLER_0_IAM_Rx: PduLength=8
          CANIF_ESS_PTCANFD_100ms_FrP32_CONTROLLER_0_IAM_Rx: PduLength=8
          COM_RHZCU_RHBKBCANFD_100ms_FrP12_CONTROLLER_0_IAM_Rx: PduLength=8
          CANIF_RHZCU_RHBKBCANFD_100ms_FrP12_CONTROLLER_0_IAM_Rx: PduLength=8
          COM_RHZCU_RHBKBCANFD_100ms_FrP15_CONTROLLER_0_IAM_Rx: PduLength=8
          CANIF_RHZCU_RHBKBCANFD_100ms_FrP15_CONTROLLER_0_IAM_Rx: PduLength=8
          COM_ICBVC_RZCUCANFD_100ms_FrP39_CONTROLLER_0_IAM_Rx: PduLength=8
          CANIF_ICBVC_RZCUCANFD_100ms_FrP39_CONTROLLER_0_IAM_Rx: PduLength=8
          COM_RZCU_LHBKBCANFD_100ms_FrP32_CONTROLLER_0_IAM_Rx: PduLength=8
          CANIF_RZCU_LHBKBCANFD_100ms_FrP32_CONTROLLER_0_IAM_Rx: PduLength=8
          COM_RHZCU_RHBKBCANFD_100ms_FrP14_CONTROLLER_0_IAM_Rx: PduLength=8
          CANIF_RHZCU_RHBKBCANFD_100ms_FrP14_CONTROLLER_0_IAM_Rx: PduLength=8
          COM_ESS_PTEXTDCAN_100ms_FrP27_CONTROLLER_0_IAM_Rx: PduLength=8
          CANIF_ESS_PTEXTDCAN_100ms_FrP27_CONTROLLER_0_IAM_Rx: PduLength=8
          COM_ICBAD_BKPCANFD_100ms_FrP36_CONTROLLER_0_IAM_Rx: PduLength=16
          CANIF_ICBAD_BKPCANFD_100ms_FrP36_CONTROLLER_0_IAM_Rx: PduLength=16
          COM_PEU_ERCANFD_100ms_FrP11_CONTROLLER_0_IAM_Rx: PduLength=16
          CANIF_PEU_ERCANFD_100ms_FrP11_CONTROLLER_0_IAM_Rx: PduLength=16
          COM_ICB_BKBCANFD_100ms_FrP221_CONTROLLER_0_IAM_Rx: PduLength=24
          CANIF_ICB_BKBCANFD_100ms_FrP221_CONTROLLER_0_IAM_Rx: PduLength=24
          COM_RHZCU_RHBKBCANFD_100ms_FrP13_CONTROLLER_0_IAM_Rx: PduLength=8
          CANIF_RHZCU_RHBKBCANFD_100ms_FrP13_CONTROLLER_0_IAM_Rx: PduLength=8
          COM_ICBVC_RZCUCANFD_100ms_FrP80_CONTROLLER_0_IAM_Rx: PduLength=8
          CANIF_ICBVC_RZCUCANFD_100ms_FrP80_CONTROLLER_0_IAM_Rx: PduLength=8
          COM_ESS_PTEXTDCAN_100ms_FrP24_CONTROLLER_0_IAM_Rx: PduLength=8
          CANIF_ESS_PTEXTDCAN_100ms_FrP24_CONTROLLER_0_IAM_Rx: PduLength=8
          COM_RZCU_RZCUCANFD_100ms_FrP82_CONTROLLER_0_IAM_Rx: PduLength=20
          CANIF_RZCU_RZCUCANFD_100ms_FrP82_CONTROLLER_0_IAM_Rx: PduLength=20
          COM_RHZCU_RHBKBCANFD_100ms_FrP19_CONTROLLER_0_IAM_Rx: PduLength=8
          CANIF_RHZCU_RHBKBCANFD_100ms_FrP19_CONTROLLER_0_IAM_Rx: PduLength=8
          COM_LVBM_PTEXTDCAN_100ms_FrP04_CONTROLLER_0_IAM_Rx: PduLength=8
          CANIF_LVBM_PTEXTDCAN_100ms_FrP04_CONTROLLER_0_IAM_Rx: PduLength=8
          COM_TC_PTCANFD_100ms_FrP05_CONTROLLER_0_IAM_Rx: PduLength=8
          CANIF_TC_PTCANFD_100ms_FrP05_CONTROLLER_0_IAM_Rx: PduLength=8
          COM_RZCU_PTCANFD_100ms_FrP12_CONTROLLER_0_IAM_Rx: PduLength=8
          CANIF_RZCU_PTCANFD_100ms_FrP12_CONTROLLER_0_IAM_Rx: PduLength=8
          COM_ICBVC_INFOCANFD_250ms_FrP52_CONTROLLER_0_IAM_Rx: PduLength=8
          CANIF_ICBVC_INFOCANFD_250ms_FrP52_CONTROLLER_0_IAM_Rx: PduLength=8
          COM_ICB_RZCUCANFD_100ms_FrP144_CONTROLLER_0_IAM_Rx: PduLength=32
          CANIF_ICB_RZCUCANFD_100ms_FrP144_CONTROLLER_0_IAM_Rx: PduLength=32
          COM_SDM_CHCANFD_100ms_FrP03_CONTROLLER_0_IAM_Rx: PduLength=8
          CANIF_SDM_CHCANFD_100ms_FrP03_CONTROLLER_0_IAM_Rx: PduLength=8
          COM_RZCU_IMCU_SFCANFD_100ms_FrP26_CONTROLLER_0_IAM_Rx: PduLength=8
          CANIF_RZCU_IMCU_SFCANFD_100ms_FrP26_CONTROLLER_0_IAM_Rx: PduLength=8
          COM_ICBVC_CONNCANFD_200ms_FrP157_CONTROLLER_0_IAM_Rx: PduLength=20
          CANIF_ICBVC_CONNCANFD_200ms_FrP157_CONTROLLER_0_IAM_Rx: PduLength=20
          COM_ESS_PTCANFD_200ms_FrP42_CONTROLLER_0_IAM_Rx: PduLength=8
          CANIF_ESS_PTCANFD_200ms_FrP42_CONTROLLER_0_IAM_Rx: PduLength=8
          COM_ESS_PTCANFD_200ms_FrP39_CONTROLLER_0_IAM_Rx: PduLength=8
          CANIF_ESS_PTCANFD_200ms_FrP39_CONTROLLER_0_IAM_Rx: PduLength=8
          COM_ICBAD_BKPCANFD_100ms_FrP38_CONTROLLER_0_IAM_Rx: PduLength=32
          CANIF_ICBAD_BKPCANFD_100ms_FrP38_CONTROLLER_0_IAM_Rx: PduLength=32
          COM_CCU_PTEXTDCAN_100ms_FrP06_CONTROLLER_0_IAM_Rx: PduLength=8
          CANIF_CCU_PTEXTDCAN_100ms_FrP06_CONTROLLER_0_IAM_Rx: PduLength=8
          COM_RZCU_PTEXTDCAN_100ms_FrP21_CONTROLLER_0_IAM_Rx: PduLength=8
          CANIF_RZCU_PTEXTDCAN_100ms_FrP21_CONTROLLER_0_IAM_Rx: PduLength=8
          COM_TC_PTCANFD_20ms_FrP08_CONTROLLER_0_IAM_Rx: PduLength=12
          CANIF_TC_PTCANFD_20ms_FrP08_CONTROLLER_0_IAM_Rx: PduLength=12
          COM_LHZCU_LHBKBCANFDF_400ms_FrP18_CONTROLLER_0_IAM_Rx: PduLength=8
          CANIF_LHZCU_LHBKBCANFDF_400ms_FrP18_CONTROLLER_0_IAM_Rx: PduLength=8
          COM_ICBVC_RZCUCANFD_200ms_FrP79_CONTROLLER_0_IAM_Rx: PduLength=8
          CANIF_ICBVC_RZCUCANFD_200ms_FrP79_CONTROLLER_0_IAM_Rx: PduLength=8
          COM_ICBVC_CONNCANFD_Event_FrS145_CONTROLLER_0_IAM_Rx: PduLength=20
          CANIF_ICBVC_CONNCANFD_Event_FrS145_CONTROLLER_0_IAM_Rx: PduLength=20
          COM_LHZCU_LHBDCANFD_Event_FrS48_CONTROLLER_0_IAM_Rx: PduLength=8
          CANIF_LHZCU_LHBDCANFD_Event_FrS48_CONTROLLER_0_IAM_Rx: PduLength=8
          COM_LHZCU_LHBDCANFD_Event_FrS49_CONTROLLER_0_IAM_Rx: PduLength=8
          CANIF_LHZCU_LHBDCANFD_Event_FrS49_CONTROLLER_0_IAM_Rx: PduLength=8
          COM_ICBVC_RHBKBCANFD_500ms_FrP67_CONTROLLER_0_IAM_Rx: PduLength=8
          CANIF_ICBVC_RHBKBCANFD_500ms_FrP67_CONTROLLER_0_IAM_Rx: PduLength=8
          COM_ZXD_CONNCANFD_Event_FrS220_CONTROLLER_0_IAM_Rx: PduLength=8
          CANIF_ZXD_CONNCANFD_Event_FrS220_CONTROLLER_0_IAM_Rx: PduLength=8
          COM_ICBVC_RZCUCANFD_200ms_FrP50_CONTROLLER_0_IAM_Rx: PduLength=8
          CANIF_ICBVC_RZCUCANFD_200ms_FrP50_CONTROLLER_0_IAM_Rx: PduLength=8
          COM_ICB_CONNCANFD_Event_FrS67_CONTROLLER_0_IAM_Rx: PduLength=16
          CANIF_ICB_CONNCANFD_Event_FrS67_CONTROLLER_0_IAM_Rx: PduLength=16
          COM_synthesized_ICBVC_SecOC_SyncMsg__CONTROLLER_0_IAM_Rx: PduLength=5
          CANIF_synthesized_ICBVC_SecOC_SyncMsg__CONTROLLER_0_IAM_Rx: PduLength=8
          COM_RHZCU_BKBCANFD_Event_FrS37_CONTROLLER_0_IAM_Rx: PduLength=16
          CANIF_RHZCU_BKBCANFD_Event_FrS37_CONTROLLER_0_IAM_Rx: PduLength=16
          COM_ESS_PTCANFD_Event_FrS452_CONTROLLER_0_IAM_Rx: PduLength=8
          CANIF_ESS_PTCANFD_Event_FrS452_CONTROLLER_0_IAM_Rx: PduLength=8
          COM_IPD_BKPCANFD_Event_FrS35_CONTROLLER_0_IAM_Rx: PduLength=8
          CANIF_IPD_BKPCANFD_Event_FrS35_CONTROLLER_0_IAM_Rx: PduLength=8
          COM_CCU_PTCANFD_500ms_FrP13_CONTROLLER_0_IAM_Rx: PduLength=16
          CANIF_CCU_PTCANFD_500ms_FrP13_CONTROLLER_0_IAM_Rx: PduLength=16
          COM_ESS_PTCANFD_500ms_FrP60_CONTROLLER_0_IAM_Rx: PduLength=16
          CANIF_ESS_PTCANFD_500ms_FrP60_CONTROLLER_0_IAM_Rx: PduLength=16
          COM_ICBVC_CONNCANFD_Event_FrS139_CONTROLLER_0_IAM_Rx: PduLength=20
          CANIF_ICBVC_CONNCANFD_Event_FrS139_CONTROLLER_0_IAM_Rx: PduLength=20
          COM_SDM_SFCANFD_Event_FrS13_CONTROLLER_0_IAM_Rx: PduLength=8
          CANIF_SDM_SFCANFD_Event_FrS13_CONTROLLER_0_IAM_Rx: PduLength=8
          COM_SDM_SFCANFD_Event_FrS12_CONTROLLER_0_IAM_Rx: PduLength=20
          CANIF_SDM_SFCANFD_Event_FrS12_CONTROLLER_0_IAM_Rx: PduLength=20
          COM_ICB_CONNCANFD_EvtInfo_CONTROLLER_0_IAM_Rx: PduLength=8
          CANIF_ICB_CONNCANFD_EvtInfo_CONTROLLER_0_IAM_Rx: PduLength=8
          COM_ESS_PTCANFD_EvtInfo_CONTROLLER_0_IAM_Rx: PduLength=64
          CANIF_ESS_PTCANFD_EvtInfo_CONTROLLER_0_IAM_Rx: PduLength=64
          COM_DIAG_DTCInfo_ECM_CONTROLLER_0_IAM_Rx: PduLength=8
          CANIF_DIAG_DTCInfo_ECM_CONTROLLER_0_IAM_Rx: PduLength=8
          COM_DIAG_DTCInfo_PEU_CONTROLLER_0_IAM_Rx: PduLength=8
          CANIF_DIAG_DTCInfo_PEU_CONTROLLER_0_IAM_Rx: PduLength=8
          COM_DIAG_DTCInfo_ESS_CONTROLLER_0_IAM_Rx: PduLength=8
          CANIF_DIAG_DTCInfo_ESS_CONTROLLER_0_IAM_Rx: PduLength=8
          COM_DIAG_DTCInfo_TC_CONTROLLER_0_IAM_Rx: PduLength=8
          CANIF_DIAG_DTCInfo_TC_CONTROLLER_0_IAM_Rx: PduLength=8
          COM_Diag_CONNCANFD_PhyReq_IAM_CONTROLLER_0_IAM_Rx: PduLength=64
          CANIF_Diag_CONNCANFD_PhyReq_IAM_CONTROLLER_0_IAM_Rx: PduLength=64
          COM_Diag_CONNCANFD_FuncReq_CONTROLLER_0_IAM_Rx: PduLength=64
          CANIF_Diag_CONNCANFD_FuncReq_CONTROLLER_0_IAM_Rx: PduLength=64
          CANIF_IAM_CONNCANFD_NM_IAM_NM_TxPdu: PduLength=8
          CANIF_IAM_NM_RxPdu_IAM_NM_RxPdu: PduLength=8
          CanNm_UserDataPdu_IAM: PduLength=8
          Com_NmUserDataPdu_IAM: PduLength=6
          CanTp_phy_rx_0x711: PduLength=64
          CanTp_fun_rx_0x7df: PduLength=64
          CanTp_phy_tx_0x719: PduLength=64
          CanIf_phy_rx_0x711: PduLength=64
          CanIf_fun_rx_0x7df: PduLength=64
          CanIf_phy_tx_0x719: PduLength=64
          Dcm_phy_rx_0x711: PduLength=1024
          Dcm_fun_rx_0x7df: PduLength=64
          Dcm_phy_tx_0x719: PduLength=1024
          Com_Contained_Tx_0x377_Pdu06: PduLength=8
          Com_Contained_Tx_0x377_Pdu07: PduLength=8
          Com_Contained_Tx_0x377_Pdu08: PduLength=24
          IpduM_Contained_Tx_Pdu_0x377: PduLength=64
          IpduM_Contained_Tx_0x377_Pdu06: PduLength=8
          IpduM_Contained_Tx_0x377_Pdu07: PduLength=8
          IpduM_Contained_Tx_0x377_Pdu08: PduLength=24
          CanIf_Contained_Tx_Pdu_0x377: PduLength=64
          IpduM_Contained_Tx_Pdu_0x36A: PduLength=64
          CanIf_Contained_Tx_Pdu_0x36A: PduLength=64
          IpduM_Contained_Tx_0x36A_Pdu13: PduLength=8
          IpduM_Contained_Tx_0x36A_Pdu34: PduLength=8
          IpduM_Contained_Tx_0x36A_Pdu35: PduLength=8
          IpduM_Contained_Tx_0x36A_Pdu39: PduLength=8
          IpduM_Contained_Tx_0x36A_Pdu40: PduLength=8
          Com_Contained_Tx_0x36A_Pdu13: PduLength=8
          Com_Contained_Tx_0x36A_Pdu34: PduLength=8
          Com_Contained_Tx_0x36A_Pdu35: PduLength=8
          Com_Contained_Tx_0x36A_Pdu39: PduLength=8
          Com_Contained_Tx_0x36A_Pdu40: PduLength=8
          IpduM_Contained_Tx_Pdu_0x3A2: PduLength=64
          CanIf_Contained_Tx_Pdu_0x3A2: PduLength=64
          IpduM_Contained_Tx_0x3A2_Pdu03: PduLength=8
          IpduM_Contained_Tx_0x3A2_Pdu04: PduLength=8
          IpduM_Contained_Tx_0x3A2_Pdu41: PduLength=8
          IpduM_Contained_Tx_0x3A2_Pdu57: PduLength=24
          Com_Contained_Tx_0x3A2_Pdu03: PduLength=8
          Com_Contained_Tx_0x3A2_Pdu04: PduLength=8
          Com_Contained_Tx_0x3A2_Pdu41: PduLength=8
          Com_Contained_Tx_0x3A2_Pdu57: PduLength=24
          CAN0_Tx_ComKeyResp_0x98_SecOC_Authentic: PduLength=8
          CAN0_Tx_ComKeyResp_0x98_SecOC_Secured: PduLength=12
          CAN0_Rx_SecOC_SyncMsg_0x56F_SecOC_Authentic: PduLength=5
          CAN0_Rx_SecOC_SyncMsg_0x56F_SecOC_Secured: PduLength=8
          CAN0_Rx_FVM_SyncMsg_0x56F_SecOC_Authentic: PduLength=5
          RX_PDU_CANTSYNC: PduLength=8
          SecOC_synthesized_IAM_BKPCANFD_20ms_Fr_CONTROLLER_0_IAM_TxAuthentic: PduLength=8
          SecOC_synthesized_IAM_BKPCANFD_20ms_Fr_CONTROLLER_0_IAM_TxSecured: PduLength=12
          SecOC_synthesized_IAM_ZONE_CONNCA_0001_CONTROLLER_0_IAM_TxAuthentic: PduLength=48
          SecOC_synthesized_IAM_ZONE_CONNCA_0001_CONTROLLER_0_IAM_TxSecured: PduLength=52
          SecOC_synthesized_IAM_ZONE_CONNCA_0000_CONTROLLER_0_IAM_TxAuthentic: PduLength=48
          SecOC_synthesized_IAM_ZONE_CONNCA_0000_CONTROLLER_0_IAM_TxSecured: PduLength=52
          SecOC_synthesized_IAM_ZONE_CONNCANFD_E_CONTROLLER_0_IAM_TxAuthentic: PduLength=16
          SecOC_synthesized_IAM_ZONE_CONNCANFD_E_CONTROLLER_0_IAM_TxSecured: PduLength=20
