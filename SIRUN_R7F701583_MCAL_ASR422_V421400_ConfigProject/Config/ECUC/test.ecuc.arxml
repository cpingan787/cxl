AUTOSAR XML (schema 00049)
package /ActiveEcuC
  ecuc value collection ActiveEcuC: ecuc-values=[Adc0, Dio0, Mcu0, Port0, Os, Can, Pwm0, Fls, Gpt, Wdg_DriverA, Wdg_DriverB]
