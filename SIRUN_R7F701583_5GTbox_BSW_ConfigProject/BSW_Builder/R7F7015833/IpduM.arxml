AUTOSAR XML (schema 00048)
package /R7F7015833
  module config IpduM
    IpduMGeneral: IpduMDevErrorDetect=false, IpduMHeaderByteOrder=IPDUM_BIG_ENDIAN, IpduMStaticPartExists=true, IpduMVersionInfoApi=false
    IpduMConfig
      IpduMContainedTxPdu_0x377_Pdu06 (IpduMContainedTxPdu):
        IpduMContainedPduHeaderId = 132608
        IpduMContainedTxPduCollectionSemantics = IPDUM_COLLECT_QUEUED
        IpduMContainedTxPduConfirmation = true
        IpduMContainedTxPduHandleId = CONTAINED_TX_PDU_IpduM_Contained_Tx_0x377_Pdu06
        IpduMContainedTxPduTrigger = IPDUM_TRIGGER_ALWAYS
        IpduMContainedTxInContainerPduRef = IpduMContainerTxPdu_0x377
        IpduMContainedTxPduRef = IpduM_Contained_Tx_0x377_Pdu06
      IpduMContainerTxPdu_0x377 (IpduMContainerTxPdu):
        IpduMContainerHeaderSize = IPDUM_HEADERTYPE_SHORT
        IpduMContainerQueueSize = 100
        IpduMContainerTxFirstContainedPduTrigger = true
        IpduMContainerTxHandleId = CONTAINER_TX_PDU_IpduM_Contained_Tx_Pdu_0x377
        IpduMContainerTxTriggerMode = IPDUM_DIRECT
        IpduMContainerTxPduRef = IpduM_Contained_Tx_Pdu_0x377
        IpduMMainFunctionTxRef = IpduMMainFunctionTx
      IpduMContainedTxPdu_0x377_Pdu07 (IpduMContainedTxPdu):
        IpduMContainedPduHeaderId = 132609
        IpduMContainedTxPduCollectionSemantics = IPDUM_COLLECT_QUEUED
        IpduMContainedTxPduConfirmation = true
        IpduMContainedTxPduHandleId = CONTAINED_TX_PDU_IpduM_Contained_Tx_0x377_Pdu07
        IpduMContainedTxPduTrigger = IPDUM_TRIGGER_ALWAYS
        IpduMContainedTxInContainerPduRef = IpduMContainerTxPdu_0x377
        IpduMContainedTxPduRef = IpduM_Contained_Tx_0x377_Pdu07
      IpduMContainedTxPdu_0x377_Pdu08 (IpduMContainedTxPdu):
        IpduMContainedPduHeaderId = 132642
        IpduMContainedTxPduCollectionSemantics = IPDUM_COLLECT_QUEUED
        IpduMContainedTxPduConfirmation = true
        IpduMContainedTxPduHandleId = CONTAINED_TX_PDU_IpduM_Contained_Tx_0x377_Pdu08
        IpduMContainedTxPduTrigger = IPDUM_TRIGGER_ALWAYS
        IpduMContainedTxInContainerPduRef = IpduMContainerTxPdu_0x377
        IpduMContainedTxPduRef = IpduM_Contained_Tx_0x377_Pdu08
      IpduMContainerTxPdu_0x36A (IpduMContainerTxPdu):
        IpduMContainerHeaderSize = IPDUM_HEADERTYPE_SHORT
        IpduMContainerQueueSize = 100
        IpduMContainerTxFirstContainedPduTrigger = true
        IpduMContainerTxHandleId = CONTAINER_TX_PDU_IpduM_Contained_Tx_Pdu_0x36A
        IpduMContainerTxTriggerMode = IPDUM_DIRECT
        IpduMContainerTxPduRef = IpduM_Contained_Tx_Pdu_0x36A
        IpduMMainFunctionTxRef = IpduMMainFunctionTx
      5 x IpduMContainedTxPdu, all with IpduMContainedTxPduCollectionSemantics=IPDUM_COLLECT_QUEUED, IpduMContainedTxPduConfirmation=true, IpduMContainedTxPduTrigger=IPDUM_TRIGGER_ALWAYS, IpduMContainedTxInContainerPduRef=IpduMContainerTxPdu_0x36A:
        IpduMContainedTxPdu_0x36A_Pdu13: IpduMContainedPduHeaderId=132629, IpduMContainedTxPduHandleId=CONTAINED_TX_PDU_IpduM_Contained_Tx_0x36A_Pdu13, IpduMContainedTxPduRef=IpduM_Contained_Tx_0x36A_Pdu13
        IpduMContainedTxPdu_0x36A_Pdu34: IpduMContainedPduHeaderId=132616, IpduMContainedTxPduHandleId=CONTAINED_TX_PDU_IpduM_Contained_Tx_0x36A_Pdu34, IpduMContainedTxPduRef=IpduM_Contained_Tx_0x36A_Pdu34
        IpduMContainedTxPdu_0x36A_Pdu35: IpduMContainedPduHeaderId=132633, IpduMContainedTxPduHandleId=CONTAINED_TX_PDU_IpduM_Contained_Tx_0x36A_Pdu35, IpduMContainedTxPduRef=IpduM_Contained_Tx_0x36A_Pdu35
        IpduMContainedTxPdu_0x36A_Pdu39: IpduMContainedPduHeaderId=132630, IpduMContainedTxPduHandleId=CONTAINED_TX_PDU_IpduM_Contained_Tx_0x36A_Pdu39, IpduMContainedTxPduRef=IpduM_Contained_Tx_0x36A_Pdu39
        IpduMContainedTxPdu_0x36A_Pdu40: IpduMContainedPduHeaderId=132613, IpduMContainedTxPduHandleId=CONTAINED_TX_PDU_IpduM_Contained_Tx_0x36A_Pdu40, IpduMContainedTxPduRef=IpduM_Contained_Tx_0x36A_Pdu40
      IpduMContainerTxPdu_0x3A2 (IpduMContainerTxPdu):
        IpduMContainerHeaderSize = IPDUM_HEADERTYPE_SHORT
        IpduMContainerQueueSize = 100
        IpduMContainerTxFirstContainedPduTrigger = true
        IpduMContainerTxHandleId = CONTAINER_TX_PDU_IpduM_Contained_Tx_Pdu_0x3A2
        IpduMContainerTxTriggerMode = IPDUM_DIRECT
        IpduMContainerTxPduRef = IpduM_Contained_Tx_Pdu_0x3A2
        IpduMMainFunctionTxRef = IpduMMainFunctionTx
      4 x IpduMContainedTxPdu, all with IpduMContainedTxPduCollectionSemantics=IPDUM_COLLECT_QUEUED, IpduMContainedTxPduConfirmation=true, IpduMContainedTxPduTrigger=IPDUM_TRIGGER_ALWAYS, IpduMContainedTxInContainerPduRef=IpduMContainerTxPdu_0x3A2:
        IpduMContainedTxPdu_0x3A2_Pdu03: IpduMContainedPduHeaderId=209158, IpduMContainedTxPduHandleId=CONTAINED_TX_PDU_IpduM_Contained_Tx_0x3A2_Pdu03, IpduMContainedTxPduRef=IpduM_Contained_Tx_0x3A2_Pdu03
        IpduMContainedTxPdu_0x3A2_Pdu04: IpduMContainedPduHeaderId=209176, IpduMContainedTxPduHandleId=CONTAINED_TX_PDU_IpduM_Contained_Tx_0x3A2_Pdu04, IpduMContainedTxPduRef=IpduM_Contained_Tx_0x3A2_Pdu04
        IpduMContainedTxPdu_0x3A2_Pdu41: IpduMContainedPduHeaderId=209170, IpduMContainedTxPduHandleId=CONTAINED_TX_PDU_IpduM_Contained_Tx_0x3A2_Pdu41, IpduMContainedTxPduRef=IpduM_Contained_Tx_0x3A2_Pdu41
        IpduMContainedTxPdu_0x3A2_Pdu57: IpduMContainedPduHeaderId=209201, IpduMContainedTxPduHandleId=CONTAINED_TX_PDU_IpduM_Contained_Tx_0x3A2_Pdu57, IpduMContainedTxPduRef=IpduM_Contained_Tx_0x3A2_Pdu57
      IpduMMainFunctionTx: IpduMMainTxTimeBase=0.1
    IpduMPublishedInformation: IpduMRxDirectComInvocation=false
