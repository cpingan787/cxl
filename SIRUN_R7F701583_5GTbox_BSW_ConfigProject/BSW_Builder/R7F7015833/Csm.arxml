AUTOSAR XML (schema 00048)
package /R7F7015833
  module config Csm
    CsmGeneral: CsmDevErrorDetect=true, CsmUseDeprecated=false, CsmVersionInfoApi=false, CsmMainFunctionPeriod=0.05
    CsmKeys
      CsmKey_SecOC_Key (CsmKey): CsmKeyId=0, CsmKeyUsePort=false, CsmKeyRef=CryIfKey_SecOCKey
    CsmJobs
      CsmJob_MacGenSyn (CsmJob):
        CsmJobId = 0
        CsmJobInterfaceUsePort = CRYPTO_USE_FNC
        CsmJobPriority = 2
        CsmProcessingMode = CRYPTO_PROCESSING_SYNC
        CsmJobKeyRef = CsmKey_SecOC_Key
        CsmJobPrimitiveRef = CsmMacGenerateConfig
        CsmJobQueueRef = CsmQueue_0
      CsmJob_MacVerifySyn (CsmJob):
        CsmJobId = 1
        CsmJobInterfaceUsePort = CRYPTO_USE_FNC
        CsmJobPriority = 1
        CsmProcessingMode = CRYPTO_PROCESSING_SYNC
        CsmJobKeyRef = CsmKey_SecOC_Key
        CsmJobPrimitiveRef = CsmMacVerifyConfig
        CsmJobQueueRef = CsmQueue_0
    CsmPrimitives_0 (CsmPrimitives)
      CsmMacGenerate
        CsmMacGenerateConfig:
          CsmMacGenerateAlgorithmFamily = CRYPTO_ALGOFAM_AES
          CsmMacGenerateAlgorithmKeyLength = 16
          CsmMacGenerateAlgorithmMode = CRYPTO_ALGOMODE_CMAC
          CsmMacGenerateAlgorithmSecondaryFamily = CRYPTO_ALGOFAM_NOT_SET
          CsmMacGenerateResultLength = 3
      CsmMacVerify
        CsmMacVerifyConfig:
          CsmMacVerifyAlgorithmFamily = CRYPTO_ALGOFAM_AES
          CsmMacVerifyAlgorithmKeyLength = 16
          CsmMacVerifyAlgorithmMode = CRYPTO_ALGOMODE_CMAC
          CsmMacVerifyAlgorithmSecondaryFamily = CRYPTO_ALGOFAM_NOT_SET
          CsmMacVerifyCompareLength = 3
    CsmQueues
      CsmQueue_0 (CsmQueue): CsmQueueSize=5, CsmChannelRef=CryIfChannel_0
