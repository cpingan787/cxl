AUTOSAR XML (schema 00048)
package /AUTOSAR/BswOverviews
  bsw module description Csm: implemented-entrys=Csm_MainFunction
    bsw internal behavior IB_CSM
      exclusive area Area_Csm
      bsw schedulable entity SE_CSM_Mainfunction: implemented-entry=Csm_MainFunction
      bsw timing event TE_Csm_Mainfunction: starts-on-event=SE_CSM_Mainfunction, period=0.05
package /AUTOSAR/BswInterfaces
  bsw module entry Csm_MainFunction: service-id=1, is-reentrant=false, is-synchronous=true, call-type=SCHEDULED, execution-context=TASK, sw-service-impl-policy=STANDARD
package /AUTOSAR/BswImplementations
  bsw implementation Imp_Csm: programming-language=C, sw-version=1.0.0, vendor-id=62, ar-release-version=4.8.0, behavior=IB_CSM
