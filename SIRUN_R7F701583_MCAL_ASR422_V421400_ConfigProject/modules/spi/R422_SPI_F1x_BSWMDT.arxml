AUTOSAR XML (schema 4-2-2)
# COPYRIGHT
# (c) 2019 - 2021 Renesas Electronics Corporation. All rights reserved.
package /Renesas/BswModuleDescriptions_Spi
  bsw implementation Spi_Impl: programming-language=C, sw-version=1.0.3, vendor-id=59, ar-release-version=4.2.2, behavior=BswInternalBehavior_0, vendor-specific-module-def=Spi
    code-descriptors:
      code Spi_Code: artifact-descriptors=[{short-label=Spi.c, category=SWSRC}, {short-label=Spi.h, category=SWHDR}]
    resource consumption SpiResourceConsumption
      10 x memory section:
        PUBLIC_CODE: sw-addrmethod=CODE
        PRIVATE_CODE: sw-addrmethod=CODE
        CODE_FAST: sw-addrmethod=CODE
        VAR_INIT_BOOLEAN: alignment=BOOLEAN, sw-addrmethod=VAR_INIT
        VAR_NO_INIT_UNSPECIFIED: alignment=UNSPECIFIED, sw-addrmethod=VAR_NO_INIT
        VAR_NO_INIT_32: alignment=32, sw-addrmethod=VAR_NO_INIT
        CONST_UNSPECIFIED: alignment=UNSPECIFIED, sw-addrmethod=CONST
        CONFIG_DATA_UNSPECIFIED: alignment=UNSPECIFIED, sw-addrmethod=CONFIG_DATA
        DBTOC_DATA_UNSPECIFIED: alignment=UNSPECIFIED, sw-addrmethod=CONFIG_DATA
        CONST_8: alignment=8, sw-addrmethod=CONST
  bsw module description Spi: module-id=83
    provided-entrys:
      Spi_Init
      Spi_DeInit
      Spi_WriteIB
      Spi_AsyncTransmit
      Spi_ReadIB
      Spi_SetupEB
      Spi_GetStatus
      Spi_GetJobResult
      Spi_GetSequenceResult
      Spi_GetVersionInfo
      Spi_SyncTransmit
      Spi_GetHWUnitStatus
      Spi_Cancel
      Spi_SetAsyncMode
      Spi_ForceCancel
      Spi_SetClockMode
      Spi_GetErrorInfo
      Spi_SelfTest
      Spi_CheckHWConsistency
      Spi_MainFunction_Handling
      SPI_CSIG{0..4}_TIC_CAT2_ISR
      SPI_CSIG{0..4}_TIR_CAT2_ISR
      SPI_CSIH{0..4}_TIC_CAT2_ISR
      SPI_CSIH{0..4}_TIR_CAT2_ISR
      SPI_DMA{00..63}_CAT2_ISR
      SPI_CSIG{0..4}_TIC_ISR
      SPI_CSIG{0..4}_TIR_ISR
      SPI_CSIH{0..4}_TIC_ISR
      SPI_CSIH{0..4}_TIR_ISR
      SPI_DMA{00..63}_ISR
    bsw internal behavior BswInternalBehavior_0
      exclusive area SPI_RAM_DATA_PROTECTION
      exclusive area SPI_INTERRUPT_CONTROL_PROTECTION
      exclusive area nesting order ExclusiveAreaNestingOrder_0: exclusive-area=SPI_RAM_DATA_PROTECTION
      exclusive area nesting order ExclusiveAreaNestingOrder_1: exclusive-area=SPI_INTERRUPT_CONTROL_PROTECTION
      19 x bsw called entity:
        CalledEntity_0: reentrancy-level=NON-REENTRANT, implemented-entry=Spi_Init
        CalledEntity_1: reentrancy-level=NON-REENTRANT, implemented-entry=Spi_DeInit
        CalledEntity_2: reentrancy-level=SINGLE-CORE-REENTRANT, implemented-entry=Spi_WriteIB
        CalledEntity_3: can-enter-exclusive-area=[SPI_RAM_DATA_PROTECTION, SPI_INTERRUPT_CONTROL_PROTECTION], exclusive-area-nesting-order=[ExclusiveAreaNestingOrder_0, ExclusiveAreaNestingOrder_1], reentrancy-level=SINGLE-CORE-REENTRANT, implemented-entry=Spi_AsyncTransmit
        CalledEntity_4: reentrancy-level=SINGLE-CORE-REENTRANT, implemented-entry=Spi_ReadIB
        CalledEntity_5: reentrancy-level=SINGLE-CORE-REENTRANT, implemented-entry=Spi_SetupEB
        CalledEntity_6: reentrancy-level=SINGLE-CORE-REENTRANT, implemented-entry=Spi_GetStatus
        CalledEntity_7: reentrancy-level=SINGLE-CORE-REENTRANT, implemented-entry=Spi_GetJobResult
        CalledEntity_8: reentrancy-level=SINGLE-CORE-REENTRANT, implemented-entry=Spi_GetSequenceResult
        CalledEntity_9: reentrancy-level=SINGLE-CORE-REENTRANT, implemented-entry=Spi_GetVersionInfo
        CalledEntity_10: can-enter-exclusive-area=[SPI_RAM_DATA_PROTECTION, SPI_INTERRUPT_CONTROL_PROTECTION], exclusive-area-nesting-order=[ExclusiveAreaNestingOrder_0, ExclusiveAreaNestingOrder_1], reentrancy-level=SINGLE-CORE-REENTRANT, implemented-entry=Spi_SyncTransmit
        CalledEntity_11: reentrancy-level=SINGLE-CORE-REENTRANT, implemented-entry=Spi_GetHWUnitStatus
        CalledEntity_12: can-enter-exclusive-area=[SPI_RAM_DATA_PROTECTION, SPI_INTERRUPT_CONTROL_PROTECTION], exclusive-area-nesting-order=[ExclusiveAreaNestingOrder_0, ExclusiveAreaNestingOrder_1], reentrancy-level=SINGLE-CORE-REENTRANT, implemented-entry=Spi_Cancel
        CalledEntity_13: reentrancy-level=NON-REENTRANT, implemented-entry=Spi_SetAsyncMode
        CalledEntity_14: can-enter-exclusive-area=[SPI_RAM_DATA_PROTECTION, SPI_INTERRUPT_CONTROL_PROTECTION], exclusive-area-nesting-order=[ExclusiveAreaNestingOrder_0, ExclusiveAreaNestingOrder_1], reentrancy-level=SINGLE-CORE-REENTRANT, implemented-entry=Spi_ForceCancel
        CalledEntity_15: reentrancy-level=NON-REENTRANT, implemented-entry=Spi_SetClockMode
        CalledEntity_16: reentrancy-level=SINGLE-CORE-REENTRANT, implemented-entry=Spi_GetErrorInfo
        CalledEntity_17: reentrancy-level=NON-REENTRANT, implemented-entry=Spi_SelfTest
        CalledEntity_18: can-enter-exclusive-area=SPI_INTERRUPT_CONTROL_PROTECTION, exclusive-area-nesting-order=ExclusiveAreaNestingOrder_1, reentrancy-level=SINGLE-CORE-REENTRANT, implemented-entry=Spi_CheckHWConsistency
      bsw schedulable entity SchedulableEntity_0: can-enter-exclusive-area=[SPI_RAM_DATA_PROTECTION, SPI_INTERRUPT_CONTROL_PROTECTION], exclusive-area-nesting-order=[ExclusiveAreaNestingOrder_0, ExclusiveAreaNestingOrder_1], reentrancy-level=NON-REENTRANT, implemented-entry=Spi_MainFunction_Handling
      168 x bsw interrupt entity, all with can-enter-exclusive-area=[SPI_RAM_DATA_PROTECTION, SPI_INTERRUPT_CONTROL_PROTECTION], exclusive-area-nesting-order=[ExclusiveAreaNestingOrder_0, ExclusiveAreaNestingOrder_1]:
        InterruptEntity_0: reentrancy-level=NON-REENTRANT, implemented-entry=SPI_CSIG0_TIC_ISR, interrupt-category=CAT-1, interrupt-source=INTCSIG0IC
        InterruptEntity_1: reentrancy-level=NON-REENTRANT, implemented-entry=SPI_CSIG0_TIC_CAT2_ISR, interrupt-category=CAT-2, interrupt-source=INTCSIG0IC
        InterruptEntity_2: implemented-entry=SPI_CSIG1_TIC_ISR, interrupt-category=CAT-1, interrupt-source=INTCSIG1IC
        InterruptEntity_3: implemented-entry=SPI_CSIG1_TIC_CAT2_ISR, interrupt-category=CAT-2, interrupt-source=INTCSIG1IC
        InterruptEntity_4: implemented-entry=SPI_CSIG2_TIC_ISR, interrupt-category=CAT-1, interrupt-source=INTCSIG2IC
        InterruptEntity_5: implemented-entry=SPI_CSIG2_TIC_CAT2_ISR, interrupt-category=CAT-2, interrupt-source=INTCSIG2IC
        InterruptEntity_6: implemented-entry=SPI_CSIG3_TIC_ISR, interrupt-category=CAT-1, interrupt-source=INTCSIG3IC
        InterruptEntity_7: implemented-entry=SPI_CSIG3_TIC_CAT2_ISR, interrupt-category=CAT-2, interrupt-source=INTCSIG3IC
        InterruptEntity_8: implemented-entry=SPI_CSIG4_TIC_ISR, interrupt-category=CAT-1, interrupt-source=INTCSIG4IC
        InterruptEntity_9: implemented-entry=SPI_CSIG4_TIC_CAT2_ISR, interrupt-category=CAT-2, interrupt-source=INTCSIG4IC
        InterruptEntity_10: reentrancy-level=NON-REENTRANT, implemented-entry=SPI_CSIG0_TIR_ISR, interrupt-category=CAT-1, interrupt-source=INTCSIG0IR
        InterruptEntity_11: reentrancy-level=NON-REENTRANT, implemented-entry=SPI_CSIG0_TIR_CAT2_ISR, interrupt-category=CAT-2, interrupt-source=INTCSIG0IR
        InterruptEntity_12: implemented-entry=SPI_CSIG1_TIR_ISR, interrupt-category=CAT-1, interrupt-source=INTCSIG1IR
        InterruptEntity_13: implemented-entry=SPI_CSIG1_TIR_CAT2_ISR, interrupt-category=CAT-2, interrupt-source=INTCSIG1IR
        InterruptEntity_14: implemented-entry=SPI_CSIG2_TIR_ISR, interrupt-category=CAT-1, interrupt-source=INTCSIG2IR
        InterruptEntity_15: implemented-entry=SPI_CSIG2_TIR_CAT2_ISR, interrupt-category=CAT-2, interrupt-source=INTCSIG2IR
        InterruptEntity_16: implemented-entry=SPI_CSIG3_TIR_ISR, interrupt-category=CAT-1, interrupt-source=INTCSIG3IR
        InterruptEntity_17: implemented-entry=SPI_CSIG3_TIR_CAT2_ISR, interrupt-category=CAT-2, interrupt-source=INTCSIG3IR
        InterruptEntity_18: implemented-entry=SPI_CSIG4_TIR_ISR, interrupt-category=CAT-1, interrupt-source=INTCSIG4IR
        InterruptEntity_19: implemented-entry=SPI_CSIG4_TIR_CAT2_ISR, interrupt-category=CAT-2, interrupt-source=INTCSIG4IR
        InterruptEntity_20: reentrancy-level=NON-REENTRANT, implemented-entry=SPI_CSIH0_TIC_ISR, interrupt-category=CAT-1, interrupt-source=INTCSIH0IC
        InterruptEntity_21: reentrancy-level=NON-REENTRANT, implemented-entry=SPI_CSIH0_TIC_CAT2_ISR, interrupt-category=CAT-2, interrupt-source=INTCSIH0IC
        InterruptEntity_22: implemented-entry=SPI_CSIH1_TIC_ISR, interrupt-category=CAT-1, interrupt-source=INTCSIH1IC
        InterruptEntity_23: implemented-entry=SPI_CSIH1_TIC_CAT2_ISR, interrupt-category=CAT-2, interrupt-source=INTCSIH1IC
        InterruptEntity_24: implemented-entry=SPI_CSIH2_TIC_ISR, interrupt-category=CAT-1, interrupt-source=INTCSIH2IC
        InterruptEntity_25: implemented-entry=SPI_CSIH2_TIC_CAT2_ISR, interrupt-category=CAT-2, interrupt-source=INTCSIH2IC
        InterruptEntity_26: implemented-entry=SPI_CSIH3_TIC_ISR, interrupt-category=CAT-1, interrupt-source=INTCSIH3IC
        InterruptEntity_27: implemented-entry=SPI_CSIH3_TIC_CAT2_ISR, interrupt-category=CAT-2, interrupt-source=INTCSIH3IC
        InterruptEntity_28: implemented-entry=SPI_CSIH4_TIC_ISR, interrupt-category=CAT-1, interrupt-source=INTCSIH4IC
        InterruptEntity_29: implemented-entry=SPI_CSIH4_TIC_CAT2_ISR, interrupt-category=CAT-2, interrupt-source=INTCSIH4IC
        InterruptEntity_30: reentrancy-level=NON-REENTRANT, implemented-entry=SPI_CSIH0_TIR_ISR, interrupt-category=CAT-1, interrupt-source=INTCSIH0IR
        InterruptEntity_31: reentrancy-level=NON-REENTRANT, implemented-entry=SPI_CSIH0_TIR_CAT2_ISR, interrupt-category=CAT-2, interrupt-source=INTCSIH0IR
        InterruptEntity_32: implemented-entry=SPI_CSIH1_TIR_ISR, interrupt-category=CAT-1, interrupt-source=INTCSIH1IR
        InterruptEntity_33: implemented-entry=SPI_CSIH1_TIR_CAT2_ISR, interrupt-category=CAT-2, interrupt-source=INTCSIH1IR
        InterruptEntity_34: implemented-entry=SPI_CSIH2_TIR_ISR, interrupt-category=CAT-1, interrupt-source=INTCSIH2IR
        InterruptEntity_35: implemented-entry=SPI_CSIH2_TIR_CAT2_ISR, interrupt-category=CAT-2, interrupt-source=INTCSIH2IR
        InterruptEntity_36: implemented-entry=SPI_CSIH3_TIR_ISR, interrupt-category=CAT-1, interrupt-source=INTCSIH3IR
        InterruptEntity_37: implemented-entry=SPI_CSIH3_TIR_CAT2_ISR, interrupt-category=CAT-2, interrupt-source=INTCSIH3IR
        InterruptEntity_38: implemented-entry=SPI_CSIH4_TIR_ISR, interrupt-category=CAT-1, interrupt-source=INTCSIH4IR
        InterruptEntity_39: implemented-entry=SPI_CSIH4_TIR_CAT2_ISR, interrupt-category=CAT-2, interrupt-source=INTCSIH4IR
        InterruptEntity_40: reentrancy-level=NON-REENTRANT, implemented-entry=SPI_DMA00_ISR, interrupt-category=CAT-1, interrupt-source=INTDMA0
        InterruptEntity_41: reentrancy-level=NON-REENTRANT, implemented-entry=SPI_DMA00_CAT2_ISR, interrupt-category=CAT-2, interrupt-source=INTDMA0
        InterruptEntity_42: implemented-entry=SPI_DMA01_ISR, interrupt-category=CAT-1, interrupt-source=INTDMA1
        InterruptEntity_43: implemented-entry=SPI_DMA01_CAT2_ISR, interrupt-category=CAT-2, interrupt-source=INTDMA1
        InterruptEntity_44: implemented-entry=SPI_DMA02_ISR, interrupt-category=CAT-1, interrupt-source=INTDMA2
        InterruptEntity_45: implemented-entry=SPI_DMA02_CAT2_ISR, interrupt-category=CAT-2, interrupt-source=INTDMA2
        InterruptEntity_46: implemented-entry=SPI_DMA03_ISR, interrupt-category=CAT-1, interrupt-source=INTDMA3
        InterruptEntity_47: implemented-entry=SPI_DMA03_CAT2_ISR, interrupt-category=CAT-2, interrupt-source=INTDMA3
        InterruptEntity_48: implemented-entry=SPI_DMA04_ISR, interrupt-category=CAT-1, interrupt-source=INTDMA4
        InterruptEntity_49: implemented-entry=SPI_DMA04_CAT2_ISR, interrupt-category=CAT-2, interrupt-source=INTDMA4
        InterruptEntity_50: implemented-entry=SPI_DMA05_ISR, interrupt-category=CAT-1, interrupt-source=INTDMA5
        InterruptEntity_51: implemented-entry=SPI_DMA05_CAT2_ISR, interrupt-category=CAT-2, interrupt-source=INTDMA5
        InterruptEntity_52: implemented-entry=SPI_DMA06_ISR, interrupt-category=CAT-1, interrupt-source=INTDMA6
        InterruptEntity_53: implemented-entry=SPI_DMA06_CAT2_ISR, interrupt-category=CAT-2, interrupt-source=INTDMA6
        InterruptEntity_54: implemented-entry=SPI_DMA07_ISR, interrupt-category=CAT-1, interrupt-source=INTDMA7
        InterruptEntity_55: implemented-entry=SPI_DMA07_CAT2_ISR, interrupt-category=CAT-2, interrupt-source=INTDMA7
        InterruptEntity_56: implemented-entry=SPI_DMA08_ISR, interrupt-category=CAT-1, interrupt-source=INTDMA8
        InterruptEntity_57: implemented-entry=SPI_DMA08_CAT2_ISR, interrupt-category=CAT-2, interrupt-source=INTDMA8
        InterruptEntity_58: implemented-entry=SPI_DMA09_ISR, interrupt-category=CAT-1, interrupt-source=INTDMA9
        InterruptEntity_59: implemented-entry=SPI_DMA09_CAT2_ISR, interrupt-category=CAT-2, interrupt-source=INTDMA9
        InterruptEntity_60: implemented-entry=SPI_DMA10_ISR, interrupt-category=CAT-1, interrupt-source=INTDMA10
        InterruptEntity_61: implemented-entry=SPI_DMA10_CAT2_ISR, interrupt-category=CAT-2, interrupt-source=INTDMA10
        InterruptEntity_62: implemented-entry=SPI_DMA11_ISR, interrupt-category=CAT-1, interrupt-source=INTDMA11
        InterruptEntity_63: implemented-entry=SPI_DMA11_CAT2_ISR, interrupt-category=CAT-2, interrupt-source=INTDMA11
        InterruptEntity_64: implemented-entry=SPI_DMA12_ISR, interrupt-category=CAT-1, interrupt-source=INTDMA12
        InterruptEntity_65: implemented-entry=SPI_DMA12_CAT2_ISR, interrupt-category=CAT-2, interrupt-source=INTDMA12
        InterruptEntity_66: implemented-entry=SPI_DMA13_ISR, interrupt-category=CAT-1, interrupt-source=INTDMA13
        InterruptEntity_67: implemented-entry=SPI_DMA13_CAT2_ISR, interrupt-category=CAT-2, interrupt-source=INTDMA13
        InterruptEntity_68: implemented-entry=SPI_DMA14_ISR, interrupt-category=CAT-1, interrupt-source=INTDMA14
        InterruptEntity_69: implemented-entry=SPI_DMA14_CAT2_ISR, interrupt-category=CAT-2, interrupt-source=INTDMA14
        InterruptEntity_70: implemented-entry=SPI_DMA15_ISR, interrupt-category=CAT-1, interrupt-source=INTDMA15
        InterruptEntity_71: implemented-entry=SPI_DMA15_CAT2_ISR, interrupt-category=CAT-2, interrupt-source=INTDMA15
        InterruptEntity_72: implemented-entry=SPI_DMA16_ISR, interrupt-category=CAT-1, interrupt-source=INTDMA16
        InterruptEntity_73: implemented-entry=SPI_DMA16_CAT2_ISR, interrupt-category=CAT-2, interrupt-source=INTDMA16
        InterruptEntity_74: implemented-entry=SPI_DMA17_ISR, interrupt-category=CAT-1, interrupt-source=INTDMA17
        InterruptEntity_75: implemented-entry=SPI_DMA17_CAT2_ISR, interrupt-category=CAT-2, interrupt-source=INTDMA17
        InterruptEntity_76: implemented-entry=SPI_DMA18_ISR, interrupt-category=CAT-1, interrupt-source=INTDMA18
        InterruptEntity_77: implemented-entry=SPI_DMA18_CAT2_ISR, interrupt-category=CAT-2, interrupt-source=INTDMA18
        InterruptEntity_78: implemented-entry=SPI_DMA19_ISR, interrupt-category=CAT-1, interrupt-source=INTDMA19
        InterruptEntity_79: implemented-entry=SPI_DMA19_CAT2_ISR, interrupt-category=CAT-2, interrupt-source=INTDMA19
        InterruptEntity_80: implemented-entry=SPI_DMA20_ISR, interrupt-category=CAT-1, interrupt-source=INTDMA20
        InterruptEntity_81: implemented-entry=SPI_DMA20_CAT2_ISR, interrupt-category=CAT-2, interrupt-source=INTDMA20
        InterruptEntity_82: implemented-entry=SPI_DMA21_ISR, interrupt-category=CAT-1, interrupt-source=INTDMA21
        InterruptEntity_83: implemented-entry=SPI_DMA21_CAT2_ISR, interrupt-category=CAT-2, interrupt-source=INTDMA21
        InterruptEntity_84: implemented-entry=SPI_DMA22_ISR, interrupt-category=CAT-1, interrupt-source=INTDMA22
        InterruptEntity_85: implemented-entry=SPI_DMA22_CAT2_ISR, interrupt-category=CAT-2, interrupt-source=INTDMA22
        InterruptEntity_86: implemented-entry=SPI_DMA23_ISR, interrupt-category=CAT-1, interrupt-source=INTDMA23
        InterruptEntity_87: implemented-entry=SPI_DMA23_CAT2_ISR, interrupt-category=CAT-2, interrupt-source=INTDMA23
        InterruptEntity_88: implemented-entry=SPI_DMA24_ISR, interrupt-category=CAT-1, interrupt-source=INTDMA24
        InterruptEntity_89: implemented-entry=SPI_DMA24_CAT2_ISR, interrupt-category=CAT-2, interrupt-source=INTDMA24
        InterruptEntity_90: implemented-entry=SPI_DMA25_ISR, interrupt-category=CAT-1, interrupt-source=INTDMA25
        InterruptEntity_91: implemented-entry=SPI_DMA25_CAT2_ISR, interrupt-category=CAT-2, interrupt-source=INTDMA25
        InterruptEntity_92: implemented-entry=SPI_DMA26_ISR, interrupt-category=CAT-1, interrupt-source=INTDMA26
        InterruptEntity_93: implemented-entry=SPI_DMA26_CAT2_ISR, interrupt-category=CAT-2, interrupt-source=INTDMA26
        InterruptEntity_94: implemented-entry=SPI_DMA27_ISR, interrupt-category=CAT-1, interrupt-source=INTDMA27
        InterruptEntity_95: implemented-entry=SPI_DMA27_CAT2_ISR, interrupt-category=CAT-2, interrupt-source=INTDMA27
        InterruptEntity_96: implemented-entry=SPI_DMA28_ISR, interrupt-category=CAT-1, interrupt-source=INTDMA28
        InterruptEntity_97: implemented-entry=SPI_DMA28_CAT2_ISR, interrupt-category=CAT-2, interrupt-source=INTDMA28
        InterruptEntity_98: implemented-entry=SPI_DMA29_ISR, interrupt-category=CAT-1, interrupt-source=INTDMA29
        InterruptEntity_99: implemented-entry=SPI_DMA29_CAT2_ISR, interrupt-category=CAT-2, interrupt-source=INTDMA29
        InterruptEntity_100: implemented-entry=SPI_DMA30_ISR, interrupt-category=CAT-1, interrupt-source=INTDMA30
        InterruptEntity_101: implemented-entry=SPI_DMA30_CAT2_ISR, interrupt-category=CAT-2, interrupt-source=INTDMA30
        InterruptEntity_102: implemented-entry=SPI_DMA31_ISR, interrupt-category=CAT-1, interrupt-source=INTDMA31
        InterruptEntity_103: implemented-entry=SPI_DMA31_CAT2_ISR, interrupt-category=CAT-2, interrupt-source=INTDMA31
        InterruptEntity_104: implemented-entry=SPI_DMA32_ISR, interrupt-category=CAT-1, interrupt-source=INTDMA32
        InterruptEntity_105: implemented-entry=SPI_DMA32_CAT2_ISR, interrupt-category=CAT-2, interrupt-source=INTDMA32
        InterruptEntity_106: implemented-entry=SPI_DMA33_ISR, interrupt-category=CAT-1, interrupt-source=INTDMA33
        InterruptEntity_107: implemented-entry=SPI_DMA33_CAT2_ISR, interrupt-category=CAT-2, interrupt-source=INTDMA33
        InterruptEntity_108: implemented-entry=SPI_DMA34_ISR, interrupt-category=CAT-1, interrupt-source=INTDMA34
        InterruptEntity_109: implemented-entry=SPI_DMA34_CAT2_ISR, interrupt-category=CAT-2, interrupt-source=INTDMA34
        InterruptEntity_110: implemented-entry=SPI_DMA35_ISR, interrupt-category=CAT-1, interrupt-source=INTDMA35
        InterruptEntity_111: implemented-entry=SPI_DMA35_CAT2_ISR, interrupt-category=CAT-2, interrupt-source=INTDMA35
        InterruptEntity_112: implemented-entry=SPI_DMA36_ISR, interrupt-category=CAT-1, interrupt-source=INTDMA36
        InterruptEntity_113: implemented-entry=SPI_DMA36_CAT2_ISR, interrupt-category=CAT-2, interrupt-source=INTDMA36
        InterruptEntity_114: implemented-entry=SPI_DMA37_ISR, interrupt-category=CAT-1, interrupt-source=INTDMA37
        InterruptEntity_115: implemented-entry=SPI_DMA37_CAT2_ISR, interrupt-category=CAT-2, interrupt-source=INTDMA37
        InterruptEntity_116: implemented-entry=SPI_DMA38_ISR, interrupt-category=CAT-1, interrupt-source=INTDMA38
        InterruptEntity_117: implemented-entry=SPI_DMA38_CAT2_ISR, interrupt-category=CAT-2, interrupt-source=INTDMA38
        InterruptEntity_118: implemented-entry=SPI_DMA39_ISR, interrupt-category=CAT-1, interrupt-source=INTDMA39
        InterruptEntity_119: implemented-entry=SPI_DMA39_CAT2_ISR, interrupt-category=CAT-2, interrupt-source=INTDMA39
        InterruptEntity_120: implemented-entry=SPI_DMA40_ISR, interrupt-category=CAT-1, interrupt-source=INTDMA40
        InterruptEntity_121: implemented-entry=SPI_DMA40_CAT2_ISR, interrupt-category=CAT-2, interrupt-source=INTDMA40
        InterruptEntity_122: implemented-entry=SPI_DMA41_ISR, interrupt-category=CAT-1, interrupt-source=INTDMA41
        InterruptEntity_123: implemented-entry=SPI_DMA41_CAT2_ISR, interrupt-category=CAT-2, interrupt-source=INTDMA41
        InterruptEntity_124: implemented-entry=SPI_DMA42_ISR, interrupt-category=CAT-1, interrupt-source=INTDMA42
        InterruptEntity_125: implemented-entry=SPI_DMA42_CAT2_ISR, interrupt-category=CAT-2, interrupt-source=INTDMA42
        InterruptEntity_126: implemented-entry=SPI_DMA43_ISR, interrupt-category=CAT-1, interrupt-source=INTDMA43
        InterruptEntity_127: implemented-entry=SPI_DMA43_CAT2_ISR, interrupt-category=CAT-2, interrupt-source=INTDMA43
        InterruptEntity_128: implemented-entry=SPI_DMA44_ISR, interrupt-category=CAT-1, interrupt-source=INTDMA44
        InterruptEntity_129: implemented-entry=SPI_DMA44_CAT2_ISR, interrupt-category=CAT-2, interrupt-source=INTDMA44
        InterruptEntity_130: implemented-entry=SPI_DMA45_ISR, interrupt-category=CAT-1, interrupt-source=INTDMA45
        InterruptEntity_131: implemented-entry=SPI_DMA45_CAT2_ISR, interrupt-category=CAT-2, interrupt-source=INTDMA45
        InterruptEntity_132: implemented-entry=SPI_DMA46_ISR, interrupt-category=CAT-1, interrupt-source=INTDMA46
        InterruptEntity_133: implemented-entry=SPI_DMA46_CAT2_ISR, interrupt-category=CAT-2, interrupt-source=INTDMA46
        InterruptEntity_134: implemented-entry=SPI_DMA47_ISR, interrupt-category=CAT-1, interrupt-source=INTDMA47
        InterruptEntity_135: implemented-entry=SPI_DMA47_CAT2_ISR, interrupt-category=CAT-2, interrupt-source=INTDMA47
        InterruptEntity_136: implemented-entry=SPI_DMA48_ISR, interrupt-category=CAT-1, interrupt-source=INTDMA48
        InterruptEntity_137: implemented-entry=SPI_DMA48_CAT2_ISR, interrupt-category=CAT-2, interrupt-source=INTDMA48
        InterruptEntity_138: implemented-entry=SPI_DMA49_ISR, interrupt-category=CAT-1, interrupt-source=INTDMA49
        InterruptEntity_139: implemented-entry=SPI_DMA49_CAT2_ISR, interrupt-category=CAT-2, interrupt-source=INTDMA49
        InterruptEntity_140: implemented-entry=SPI_DMA50_ISR, interrupt-category=CAT-1, interrupt-source=INTDMA50
        InterruptEntity_141: implemented-entry=SPI_DMA50_CAT2_ISR, interrupt-category=CAT-2, interrupt-source=INTDMA50
        InterruptEntity_142: implemented-entry=SPI_DMA51_ISR, interrupt-category=CAT-1, interrupt-source=INTDMA51
        InterruptEntity_143: implemented-entry=SPI_DMA51_CAT2_ISR, interrupt-category=CAT-2, interrupt-source=INTDMA51
        InterruptEntity_144: implemented-entry=SPI_DMA52_ISR, interrupt-category=CAT-1, interrupt-source=INTDMA52
        InterruptEntity_145: implemented-entry=SPI_DMA52_CAT2_ISR, interrupt-category=CAT-2, interrupt-source=INTDMA52
        InterruptEntity_146: implemented-entry=SPI_DMA53_ISR, interrupt-category=CAT-1, interrupt-source=INTDMA53
        InterruptEntity_147: implemented-entry=SPI_DMA53_CAT2_ISR, interrupt-category=CAT-2, interrupt-source=INTDMA53
        InterruptEntity_148: implemented-entry=SPI_DMA54_ISR, interrupt-category=CAT-1, interrupt-source=INTDMA54
        InterruptEntity_149: implemented-entry=SPI_DMA54_CAT2_ISR, interrupt-category=CAT-2, interrupt-source=INTDMA54
        InterruptEntity_150: implemented-entry=SPI_DMA55_ISR, interrupt-category=CAT-1, interrupt-source=INTDMA55
        InterruptEntity_151: implemented-entry=SPI_DMA55_CAT2_ISR, interrupt-category=CAT-2, interrupt-source=INTDMA55
        InterruptEntity_152: implemented-entry=SPI_DMA56_ISR, interrupt-category=CAT-1, interrupt-source=INTDMA56
        InterruptEntity_153: implemented-entry=SPI_DMA56_CAT2_ISR, interrupt-category=CAT-2, interrupt-source=INTDMA56
        InterruptEntity_154: implemented-entry=SPI_DMA57_ISR, interrupt-category=CAT-1, interrupt-source=INTDMA57
        InterruptEntity_155: implemented-entry=SPI_DMA57_CAT2_ISR, interrupt-category=CAT-2, interrupt-source=INTDMA57
        InterruptEntity_156: implemented-entry=SPI_DMA58_ISR, interrupt-category=CAT-1, interrupt-source=INTDMA58
        InterruptEntity_157: implemented-entry=SPI_DMA58_CAT2_ISR, interrupt-category=CAT-2, interrupt-source=INTDMA58
        InterruptEntity_158: implemented-entry=SPI_DMA59_ISR, interrupt-category=CAT-1, interrupt-source=INTDMA59
        InterruptEntity_159: implemented-entry=SPI_DMA59_CAT2_ISR, interrupt-category=CAT-2, interrupt-source=INTDMA59
        InterruptEntity_160: implemented-entry=SPI_DMA60_ISR, interrupt-category=CAT-1, interrupt-source=INTDMA60
        InterruptEntity_161: implemented-entry=SPI_DMA60_CAT2_ISR, interrupt-category=CAT-2, interrupt-source=INTDMA60
        InterruptEntity_162: implemented-entry=SPI_DMA61_ISR, interrupt-category=CAT-1, interrupt-source=INTDMA61
        InterruptEntity_163: implemented-entry=SPI_DMA61_CAT2_ISR, interrupt-category=CAT-2, interrupt-source=INTDMA61
        InterruptEntity_164: implemented-entry=SPI_DMA62_ISR, interrupt-category=CAT-1, interrupt-source=INTDMA62
        InterruptEntity_165: implemented-entry=SPI_DMA62_CAT2_ISR, interrupt-category=CAT-2, interrupt-source=INTDMA62
        InterruptEntity_166: implemented-entry=SPI_DMA63_ISR, interrupt-category=CAT-1, interrupt-source=INTDMA63
        InterruptEntity_167: implemented-entry=SPI_DMA63_CAT2_ISR, interrupt-category=CAT-2, interrupt-source=INTDMA63
      bsw timing event Evt_Spi_MainFunction_Handling: starts-on-event=SchedulableEntity_0, period=0.001
  188 x bsw module entry, all with sw-service-impl-policy=STANDARD:
    Spi_Init: service-id=0, is-reentrant=false, is-synchronous=true, call-type=REGULAR, execution-context=TASK
    Spi_DeInit: service-id=1, is-reentrant=false, is-synchronous=true, call-type=REGULAR, execution-context=TASK
    Spi_WriteIB: service-id=2, is-reentrant=true, is-synchronous=true, call-type=REGULAR, execution-context=TASK
    Spi_AsyncTransmit: service-id=3, is-reentrant=true, is-synchronous=false, call-type=REGULAR, execution-context=TASK
    Spi_ReadIB: service-id=4, is-reentrant=true, is-synchronous=true, call-type=REGULAR, execution-context=TASK
    Spi_SetupEB: service-id=5, is-reentrant=true, is-synchronous=true, call-type=REGULAR, execution-context=TASK
    Spi_GetStatus: service-id=6, is-reentrant=true, is-synchronous=true, call-type=REGULAR, execution-context=TASK
    Spi_GetJobResult: service-id=7, is-reentrant=true, is-synchronous=true, call-type=REGULAR, execution-context=TASK
    Spi_GetSequenceResult: service-id=8, is-reentrant=true, is-synchronous=true, call-type=REGULAR, execution-context=TASK
    Spi_GetVersionInfo: service-id=9, is-reentrant=true, is-synchronous=true, call-type=REGULAR, execution-context=TASK
    Spi_SyncTransmit: service-id=10, is-reentrant=true, is-synchronous=true, call-type=REGULAR, execution-context=TASK
    Spi_GetHWUnitStatus: service-id=11, is-reentrant=true, is-synchronous=true, call-type=REGULAR, execution-context=TASK
    Spi_Cancel: service-id=12, is-reentrant=true, is-synchronous=false, call-type=REGULAR, execution-context=TASK
    Spi_SetAsyncMode: service-id=13, is-reentrant=false, is-synchronous=true, call-type=REGULAR, execution-context=TASK
    Spi_ForceCancel: service-id=160, is-reentrant=true, is-synchronous=true, call-type=REGULAR, execution-context=TASK
    Spi_SetClockMode: service-id=161, is-reentrant=false, is-synchronous=true, call-type=REGULAR, execution-context=TASK
    Spi_GetErrorInfo: service-id=162, is-reentrant=true, is-synchronous=true, call-type=REGULAR, execution-context=TASK
    Spi_SelfTest: service-id=163, is-reentrant=false, is-synchronous=true, call-type=REGULAR, execution-context=TASK
    Spi_CheckHWConsistency: service-id=164, is-reentrant=true, is-synchronous=true, call-type=REGULAR, execution-context=TASK
    Spi_MainFunction_Handling: service-id=16, is-reentrant=false, is-synchronous=true, call-type=SCHEDULED, execution-context=TASK
    SPI_CSIG0_TIC_ISR: is-reentrant=false, is-synchronous=true, call-type=INTERRUPT, execution-context=INTERRUPT-CAT-1
    SPI_CSIG0_TIC_CAT2_ISR: is-reentrant=false, is-synchronous=true, call-type=INTERRUPT, execution-context=INTERRUPT-CAT-2
    SPI_CSIG1_TIC_ISR: is-reentrant=false, is-synchronous=true, call-type=INTERRUPT, execution-context=INTERRUPT-CAT-1
    SPI_CSIG1_TIC_CAT2_ISR: is-reentrant=false, is-synchronous=true, call-type=INTERRUPT, execution-context=INTERRUPT-CAT-2
    SPI_CSIG2_TIC_ISR: is-reentrant=false, is-synchronous=true, call-type=INTERRUPT, execution-context=INTERRUPT-CAT-1
    SPI_CSIG2_TIC_CAT2_ISR: is-reentrant=false, is-synchronous=true, call-type=INTERRUPT, execution-context=INTERRUPT-CAT-2
    SPI_CSIG3_TIC_ISR: is-reentrant=false, is-synchronous=true, call-type=INTERRUPT, execution-context=INTERRUPT-CAT-1
    SPI_CSIG3_TIC_CAT2_ISR: is-reentrant=false, is-synchronous=true, call-type=INTERRUPT, execution-context=INTERRUPT-CAT-2
    SPI_CSIG4_TIC_ISR: is-reentrant=false, is-synchronous=true, call-type=INTERRUPT, execution-context=INTERRUPT-CAT-1
    SPI_CSIG4_TIC_CAT2_ISR: is-reentrant=false, is-synchronous=true, call-type=INTERRUPT, execution-context=INTERRUPT-CAT-2
    SPI_CSIG0_TIR_ISR: is-reentrant=false, is-synchronous=true, call-type=INTERRUPT, execution-context=INTERRUPT-CAT-1
    SPI_CSIG0_TIR_CAT2_ISR: is-reentrant=false, is-synchronous=true, call-type=INTERRUPT, execution-context=INTERRUPT-CAT-2
    SPI_CSIG1_TIR_ISR: is-reentrant=false, is-synchronous=true, call-type=INTERRUPT, execution-context=INTERRUPT-CAT-1
    SPI_CSIG1_TIR_CAT2_ISR: is-reentrant=false, is-synchronous=true, call-type=INTERRUPT, execution-context=INTERRUPT-CAT-2
    SPI_CSIG2_TIR_ISR: is-reentrant=false, is-synchronous=true, call-type=INTERRUPT, execution-context=INTERRUPT-CAT-1
    SPI_CSIG2_TIR_CAT2_ISR: is-reentrant=false, is-synchronous=true, call-type=INTERRUPT, execution-context=INTERRUPT-CAT-2
    SPI_CSIG3_TIR_ISR: is-reentrant=false, is-synchronous=true, call-type=INTERRUPT, execution-context=INTERRUPT-CAT-1
    SPI_CSIG3_TIR_CAT2_ISR: is-reentrant=false, is-synchronous=true, call-type=INTERRUPT, execution-context=INTERRUPT-CAT-2
    SPI_CSIG4_TIR_ISR: is-reentrant=false, is-synchronous=true, call-type=INTERRUPT, execution-context=INTERRUPT-CAT-1
    SPI_CSIG4_TIR_CAT2_ISR: is-reentrant=false, is-synchronous=true, call-type=INTERRUPT, execution-context=INTERRUPT-CAT-2
    SPI_CSIH0_TIC_ISR: is-reentrant=false, is-synchronous=true, call-type=INTERRUPT, execution-context=INTERRUPT-CAT-1
    SPI_CSIH0_TIC_CAT2_ISR: is-reentrant=false, is-synchronous=true, call-type=INTERRUPT, execution-context=INTERRUPT-CAT-2
    SPI_CSIH1_TIC_ISR: is-reentrant=false, is-synchronous=true, call-type=INTERRUPT, execution-context=INTERRUPT-CAT-1
    SPI_CSIH1_TIC_CAT2_ISR: is-reentrant=false, is-synchronous=true, call-type=INTERRUPT, execution-context=INTERRUPT-CAT-2
    SPI_CSIH2_TIC_ISR: is-reentrant=false, is-synchronous=true, call-type=INTERRUPT, execution-context=INTERRUPT-CAT-1
    SPI_CSIH2_TIC_CAT2_ISR: is-reentrant=false, is-synchronous=true, call-type=INTERRUPT, execution-context=INTERRUPT-CAT-2
    SPI_CSIH3_TIC_ISR: is-reentrant=false, is-synchronous=true, call-type=INTERRUPT, execution-context=INTERRUPT-CAT-1
    SPI_CSIH3_TIC_CAT2_ISR: is-reentrant=false, is-synchronous=true, call-type=INTERRUPT, execution-context=INTERRUPT-CAT-2
    SPI_CSIH4_TIC_ISR: is-reentrant=false, is-synchronous=true, call-type=INTERRUPT, execution-context=INTERRUPT-CAT-1
    SPI_CSIH4_TIC_CAT2_ISR: is-reentrant=false, is-synchronous=true, call-type=INTERRUPT, execution-context=INTERRUPT-CAT-2
    SPI_CSIH0_TIR_ISR: is-reentrant=false, is-synchronous=true, call-type=INTERRUPT, execution-context=INTERRUPT-CAT-1
    SPI_CSIH0_TIR_CAT2_ISR: is-reentrant=false, is-synchronous=true, call-type=INTERRUPT, execution-context=INTERRUPT-CAT-2
    SPI_CSIH1_TIR_ISR: is-reentrant=false, is-synchronous=true, call-type=INTERRUPT, execution-context=INTERRUPT-CAT-1
    SPI_CSIH1_TIR_CAT2_ISR: is-reentrant=false, is-synchronous=true, call-type=INTERRUPT, execution-context=INTERRUPT-CAT-2
    SPI_CSIH2_TIR_ISR: is-reentrant=false, is-synchronous=true, call-type=INTERRUPT, execution-context=INTERRUPT-CAT-1
    SPI_CSIH2_TIR_CAT2_ISR: is-reentrant=false, is-synchronous=true, call-type=INTERRUPT, execution-context=INTERRUPT-CAT-2
    SPI_CSIH3_TIR_ISR: is-reentrant=false, is-synchronous=true, call-type=INTERRUPT, execution-context=INTERRUPT-CAT-1
    SPI_CSIH3_TIR_CAT2_ISR: is-reentrant=false, is-synchronous=true, call-type=INTERRUPT, execution-context=INTERRUPT-CAT-2
    SPI_CSIH4_TIR_ISR: is-reentrant=false, is-synchronous=true, call-type=INTERRUPT, execution-context=INTERRUPT-CAT-1
    SPI_CSIH4_TIR_CAT2_ISR: is-reentrant=false, is-synchronous=true, call-type=INTERRUPT, execution-context=INTERRUPT-CAT-2
    SPI_DMA00_ISR: is-reentrant=false, is-synchronous=true, call-type=INTERRUPT, execution-context=INTERRUPT-CAT-1
    SPI_DMA00_CAT2_ISR: is-reentrant=false, is-synchronous=true, call-type=INTERRUPT, execution-context=INTERRUPT-CAT-2
    SPI_DMA01_ISR: is-reentrant=false, is-synchronous=true, call-type=INTERRUPT, execution-context=INTERRUPT-CAT-1
    SPI_DMA01_CAT2_ISR: is-reentrant=false, is-synchronous=true, call-type=INTERRUPT, execution-context=INTERRUPT-CAT-2
    SPI_DMA02_ISR: is-reentrant=false, is-synchronous=true, call-type=INTERRUPT, execution-context=INTERRUPT-CAT-1
    SPI_DMA02_CAT2_ISR: is-reentrant=false, is-synchronous=true, call-type=INTERRUPT, execution-context=INTERRUPT-CAT-2
    SPI_DMA03_ISR: is-reentrant=false, is-synchronous=true, call-type=INTERRUPT, execution-context=INTERRUPT-CAT-1
    SPI_DMA03_CAT2_ISR: is-reentrant=false, is-synchronous=true, call-type=INTERRUPT, execution-context=INTERRUPT-CAT-2
    SPI_DMA04_ISR: is-reentrant=false, is-synchronous=true, call-type=INTERRUPT, execution-context=INTERRUPT-CAT-1
    SPI_DMA04_CAT2_ISR: is-reentrant=false, is-synchronous=true, call-type=INTERRUPT, execution-context=INTERRUPT-CAT-2
    SPI_DMA05_ISR: is-reentrant=false, is-synchronous=true, call-type=INTERRUPT, execution-context=INTERRUPT-CAT-1
    SPI_DMA05_CAT2_ISR: is-reentrant=false, is-synchronous=true, call-type=INTERRUPT, execution-context=INTERRUPT-CAT-2
    SPI_DMA06_ISR: is-reentrant=false, is-synchronous=true, call-type=INTERRUPT, execution-context=INTERRUPT-CAT-1
    SPI_DMA06_CAT2_ISR: is-reentrant=false, is-synchronous=true, call-type=INTERRUPT, execution-context=INTERRUPT-CAT-2
    SPI_DMA07_ISR: is-reentrant=false, is-synchronous=true, call-type=INTERRUPT, execution-context=INTERRUPT-CAT-1
    SPI_DMA07_CAT2_ISR: is-reentrant=false, is-synchronous=true, call-type=INTERRUPT, execution-context=INTERRUPT-CAT-2
    SPI_DMA08_ISR: is-reentrant=false, is-synchronous=true, call-type=INTERRUPT, execution-context=INTERRUPT-CAT-1
    SPI_DMA08_CAT2_ISR: is-reentrant=false, is-synchronous=true, call-type=INTERRUPT, execution-context=INTERRUPT-CAT-2
    SPI_DMA09_ISR: is-reentrant=false, is-synchronous=true, call-type=INTERRUPT, execution-context=INTERRUPT-CAT-1
    SPI_DMA09_CAT2_ISR: is-reentrant=false, is-synchronous=true, call-type=INTERRUPT, execution-context=INTERRUPT-CAT-2
    SPI_DMA10_ISR: is-reentrant=false, is-synchronous=true, call-type=INTERRUPT, execution-context=INTERRUPT-CAT-1
    SPI_DMA10_CAT2_ISR: is-reentrant=false, is-synchronous=true, call-type=INTERRUPT, execution-context=INTERRUPT-CAT-2
    SPI_DMA11_ISR: is-reentrant=false, is-synchronous=true, call-type=INTERRUPT, execution-context=INTERRUPT-CAT-1
    SPI_DMA11_CAT2_ISR: is-reentrant=false, is-synchronous=true, call-type=INTERRUPT, execution-context=INTERRUPT-CAT-2
    SPI_DMA12_ISR: is-reentrant=false, is-synchronous=true, call-type=INTERRUPT, execution-context=INTERRUPT-CAT-1
    SPI_DMA12_CAT2_ISR: is-reentrant=false, is-synchronous=true, call-type=INTERRUPT, execution-context=INTERRUPT-CAT-2
    SPI_DMA13_ISR: is-reentrant=false, is-synchronous=true, call-type=INTERRUPT, execution-context=INTERRUPT-CAT-1
    SPI_DMA13_CAT2_ISR: is-reentrant=false, is-synchronous=true, call-type=INTERRUPT, execution-context=INTERRUPT-CAT-2
    SPI_DMA14_ISR: is-reentrant=false, is-synchronous=true, call-type=INTERRUPT, execution-context=INTERRUPT-CAT-1
    SPI_DMA14_CAT2_ISR: is-reentrant=false, is-synchronous=true, call-type=INTERRUPT, execution-context=INTERRUPT-CAT-2
    SPI_DMA15_ISR: is-reentrant=false, is-synchronous=true, call-type=INTERRUPT, execution-context=INTERRUPT-CAT-1
    SPI_DMA15_CAT2_ISR: is-reentrant=false, is-synchronous=true, call-type=INTERRUPT, execution-context=INTERRUPT-CAT-2
    SPI_DMA16_ISR: is-reentrant=false, is-synchronous=true, call-type=INTERRUPT, execution-context=INTERRUPT-CAT-1
    SPI_DMA16_CAT2_ISR: is-reentrant=false, is-synchronous=true, call-type=INTERRUPT, execution-context=INTERRUPT-CAT-2
    SPI_DMA17_ISR: is-reentrant=false, is-synchronous=true, call-type=INTERRUPT, execution-context=INTERRUPT-CAT-1
    SPI_DMA17_CAT2_ISR: is-reentrant=false, is-synchronous=true, call-type=INTERRUPT, execution-context=INTERRUPT-CAT-2
    SPI_DMA18_ISR: is-reentrant=false, is-synchronous=true, call-type=INTERRUPT, execution-context=INTERRUPT-CAT-1
    SPI_DMA18_CAT2_ISR: is-reentrant=false, is-synchronous=true, call-type=INTERRUPT, execution-context=INTERRUPT-CAT-2
    SPI_DMA19_ISR: is-reentrant=false, is-synchronous=true, call-type=INTERRUPT, execution-context=INTERRUPT-CAT-1
    SPI_DMA19_CAT2_ISR: is-reentrant=false, is-synchronous=true, call-type=INTERRUPT, execution-context=INTERRUPT-CAT-2
    SPI_DMA20_ISR: is-reentrant=false, is-synchronous=true, call-type=INTERRUPT, execution-context=INTERRUPT-CAT-1
    SPI_DMA20_CAT2_ISR: is-reentrant=false, is-synchronous=true, call-type=INTERRUPT, execution-context=INTERRUPT-CAT-2
    SPI_DMA21_ISR: is-reentrant=false, is-synchronous=true, call-type=INTERRUPT, execution-context=INTERRUPT-CAT-1
    SPI_DMA21_CAT2_ISR: is-reentrant=false, is-synchronous=true, call-type=INTERRUPT, execution-context=INTERRUPT-CAT-2
    SPI_DMA22_ISR: is-reentrant=false, is-synchronous=true, call-type=INTERRUPT, execution-context=INTERRUPT-CAT-1
    SPI_DMA22_CAT2_ISR: is-reentrant=false, is-synchronous=true, call-type=INTERRUPT, execution-context=INTERRUPT-CAT-2
    SPI_DMA23_ISR: is-reentrant=false, is-synchronous=true, call-type=INTERRUPT, execution-context=INTERRUPT-CAT-1
    SPI_DMA23_CAT2_ISR: is-reentrant=false, is-synchronous=true, call-type=INTERRUPT, execution-context=INTERRUPT-CAT-2
    SPI_DMA24_ISR: is-reentrant=false, is-synchronous=true, call-type=INTERRUPT, execution-context=INTERRUPT-CAT-1
    SPI_DMA24_CAT2_ISR: is-reentrant=false, is-synchronous=true, call-type=INTERRUPT, execution-context=INTERRUPT-CAT-2
    SPI_DMA25_ISR: is-reentrant=false, is-synchronous=true, call-type=INTERRUPT, execution-context=INTERRUPT-CAT-1
    SPI_DMA25_CAT2_ISR: is-reentrant=false, is-synchronous=true, call-type=INTERRUPT, execution-context=INTERRUPT-CAT-2
    SPI_DMA26_ISR: is-reentrant=false, is-synchronous=true, call-type=INTERRUPT, execution-context=INTERRUPT-CAT-1
    SPI_DMA26_CAT2_ISR: is-reentrant=false, is-synchronous=true, call-type=INTERRUPT, execution-context=INTERRUPT-CAT-2
    SPI_DMA27_ISR: is-reentrant=false, is-synchronous=true, call-type=INTERRUPT, execution-context=INTERRUPT-CAT-1
    SPI_DMA27_CAT2_ISR: is-reentrant=false, is-synchronous=true, call-type=INTERRUPT, execution-context=INTERRUPT-CAT-2
    SPI_DMA28_ISR: is-reentrant=false, is-synchronous=true, call-type=INTERRUPT, execution-context=INTERRUPT-CAT-1
    SPI_DMA28_CAT2_ISR: is-reentrant=false, is-synchronous=true, call-type=INTERRUPT, execution-context=INTERRUPT-CAT-2
    SPI_DMA29_ISR: is-reentrant=false, is-synchronous=true, call-type=INTERRUPT, execution-context=INTERRUPT-CAT-1
    SPI_DMA29_CAT2_ISR: is-reentrant=false, is-synchronous=true, call-type=INTERRUPT, execution-context=INTERRUPT-CAT-2
    SPI_DMA30_ISR: is-reentrant=false, is-synchronous=true, call-type=INTERRUPT, execution-context=INTERRUPT-CAT-1
    SPI_DMA30_CAT2_ISR: is-reentrant=false, is-synchronous=true, call-type=INTERRUPT, execution-context=INTERRUPT-CAT-2
    SPI_DMA31_ISR: is-reentrant=false, is-synchronous=true, call-type=INTERRUPT, execution-context=INTERRUPT-CAT-1
    SPI_DMA31_CAT2_ISR: is-reentrant=false, is-synchronous=true, call-type=INTERRUPT, execution-context=INTERRUPT-CAT-2
    SPI_DMA32_ISR: is-reentrant=false, is-synchronous=true, call-type=INTERRUPT, execution-context=INTERRUPT-CAT-1
    SPI_DMA32_CAT2_ISR: is-reentrant=false, is-synchronous=true, call-type=INTERRUPT, execution-context=INTERRUPT-CAT-2
    SPI_DMA33_ISR: is-reentrant=false, is-synchronous=true, call-type=INTERRUPT, execution-context=INTERRUPT-CAT-1
    SPI_DMA33_CAT2_ISR: is-reentrant=false, is-synchronous=true, call-type=INTERRUPT, execution-context=INTERRUPT-CAT-2
    SPI_DMA34_ISR: is-reentrant=false, is-synchronous=true, call-type=INTERRUPT, execution-context=INTERRUPT-CAT-1
    SPI_DMA34_CAT2_ISR: is-reentrant=false, is-synchronous=true, call-type=INTERRUPT, execution-context=INTERRUPT-CAT-2
    SPI_DMA35_ISR: is-reentrant=false, is-synchronous=true, call-type=INTERRUPT, execution-context=INTERRUPT-CAT-1
    SPI_DMA35_CAT2_ISR: is-reentrant=false, is-synchronous=true, call-type=INTERRUPT, execution-context=INTERRUPT-CAT-2
    SPI_DMA36_ISR: is-reentrant=false, is-synchronous=true, call-type=INTERRUPT, execution-context=INTERRUPT-CAT-1
    SPI_DMA36_CAT2_ISR: is-reentrant=false, is-synchronous=true, call-type=INTERRUPT, execution-context=INTERRUPT-CAT-2
    SPI_DMA37_ISR: is-reentrant=false, is-synchronous=true, call-type=INTERRUPT, execution-context=INTERRUPT-CAT-1
    SPI_DMA37_CAT2_ISR: is-reentrant=false, is-synchronous=true, call-type=INTERRUPT, execution-context=INTERRUPT-CAT-2
    SPI_DMA38_ISR: is-reentrant=false, is-synchronous=true, call-type=INTERRUPT, execution-context=INTERRUPT-CAT-1
    SPI_DMA38_CAT2_ISR: is-reentrant=false, is-synchronous=true, call-type=INTERRUPT, execution-context=INTERRUPT-CAT-2
    SPI_DMA39_ISR: is-reentrant=false, is-synchronous=true, call-type=INTERRUPT, execution-context=INTERRUPT-CAT-1
    SPI_DMA39_CAT2_ISR: is-reentrant=false, is-synchronous=true, call-type=INTERRUPT, execution-context=INTERRUPT-CAT-2
    SPI_DMA40_ISR: is-reentrant=false, is-synchronous=true, call-type=INTERRUPT, execution-context=INTERRUPT-CAT-1
    SPI_DMA40_CAT2_ISR: is-reentrant=false, is-synchronous=true, call-type=INTERRUPT, execution-context=INTERRUPT-CAT-2
    SPI_DMA41_ISR: is-reentrant=false, is-synchronous=true, call-type=INTERRUPT, execution-context=INTERRUPT-CAT-1
    SPI_DMA41_CAT2_ISR: is-reentrant=false, is-synchronous=true, call-type=INTERRUPT, execution-context=INTERRUPT-CAT-2
    SPI_DMA42_ISR: is-reentrant=false, is-synchronous=true, call-type=INTERRUPT, execution-context=INTERRUPT-CAT-1
    SPI_DMA42_CAT2_ISR: is-reentrant=false, is-synchronous=true, call-type=INTERRUPT, execution-context=INTERRUPT-CAT-2
    SPI_DMA43_ISR: is-reentrant=false, is-synchronous=true, call-type=INTERRUPT, execution-context=INTERRUPT-CAT-1
    SPI_DMA43_CAT2_ISR: is-reentrant=false, is-synchronous=true, call-type=INTERRUPT, execution-context=INTERRUPT-CAT-2
    SPI_DMA44_ISR: is-reentrant=false, is-synchronous=true, call-type=INTERRUPT, execution-context=INTERRUPT-CAT-1
    SPI_DMA44_CAT2_ISR: is-reentrant=false, is-synchronous=true, call-type=INTERRUPT, execution-context=INTERRUPT-CAT-2
    SPI_DMA45_ISR: is-reentrant=false, is-synchronous=true, call-type=INTERRUPT, execution-context=INTERRUPT-CAT-1
    SPI_DMA45_CAT2_ISR: is-reentrant=false, is-synchronous=true, call-type=INTERRUPT, execution-context=INTERRUPT-CAT-2
    SPI_DMA46_ISR: is-reentrant=false, is-synchronous=true, call-type=INTERRUPT, execution-context=INTERRUPT-CAT-1
    SPI_DMA46_CAT2_ISR: is-reentrant=false, is-synchronous=true, call-type=INTERRUPT, execution-context=INTERRUPT-CAT-2
    SPI_DMA47_ISR: is-reentrant=false, is-synchronous=true, call-type=INTERRUPT, execution-context=INTERRUPT-CAT-1
    SPI_DMA47_CAT2_ISR: is-reentrant=false, is-synchronous=true, call-type=INTERRUPT, execution-context=INTERRUPT-CAT-2
    SPI_DMA48_ISR: is-reentrant=false, is-synchronous=true, call-type=INTERRUPT, execution-context=INTERRUPT-CAT-1
    SPI_DMA48_CAT2_ISR: is-reentrant=false, is-synchronous=true, call-type=INTERRUPT, execution-context=INTERRUPT-CAT-2
    SPI_DMA49_ISR: is-reentrant=false, is-synchronous=true, call-type=INTERRUPT, execution-context=INTERRUPT-CAT-1
    SPI_DMA49_CAT2_ISR: is-reentrant=false, is-synchronous=true, call-type=INTERRUPT, execution-context=INTERRUPT-CAT-2
    SPI_DMA50_ISR: is-reentrant=false, is-synchronous=true, call-type=INTERRUPT, execution-context=INTERRUPT-CAT-1
    SPI_DMA50_CAT2_ISR: is-reentrant=false, is-synchronous=true, call-type=INTERRUPT, execution-context=INTERRUPT-CAT-2
    SPI_DMA51_ISR: is-reentrant=false, is-synchronous=true, call-type=INTERRUPT, execution-context=INTERRUPT-CAT-1
    SPI_DMA51_CAT2_ISR: is-reentrant=false, is-synchronous=true, call-type=INTERRUPT, execution-context=INTERRUPT-CAT-2
    SPI_DMA52_ISR: is-reentrant=false, is-synchronous=true, call-type=INTERRUPT, execution-context=INTERRUPT-CAT-1
    SPI_DMA52_CAT2_ISR: is-reentrant=false, is-synchronous=true, call-type=INTERRUPT, execution-context=INTERRUPT-CAT-2
    SPI_DMA53_ISR: is-reentrant=false, is-synchronous=true, call-type=INTERRUPT, execution-context=INTERRUPT-CAT-1
    SPI_DMA53_CAT2_ISR: is-reentrant=false, is-synchronous=true, call-type=INTERRUPT, execution-context=INTERRUPT-CAT-2
    SPI_DMA54_ISR: is-reentrant=false, is-synchronous=true, call-type=INTERRUPT, execution-context=INTERRUPT-CAT-1
    SPI_DMA54_CAT2_ISR: is-reentrant=false, is-synchronous=true, call-type=INTERRUPT, execution-context=INTERRUPT-CAT-2
    SPI_DMA55_ISR: is-reentrant=false, is-synchronous=true, call-type=INTERRUPT, execution-context=INTERRUPT-CAT-1
    SPI_DMA55_CAT2_ISR: is-reentrant=false, is-synchronous=true, call-type=INTERRUPT, execution-context=INTERRUPT-CAT-2
    SPI_DMA56_ISR: is-reentrant=false, is-synchronous=true, call-type=INTERRUPT, execution-context=INTERRUPT-CAT-1
    SPI_DMA56_CAT2_ISR: is-reentrant=false, is-synchronous=true, call-type=INTERRUPT, execution-context=INTERRUPT-CAT-2
    SPI_DMA57_ISR: is-reentrant=false, is-synchronous=true, call-type=INTERRUPT, execution-context=INTERRUPT-CAT-1
    SPI_DMA57_CAT2_ISR: is-reentrant=false, is-synchronous=true, call-type=INTERRUPT, execution-context=INTERRUPT-CAT-2
    SPI_DMA58_ISR: is-reentrant=false, is-synchronous=true, call-type=INTERRUPT, execution-context=INTERRUPT-CAT-1
    SPI_DMA58_CAT2_ISR: is-reentrant=false, is-synchronous=true, call-type=INTERRUPT, execution-context=INTERRUPT-CAT-2
    SPI_DMA59_ISR: is-reentrant=false, is-synchronous=true, call-type=INTERRUPT, execution-context=INTERRUPT-CAT-1
    SPI_DMA59_CAT2_ISR: is-reentrant=false, is-synchronous=true, call-type=INTERRUPT, execution-context=INTERRUPT-CAT-2
    SPI_DMA60_ISR: is-reentrant=false, is-synchronous=true, call-type=INTERRUPT, execution-context=INTERRUPT-CAT-1
    SPI_DMA60_CAT2_ISR: is-reentrant=false, is-synchronous=true, call-type=INTERRUPT, execution-context=INTERRUPT-CAT-2
    SPI_DMA61_ISR: is-reentrant=false, is-synchronous=true, call-type=INTERRUPT, execution-context=INTERRUPT-CAT-1
    SPI_DMA61_CAT2_ISR: is-reentrant=false, is-synchronous=true, call-type=INTERRUPT, execution-context=INTERRUPT-CAT-2
    SPI_DMA62_ISR: is-reentrant=false, is-synchronous=true, call-type=INTERRUPT, execution-context=INTERRUPT-CAT-1
    SPI_DMA62_CAT2_ISR: is-reentrant=false, is-synchronous=true, call-type=INTERRUPT, execution-context=INTERRUPT-CAT-2
    SPI_DMA63_ISR: is-reentrant=false, is-synchronous=true, call-type=INTERRUPT, execution-context=INTERRUPT-CAT-1
    SPI_DMA63_CAT2_ISR: is-reentrant=false, is-synchronous=true, call-type=INTERRUPT, execution-context=INTERRUPT-CAT-2
