AUTOSAR XML (schema 00048)
package /R7F7015833
  module config BswM
    BswMGeneral:
      BswMCanSMEnabled = true
      BswMCanSMIcomEnabled = false
      BswMComMEnabled = true
      BswMComMPncEnabled = false
      BswMDcmEnabled = true
      BswMDevErrorDetect = true
      BswMEcuMEnabled = true
      BswMEthSMEnabled = false
      BswMFrSMEnabled = false
      BswMGenericRequestEnabled = true
      BswMJ1939DcmEnabled = false
      BswMJ1939NmEnabled = false
      BswMLinSMEnabled = false
      BswMLinTPEnabled = false
      BswMNmEnabled = true
      BswMNvMEnabled = false
      BswMSchMEnabled = false
      BswMSdEnabled = false
      BswMVersionInfoApi = false
      BswMWdgMEnabled = true
      BswMTimerEnabled = true
      BswMMainFunctionPeriod = 0.01
      BswMUserIncludeFiles: BswMUserIncludeFile=BswM_Ext.h
    BswMConfig
      BswMArbitration
        LE_EcuM_WakeupSourceClear_EcuMWakeupSource_CAN1 (BswMLogicalExpression):
          BswMLogicalOperator = BSWM_OR
          BswMArgumentRef = Cond_EcuMWakeupIndication_EcuMWakeupSource_CAN_HCML_EQ_ECUM_WKSTATUS_EXPIRED
          BswMArgumentRef = LE_EcuM_WakeupSourceClear_EcuMWakeupSource_CAN2
        LE_WakeupEventValidated (BswMLogicalExpression):
          BswMLogicalOperator = BSWM_OR
          BswMArgumentRef = Cond_EcuMWakeupIndication_EcuMWakeupSource_CAN_HCML_EQ_ECUM_WKSTATUS_VALIDATED
          BswMArgumentRef = Cond_KL15_ON
        8 x BswMModeCondition, all with BswMConditionType=BSWM_EQUALS:
          Cond_CanSMIndication_CanChannel_0_EQ_CANSM_BSWM_BUS_OFF: BswMConditionMode=RPort_CanSMIndi_Can
            BswMConditionValue
              BswMBswMode: BswModeCompareValue=CANSM_BSWM_BUS_OFF
          Cond_CanSMIndication_CanChannel_0_EQ_CANSM_BSWM_NO_COMMUNICATION: BswMConditionMode=RPort_CanSMIndi_Can
            BswMConditionValue
              BswMBswMode: BswModeCompareValue=CANSM_BSWM_NO_COMMUNICATION
          Cond_CanSMIndication_CanChannel_0_EQ_CANSM_BSWM_SILENT_COMMUNICATION: BswMConditionMode=RPort_CanSMIndi_Can
            BswMConditionValue
              BswMBswMode: BswModeCompareValue=CANSM_BSWM_SILENT_COMMUNICATION
          Cond_CanSMIndication_CanChannel_0_EQ_CANSM_BSWM_FULL_COMMUNICATION: BswMConditionMode=RPort_CanSMIndi_Can
            BswMConditionValue
              BswMBswMode: BswModeCompareValue=CANSM_BSWM_FULL_COMMUNICATION
          Cond_EcuMWakeupIndication_EcuMWakeupSource_CAN_HCML_EQ_ECUM_WKSTATUS_NONE: BswMConditionMode=RPort_Wks_Can
            BswMConditionValue
              BswMBswMode: BswModeCompareValue=ECUM_WKSTATUS_NONE
          Cond_EcuMWakeupIndication_EcuMWakeupSource_CAN_HCML_EQ_ECUM_WKSTATUS_PENDING: BswMConditionMode=RPort_Wks_Can
            BswMConditionValue
              BswMBswMode: BswModeCompareValue=ECUM_WKSTATUS_PENDING
          Cond_EcuMWakeupIndication_EcuMWakeupSource_CAN_HCML_EQ_ECUM_WKSTATUS_VALIDATED: BswMConditionMode=RPort_Wks_Can
            BswMConditionValue
              BswMBswMode: BswModeCompareValue=ECUM_WKSTATUS_VALIDATED
          Cond_EcuMWakeupIndication_EcuMWakeupSource_CAN_HCML_EQ_ECUM_WKSTATUS_EXPIRED: BswMConditionMode=RPort_Wks_Can
            BswMConditionValue
              BswMBswMode: BswModeCompareValue=ECUM_WKSTATUS_EXPIRED
        BswMModeInitValue:
          BswMCanSMIndicationInitState = CANSM_BSWM_NO_COMMUNICATION
          BswMGenericRequestInitMode = 0
          BswMComMIndicationInitMode = COMM_NO_COMMUNICATION
          BswMDcmComModeRequestInitMode = DCM_ENABLE_RX_TX_NORM_NM
          BswMEcuMWakeupSourceInitstate = ECUM_WKSTATUS_NONE
          BswMEcuMRUNRequestIndicationInitStatus = ECUM_RUNSTATUS_RELEASED
          BswMNvMJobModeIndicationInitMode = NVM_REQ_PENDING
        BswMEventRequestPort_0 (BswMEventRequestPort): BswMEventRequestProcessing=BSWM_IMMEDIATE
          BswMEventRequestSource
            BswMComMInitiateReset
        Rule_SartUp (BswMRule): BswMNestedExecutionOnly=false, BswMRuleInitState=BSWM_FALSE, BswMRuleExpressionRef=LE_SartUp, BswMRuleTrueActionList=AL_StartUp
        3 x BswMModeCondition, all with BswMConditionType=BSWM_EQUALS, BswMConditionMode=RPort_EcuMIndi:
          Cond_EcuMState_EQ_STARTUP
            BswMConditionValue
              BswMBswMode: BswModeCompareValue=ECUM_STATE_STARTUP
          Cond_EcuMState_EQ_ECUM_STATE_RUN
            BswMConditionValue
              BswMBswMode: BswModeCompareValue=ECUM_STATE_APP_POST_RUN
          Cond_EcuMState_EQ_ECUM_STATE_SHUTDOWN
            BswMConditionValue
              BswMBswMode: BswModeCompareValue=ECUM_STATE_SHUTDOWN
        5 x BswMLogicalExpression, all with BswMLogicalOperator=BSWM_OR:
          LE_DCM_Normal_Rx_Enable_CanChannel_0: BswMArgumentRef=Cond_DcmIndication_CanChannel_0_EQ_DCM_ENABLE_RX_TX_NORM, BswMArgumentRef=Cond_DcmIndication_CanChannel_0_EQ_DCM_ENABLE_RX_DISABLE_TX_NORM, BswMArgumentRef=Cond_DcmIndication_CanChannel_0_EQ_DCM_ENABLE_RX_TX_NORM_NM, BswMArgumentRef=Cond_DcmIndication_CanChannel_0_EQ_DCM_ENABLE_RX_DISABLE_TX_NORM_NM
          LE_DCM_Normal_Rx_Disable_CanChannel_0: BswMArgumentRef=Cond_DcmIndication_CanChannel_0_EQ_DCM_DISABLE_RX_ENABLE_TX_NORM, BswMArgumentRef=Cond_DcmIndication_CanChannel_0_EQ_DCM_DISABLE_RX_TX_NORMAL, BswMArgumentRef=Cond_DcmIndication_CanChannel_0_EQ_DCM_DISABLE_RX_ENABLE_TX_NORM_NM, BswMArgumentRef=Cond_DcmIndication_CanChannel_0_EQ_DCM_DISABLE_RX_TX_NORM_NM
          LE_DCM_Normal_Tx_Enable_CanChannel_0: BswMArgumentRef=Cond_DcmIndication_CanChannel_0_EQ_DCM_ENABLE_RX_TX_NORM, BswMArgumentRef=Cond_DcmIndication_CanChannel_0_EQ_DCM_DISABLE_RX_ENABLE_TX_NORM, BswMArgumentRef=Cond_DcmIndication_CanChannel_0_EQ_DCM_ENABLE_RX_TX_NORM_NM, BswMArgumentRef=Cond_DcmIndication_CanChannel_0_EQ_DCM_DISABLE_RX_ENABLE_TX_NORM_NM
          LE_DCM_Normal_Tx_Disable_CanChannel_0: BswMArgumentRef=Cond_DcmIndication_CanChannel_0_EQ_DCM_ENABLE_RX_DISABLE_TX_NORM, BswMArgumentRef=Cond_DcmIndication_CanChannel_0_EQ_DCM_DISABLE_RX_TX_NORMAL, BswMArgumentRef=Cond_DcmIndication_CanChannel_0_EQ_DCM_ENABLE_RX_DISABLE_TX_NORM_NM, BswMArgumentRef=Cond_DcmIndication_CanChannel_0_EQ_DCM_DISABLE_RX_TX_NORM_NM
          LE_DCM_Nm_Tx_Enable_CanChannel_0: BswMArgumentRef=Cond_DcmIndication_CanChannel_0_EQ_DCM_ENABLE_RX_TX_NM, BswMArgumentRef=Cond_DcmIndication_CanChannel_0_EQ_DCM_DISABLE_RX_ENABLE_TX_NM, BswMArgumentRef=Cond_DcmIndication_CanChannel_0_EQ_DCM_ENABLE_RX_TX_NORM_NM, BswMArgumentRef=Cond_DcmIndication_CanChannel_0_EQ_DCM_DISABLE_RX_ENABLE_TX_NORM_NM
        12 x BswMModeCondition, all with BswMConditionType=BSWM_EQUALS, BswMConditionMode=RPort_DcmIndi:
          Cond_DcmIndication_CanChannel_0_EQ_DCM_ENABLE_RX_TX_NORM
            BswMConditionValue
              BswMBswMode: BswModeCompareValue=DCM_ENABLE_RX_TX_NORM
          Cond_DcmIndication_CanChannel_0_EQ_DCM_ENABLE_RX_DISABLE_TX_NORM
            BswMConditionValue
              BswMBswMode: BswModeCompareValue=DCM_ENABLE_RX_DISABLE_TX_NORM
          Cond_DcmIndication_CanChannel_0_EQ_DCM_DISABLE_RX_ENABLE_TX_NORM
            BswMConditionValue
              BswMBswMode: BswModeCompareValue=DCM_DISABLE_RX_ENABLE_TX_NORM
          Cond_DcmIndication_CanChannel_0_EQ_DCM_DISABLE_RX_TX_NORMAL
            BswMConditionValue
              BswMBswMode: BswModeCompareValue=DCM_DISABLE_RX_TX_NORMAL
          Cond_DcmIndication_CanChannel_0_EQ_DCM_ENABLE_RX_TX_NM
            BswMConditionValue
              BswMBswMode: BswModeCompareValue=DCM_ENABLE_RX_TX_NM
          Cond_DcmIndication_CanChannel_0_EQ_DCM_ENABLE_RX_DISABLE_TX_NM
            BswMConditionValue
              BswMBswMode: BswModeCompareValue=DCM_ENABLE_RX_DISABLE_TX_NM
          Cond_DcmIndication_CanChannel_0_EQ_DCM_DISABLE_RX_ENABLE_TX_NM
            BswMConditionValue
              BswMBswMode: BswModeCompareValue=DCM_DISABLE_RX_ENABLE_TX_NM
          Cond_DcmIndication_CanChannel_0_EQ_DCM_DISABLE_RX_TX_NM
            BswMConditionValue
              BswMBswMode: BswModeCompareValue=DCM_DISABLE_RX_TX_NM
          Cond_DcmIndication_CanChannel_0_EQ_DCM_ENABLE_RX_TX_NORM_NM
            BswMConditionValue
              BswMBswMode: BswModeCompareValue=DCM_ENABLE_RX_TX_NORM_NM
          Cond_DcmIndication_CanChannel_0_EQ_DCM_ENABLE_RX_DISABLE_TX_NORM_NM
            BswMConditionValue
              BswMBswMode: BswModeCompareValue=DCM_ENABLE_RX_DISABLE_TX_NORM_NM
          Cond_DcmIndication_CanChannel_0_EQ_DCM_DISABLE_RX_ENABLE_TX_NORM_NM
            BswMConditionValue
              BswMBswMode: BswModeCompareValue=DCM_DISABLE_RX_ENABLE_TX_NORM_NM
          Cond_DcmIndication_CanChannel_0_EQ_DCM_DISABLE_RX_TX_NORM_NM
            BswMConditionValue
              BswMBswMode: BswModeCompareValue=DCM_DISABLE_RX_TX_NORM_NM
        LE_DCM_Nm_Tx_Disable_CanChannel_0 (BswMLogicalExpression):
          BswMLogicalOperator = BSWM_OR
          BswMArgumentRef = Cond_DcmIndication_CanChannel_0_EQ_DCM_ENABLE_RX_DISABLE_TX_NM
          BswMArgumentRef = Cond_DcmIndication_CanChannel_0_EQ_DCM_DISABLE_RX_TX_NM
          BswMArgumentRef = Cond_DcmIndication_CanChannel_0_EQ_DCM_ENABLE_RX_DISABLE_TX_NORM_NM
          BswMArgumentRef = Cond_DcmIndication_CanChannel_0_EQ_DCM_DISABLE_RX_TX_NORM_NM
        6 x BswMRule, all with BswMNestedExecutionOnly=false, BswMRuleInitState=BSWM_FALSE:
          Rule_DCM_Normal_Rx_Enable_CanChannel_0: BswMRuleExpressionRef=LE_DCM_Normal_Rx_Enable_CanChannel_0, BswMRuleTrueActionList=AL_DCM_Normal_Rx_Enable_CanChannel_0
          Rule_DCM_Normal_Rx_Disable_CanChannel_0: BswMRuleExpressionRef=LE_DCM_Normal_Rx_Disable_CanChannel_0, BswMRuleTrueActionList=AL_DCM_Normal_Rx_Disable_CanChannel_0
          Rule_DCM_Normal_Tx_Enable_CanChannel_0: BswMRuleExpressionRef=LE_DCM_Normal_Tx_Enable_CanChannel_0, BswMRuleTrueActionList=AL_DCM_Normal_Tx_Enable_CanChannel_0
          Rule_DCM_Normal_Tx_Disable_CanChannel_0: BswMRuleExpressionRef=LE_DCM_Normal_Tx_Disable_CanChannel_0, BswMRuleTrueActionList=AL_DCM_Normal_Tx_Disable_CanChannel_0
          Rule_DCM_Nm_Tx_Enable_CanChannel_0: BswMRuleExpressionRef=LE_DCM_Nm_Tx_Enable_CanChannel_0, BswMRuleTrueActionList=AL_DCM_Nm_Tx_Enable_CanChannel_0
          Rule_DCM_Nm_Tx_Disable_CanChannel_0: BswMRuleExpressionRef=LE_DCM_Nm_Tx_Disable_CanChannel_0, BswMRuleTrueActionList=AL_DCM_Nm_Tx_Disable_CanChannel_0
        7 x BswMModeRequestPort, all with BswMRequestProcessing=BSWM_IMMEDIATE:
          RPort_EcuMIndi
            BswMModeRequestSource
              BswMEcuMIndication
          RPort_Wks_Can
            BswMModeRequestSource
              BswMEcuMWakeupSource: BswMEcuMWakeupSrcRef=EcuMWakeupSource_CAN
          RPort_CanSMIndi_Can
            BswMModeRequestSource
              BswMCanSMIndication: BswMCanSMChannelRef=ComMChannel_0
          RPort_DcmIndi
            BswMModeRequestSource
              BswMDcmComModeRequest: BswMDcmComMChannelRef=ComMChannel_0
          RPort_CanNMIndi_1
            BswMModeRequestSource
              BswMGenericRequest: BswMModeRequesterId=1
          RPort_KL15_2
            BswMModeRequestSource
              BswMGenericRequest: BswMModeRequesterId=2
          RPort_AppInd_3
            BswMModeRequestSource
              BswMGenericRequest: BswMModeRequesterId=3
        8 x BswMModeCondition, all with BswMConditionType=BSWM_EQUALS:
          Cond_EcuMState_EQ_ECUM_STATE_APPRUN: BswMConditionMode=RPort_EcuMIndi
            BswMConditionValue
              BswMBswMode: BswModeCompareValue=ECUM_STATE_APP_RUN
          Cond_EcuMState_EQ_ECUM_STATE_APPPOSTRUN: BswMConditionMode=RPort_EcuMIndi
            BswMConditionValue
              BswMBswMode: BswModeCompareValue=ECUM_STATE_APP_POST_RUN
          Cond_CanNMIndi_NoAllowedSleep: BswMConditionMode=RPort_CanNMIndi_1
            BswMConditionValue
              COND_NM_NOALLOWED_SLEEP (BswMBswMode): BswMBswRequestedMode=1
          Cond_CanNMIndi_AllowedSleep: BswMConditionMode=RPort_CanNMIndi_1
            BswMConditionValue
              COND_NM_ALLOWED_SLEEP (BswMBswMode): BswMBswRequestedMode=2
          Cond_KL15_OFF: BswMConditionMode=RPort_KL15_2
            BswMConditionValue
              COND_KL15_OFF (BswMBswMode): BswMBswRequestedMode=1
          Cond_KL15_ON: BswMConditionMode=RPort_KL15_2
            BswMConditionValue
              COND_KL15_ON (BswMBswMode): BswMBswRequestedMode=2
          Cond_AppIndi_NoAllowedSleep: BswMConditionMode=RPort_AppInd_3
            BswMConditionValue
              COND_APP_NOALLOWED_SLEEP (BswMBswMode): BswMBswRequestedMode=1
          Cond_AppIndi_AllowedSleep: BswMConditionMode=RPort_AppInd_3
            BswMConditionValue
              COND_APP_ALLOWED_SLEEP (BswMBswMode): BswMBswRequestedMode=2
        11 x BswMLogicalExpression:
          LE_Bsw_Allow_GoDown: BswMLogicalOperator=BSWM_AND, BswMArgumentRef=Cond_EcuMWakeupIndication_EcuMWakeupSource_CAN_HCML_EQ_ECUM_WKSTATUS_NONE, BswMArgumentRef=Cond_KL15_OFF, BswMArgumentRef=Cond_CanSMIndication_CanChannel_0_EQ_CANSM_BSWM_NO_COMMUNICATION, BswMArgumentRef=Cond_CanNMIndi_AllowedSleep
          LE_GoDown: BswMLogicalOperator=BSWM_AND, BswMArgumentRef=Cond_EcuMWakeupIndication_EcuMWakeupSource_CAN_HCML_EQ_ECUM_WKSTATUS_NONE, BswMArgumentRef=Cond_CanSMIndication_CanChannel_0_EQ_CANSM_BSWM_NO_COMMUNICATION, BswMArgumentRef=Cond_KL15_OFF, BswMArgumentRef=Cond_CanNMIndi_AllowedSleep, BswMArgumentRef=Cond_AppIndi_AllowedSleep
          LE_KL15_ON_ComM_ReqFullCom: BswMArgumentRef=Cond_KL15_ON
          LE_KL15_OFF_ComM_ReqNoCom: BswMArgumentRef=Cond_KL15_OFF
          LE_EcuM_WakeupSourceClear_EcuMWakeupSource_CAN2: BswMLogicalOperator=BSWM_AND, BswMArgumentRef=Cond_EcuMWakeupIndication_EcuMWakeupSource_CAN_HCML_EQ_ECUM_WKSTATUS_EXPIRED, BswMArgumentRef=Cond_CanSMIndication_CanChannel_0_EQ_CANSM_BSWM_FULL_COMMUNICATION
          LE_SartUp: BswMArgumentRef=Cond_EcuMState_EQ_STARTUP
          LE_CanSMIndi_NoCom_BCan: BswMArgumentRef=Cond_CanSMIndication_CanChannel_0_EQ_CANSM_BSWM_NO_COMMUNICATION
          LE_CanSMIndi_SilentCom_BCan: BswMArgumentRef=Cond_CanSMIndication_CanChannel_0_EQ_CANSM_BSWM_SILENT_COMMUNICATION
          LE_CanSMIndi_FullCom_BCan1: BswMLogicalOperator=BSWM_AND, BswMArgumentRef=Cond_CanSMIndication_CanChannel_0_EQ_CANSM_BSWM_FULL_COMMUNICATION, BswMArgumentRef=LE_CanSMIndi_FullCom_BCan2
          LE_CanSMIndi_BusOff_BCan: BswMArgumentRef=Cond_CanSMIndication_CanChannel_0_EQ_CANSM_BSWM_BUS_OFF
          LE_CanSMIndi_FullCom_BCan2: BswMLogicalOperator=BSWM_OR, BswMArgumentRef=Cond_DcmIndication_CanChannel_0_EQ_DCM_ENABLE_RX_TX_NORM, BswMArgumentRef=Cond_DcmIndication_CanChannel_0_EQ_DCM_ENABLE_RX_TX_NORM_NM
        10 x BswMRule, all with BswMNestedExecutionOnly=false, BswMRuleInitState=BSWM_FALSE:
          Rule_Bsw_Allow_GoDown: BswMRuleExpressionRef=LE_Bsw_Allow_GoDown, BswMRuleTrueActionList=AL_Bsw_Allow_GoDown
          Rule_GoDown: BswMRuleExpressionRef=LE_GoDown, BswMRuleTrueActionList=AL_GoDown
          Rule_WakeupEventValidated: BswMRuleExpressionRef=LE_WakeupEventValidated, BswMRuleTrueActionList=AL_WakeupEventValidated
          Rule_ClearWakeupEvent: BswMRuleExpressionRef=LE_EcuM_WakeupSourceClear_EcuMWakeupSource_CAN1, BswMRuleTrueActionList=AL_ClearWakeupEvent
          Rule_KL15_ON_ComM_ReqFullCom: BswMRuleExpressionRef=LE_KL15_ON_ComM_ReqFullCom, BswMRuleTrueActionList=AL_KL15_ON_ComM_ReqFullCom
          Rule_KL15_OFF_ComM_ReqNoCom: BswMRuleExpressionRef=LE_KL15_OFF_ComM_ReqNoCom, BswMRuleTrueActionList=AL_KL15_OFF_ComM_ReqNoCom
          Rule_CanSMIndi_NoCom_BCan: BswMRuleExpressionRef=LE_CanSMIndi_NoCom_BCan, BswMRuleTrueActionList=AL_CanSMIndi_NoCom_BCan
          Rule_CanSMIndi_SilentCom_BCan: BswMRuleExpressionRef=LE_CanSMIndi_SilentCom_BCan, BswMRuleTrueActionList=AL_CanSMIndi_SilentCom_BCan
          Rule_CanSMIndi_FullCom_BCan: BswMRuleExpressionRef=LE_CanSMIndi_FullCom_BCan1, BswMRuleTrueActionList=AL_CanSMIndi_FullCom_BCan
          Rule_CanSMIndi_BusOff_BCan: BswMRuleExpressionRef=LE_CanSMIndi_BusOff_BCan, BswMRuleTrueActionList=AL__CanSMIndi_BusOff_BCan
      BswMModeControl
        10 x BswMAction:
          BswMAction_RxEnableDM_CanChannel_0
            BswMAvailableActions
              BswMDeadlineMonitoringControl: BswMEnabledDMPduGroupRef=Com_RxPduGroup_CONTROLLER_0_IAM
          BswMAction_RxDisableDM_CanChannel_0
            BswMAvailableActions
              BswMDeadlineMonitoringControl: BswMDisabledDMPduGroupRef=Com_RxPduGroup_CONTROLLER_0_IAM
          BswMAction_RxEnableGroupSwitch_CanChannel_0
            BswMAvailableActions
              BswMPduGroupSwitch: BswMPduGroupSwitchReinit=false, BswMEnabledPduGroupRef=Com_RxPduGroup_CONTROLLER_0_IAM
          BswMAction_RxDisableGroupSwitch_CanChannel_0
            BswMAvailableActions
              BswMPduGroupSwitch: BswMPduGroupSwitchReinit=false, BswMDisabledPduGroupRef=Com_RxPduGroup_CONTROLLER_0_IAM
          BswMAction_EcuM_ClearWakeUpSource_EcuMWakeupSource_CAN
            BswMAvailableActions
              BswMUserCallout: BswMUserCalloutFunction=User_EcuM_ClearWakeUpSource_EcuMWakeupSource_CAN
          BswMAction_EcuM_SetStatus_RUN
            BswMAvailableActions
              BswMEcuMStateSwitch: BswMEcuMState=BSWM_ECUM_STATE_APP_RUN
          BswMAction_EcuM_SetStatus_POST_RUN
            BswMAvailableActions
              BswMEcuMStateSwitch: BswMEcuMState=BSWM_ECUM_STATE_APP_POST_RUN
          Act_Bsw_Allow_GoDown
            BswMAvailableActions
              BswMUserCallout: BswMUserCalloutFunction=Act_Bsw_Allow_GoDown_Function
          BswMAction_EcuM_GoHalt
            BswMAvailableActions
              BswMEcuMGoDownHaltPoll: BswMEcuMUserIdRef=EcuMFlexUserConfig
          BswMAction_ComMAllow_CanChannel_0
            BswMAvailableActions
              BswMComMAllowCom: BswMComAllowed=true, BswMComMAllowChannelRef=ComMChannel_0
        6 x BswMActionList, all with BswMActionListExecution=BSWM_TRIGGER:
          AL_DCM_Normal_Rx_Enable_CanChannel_0
            Item_Action_RxEnableGroupSwitch_CanChannel_0 (BswMActionListItem): BswMAbortOnFail=false, BswMActionListItemIndex=0, BswMActionListItemRef=BswMAction_RxEnableGroupSwitch_CanChannel_0
          AL_DCM_Normal_Rx_Disable_CanChannel_0
            Item_Action_RxDisabledGroupSwitch_CanChannel_0 (BswMActionListItem): BswMAbortOnFail=false, BswMActionListItemIndex=0, BswMActionListItemRef=BswMAction_RxDisableGroupSwitch_CanChannel_0
          AL_DCM_Normal_Tx_Enable_CanChannel_0
            Item_Action_TxEnableGroupSwitch_CanChannel_0 (BswMActionListItem): BswMAbortOnFail=false, BswMActionListItemIndex=0, BswMActionListItemRef=Action_TxEnableGroupSwitch_CanChannel_0
          AL_DCM_Normal_Tx_Disable_CanChannel_0
            Item_Action_TxDisabledGroupSwitch_CanChannel_0 (BswMActionListItem): BswMAbortOnFail=false, BswMActionListItemIndex=0, BswMActionListItemRef=Action_TxDisabledGroupSwitch_CanChannel_0
          AL_DCM_Nm_Tx_Enable_CanChannel_0
            Item_Action_NmCtrol_Enable_CanChannel_0 (BswMActionListItem): BswMAbortOnFail=false, BswMActionListItemIndex=0, BswMActionListItemRef=BswMAction_NmCtrol_Enable_CanChannel_0
          AL_DCM_Nm_Tx_Disable_CanChannel_0
            Item_Action_NmCtrol_Disable_CanChannel_0 (BswMActionListItem): BswMAbortOnFail=false, BswMActionListItemIndex=0, BswMActionListItemRef=BswMAction_NmCtrol_Disable_CanChannel_0
        5 x BswMAction:
          BswMAction_ComMDisAllow_CanChannel_0
            BswMAvailableActions
              BswMComMAllowCom: BswMComAllowed=false, BswMComMAllowChannelRef=ComMChannel_0
          BswMAction_ComMRequestFULL_CanChannel_0
            BswMAvailableActions
              BswMComMModeSwitch: BswMComMRequestedMode=COMM_FULL_COMMUNICATION, BswMComMUserRef=ComMUser_0
          BswMAction_NmCtrol_Enable_CanChannel_0
            BswMAvailableActions
              BswMNMControl: BswMNMAction=BSWM_NM_ENABLE, BswMComMNetworkHandleRef=ComMChannel_0
          BswMAction_NmCtrol_Disable_CanChannel_0
            BswMAvailableActions
              BswMNMControl: BswMNMAction=BSWM_NM_DISABLE, BswMComMNetworkHandleRef=ComMChannel_0
          BswMAction_BSW_Module_Init
            BswMAvailableActions
              BswMEcuMDriverInitListBswM: BswMEcuMDriverInitListBswMRef=EcuMDriverInitListBswM_0
        AL_StartUp (BswMActionList): BswMActionListExecution=BSWM_TRIGGER
          7 x BswMActionListItem, all with BswMAbortOnFail=false:
            Item_Action_BswMAction_BswMAction_BSW_Module_Init: BswMActionListItemIndex=0, BswMActionListItemRef=BswMAction_BSW_Module_Init
            Item_Action_BswMAction_BswMAction_DIAG_Module_Init: BswMActionListItemIndex=1, BswMActionListItemRef=BswMAction_DIAG_Module_Init
            Item_Act_ComM_Allow: BswMActionListItemIndex=2, BswMActionListItemRef=BswMAction_ComMAllow_CanChannel_0
            Item_Act_Reinit_EnRx_PduGroup: BswMActionListItemIndex=3, BswMActionListItemRef=Action_RxEnableGroupSwitch_ReInit_CanChannel_0
            Item_Act_Reinit_EnTx_PduGroup: BswMActionListItemIndex=4, BswMActionListItemRef=Action_TxEnableGroupSwitch_ReInit_CanChannel_0
            Item_Act_DisTx_PduGroup: BswMActionListItemIndex=5, BswMActionListItemRef=BswMAction_RxDisableGroupSwitch_CanChannel_0
            Item_Act_DisRx_PduGroup: BswMActionListItemIndex=6, BswMActionListItemRef=Action_TxDisabledGroupSwitch_CanChannel_0
        8 x BswMAction:
          Action_TxEnableGroupSwitch_CanChannel_0
            BswMAvailableActions
              BswMPduGroupSwitch: BswMPduGroupSwitchReinit=false, BswMEnabledPduGroupRef=Com_TxPduGroup_CONTROLLER_0_IAM
          Action_TxDisabledGroupSwitch_CanChannel_0
            BswMAvailableActions
              BswMPduGroupSwitch: BswMPduGroupSwitchReinit=false, BswMDisabledPduGroupRef=Com_TxPduGroup_CONTROLLER_0_IAM
          Action_TxEnableGroupSwitch_ReInit_CanChannel_0
            BswMAvailableActions
              BswMPduGroupSwitch: BswMPduGroupSwitchReinit=true, BswMEnabledPduGroupRef=Com_TxPduGroup_CONTROLLER_0_IAM
          BswMAction_DIAG_Module_Init
            BswMAvailableActions
              BswMEcuMDriverInitListBswM: BswMEcuMDriverInitListBswMRef=EcuMDriverInitListBswM_Diag
          Act_ComM_ReqNoCom
            BswMAvailableActions
              BswMComMModeSwitch: BswMComMRequestedMode=COMM_NO_COMMUNICATION, BswMComMUserRef=ComMUser_0
          BswMAction_TxEnableDM_CanChannel_0
            BswMAvailableActions
              BswMDeadlineMonitoringControl: BswMEnabledDMPduGroupRef=Com_TxPduGroup_CONTROLLER_0_IAM
          BswMAction_TxDisableDM_CanChannel_0
            BswMAvailableActions
              BswMDeadlineMonitoringControl: BswMDisabledDMPduGroupRef=Com_TxPduGroup_CONTROLLER_0_IAM
          Action_RxEnableGroupSwitch_ReInit_CanChannel_0
            BswMAvailableActions
              BswMPduGroupSwitch: BswMPduGroupSwitchReinit=true, BswMEnabledPduGroupRef=Com_RxPduGroup_CONTROLLER_0_IAM
        10 x BswMActionList, all with BswMActionListExecution=BSWM_TRIGGER:
          AL_Bsw_Allow_GoDown
            Item_Act_Bsw_Allow_GoDown (BswMActionListItem): BswMAbortOnFail=false, BswMActionListItemIndex=0, BswMActionListItemRef=Act_Bsw_Allow_GoDown
          AL_GoDown
            Item_Act_EcuMGoDown (BswMActionListItem): BswMAbortOnFail=false, BswMActionListItemIndex=0, BswMActionListItemRef=BswMAction_EcuM_GoHalt
          AL_WakeupEventValidated
            Item_Act_WakeupEventValidated (BswMActionListItem): BswMAbortOnFail=false, BswMActionListItemIndex=0, BswMActionListItemRef=Act_WakeupEventValidated
          AL_ClearWakeupEvent
            Item_Act_ClearWakeupEvent (BswMActionListItem): BswMAbortOnFail=false, BswMActionListItemIndex=0, BswMActionListItemRef=BswMAction_EcuM_ClearWakeUpSource_EcuMWakeupSource_CAN
          AL_KL15_ON_ComM_ReqFullCom
            Item_Act_ComM_ReqFullCom (BswMActionListItem): BswMAbortOnFail=false, BswMActionListItemIndex=0, BswMActionListItemRef=BswMAction_ComMRequestFULL_CanChannel_0
          AL_KL15_OFF_ComM_ReqNoCom
            Item_Act_ComM_ReqNoCom (BswMActionListItem): BswMAbortOnFail=false, BswMActionListItemIndex=0, BswMActionListItemRef=Act_ComM_ReqNoCom
          AL_CanSMIndi_NoCom_BCan
            Item_AL_DisTx_PduGroup (BswMActionListItem): BswMAbortOnFail=false, BswMActionListItemIndex=0, BswMActionListItemRef=Action_TxDisabledGroupSwitch_CanChannel_0
            Item_AL_DisRx_PduGroup (BswMActionListItem): BswMAbortOnFail=false, BswMActionListItemIndex=1, BswMActionListItemRef=BswMAction_RxDisableDM_CanChannel_0
          AL_CanSMIndi_SilentCom_BCan
            Item_AL_DisTx_PduGroup (BswMActionListItem): BswMAbortOnFail=false, BswMActionListItemIndex=0, BswMActionListItemRef=Action_TxDisabledGroupSwitch_CanChannel_0
            Item_AL_EnRx_PduGroup (BswMActionListItem): BswMAbortOnFail=false, BswMActionListItemIndex=1, BswMActionListItemRef=BswMAction_RxEnableDM_CanChannel_0
          AL_CanSMIndi_FullCom_BCan
            Item_AL_EnTx_PduGroup (BswMActionListItem): BswMAbortOnFail=false, BswMActionListItemIndex=0, BswMActionListItemRef=Action_TxEnableGroupSwitch_CanChannel_0
            Item_AL_EnRx_PduGroup (BswMActionListItem): BswMAbortOnFail=false, BswMActionListItemIndex=1, BswMActionListItemRef=BswMAction_RxEnableGroupSwitch_CanChannel_0
          AL__CanSMIndi_BusOff_BCan
            Item_AL_DisTx_PduGroup (BswMActionListItem): BswMAbortOnFail=false, BswMActionListItemIndex=0, BswMActionListItemRef=Action_TxDisabledGroupSwitch_CanChannel_0
            Item_AL_DisRx_PduGroup (BswMActionListItem): BswMAbortOnFail=false, BswMActionListItemIndex=1, BswMActionListItemRef=BswMAction_RxDisableDM_CanChannel_0
        Act_WakeupEventValidated (BswMAction)
          BswMAvailableActions
            BswMUserCallout: BswMUserCalloutFunction=WakeupSource_Validated
