AUTOSAR XML (schema 00048)
package /R7F7015833
  module config Crypto_ISoft
    CryptoGeneral: CryptoDevErrorDetect=true, CryptoInstanceId=0, CryptoVersionInfoApi=false, CryptoMainFunctionPeriod=0.05
    CryptoDriverObjects
      CryptoDriverObject_CMCA (CryptoDriverObject): CryptoDriverObjectId=0, CryptoQueueSize=5, CryptoPrimitiveRef=CryptoPrimitive_SecOC_CMAC_Gen, CryptoPrimitiveRef=CryptoPrimitive_SecOC_CMAC_Verify
    CryptoKeys
      CryptoKey_SecOC_CMAC (CryptoKey): CryptoKeyId=0, CryptoKeyTypeRef=CryptoKeyType_CMAC
    CryptoPrimitives_0 (CryptoPrimitives)
      CryptoPrimitive_SecOC_CMAC_Gen (CryptoPrimitive):
        CryptoPrimitiveAlgorithmFamily = CRYPTO_ALGOFAM_AES
        CryptoPrimitiveAlgorithmMode = CRYPTO_ALGOMODE_CMAC
        CryptoPrimitiveAlgorithmSecondaryFamily = CRYPTO_ALGOFAM_NOT_SET
        CryptoPrimitiveService = MAC_GENERATE
      CryptoPrimitive_SecOC_CMAC_Verify (CryptoPrimitive):
        CryptoPrimitiveAlgorithmFamily = CRYPTO_ALGOFAM_AES
        CryptoPrimitiveAlgorithmMode = CRYPTO_ALGOMODE_CMAC
        CryptoPrimitiveAlgorithmSecondaryFamily = CRYPTO_ALGOFAM_NOT_SET
        CryptoPrimitiveService = MAC_VERIFY
    CryptoKeyElements_0 (CryptoKeyElements)
      CryptoKeyElement_CMAC (CryptoKeyElement):
        CryptoKeyElementAllowPartialAccess = false
        CryptoKeyElementFormat = CRYPTO_KE_FORMAT_BIN_OCTET
        CryptoKeyElementId = 1
        CryptoKeyElementPersist = false
        CryptoKeyElementReadAccess = CRYPTO_RA_ALLOWED
        CryptoKeyElementSize = 16
        CryptoKeyElementWriteAccess = CRYPTO_WA_ALLOWED
      CryptoKeyElement_CIPHER_IV (CryptoKeyElement):
        CryptoKeyElementAllowPartialAccess = false
        CryptoKeyElementFormat = CRYPTO_KE_FORMAT_BIN_OCTET
        CryptoKeyElementId = 5
        CryptoKeyElementPersist = false
        CryptoKeyElementReadAccess = CRYPTO_RA_ALLOWED
        CryptoKeyElementSize = 16
        CryptoKeyElementWriteAccess = CRYPTO_WA_ALLOWED
    CryptoKeyTypes
      CryptoKeyType_CMAC (CryptoKeyType): CryptoKeyElementRef=CryptoKeyElement_CMAC, CryptoKeyElementRef=CryptoKeyElement_CIPHER_IV
