AUTOSAR XML (schema 00048)
package /R7F7015833
  module config Nm
    NmChannelConfig_0 (NmChannelConfig):
      NmChannelSleepMaster = false
      NmPassiveModeEnabled = false
      NmStateReportEnabled = false
      NmSynchronizingNetwork = false
      NmComUserDataSupport = true
      NmComMChannelRef = ComMChannel_0
      NmBusType
        NmStandardBusNmConfig: NmStandardBusType=NM_BUSNM_CANNM
    NmGlobalConfig
      NmGlobalConstants: NmNumberOfChannels=1
      NmGlobalFeatures:
        NmBusSynchronizationEnabled = false
        NmCarWakeUpRxEnabled = false
        NmComControlEnabled = true
        NmCoordinatorSupportEnabled = false
        NmCoordinatorSyncSupport = false
        NmPduRxIndicationEnabled = true
        NmRemoteSleepIndEnabled = false
        NmStateChangeIndEnabled = false
        NmUserDataEnabled = false
      NmGlobalProperties: NmDevErrorDetect=false, NmVersionInfoApi=false
