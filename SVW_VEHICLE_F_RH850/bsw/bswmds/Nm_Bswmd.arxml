AUTOSAR XML (schema 00048)
package /AUTOSAR/BswOverviews
  bsw module description Nm: category=BSW_MODULE, module-id=29
    bsw internal behavior NmBehavior
      exclusive area Coordinator
      exclusive area IRA
      bsw schedulable entity Nm_MainFunction
package /AUTOSAR/BswImplementations
  bsw implementation NmImplementation: programming-language=C, sw-version=1.0.0, vendor-id=62, ar-release-version=1.0.0, behavior=NmBehavior
    code-descriptors:
      code Code: artifact-descriptors=autosar-engineering-object={short-label=Label, category=Category}
    resource consumption resourceConsumption
