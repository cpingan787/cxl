AUTOSAR XML (schema 00048)
package /AUTOSAR/BswOverviews
  bsw module description SecOC: implemented-entrys=[SecOC_MainFunctionRx, SecOC_MainFunctionTx]
    bsw internal behavior IB_SecOC: bsw-distinguished-partition
      exclusive area TxData
      exclusive area RxData
      exclusive area Authentication
      bsw schedulable entity SE_SecOC_MainFunctionRx: reentrancy-level=NON-REENTRANT, implemented-entry=SecOC_MainFunctionRx
      bsw schedulable entity SE_SecOC_MainFunctionTx: reentrancy-level=NON-REENTRANT, implemented-entry=SecOC_MainFunctionTx
      bsw timing event TE_SecOC_MainFunctionRx: starts-on-event=SE_SecOC_MainFunctionRx, period=0.05
      bsw timing event TE_SecOC_MainFunctionTx: starts-on-event=SE_SecOC_MainFunctionTx, period=0.05
package /AUTOSAR/BswImplementations
  bsw implementation Imp_SecOC: programming-language=C, sw-version=1.0.0, vendor-id=62, ar-release-version=1.0.0, behavior=IB_SecOC
package /AUTOSAR/BswInterfaces
  bsw module entry SecOC_MainFunctionRx: service-id=6, is-synchronous=true, call-type=SCHEDULED, execution-context=TASK, sw-service-impl-policy=STANDARD
  bsw module entry SecOC_MainFunctionTx: service-id=3, is-synchronous=true, call-type=SCHEDULED, execution-context=TASK, sw-service-impl-policy=STANDARD
