AUTOSAR XML (schema 00048)
package /AUTOSAR/BswImplementations
  bsw implementation Imp_Crypto_ISoft: programming-language=C, sw-version=1.0.0, vendor-id=62, ar-release-version=4.8.0, behavior=IB_Crypto_ISoft
package /AUTOSAR/BswOverviews
  bsw module description Crypto_ISoft: implemented-entrys=Crypto_ISoft_MainFunction
    bsw internal behavior IB_Crypto_ISoft
      bsw schedulable entity SE_Crypto_ISoft_MainFunction: implemented-entry=Crypto_ISoft_MainFunction
      bsw timing event TE_Crypto_ISoft_MainFunction: starts-on-event=SE_Crypto_ISoft_MainFunction, period=0.05
package /AUTOSAR/BswInterfaces
  bsw module entry Crypto_ISoft_MainFunction: service-id=12, is-synchronous=true, call-type=SCHEDULED, execution-context=TASK, sw-service-impl-policy=STANDARD
