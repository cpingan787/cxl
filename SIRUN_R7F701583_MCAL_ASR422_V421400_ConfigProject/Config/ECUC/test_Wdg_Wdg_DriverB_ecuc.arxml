AUTOSAR XML (schema 00049)
package /ActiveEcuC
  module config Wdg_DriverB: definition=Wdg, implementation-config-variant=VARIANT-POST-BUILD-LOADABLE, module-description=Wdg_Impl
    WdgGeneral_DriverB (WdgGeneral):
      WdgCriticalSectionProtection = true
      WdgDevErrorDetect = false
      WdgDeviceName = R7F701583
      WdgDisableAllowed = false
      WdgEnableClkImmediateValue = true
      WdgErrorModeSetting = WDG_RESET_MODE
      WdgIndex = 1
      WdgInitialTimeout = 1
      WdgMaxTimeout = 5
      WdgRamMirror = DISABLE
      WdgRunArea = RAM
      WdgTriggerLocation = NULL
      WdgUseWriteVerifyErrorInterface = false
      WdgVaryingActivationCodeMode = DISABLE
      WdgVersionCheckExternalModules = true
      WdgVersionInfoApi = false
      WdgWakeUpFactorClearIsr = false
      WdgWindowSizeSelection = SIZE_100_PERCENT
      WdgWriteVerify = WV_DISABLE
      WdgClockRefImmediateValue = WDTATCKI_240000Hz
      WdgWriteVerifyErrorInterface = ReportError_DriverB
      WdgClockRef = McuIsoLrosc0
    WdgPublishedInformation: WdgTriggerMode=WDG_WINDOW
    WdgSettingsConfig: WdgDefaultMode=WDGIF_SLOW_MODE
      WdgSettingsFast: WdgClkSettingsFast=WDGCLK_DIVBY_2POWOF_9
      WdgSettingsOff
      WdgSettingsSlow: WdgClkSettingsSlow=WDGCLK_DIVBY_2POWOF_16
