AUTOSAR XML (schema 00049)
package /ActiveEcuC
  module config Gpt: implementation-config-variant=VARIANT-POST-BUILD, module-description=Gpt_Impl
    GptDriverConfiguration:
      GptDevErrorDetect = false
      GptPredefTimer100us32bitEnable = true
      GptPredefTimer1usEnablingGrade = GPT_PREDEF_TIMER_1US_16_24_32BIT_ENABLED
      GptPredefTimerHarwareUnitSelection = OSTM4
      GptReportWakeupSource = false
      GptCriticalSectionProtection = true
      GptDeviceName = R7F701583
      GptClearPendingInterrupts = true
      GptVersionCheckExternalModules = true
      GptAlreadyInitDetCheck = true
      GptTimerOutputEnable = true
      GptOSTMWriteVerify = WV_INIT_RUNTIME
      GptTAUDBWriteVerify = WV_INIT_RUNTIME
      GptTAUJWriteVerify = WV_INIT_RUNTIME
      GptWUFWriteVerify = WV_DISABLE
      GptOSTMRamMirror = ENABLE
      GptTAUDBRamMirror = ENABLE
      GptTAUJRamMirror = ENABLE
      GptUseWriteVerifyErrorInterface = true
      GptWakeUpFactorClearIsr = false
      GptWriteVerifyErrorInterface = Gpt_WriteVerifyErrorCallback
      CpuClkFreqRefImmediateValue = 16000000
      GptEnableClkImmediateValue = false
      GptTimeOutWaitingTime = 2
      GptOSTMClkRefPoint = McuClockReferencePoint0
      GptClockReferencePoint: GptClockReference=McuClockReferencePoint0, CpuClockFrequencyRef=McuClockSettingConfig0
    GptConfigurationOfOptApiServices:
      GptDeinitApi = true
      GptEnableDisableNotificationApi = true
      GptTimeElapsedApi = true
      GptTimeRemainingApi = true
      GptVersionInfoApi = true
      GptWakeupFunctionalityApi = false
    GptChannelConfigSet0 (GptChannelConfigSet)
      GptChannelConfiguration0 (GptChannelConfiguration):
        GptChannelId = 0
        GptTimerInputSelection = TAUD0I9
        GptChannelMode = GPT_CH_MODE_CONTINUOUS
        GptChannelTickFrequency = 0
        GptChannelTickValueMax = 0
        GptEnableWakeup = false
        GptChannelClk = CK0
        GptNotification = Gpt_Notification_0
        GptChannelClkSrcRef = GptClockReferencePoint
      3 x GptTaUnit, all with GptPrescalerCk3BaudRate=255:
        GptTaUnit0: GptTaUnitSelection=TAUD0, GptPrescalerCk0=PCLK_DIVBY_2_POWOF_02, GptPrescalerCk1=PCLK_DIVBY_2_POWOF_02, GptPrescalerCk2=PCLK_DIVBY_2_POWOF_02, GptPrescalerCk3Pre=PCLK_DIVBY_2_POWOF_02, GptTauUnitClkRefPoint=McuIsoPeri10
        GptTaUnit1: GptTaUnitSelection=TAUB0, GptPrescalerCk0=PCLK_DIVBY_2_POWOF_04, GptPrescalerCk1=PCLK_DIVBY_2_POWOF_05, GptPrescalerCk2=PCLK_DIVBY_2_POWOF_09, GptPrescalerCk3Pre=PCLK_DIVBY_2_POWOF_15, GptTauUnitClkRefPoint=McuIsoPeri10
        GptTaUnit2: GptTaUnitSelection=TAUJ0, GptPrescalerCk0=PCLK_DIVBY_2_POWOF_00, GptPrescalerCk1=PCLK_DIVBY_2_POWOF_15, GptPrescalerCk2=PCLK_DIVBY_2_POWOF_15, GptPrescalerCk3Pre=PCLK_DIVBY_2_POWOF_15, GptTauUnitClkRefPoint=McuAwoTauj0
      7 x GptChannelConfiguration, all with GptChannelMode=GPT_CH_MODE_CONTINUOUS, GptChannelTickFrequency=0, GptChannelTickValueMax=0, GptEnableWakeup=false, GptChannelClk=CK0, GptChannelClkSrcRef=GptClockReferencePoint:
        GptChannelConfiguration1: GptChannelId=1, GptTimerInputSelection=TAUD0I8, GptNotification=NULL
        GptChannelConfiguration2: GptChannelId=2, GptTimerInputSelection=TAUB0I12, GptNotification=Gpt_Notification_1
        GptChannelConfiguration3: GptChannelId=3, GptTimerInputSelection=TAUJ0I0, GptNotification=Gpt_Notification_2
        GptChannelConfiguration4: GptChannelId=4, GptTimerInputSelection=OSTM0, GptNotification=Gpt_Notification_0
        GptChannelConfiguration5: GptChannelId=5, GptTimerInputSelection=OSTM1, GptNotification=Gpt_Notification_0
        GptChannelConfiguration6: GptChannelId=6, GptTimerInputSelection=OSTM2, GptNotification=Gpt_Notification_0
        GptChannelConfiguration7: GptChannelId=7, GptTimerInputSelection=OSTM3, GptNotification=Gpt_Notification_0
    GptDemEventParameterRefs: GPT_E_TIMEOUT_FAILURE=DemEventParameter0, GPT_E_REG_WRITE_VERIFY=DemEventParameter1
