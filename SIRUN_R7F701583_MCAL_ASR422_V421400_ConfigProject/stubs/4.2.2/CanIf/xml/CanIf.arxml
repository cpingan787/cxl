AUTOSAR XML (schema 4-2-2)
package /Renesas/EcucDefs_CanIf
  ecuc value collection ECUConfiguration: ecuc-values=CanIf0
  module config CanIf0: definition=CanIf, implementation-config-variant=VARIANT-PRE-COMPILE
    CanIfCtrlDrvCfg0 (CanIfCtrlDrvCfg): CanIfCtrlDrvRxIndication=0, CanIfCtrlDrvTxCancellation=0, CanIfCtrlDrvTxConfirmation=0, CanIfCtrlDrvInitHohConfigRef=64, CanIfCtrlDrvNameRef=Can0
      CanIfCtrlCfg0 (CanIfCtrlCfg): CanIfCtrlId=0, CanIfCtrlWakeupSupport=0, CanIfCtrlCanCtrlIdRef=0, CanIfCtrlWakeupSourceInRef=, CanIfCtrlWakeupSourceOutRef=
    CanIfDispatchCfg0 (CanIfDispatchCfg):
      CanIfDispatchUserCtrlBusOffName = 
      CanIfDispatchUserCtrlBusOffUL = CAN_SM
      CanIfDispatchUserCtrlModeIndicationName = 
      CanIfDispatchUserCtrlModeIndicationUL = CAN_SM
      CanIfDispatchUserSetWakeupEventName = 
      CanIfDispatchUserSetWakeupEventUL = 
      CanIfDispatchUserTrcvModeIndicationName = 
      CanIfDispatchUserTrcvModeIndicationUL = 
      CanIfDispatchUserValidateWakeupEventName = 
      CanIfDispatchUserValidateWakeupEventUL = 
    CanIfInitCfg0 (CanIfInitCfg): CanIfInitCfgSet=CanConfigSet_0
    CanIfPrivateCfg0 (CanIfPrivateCfg): CanIfPrivateDlcCheck=1, CanIfPrivateSoftwareFilterType=INDEX, CanIfSupportTTCAN=0
    CanIfPublicCfg0 (CanIfPublicCfg):
      CanIfPublicCancelTransmitSupport = 0
      CanIfPublicCddHeaderFile = 
      CanIfPublicDevErrorDetect = 1
      CanIfPublicHandleTypeEnum = UINT8
      CanIfPublicMultipleDrvSupport = 1
      CanIfPublicNumberOfCanHwUnits = 1
      CanIfPublicReadRxPduDataApi = 0
      CanIfPublicReadRxPduNotifyStatusApi = 0
      CanIfPublicReadTxPduNotifyStatusApi = 0
      CanIfPublicSetDynamicTxIdApi = 0
      CanIfPublicTxBuffering = 0
      CanIfPublicTxConfirmPollingSupport = 0
      CanIfPublicVersionInfoApi = 1
      CanIfPublicWakeupCheckValidApi = 0
      CanIfPublicWakeupCheckValidByNM = 0
