AUTOSAR XML (schema 00048)
package /AUTOSAR/BswOverviews
  bsw module description Com: implemented-entrys=[Com_MainFunctionRx_ComMainFunctionRx, Com_MainFunctionTx_ComMainFunctionTx], module-id=50
    bsw internal behavior IB_Com
      exclusive area MultiCore_Lock
      exclusive area Context
      bsw schedulable entity SE_ComMainFunctionRx: reentrancy-level=NON-REENTRANT, implemented-entry=Com_MainFunctionRx_ComMainFunctionRx
      bsw schedulable entity SE_ComMainFunctionTx: reentrancy-level=NON-REENTRANT, implemented-entry=Com_MainFunctionTx_ComMainFunctionTx
      bsw timing event TE_ComMainFunctionRx: starts-on-event=SE_ComMainFunctionRx, period=0.005
      bsw timing event TE_ComMainFunctionTx: starts-on-event=SE_ComMainFunctionTx, period=0.005
package /AUTOSAR/BswImplementations
  bsw implementation Imp_Com_IB_Com: programming-language=C, sw-version=2.1.2, vendor-id=62, ar-release-version=4.5.0, behavior=IB_Com
    code-descriptors:
      code code_IB_Com: artifact-descriptors=autosar-engineering-object={short-label=ComStack_Types.h, category=SWHDR}
package /AUTOSAR/BswInterfaces
  bsw module entry Com_MainFunctionRx_ComMainFunctionRx: service-id=24, is-reentrant=true, is-synchronous=true, call-type=SCHEDULED, execution-context=TASK, sw-service-impl-policy=STANDARD
  bsw module entry Com_MainFunctionTx_ComMainFunctionTx: service-id=25, is-reentrant=true, is-synchronous=true, call-type=SCHEDULED, execution-context=TASK, sw-service-impl-policy=STANDARD
