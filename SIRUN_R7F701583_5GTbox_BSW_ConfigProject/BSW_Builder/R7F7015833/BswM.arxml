AUTOSAR XML (schema 00048)
package /R7F7015833
  module config BswM
    BswMGeneral:
      BswMCanSMEnabled = true
      BswMCanSMIcomEnabled = false
      BswMComMEnabled = true
      BswMComMPncEnabled = false
      BswMDcmEnabled = true
      BswMDevErrorDetect = true
      BswMEcuMEnabled = true
      BswMEthSMEnabled = false
      BswMFrSMEnabled = false
      BswMGenericRequestEnabled = true
      BswMJ1939DcmEnabled = false
      BswMJ1939NmEnabled = false
      BswMLinSMEnabled = false
      BswMLinTPEnabled = false
      BswMNmEnabled = true
      BswMNvMEnabled = false
      BswMSchMEnabled = false
      BswMSdEnabled = false
      BswMVersionInfoApi = false
      BswMWdgMEnabled = false
      BswMTimerEnabled = true
      BswMMainFunctionPeriod = 0.01
      BswMUserIncludeFiles: BswMUserIncludeFile=BswM_Ext.h
    BswMConfig
      BswMArbitration
        12 x BswMLogicalExpression:
          LE_NO_COM_CanChannel_0: BswMArgumentRef=Cond_CanSMIndication_CanChannel_0_EQ_CANSM_BSWM_NO_COMMUNICATION
          LE_BUSOFF_SILENT_CanChannel_0: BswMLogicalOperator=BSWM_OR, BswMArgumentRef=Cond_CanSMIndication_CanChannel_0_EQ_CANSM_BSWM_BUS_OFF, BswMArgumentRef=Cond_CanSMIndication_CanChannel_0_EQ_CANSM_BSWM_SILENT_COMMUNICATION
          LE_EcuM_WakeupSourceClear_EcuMWakeupSource_CAN: BswMArgumentRef=Cond_EcuMWakeupIndication_EcuMWakeupSource_CAN_HCML_EQ_ECUM_WKSTATUS_VALIDATED
          LE_EcuM_RequestStatus_RUN_REQUEST: BswMArgumentRef=Cond_EcuMWakeupIndication_EcuMRequstRun_EQ_ECUM_RUNSTATUS_REQUESTED
          LE_EcuM_RequestStatus_RUN_RELEASE: BswMArgumentRef=Cond_EcuMWakeupIndication_EcuMRequstRun_EQ_ECUM_RUNSTATUS_RELEASED
          LE_EcuM_RequestStatus_POSTRUN_REQ_AND_RUN_REL: BswMLogicalOperator=BSWM_AND, BswMArgumentRef=Cond_EcuMWakeupIndication_EcuMRequstPostRun_EQ_ECUM_RUNSTATUS_REQUESTED, BswMArgumentRef=Cond_EcuMWakeupIndication_EcuMRequstRun_EQ_ECUM_RUNSTATUS_RELEASED
          LE_EcuM_WakeupSourcePending: BswMLogicalOperator=BSWM_OR, BswMArgumentRef=Cond_EcuMWakeupIndication_EcuMWakeupSource_CAN_HCML_EQ_ECUM_WKSTATUS_PENDING, BswMArgumentRef=Cond_EcuMWakeupIndication_EcuMWakeupSource_LOCAL_HCML_EQ_ECUM_WKSTATUS_PENDING
          LE_RX_CanChannel_0: BswMArgumentRef=Cond_CanSMIndication_CanChannel_0_NEQ_CANSM_BSWM_NO_COMMUNICATION
          LE_RX_DM_CanChannel_0: BswMArgumentRef=Cond_CanSMIndication_CanChannel_0_EQ_CANSM_BSWM_FULL_COMMUNICATION
          LE_TX_DISABLE_CanChannel_0: BswMArgumentRef=Cond_CanSMIndication_CanChannel_0_NEQ_CANSM_BSWM_FULL_COMMUNICATION
          LE_TX_ENABLE_CanChannel_0: BswMLogicalOperator=BSWM_AND, BswMArgumentRef=Cond_CanSMIndication_CanChannel_0_EQ_CANSM_BSWM_FULL_COMMUNICATION, BswMArgumentRef=Cond_GerericCanSMBusOff_CanChannel_0_EQ_GENERIC_CANSMBUSOFF_BUSOFF_SILENT
          LE_TX_ENABLE_REINIT_CanChannel_0: BswMLogicalOperator=BSWM_AND, BswMArgumentRef=Cond_CanSMIndication_CanChannel_0_EQ_CANSM_BSWM_FULL_COMMUNICATION, BswMArgumentRef=Cond_GerericCanSMBusOff_CanChannel_0_EQ_GENERIC_CANSMBUSOFF_NO_COM
        15 x BswMModeCondition:
          Cond_CanSMIndication_CanChannel_0_EQ_CANSM_BSWM_BUS_OFF: BswMConditionType=BSWM_EQUALS, BswMConditionMode=ReqPort_CanSm_CanChannel_0
            BswMConditionValue
              BswMBswMode: BswModeCompareValue=CANSM_BSWM_BUS_OFF
          Cond_CanSMIndication_CanChannel_0_EQ_CANSM_BSWM_NO_COMMUNICATION: BswMConditionType=BSWM_EQUALS, BswMConditionMode=ReqPort_CanSm_CanChannel_0
            BswMConditionValue
              BswMBswMode: BswModeCompareValue=CANSM_BSWM_NO_COMMUNICATION
          Cond_CanSMIndication_CanChannel_0_EQ_CANSM_BSWM_SILENT_COMMUNICATION: BswMConditionType=BSWM_EQUALS, BswMConditionMode=ReqPort_CanSm_CanChannel_0
            BswMConditionValue
              BswMBswMode: BswModeCompareValue=CANSM_BSWM_SILENT_COMMUNICATION
          Cond_CanSMIndication_CanChannel_0_EQ_CANSM_BSWM_FULL_COMMUNICATION: BswMConditionType=BSWM_EQUALS, BswMConditionMode=ReqPort_CanSm_CanChannel_0
            BswMConditionValue
              BswMBswMode: BswModeCompareValue=CANSM_BSWM_FULL_COMMUNICATION
          Cond_CanSMIndication_CanChannel_0_NEQ_CANSM_BSWM_FULL_COMMUNICATION: BswMConditionType=BSWM_EQUALS_NOT, BswMConditionMode=ReqPort_CanSm_CanChannel_0
            BswMConditionValue
              BswMBswMode: BswModeCompareValue=CANSM_BSWM_FULL_COMMUNICATION
          Cond_CanSMIndication_CanChannel_0_NEQ_CANSM_BSWM_NO_COMMUNICATION: BswMConditionType=BSWM_EQUALS_NOT, BswMConditionMode=ReqPort_CanSm_CanChannel_0
            BswMConditionValue
              BswMBswMode: BswModeCompareValue=CANSM_BSWM_NO_COMMUNICATION
          Cond_GerericCanSMBusOff_CanChannel_0_EQ_GENERIC_CANSMBUSOFF_NO_COM: BswMConditionType=BSWM_EQUALS, BswMConditionMode=ReqPort_GenericCanSmBusOff_CanChannel_0
            BswMConditionValue
              BswMBswMode: BswMBswRequestedMode=0
          Cond_GerericCanSMBusOff_CanChannel_0_EQ_GENERIC_CANSMBUSOFF_BUSOFF_SILENT: BswMConditionType=BSWM_EQUALS, BswMConditionMode=ReqPort_GenericCanSmBusOff_CanChannel_0
            BswMConditionValue
              BswMBswMode: BswMBswRequestedMode=1
          Cond_EcuMWakeupIndication_EcuMWakeupSource_CAN_HCML_EQ_ECUM_WKSTATUS_NONE: BswMConditionType=BSWM_EQUALS, BswMConditionMode=ReqPort_EcuM_EcuMWakeupSource_CAN
            BswMConditionValue
              BswMBswMode: BswModeCompareValue=ECUM_WKSTATUS_NONE
          Cond_EcuMWakeupIndication_EcuMWakeupSource_CAN_HCML_EQ_ECUM_WKSTATUS_PENDING: BswMConditionType=BSWM_EQUALS, BswMConditionMode=ReqPort_EcuM_EcuMWakeupSource_CAN
            BswMConditionValue
              BswMBswMode: BswModeCompareValue=ECUM_WKSTATUS_PENDING
          Cond_EcuMWakeupIndication_EcuMWakeupSource_CAN_HCML_EQ_ECUM_WKSTATUS_VALIDATED: BswMConditionType=BSWM_EQUALS, BswMConditionMode=ReqPort_EcuM_EcuMWakeupSource_CAN
            BswMConditionValue
              BswMBswMode: BswModeCompareValue=ECUM_WKSTATUS_VALIDATED
          Cond_EcuMWakeupIndication_EcuMWakeupSource_CAN_HCML_EQ_ECUM_WKSTATUS_EXPIRED: BswMConditionType=BSWM_EQUALS, BswMConditionMode=ReqPort_EcuM_EcuMWakeupSource_CAN
            BswMConditionValue
              BswMBswMode: BswModeCompareValue=ECUM_WKSTATUS_EXPIRED
          Cond_EcuMWakeupIndication_EcuMRequstPostRun_EQ_ECUM_RUNSTATUS_REQUESTED: BswMConditionType=BSWM_EQUALS, BswMConditionMode=ReqPort_EcuM_ReqPostRun
            BswMConditionValue
              BswMBswMode: BswModeCompareValue=ECUM_RUNSTATUS_REQUESTED
          Cond_EcuMWakeupIndication_EcuMRequstPostRun_EQ_ECUM_RUNSTATUS_RELEASED: BswMConditionType=BSWM_EQUALS, BswMConditionMode=ReqPort_EcuM_ReqPostRun
            BswMConditionValue
              BswMBswMode: BswModeCompareValue=ECUM_RUNSTATUS_RELEASED
          Cond_EcuMWakeupIndication_EcuMRequstRun_EQ_ECUM_RUNSTATUS_REQUESTED: BswMConditionType=BSWM_EQUALS, BswMConditionMode=ReqPort_EcuM_ReqRun
            BswMConditionValue
              BswMBswMode: BswModeCompareValue=ECUM_RUNSTATUS_REQUESTED
        6 x BswMModeRequestPort, all with BswMRequestProcessing=BSWM_IMMEDIATE:
          ReqPort_CanSm_CanChannel_0
            BswMModeRequestSource
              BswMCanSMIndication: BswMCanSMChannelRef=ComMChannel_0
          ReqPort_GenericCanSmBusOff_CanChannel_0
            BswMModeRequestSource
              BswMGenericRequest: BswMModeRequesterId=240
          ReqPort_EcuM_EcuMWakeupSource_CAN
            BswMModeRequestSource
              BswMEcuMWakeupSource: BswMEcuMWakeupSrcRef=EcuMWakeupSource_CAN
          ReqPort_EcuM_ReqPostRun
            BswMModeRequestSource
              BswMEcuMRUNRequestIndication: BswMEcuMRUNRequestProtocolPort=POST_RUN
          ReqPort_EcuM_ReqRun
            BswMModeRequestSource
              BswMEcuMRUNRequestIndication: BswMEcuMRUNRequestProtocolPort=RUN
          ReqPort_ComM_CanChannel_0
            BswMModeRequestSource
              BswMComMIndication: BswMComMChannelRef=ComMChannel_0
        7 x BswMRule, all with BswMNestedExecutionOnly=false:
          Rule_EcuM_WakeupSourceClear_EcuMWakeupSource_CAN: BswMRuleInitState=BSWM_FALSE, BswMRuleExpressionRef=LE_EcuM_WakeupSourceClear_EcuMWakeupSource_CAN, BswMRuleTrueActionList=AL_EcuM_ClearWakeUpSource_EcuMWakeupSource_CAN
          Rule_EcuM_RequestStatus_RUN: BswMRuleInitState=BSWM_FALSE, BswMRuleExpressionRef=LE_EcuM_RequestStatus_RUN_REQUEST, BswMRuleTrueActionList=AL_EcuM_RequestStatus_RUN
          Rule_EcuM_RequestStatus_POSTRUN: BswMRuleInitState=BSWM_FALSE, BswMRuleExpressionRef=LE_EcuM_RequestStatus_POSTRUN_REQ_AND_RUN_REL
          Rule_EcuM_WakeupSourcePending: BswMRuleInitState=BSWM_FALSE, BswMRuleExpressionRef=LE_EcuM_WakeupSourcePending, BswMRuleTrueActionList=AL_EcuM_WakeupSourcePending
          Rule_RX_CanChannel_0: BswMRuleInitState=BSWM_FALSE, BswMRuleExpressionRef=LE_RX_CanChannel_0, BswMRuleFalseActionList=AL_RxDisableGroupSwitch_CanChannel_0, BswMRuleTrueActionList=AL_RxEnableGroupSwitch_CanChannel_0
          Rule_RX_DM_CanChannel_0: BswMRuleInitState=BSWM_FALSE, BswMRuleExpressionRef=LE_RX_DM_CanChannel_0, BswMRuleFalseActionList=AL_RxDisableDM_CanChannel_0, BswMRuleTrueActionList=AL_RxEnableDM_CanChannel_0
          Rule_NO_COM_CanChannel_0: BswMRuleInitState=BSWM_TRUE, BswMRuleExpressionRef=LE_NO_COM_CanChannel_0, BswMRuleTrueActionList=AL_GenericCanSmBusOff_NO_COM_CanChannel_0
        RepPort_GerericComControl (BswMModeRequestPort): BswMRequestProcessing=BSWM_IMMEDIATE
          BswMModeRequestSource
            BswMGenericRequest: BswMModeRequesterId=66
        BswMModeInitValue:
          BswMCanSMIndicationInitState = CANSM_BSWM_NO_COMMUNICATION
          BswMGenericRequestInitMode = 0
          BswMComMIndicationInitMode = COMM_NO_COMMUNICATION
          BswMDcmComModeRequestInitMode = DCM_ENABLE_RX_TX_NORM_NM
          BswMEcuMWakeupSourceInitstate = ECUM_WKSTATUS_NONE
          BswMEcuMRUNRequestIndicationInitStatus = ECUM_RUNSTATUS_RELEASED
          BswMComMPncRequestInitMode = COMM_PNC_NO_COMMUNICATION
          BswMNvMJobModeIndicationInitMode = NVM_REQ_PENDING
        3 x BswMModeCondition, all with BswMConditionType=BSWM_EQUALS:
          Cond_EcuMWakeupIndication_EcuMRequstRun_EQ_ECUM_RUNSTATUS_RELEASED: BswMConditionMode=ReqPort_EcuM_ReqRun
            BswMConditionValue
              BswMBswMode: BswModeCompareValue=ECUM_RUNSTATUS_RELEASED
          Cond_ComMIndication_CanChannel_0_EQ_COMM_NO_COMMUNICATION: BswMConditionMode=ReqPort_ComM_CanChannel_0
            BswMConditionValue
              BswMBswMode: BswModeCompareValue=COMM_NO_COMMUNICATION
          Cond_Generic_EQ_GENERIC_COMCONTROL_ON: BswMConditionMode=RepPort_GerericComControl
            BswMConditionValue
              BswMBswMode: BswMBswRequestedMode=1
        3 x BswMLogicalExpression:
          LE_EcuM_ClearExpiredWakeUpSource_CAN: BswMLogicalOperator=BSWM_AND, BswMArgumentRef=Cond_CanSMIndication_CanChannel_0_EQ_CANSM_BSWM_NO_COMMUNICATION, BswMArgumentRef=Cond_EcuMWakeupIndication_EcuMWakeupSource_CAN_HCML_EQ_ECUM_WKSTATUS_EXPIRED
          LE_ComM_AllChanel_NO_COM: BswMArgumentRef=Cond_CanSMIndication_CanChannel_0_EQ_CANSM_BSWM_NO_COMMUNICATION
          LE_GenericComControl: BswMArgumentRef=Cond_Generic_EQ_GENERIC_COMCONTROL_ON
        4 x BswMRule, all with BswMNestedExecutionOnly=false:
          Rule_BUSOFF_SILENT_CanChannel_0: BswMRuleInitState=BSWM_FALSE, BswMRuleExpressionRef=LE_BUSOFF_SILENT_CanChannel_0, BswMRuleTrueActionList=AL_GenericCanSmBusOff_BUSOFF_SILENT_CanChannel_0
          Rule_ComM_AllChanel_NO_COM: BswMRuleInitState=BSWM_TRUE, BswMRuleExpressionRef=LE_ComM_AllChanel_NO_COM, BswMRuleTrueActionList=AL_ComM_AllChanel_NO_COM
          Rule_EcuM_ClearExpiredWakeUpSource_CAN: BswMRuleInitState=BSWM_FALSE, BswMRuleExpressionRef=LE_EcuM_ClearExpiredWakeUpSource_CAN, BswMRuleTrueActionList=AL_EcuM_ClearExpiredWakeUpSource_CAN
          Rule_Generic_ComControl: BswMRuleInitState=BSWM_TRUE, BswMRuleExpressionRef=LE_GenericComControl, BswMRuleFalseActionList=AL_ComControl_OFF, BswMRuleTrueActionList=AL_ComControl_ON
        BswMEventRequestPort_0 (BswMEventRequestPort): BswMEventRequestProcessing=BSWM_IMMEDIATE
          BswMEventRequestSource
            BswMComMInitiateReset
        ReqPort_BswMTimer (BswMModeRequestPort): BswMRequestProcessing=BSWM_DEFERRED
          BswMModeRequestSource
            BswMTimer
        Cond_WriteAll_Timer_EQ_EXPIRED (BswMModeCondition): BswMConditionType=BSWM_EQUALS, BswMConditionMode=ReqPort_BswMTimer
          BswMConditionValue
            BswMBswMode: BswModeCompareValue=BSWM_TIMER_EXPIRED
        Rule_BSW_Module_Init (BswMRule): BswMNestedExecutionOnly=false, BswMRuleInitState=BSWM_FALSE, BswMRuleExpressionRef=LE_BSW_Module_Init, BswMRuleTrueActionList=AL_StartUp
        ReqPort_EcuMStateIndication (BswMModeRequestPort): BswMRequestProcessing=BSWM_IMMEDIATE
          BswMModeRequestSource
            BswMEcuMIndication
        Cond_EcuMState_EQ_STARTUP (BswMModeCondition): BswMConditionType=BSWM_EQUALS, BswMConditionMode=ReqPort_EcuMStateIndication
          BswMConditionValue
            BswMBswMode: BswModeCompareValue=ECUM_STATE_STARTUP
        LE_BSW_Module_Init (BswMLogicalExpression): BswMArgumentRef=Cond_EcuMState_EQ_STARTUP
        Cond_ReadAll_Timer_EQ_EXPIRED (BswMModeCondition): BswMConditionType=BSWM_EQUALS, BswMConditionMode=ReqPort_BswMTimer
          BswMConditionValue
            BswMBswMode: BswModeCompareValue=BSWM_TIMER_EXPIRED
        LE_ComM_AllChanel_FULL_COM (BswMLogicalExpression): BswMArgumentRef=Cond_CanSMIndication_CanChannel_0_EQ_CANSM_BSWM_FULL_COMMUNICATION
        3 x BswMModeCondition, all with BswMConditionType=BSWM_EQUALS:
          Cond_Generic_EQ_ECU_SLEEP_Allowed: BswMConditionMode=RepPort_ECUSleepControl
            BswMConditionValue
              BswMBswMode: BswMBswRequestedMode=1
          Cond_EcuMState_EQ_ECUM_STATE_POSTRUN: BswMConditionMode=ReqPort_EcuMStateIndication
            BswMConditionValue
              BswMBswMode: BswModeCompareValue=ECUM_STATE_APP_POST_RUN
          Cond_EcuMState_EQ_ECUM_STATE_SHUTDOWN: BswMConditionMode=ReqPort_EcuMStateIndication
            BswMConditionValue
              BswMBswMode: BswModeCompareValue=ECUM_STATE_SHUTDOWN
        RepPort_ECUSleepControl (BswMModeRequestPort): BswMRequestProcessing=BSWM_IMMEDIATE
          BswMModeRequestSource
            BswMGenericRequest: BswMModeRequesterId=95
        4 x BswMRule, all with BswMNestedExecutionOnly=false, BswMRuleInitState=BSWM_FALSE:
          Rule_ComM_AllChanel_FULL_COM: BswMRuleExpressionRef=LE_ComM_AllChanel_FULL_COM
          Rule_TX_DISABLE_CanChannel_0: BswMRuleExpressionRef=LE_TX_DISABLE_CanChannel_0, BswMRuleTrueActionList=AL_TxDisable_CanChannel_0
          Rule_TX_ENABLE_CanChannel_0: BswMRuleExpressionRef=LE_TX_ENABLE_CanChannel_0, BswMRuleTrueActionList=AL_TxEnable_CanChannel_0
          Rule_TX_ENABLE_REINIT_CanChannel_0: BswMRuleExpressionRef=LE_TX_ENABLE_REINIT_CanChannel_0, BswMRuleTrueActionList=AL_TxEnableReInit_CanChannel_0
        4 x BswMLogicalExpression, all with BswMLogicalOperator=BSWM_OR:
          LE_DCM_Normal_Rx_Enable_CanChannel_0: BswMArgumentRef=Cond_DcmIndication_CanChannel_0_EQ_DCM_ENABLE_RX_TX_NORM, BswMArgumentRef=Cond_DcmIndication_CanChannel_0_EQ_DCM_ENABLE_RX_DISABLE_TX_NORM, BswMArgumentRef=Cond_DcmIndication_CanChannel_0_EQ_DCM_ENABLE_RX_TX_NORM_NM, BswMArgumentRef=Cond_DcmIndication_CanChannel_0_EQ_DCM_ENABLE_RX_DISABLE_TX_NORM_NM
          LE_DCM_Normal_Rx_Disable_CanChannel_0: BswMArgumentRef=Cond_DcmIndication_CanChannel_0_EQ_DCM_DISABLE_RX_ENABLE_TX_NORM, BswMArgumentRef=Cond_DcmIndication_CanChannel_0_EQ_DCM_DISABLE_RX_TX_NORMAL, BswMArgumentRef=Cond_DcmIndication_CanChannel_0_EQ_DCM_DISABLE_RX_ENABLE_TX_NORM_NM, BswMArgumentRef=Cond_DcmIndication_CanChannel_0_EQ_DCM_DISABLE_RX_TX_NORM_NM
          LE_DCM_Normal_Tx_Enable_CanChannel_0: BswMArgumentRef=Cond_DcmIndication_CanChannel_0_EQ_DCM_ENABLE_RX_TX_NORM, BswMArgumentRef=Cond_DcmIndication_CanChannel_0_EQ_DCM_DISABLE_RX_ENABLE_TX_NORM, BswMArgumentRef=Cond_DcmIndication_CanChannel_0_EQ_DCM_ENABLE_RX_TX_NORM_NM, BswMArgumentRef=Cond_DcmIndication_CanChannel_0_EQ_DCM_DISABLE_RX_ENABLE_TX_NORM_NM
          LE_DCM_Normal_Tx_Disable_CanChannel_0: BswMArgumentRef=Cond_DcmIndication_CanChannel_0_EQ_DCM_ENABLE_RX_DISABLE_TX_NORM, BswMArgumentRef=Cond_DcmIndication_CanChannel_0_EQ_DCM_DISABLE_RX_TX_NORMAL, BswMArgumentRef=Cond_DcmIndication_CanChannel_0_EQ_DCM_ENABLE_RX_DISABLE_TX_NORM_NM, BswMArgumentRef=Cond_DcmIndication_CanChannel_0_EQ_DCM_DISABLE_RX_TX_NORM_NM
        ReqPort_Dcm_CanChannel_0 (BswMModeRequestPort): BswMRequestProcessing=BSWM_IMMEDIATE
          BswMModeRequestSource
            BswMDcmComModeRequest: BswMDcmComMChannelRef=ComMChannel_0
        LE_DCM_Nm_Tx_Enable_CanChannel_0 (BswMLogicalExpression):
          BswMLogicalOperator = BSWM_OR
          BswMArgumentRef = Cond_DcmIndication_CanChannel_0_EQ_DCM_ENABLE_RX_TX_NM
          BswMArgumentRef = Cond_DcmIndication_CanChannel_0_EQ_DCM_DISABLE_RX_ENABLE_TX_NM
          BswMArgumentRef = Cond_DcmIndication_CanChannel_0_EQ_DCM_ENABLE_RX_TX_NORM_NM
          BswMArgumentRef = Cond_DcmIndication_CanChannel_0_EQ_DCM_DISABLE_RX_ENABLE_TX_NORM_NM
        12 x BswMModeCondition, all with BswMConditionType=BSWM_EQUALS, BswMConditionMode=ReqPort_Dcm_CanChannel_0:
          Cond_DcmIndication_CanChannel_0_EQ_DCM_ENABLE_RX_TX_NORM
            BswMConditionValue
              BswMBswMode: BswModeCompareValue=DCM_ENABLE_RX_TX_NORM
          Cond_DcmIndication_CanChannel_0_EQ_DCM_ENABLE_RX_DISABLE_TX_NORM
            BswMConditionValue
              BswMBswMode: BswModeCompareValue=DCM_ENABLE_RX_DISABLE_TX_NORM
          Cond_DcmIndication_CanChannel_0_EQ_DCM_DISABLE_RX_ENABLE_TX_NORM
            BswMConditionValue
              BswMBswMode: BswModeCompareValue=DCM_DISABLE_RX_ENABLE_TX_NORM
          Cond_DcmIndication_CanChannel_0_EQ_DCM_DISABLE_RX_TX_NORMAL
            BswMConditionValue
              BswMBswMode: BswModeCompareValue=DCM_DISABLE_RX_TX_NORMAL
          Cond_DcmIndication_CanChannel_0_EQ_DCM_ENABLE_RX_TX_NM
            BswMConditionValue
              BswMBswMode: BswModeCompareValue=DCM_ENABLE_RX_TX_NM
          Cond_DcmIndication_CanChannel_0_EQ_DCM_ENABLE_RX_DISABLE_TX_NM
            BswMConditionValue
              BswMBswMode: BswModeCompareValue=DCM_ENABLE_RX_DISABLE_TX_NM
          Cond_DcmIndication_CanChannel_0_EQ_DCM_DISABLE_RX_ENABLE_TX_NM
            BswMConditionValue
              BswMBswMode: BswModeCompareValue=DCM_DISABLE_RX_ENABLE_TX_NM
          Cond_DcmIndication_CanChannel_0_EQ_DCM_DISABLE_RX_TX_NM
            BswMConditionValue
              BswMBswMode: BswModeCompareValue=DCM_DISABLE_RX_TX_NM
          Cond_DcmIndication_CanChannel_0_EQ_DCM_ENABLE_RX_TX_NORM_NM
            BswMConditionValue
              BswMBswMode: BswModeCompareValue=DCM_ENABLE_RX_TX_NORM_NM
          Cond_DcmIndication_CanChannel_0_EQ_DCM_ENABLE_RX_DISABLE_TX_NORM_NM
            BswMConditionValue
              BswMBswMode: BswModeCompareValue=DCM_ENABLE_RX_DISABLE_TX_NORM_NM
          Cond_DcmIndication_CanChannel_0_EQ_DCM_DISABLE_RX_ENABLE_TX_NORM_NM
            BswMConditionValue
              BswMBswMode: BswModeCompareValue=DCM_DISABLE_RX_ENABLE_TX_NORM_NM
          Cond_DcmIndication_CanChannel_0_EQ_DCM_DISABLE_RX_TX_NORM_NM
            BswMConditionValue
              BswMBswMode: BswModeCompareValue=DCM_DISABLE_RX_TX_NORM_NM
        LE_DCM_Nm_Tx_Disable_CanChannel_0 (BswMLogicalExpression):
          BswMLogicalOperator = BSWM_OR
          BswMArgumentRef = Cond_DcmIndication_CanChannel_0_EQ_DCM_ENABLE_RX_DISABLE_TX_NM
          BswMArgumentRef = Cond_DcmIndication_CanChannel_0_EQ_DCM_DISABLE_RX_TX_NM
          BswMArgumentRef = Cond_DcmIndication_CanChannel_0_EQ_DCM_ENABLE_RX_DISABLE_TX_NORM_NM
          BswMArgumentRef = Cond_DcmIndication_CanChannel_0_EQ_DCM_DISABLE_RX_TX_NORM_NM
        6 x BswMRule, all with BswMNestedExecutionOnly=false, BswMRuleInitState=BSWM_FALSE:
          Rule_DCM_Normal_Rx_Enable_CanChannel_0: BswMRuleExpressionRef=LE_DCM_Normal_Rx_Enable_CanChannel_0, BswMRuleTrueActionList=AL_DCM_Normal_Rx_Enable_CanChannel_0
          Rule_DCM_Normal_Rx_Disable_CanChannel_0: BswMRuleExpressionRef=LE_DCM_Normal_Rx_Disable_CanChannel_0, BswMRuleTrueActionList=AL_DCM_Normal_Rx_Disable_CanChannel_0
          Rule_DCM_Normal_Tx_Enable_CanChannel_0: BswMRuleExpressionRef=LE_DCM_Normal_Tx_Enable_CanChannel_0, BswMRuleTrueActionList=AL_DCM_Normal_Tx_Enable_CanChannel_0
          Rule_DCM_Normal_Tx_Disable_CanChannel_0: BswMRuleExpressionRef=LE_DCM_Normal_Tx_Disable_CanChannel_0, BswMRuleTrueActionList=AL_DCM_Normal_Tx_Disable_CanChannel_0
          Rule_DCM_Nm_Tx_Enable_CanChannel_0: BswMRuleExpressionRef=LE_DCM_Nm_Tx_Enable_CanChannel_0, BswMRuleTrueActionList=AL_DCM_Nm_Tx_Enable_CanChannel_0
          Rule_DCM_Nm_Tx_Disable_CanChannel_0: BswMRuleExpressionRef=LE_DCM_Nm_Tx_Disable_CanChannel_0, BswMRuleTrueActionList=AL_DCM_Nm_Tx_Disable_CanChannel_0
        ReqPort_EcuM_EcuMWakeupSource_Local (BswMModeRequestPort): BswMRequestProcessing=BSWM_IMMEDIATE
          BswMModeRequestSource
            BswMEcuMWakeupSource: BswMEcuMWakeupSrcRef=EcuMWakeupSource_Local
        4 x BswMModeCondition, all with BswMConditionType=BSWM_EQUALS, BswMConditionMode=ReqPort_EcuM_EcuMWakeupSource_Local:
          Cond_EcuMWakeupIndication_EcuMWakeupSource_LOCAL_HCML_EQ_ECUM_WKSTATUS_NONE
            BswMConditionValue
              BswMBswMode: BswModeCompareValue=ECUM_WKSTATUS_NONE
          Cond_EcuMWakeupIndication_EcuMWakeupSource_LOCAL_HCML_EQ_ECUM_WKSTATUS_PENDING
            BswMConditionValue
              BswMBswMode: BswModeCompareValue=ECUM_WKSTATUS_PENDING
          Cond_EcuMWakeupIndication_EcuMWakeupSource_LOCAL_HCML_EQ_ECUM_WKSTATUS_VALIDATED
            BswMConditionValue
              BswMBswMode: BswModeCompareValue=ECUM_WKSTATUS_VALIDATED
          Cond_EcuMWakeupIndication_EcuMWakeupSource_LOCAL_HCML_EQ_ECUM_WKSTATUS_EXPIRED
            BswMConditionValue
              BswMBswMode: BswModeCompareValue=ECUM_WKSTATUS_EXPIRED
        LE_EcuM_WakeupSourceClear_EcuMWakeupSource_LOCAL (BswMLogicalExpression): BswMArgumentRef=Cond_EcuMWakeupIndication_EcuMWakeupSource_LOCAL_HCML_EQ_ECUM_WKSTATUS_VALIDATED
        Rule_EcuM_WakeupSourceClear_EcuMWakeupSource_Local (BswMRule):
          BswMNestedExecutionOnly = false
          BswMRuleInitState = BSWM_FALSE
          BswMRuleExpressionRef = LE_EcuM_WakeupSourceClear_EcuMWakeupSource_LOCAL
          BswMRuleTrueActionList = AL_EcuM_ClearWakeUpSource_EcuMWakeupSource_Local
      BswMModeControl
        15 x BswMAction:
          BswMAction_RxEnableDM_CanChannel_0
            BswMAvailableActions
              BswMDeadlineMonitoringControl: BswMEnabledDMPduGroupRef=Com_RxPduGroup_CONTROLLER_0_IAM
          BswMAction_RxDisableDM_CanChannel_0
            BswMAvailableActions
              BswMDeadlineMonitoringControl: BswMDisabledDMPduGroupRef=Com_RxPduGroup_CONTROLLER_0_IAM
          BswMAction_RxEnableGroupSwitch_CanChannel_0
            BswMAvailableActions
              BswMPduGroupSwitch: BswMPduGroupSwitchReinit=false, BswMEnabledPduGroupRef=Com_RxPduGroup_CONTROLLER_0_IAM
          BswMAction_RxDisableGroupSwitch_CanChannel_0
            BswMAvailableActions
              BswMPduGroupSwitch: BswMPduGroupSwitchReinit=false, BswMDisabledPduGroupRef=Com_RxPduGroup_CONTROLLER_0_IAM
          BswMAction_GenericCanSmBusOff_NO_COM_CanChannel_0
            BswMAvailableActions
              BswMUserCallout: BswMUserCalloutFunction=GenericSwitch_CanSmBusOff_NoCom_CanChannel_0
          BswMAction_GenericCanSmBusOff_BUSOFF_SILENT_CanChannel_0
            BswMAvailableActions
              BswMUserCallout: BswMUserCalloutFunction=GenericSwitch_CanSmBusOff_BusOffSilent_CanChannel_0
          BswMAction_EcuM_ClearWakeUpSource_EcuMWakeupSource_CAN
            BswMAvailableActions
              BswMUserCallout: BswMUserCalloutFunction=User_EcuM_ClearWakeUpSource_EcuMWakeupSource_CAN
          BswMAction_EcuM_SetStatus_RUN
            BswMAvailableActions
              BswMEcuMStateSwitch: BswMEcuMState=BSWM_ECUM_STATE_APP_RUN
          BswMAction_EcuM_SetStatus_POST_RUN
            BswMAvailableActions
              BswMEcuMStateSwitch: BswMEcuMState=BSWM_ECUM_STATE_APP_POST_RUN
          BswMAction_EcuM_SetStatus_SLEEP
            BswMAvailableActions
              BswMEcuMStateSwitch: BswMEcuMState=BSWM_ECUM_STATE_SLEEP
          BswMAction_EcuM_SetStatus_SHUTDOWN
            BswMAvailableActions
              BswMEcuMStateSwitch: BswMEcuMState=BSWM_ECUM_STATE_SHUTDOWN
          BswMAction_EcuM_GoHalt
            BswMAvailableActions
              BswMEcuMGoDownHaltPoll: BswMEcuMUserIdRef=EcuMFlexUserConfig
          BswMAction_EcuM_RequestRun
            BswMAvailableActions
              BswMUserCallout: BswMUserCalloutFunction=BswM_EcuM_RequestRun
          BswMAction_EcuM_ReleaseRun
            BswMAvailableActions
              BswMUserCallout: BswMUserCalloutFunction=BswM_EcuM_ReleaseRun
          BswMAction_ComMAllow_CanChannel_0
            BswMAvailableActions
              BswMComMAllowCom: BswMComAllowed=true, BswMComMAllowChannelRef=ComMChannel_0
        16 x BswMActionList, all with BswMActionListExecution=BSWM_TRIGGER:
          AL_GenericCanSmBusOff_NO_COM_CanChannel_0
            Item_Action_GenericCanSmBusOff_NO_COM_CanChannel_0 (BswMActionListItem): BswMAbortOnFail=false, BswMActionListItemIndex=0, BswMActionListItemRef=BswMAction_GenericCanSmBusOff_NO_COM_CanChannel_0
          AL_GenericCanSmBusOff_BUSOFF_SILENT_CanChannel_0
            Item_Action_GenericCanSmBusOff_BUSOFF_SILENT_CanChannel_0 (BswMActionListItem): BswMAbortOnFail=false, BswMActionListItemIndex=0, BswMActionListItemRef=BswMAction_GenericCanSmBusOff_BUSOFF_SILENT_CanChannel_0
          AL_EcuM_ClearWakeUpSource_EcuMWakeupSource_CAN
            Item_Action_EcuM_ClearWakeUpSource_EcuMWakeupSource_POWER_ON (BswMActionListItem): BswMAbortOnFail=false, BswMActionListItemIndex=0, BswMActionListItemRef=BswMAction_EcuM_ClearWakeUpSource_EcuMWakeupSource_CAN
          AL_EcuM_RequestStatus_RUN
            Item_Action_EcuM_SetStatus_RUN (BswMActionListItem): BswMAbortOnFail=false, BswMActionListItemIndex=0, BswMActionListItemRef=BswMAction_EcuM_SetStatus_RUN
            Item_Action_WakeupSourceDisable (BswMActionListItem): BswMAbortOnFail=false, BswMActionListItemIndex=1, BswMActionListItemRef=BswMAction_DisableWakeup
          AL_EcuM_RequestStatus_POSTRUN
            Item_Action_EcuM_SetStatus_POST_RUN (BswMActionListItem): BswMAbortOnFail=false, BswMActionListItemIndex=0, BswMActionListItemRef=BswMAction_EcuM_SetStatus_POST_RUN
          AL_EcuM_WakeupSourcePending
            4 x BswMActionListItem, all with BswMAbortOnFail=false:
              Item_Action_EcuM_RequestRun: BswMActionListItemIndex=0, BswMActionListItemRef=BswMAction_EcuM_RequestRun
              Item_Action_ComMAllow_CanChannel_0: BswMActionListItemIndex=1, BswMActionListItemRef=BswMAction_ComMAllow_CanChannel_0
              Item_Action_CanTrcvModeShift: BswMActionListItemIndex=2, BswMActionListItemRef=Action_CanTrcvModeShift
              Item_Action_RteStart: BswMActionListItemIndex=3, BswMActionListItemRef=BswMAction_Rte_Start
          AL_ComM_AllChanel_NO_COM
            4 x BswMActionListItem, all with BswMAbortOnFail=false:
              Item_Action_EnableWakeup: BswMActionListItemIndex=0, BswMActionListItemRef=BswMAction_EnableWakeup
              Item_Action_EcuM_ReleaseRun: BswMActionListItemIndex=1, BswMActionListItemRef=BswMAction_EcuM_ReleaseRun
              Item_Action_EcuM_GoHalt: BswMActionListItemIndex=2, BswMActionListItemRef=BswMAction_EcuM_GoHalt
              Item_Action_Rte_Stop: BswMActionListItemIndex=3, BswMActionListItemRef=BswMAction_Rte_Stop
          AL_NmCtrol_Enable_CanChannel_0
            Item_Action_NmCtrol_Enable_CanChannel_0 (BswMActionListItem): BswMAbortOnFail=false, BswMActionListItemIndex=0, BswMActionListItemRef=BswMAction_NmCtrol_Enable_CanChannel_0
          AL_NmCtrol_Disable_CanChannel_0
            Item_Action_NmCtrol_Disable_CanChannel_0 (BswMActionListItem): BswMAbortOnFail=false, BswMActionListItemIndex=0, BswMActionListItemRef=BswMAction_NmCtrol_Disable_CanChannel_0
          AL_DCM_Normal_Rx_Enable_CanChannel_0
            Item_Action_RxEnableGroupSwitch_CanChannel_0 (BswMActionListItem): BswMAbortOnFail=false, BswMActionListItemIndex=0, BswMActionListItemRef=BswMAction_RxEnableGroupSwitch_CanChannel_0
          AL_DCM_Normal_Rx_Disable_CanChannel_0
            Item_Action_RxDisabledGroupSwitch_CanChannel_0 (BswMActionListItem): BswMAbortOnFail=false, BswMActionListItemIndex=0, BswMActionListItemRef=BswMAction_RxDisableGroupSwitch_CanChannel_0
          AL_DCM_Normal_Tx_Enable_CanChannel_0
            Item_Action_TxEnableGroupSwitch_CanChannel_0 (BswMActionListItem): BswMAbortOnFail=false, BswMActionListItemIndex=0, BswMActionListItemRef=Action_TxEnableGroupSwitch_CanChannel_0
          AL_DCM_Normal_Tx_Disable_CanChannel_0
            Item_Action_TxDisabledGroupSwitch_CanChannel_0 (BswMActionListItem): BswMAbortOnFail=false, BswMActionListItemIndex=0, BswMActionListItemRef=Action_TxDisabledGroupSwitch_CanChannel_0
          AL_DCM_Nm_Tx_Enable_CanChannel_0
            Item_Action_NmCtrol_Enable_CanChannel_0 (BswMActionListItem): BswMAbortOnFail=false, BswMActionListItemIndex=0, BswMActionListItemRef=BswMAction_NmCtrol_Enable_CanChannel_0
          AL_DCM_Nm_Tx_Disable_CanChannel_0
            Item_Action_NmCtrol_Disable_CanChannel_0 (BswMActionListItem): BswMAbortOnFail=false, BswMActionListItemIndex=0, BswMActionListItemRef=BswMAction_NmCtrol_Disable_CanChannel_0
          AL_EcuM_ClearExpiredWakeUpSource_CAN
            5 x BswMActionListItem, all with BswMAbortOnFail=false:
              Item_Action_EnableWakeup: BswMActionListItemIndex=0, BswMActionListItemRef=BswMAction_EnableWakeup
              Item_Action_EcuM_ReleaseRun: BswMActionListItemIndex=1, BswMActionListItemRef=BswMAction_EcuM_ReleaseRun
              Item_Action_EcuM_ClearWakeUpSource_EcuMWakeupSource_CAN: BswMActionListItemIndex=2, BswMActionListItemRef=BswMAction_EcuM_ClearWakeUpSource_EcuMWakeupSource_CAN
              Item_Action_EcuM_GoHalt: BswMActionListItemIndex=3, BswMActionListItemRef=BswMAction_EcuM_GoHalt
              Item_Action_Rte_Stop: BswMActionListItemIndex=4, BswMActionListItemRef=BswMAction_Rte_Stop
        5 x BswMAction:
          BswMAction_ComMDisAllow_CanChannel_0
            BswMAvailableActions
              BswMComMAllowCom: BswMComAllowed=false, BswMComMAllowChannelRef=ComMChannel_0
          BswMAction_ComMRequestFULL_CanChannel_0
            BswMAvailableActions
              BswMComMModeSwitch: BswMComMRequestedMode=COMM_FULL_COMMUNICATION, BswMComMUserRef=ComMUser_0
          BswMAction_EcuMSelectShutdownTarget
            BswMAvailableActions
              BswMEcuMSelectShutdownTarget: BswMEcuMShutdownTarget=BSWM_ECUM_SHUTDOWN_TARGET_SLEEP, BswMEcuMSleepModeRef=EcuMSleepMode
          BswMAction_NmCtrol_Enable_CanChannel_0
            BswMAvailableActions
              BswMNMControl: BswMNMAction=BSWM_NM_ENABLE, BswMComMNetworkHandleRef=ComMChannel_0
          BswMAction_NmCtrol_Disable_CanChannel_0
            BswMAvailableActions
              BswMNMControl: BswMNMAction=BSWM_NM_DISABLE, BswMComMNetworkHandleRef=ComMChannel_0
        6 x BswMActionList, all with BswMActionListExecution=BSWM_TRIGGER:
          AL_RxEnableDM_CanChannel_0
            Item_Action_RxEnableDM_CanChannel_0 (BswMActionListItem): BswMAbortOnFail=false, BswMActionListItemIndex=0, BswMActionListItemRef=BswMAction_RxEnableDM_CanChannel_0
          AL_RxDisableDM_CanChannel_0
            Item_Action_RxDisableDM_CanChannel_0 (BswMActionListItem): BswMAbortOnFail=false, BswMActionListItemIndex=0, BswMActionListItemRef=BswMAction_RxDisableDM_CanChannel_0
          AL_RxEnableGroupSwitch_CanChannel_0
            Item_Action_RxEnableGroupSwitch_CanChannel_0 (BswMActionListItem): BswMAbortOnFail=false, BswMActionListItemIndex=0, BswMActionListItemRef=BswMAction_RxEnableGroupSwitch_CanChannel_0
          AL_RxDisableGroupSwitch_CanChannel_0
            Item_Action_RxDisabledGroupSwitch_CanChannel_0 (BswMActionListItem): BswMAbortOnFail=false, BswMActionListItemIndex=0, BswMActionListItemRef=BswMAction_RxDisableGroupSwitch_CanChannel_0
          AL_ComControl_ON
            3 x BswMActionListItem, all with BswMAbortOnFail=false:
              Item_Action_RxEnableGroupSwitch_CanChannel_0: BswMActionListItemIndex=0, BswMActionListItemRef=BswMAction_RxEnableGroupSwitch_CanChannel_0
              Item_Action_RxEnableDM_CanChannel_0: BswMActionListItemIndex=1, BswMActionListItemRef=BswMAction_RxEnableDM_CanChannel_0
              Item_Action_TxEnableGroupSwitch_CanChannel_0: BswMActionListItemIndex=2, BswMActionListItemRef=Action_TxEnableGroupSwitch_CanChannel_0
          AL_ComControl_OFF
            3 x BswMActionListItem, all with BswMAbortOnFail=false:
              Item_Action_RxDisabledGroupSwitch_CanChannel_0: BswMActionListItemIndex=0, BswMActionListItemRef=BswMAction_RxDisableGroupSwitch_CanChannel_0
              Item_Action_RxDisableDM_CanChannel_0: BswMActionListItemIndex=1, BswMActionListItemRef=BswMAction_RxDisableDM_CanChannel_0
              Item_Action_TxDisabledGroupSwitch_CanChannel_0: BswMActionListItemIndex=2, BswMActionListItemRef=Action_TxDisabledGroupSwitch_CanChannel_0
        3 x BswMAction:
          BswMAction_EcuM_POST_RUN_Release
            BswMAvailableActions
              BswMUserCallout: BswMUserCalloutFunction=BswM_EcuM_ReleasePostRun
          BswMAction_EcuM_POST_RUN_Request
            BswMAvailableActions
              BswMUserCallout: BswMUserCalloutFunction=BswM_EcuM_RequestPostRun
          BswMAction_BSW_Module_Init
            BswMAvailableActions
              BswMEcuMDriverInitListBswM: BswMEcuMDriverInitListBswMRef=EcuMDriverInitListBswM_0
        AL_StartUp (BswMActionList): BswMActionListExecution=BSWM_TRIGGER
          Item_Action_BswMAction_BswMAction_BSW_Module_Init (BswMActionListItem): BswMAbortOnFail=false, BswMActionListItemIndex=0, BswMActionListItemRef=BswMAction_BSW_Module_Init
          Item_Action_BswMAction_BswMAction_DIAG_Module_Init (BswMActionListItem): BswMAbortOnFail=false, BswMActionListItemIndex=1, BswMActionListItemRef=BswMAction_DIAG_Module_Init
        3 x BswMAction:
          BswMAction_EnableWakeup
            BswMAvailableActions
              BswMUserCallout: BswMUserCalloutFunction=WakeupSource_Enable
          BswMAction_DisableWakeup
            BswMAvailableActions
              BswMUserCallout: BswMUserCalloutFunction=WakeupSource_Disable
          Action_CanTrcvModeShift
            BswMAvailableActions
              BswMUserCallout: BswMUserCalloutFunction=BswM_CanTrcv_ModeShift
        AL_ComM_AllChanel_FULL_COM (BswMActionList): BswMActionListExecution=BSWM_TRIGGER
          Item_Action_WakeupSourceDisable (BswMActionListItem): BswMAbortOnFail=false, BswMActionListItemIndex=0, BswMActionListItemRef=BswMAction_DisableWakeup
        AL_EcuM_ReleasePostRun (BswMActionList): BswMActionListExecution=BSWM_TRIGGER
          3 x BswMActionListItem, all with BswMAbortOnFail=false:
            Item_Action_EcuM_ReleasePostRun: BswMActionListItemIndex=0, BswMActionListItemRef=BswMAction_EcuM_POST_RUN_Release
            Item_Action_EcuM_GoHalt: BswMActionListItemIndex=1, BswMActionListItemRef=BswMAction_EcuM_GoHalt
            Item_Action_Rte_Stop: BswMActionListItemIndex=2, BswMActionListItemRef=BswMAction_Rte_Stop
        3 x BswMAction:
          Action_TxEnableGroupSwitch_CanChannel_0
            BswMAvailableActions
              BswMPduGroupSwitch: BswMPduGroupSwitchReinit=false, BswMEnabledPduGroupRef=Com_TxPduGroup_CONTROLLER_0_IAM
          Action_TxDisabledGroupSwitch_CanChannel_0
            BswMAvailableActions
              BswMPduGroupSwitch: BswMPduGroupSwitchReinit=false, BswMDisabledPduGroupRef=Com_TxPduGroup_CONTROLLER_0_IAM
          Action_TxEnableGroupSwitch_ReInit_CanChannel_0
            BswMAvailableActions
              BswMPduGroupSwitch: BswMPduGroupSwitchReinit=true, BswMEnabledPduGroupRef=Com_TxPduGroup_CONTROLLER_0_IAM
        3 x BswMActionList, all with BswMActionListExecution=BSWM_TRIGGER:
          AL_TxEnable_CanChannel_0
            Item_Action_TxEnableGroupSwitch_CanChannel_0 (BswMActionListItem): BswMAbortOnFail=false, BswMActionListItemIndex=0, BswMActionListItemRef=Action_TxEnableGroupSwitch_CanChannel_0
          AL_TxDisable_CanChannel_0
            Item_Action_TxDisabledGroupSwitch_CanChannel_0 (BswMActionListItem): BswMAbortOnFail=false, BswMActionListItemIndex=0, BswMActionListItemRef=Action_TxDisabledGroupSwitch_CanChannel_0
          AL_TxEnableReInit_CanChannel_0
            Item_Action_TxEnableGroupSwitch_ReInit_CanChannel_0 (BswMActionListItem): BswMAbortOnFail=false, BswMActionListItemIndex=0, BswMActionListItemRef=Action_TxEnableGroupSwitch_ReInit_CanChannel_0
        BswMAction_EcuM_ClearWakeUpSource_EcuMWakeupSource_Local (BswMAction)
          BswMAvailableActions
            BswMUserCallout: BswMUserCalloutFunction=User_EcuM_ClearWakeUpSource_EcuMWakeupSource_Local
        AL_EcuM_ClearWakeUpSource_EcuMWakeupSource_Local (BswMActionList): BswMActionListExecution=BSWM_TRIGGER
          Item_Action_EcuM_ClearWakeUpSource_EcuMWakeupSource_Local (BswMActionListItem): BswMAbortOnFail=false, BswMActionListItemIndex=0, BswMActionListItemRef=BswMAction_EcuM_ClearWakeUpSource_EcuMWakeupSource_Local
          Item_Action_ComMRequestFULL_CanChannel_0 (BswMActionListItem): BswMAbortOnFail=false, BswMActionListItemIndex=1, BswMActionListItemRef=BswMAction_ComMRequestFULL_CanChannel_0
        3 x BswMAction:
          BswMAction_Rte_Start
            BswMAvailableActions
              BswMRteStart
          BswMAction_Rte_Stop
            BswMAvailableActions
              BswMRteStop
          BswMAction_DIAG_Module_Init
            BswMAvailableActions
              BswMEcuMDriverInitListBswM: BswMEcuMDriverInitListBswMRef=EcuMDriverInitListBswM_Diag
