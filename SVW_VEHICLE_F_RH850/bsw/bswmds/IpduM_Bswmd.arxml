AUTOSAR XML (schema 00048)
package /AUTOSAR/BswOverviews
  bsw module description IpduM: implemented-entrys=IpduM_MainFunctionTx_IpduMMainFunctionTx1, module-id=128
    bsw internal behavior IB_IpduM
      exclusive area MultiCore_Lock
      exclusive area Context
      bsw schedulable entity SE_IpduMMainFunctionTx1: reentrancy-level=NON-REENTRANT, implemented-entry=IpduM_MainFunctionTx_IpduMMainFunctionTx1
      bsw timing event TE_IpduMMainFunctionTx1: starts-on-event=SE_IpduMMainFunctionTx1, period=0.05
package /AUTOSAR/BswImplementations
  bsw implementation Imp_IpduM_IB_IpduM: programming-language=C, sw-version=2.1.2, vendor-id=62, ar-release-version=4.5.0, behavior=IB_IpduM
    code-descriptors:
      code code_IB_IpduM: artifact-descriptors=autosar-engineering-object={short-label=ComStack_Types.h, category=SWHDR}
package /AUTOSAR/BswInterfaces
  bsw module entry IpduM_MainFunctionTx_IpduMMainFunctionTx1: service-id=18, is-reentrant=true, is-synchronous=true, call-type=SCHEDULED, execution-context=TASK, sw-service-impl-policy=STANDARD
