AUTOSAR XML (schema 4-2-2)
# COPYRIGHT
# Copyright(c) 2016-2021 Renesas Electronics Corporation
package /Renesas/ModuleDescription_Fls
  bsw implementation Fls_Impl: programming-language=C, sw-version=1.1.11, vendor-id=59, ar-release-version=4.2.2, behavior=BswInternalBehavior_0, vendor-specific-module-def=Fls
    code-descriptors:
      code Fls_Code: artifact-descriptors=[{short-label=Fls.c, category=SWSRC}, {short-label=Fls.h, category=SWHDR}]
    resource consumption ResourceConsumption
      10 x memory section:
        VAR_INIT_BOOLEAN: sw-addrmethod=VAR
        VAR_NO_INIT_BOOLEAN: sw-addrmethod=VAR
        VAR_NO_INIT_32: sw-addrmethod=VAR
        VAR_INIT_UNSPECIFIED: sw-addrmethod=VAR
        VAR_NO_INIT_UNSPECIFIED: sw-addrmethod=VAR
        CONFIG_DATA_UNSPECIFIED: sw-addrmethod=CONFIG_DATA
        PUBLIC_CODE: sw-addrmethod=CODE
        PRIVATE_CODE: sw-addrmethod=CODE
        CODE_FAST: sw-addrmethod=CODE
        APPL_CODE: sw-addrmethod=CODE
  bsw module description Fls: module-id=92
    provided-entrys:
      Fls_MainFunction
      Fls_Init
      Fls_Erase
      Fls_Write
      Fls_Cancel
      Fls_GetStatus
      Fls_GetJobResult
      Fls_Read
      Fls_Compare
      Fls_SetMode
      Fls_ReadImmediate
      Fls_BlankCheck
      Fls_Suspend
      Fls_Resume
      Fls_GetVersionInfo
      Fls_CheckHWConsistency
      FLS_FLENDNM_ISR
      FLS_FLENDNM_CAT2_ISR
      FLS_DMA{00..63}_ISR
      FLS_DMA{00..63}_CAT2_ISR
      Fls_UseFlashControllerPreHook
      Fls_UseFlashControllerEndHook
    bsw internal behavior BswInternalBehavior_0
      exclusive area FLS_DRIVERSTATE_DATA_PROTECTION
      exclusive area FLS_REGISTER_PROTECTION
      130 x bsw interrupt entity:
        BswInterruptEntity_0: implemented-entry=FLS_FLENDNM_ISR, interrupt-category=CAT-1, interrupt-source=INTFLENDNM
        BswInterruptEntity_1: implemented-entry=FLS_DMA00_ISR, interrupt-category=CAT-1, interrupt-source=ICDMA0
        BswInterruptEntity_2: implemented-entry=FLS_DMA01_ISR, interrupt-category=CAT-1, interrupt-source=ICDMA1
        BswInterruptEntity_3: implemented-entry=FLS_DMA02_ISR, interrupt-category=CAT-1, interrupt-source=ICDMA2
        BswInterruptEntity_4: implemented-entry=FLS_DMA03_ISR, interrupt-category=CAT-1, interrupt-source=ICDMA3
        BswInterruptEntity_5: implemented-entry=FLS_DMA04_ISR, interrupt-category=CAT-1, interrupt-source=ICDMA4
        BswInterruptEntity_6: implemented-entry=FLS_DMA05_ISR, interrupt-category=CAT-1, interrupt-source=ICDMA5
        BswInterruptEntity_7: implemented-entry=FLS_DMA06_ISR, interrupt-category=CAT-1, interrupt-source=ICDMA6
        BswInterruptEntity_8: implemented-entry=FLS_DMA07_ISR, interrupt-category=CAT-1, interrupt-source=ICDMA7
        BswInterruptEntity_9: implemented-entry=FLS_DMA08_ISR, interrupt-category=CAT-1, interrupt-source=ICDMA8
        BswInterruptEntity_10: implemented-entry=FLS_DMA09_ISR, interrupt-category=CAT-1, interrupt-source=ICDMA9
        BswInterruptEntity_11: implemented-entry=FLS_DMA10_ISR, interrupt-category=CAT-1, interrupt-source=ICDMA10
        BswInterruptEntity_12: implemented-entry=FLS_DMA11_ISR, interrupt-category=CAT-1, interrupt-source=ICDMA11
        BswInterruptEntity_13: implemented-entry=FLS_DMA12_ISR, interrupt-category=CAT-1, interrupt-source=ICDMA12
        BswInterruptEntity_14: implemented-entry=FLS_DMA13_ISR, interrupt-category=CAT-1, interrupt-source=ICDMA13
        BswInterruptEntity_15: implemented-entry=FLS_DMA14_ISR, interrupt-category=CAT-1, interrupt-source=ICDMA14
        BswInterruptEntity_16: implemented-entry=FLS_DMA15_ISR, interrupt-category=CAT-1, interrupt-source=ICDMA15
        BswInterruptEntity_17: implemented-entry=FLS_DMA16_ISR, interrupt-category=CAT-1, interrupt-source=ICDMA16
        BswInterruptEntity_18: implemented-entry=FLS_DMA17_ISR, interrupt-category=CAT-1, interrupt-source=ICDMA17
        BswInterruptEntity_19: implemented-entry=FLS_DMA18_ISR, interrupt-category=CAT-1, interrupt-source=ICDMA18
        BswInterruptEntity_20: implemented-entry=FLS_DMA19_ISR, interrupt-category=CAT-1, interrupt-source=ICDMA19
        BswInterruptEntity_21: implemented-entry=FLS_DMA20_ISR, interrupt-category=CAT-1, interrupt-source=ICDMA20
        BswInterruptEntity_22: implemented-entry=FLS_DMA21_ISR, interrupt-category=CAT-1, interrupt-source=ICDMA21
        BswInterruptEntity_23: implemented-entry=FLS_DMA22_ISR, interrupt-category=CAT-1, interrupt-source=ICDMA22
        BswInterruptEntity_24: implemented-entry=FLS_DMA23_ISR, interrupt-category=CAT-1, interrupt-source=ICDMA23
        BswInterruptEntity_25: implemented-entry=FLS_DMA24_ISR, interrupt-category=CAT-1, interrupt-source=ICDMA24
        BswInterruptEntity_26: implemented-entry=FLS_DMA25_ISR, interrupt-category=CAT-1, interrupt-source=ICDMA25
        BswInterruptEntity_27: implemented-entry=FLS_DMA26_ISR, interrupt-category=CAT-1, interrupt-source=ICDMA26
        BswInterruptEntity_28: implemented-entry=FLS_DMA27_ISR, interrupt-category=CAT-1, interrupt-source=ICDMA27
        BswInterruptEntity_29: implemented-entry=FLS_DMA28_ISR, interrupt-category=CAT-1, interrupt-source=ICDMA28
        BswInterruptEntity_30: implemented-entry=FLS_DMA29_ISR, interrupt-category=CAT-1, interrupt-source=ICDMA29
        BswInterruptEntity_31: implemented-entry=FLS_DMA30_ISR, interrupt-category=CAT-1, interrupt-source=ICDMA30
        BswInterruptEntity_32: implemented-entry=FLS_DMA31_ISR, interrupt-category=CAT-1, interrupt-source=ICDMA31
        BswInterruptEntity_33: implemented-entry=FLS_DMA32_ISR, interrupt-category=CAT-1, interrupt-source=ICDMA32
        BswInterruptEntity_34: implemented-entry=FLS_DMA33_ISR, interrupt-category=CAT-1, interrupt-source=ICDMA33
        BswInterruptEntity_35: implemented-entry=FLS_DMA34_ISR, interrupt-category=CAT-1, interrupt-source=ICDMA34
        BswInterruptEntity_36: implemented-entry=FLS_DMA35_ISR, interrupt-category=CAT-1, interrupt-source=ICDMA35
        BswInterruptEntity_37: implemented-entry=FLS_DMA36_ISR, interrupt-category=CAT-1, interrupt-source=ICDMA36
        BswInterruptEntity_38: implemented-entry=FLS_DMA37_ISR, interrupt-category=CAT-1, interrupt-source=ICDMA37
        BswInterruptEntity_39: implemented-entry=FLS_DMA38_ISR, interrupt-category=CAT-1, interrupt-source=ICDMA38
        BswInterruptEntity_40: implemented-entry=FLS_DMA39_ISR, interrupt-category=CAT-1, interrupt-source=ICDMA39
        BswInterruptEntity_41: implemented-entry=FLS_DMA40_ISR, interrupt-category=CAT-1, interrupt-source=ICDMA40
        BswInterruptEntity_42: implemented-entry=FLS_DMA41_ISR, interrupt-category=CAT-1, interrupt-source=ICDMA41
        BswInterruptEntity_43: implemented-entry=FLS_DMA42_ISR, interrupt-category=CAT-1, interrupt-source=ICDMA42
        BswInterruptEntity_44: implemented-entry=FLS_DMA43_ISR, interrupt-category=CAT-1, interrupt-source=ICDMA43
        BswInterruptEntity_45: implemented-entry=FLS_DMA44_ISR, interrupt-category=CAT-1, interrupt-source=ICDMA44
        BswInterruptEntity_46: implemented-entry=FLS_DMA45_ISR, interrupt-category=CAT-1, interrupt-source=ICDMA45
        BswInterruptEntity_47: implemented-entry=FLS_DMA46_ISR, interrupt-category=CAT-1, interrupt-source=ICDMA46
        BswInterruptEntity_48: implemented-entry=FLS_DMA47_ISR, interrupt-category=CAT-1, interrupt-source=ICDMA47
        BswInterruptEntity_49: implemented-entry=FLS_DMA48_ISR, interrupt-category=CAT-1, interrupt-source=ICDMA48
        BswInterruptEntity_50: implemented-entry=FLS_DMA49_ISR, interrupt-category=CAT-1, interrupt-source=ICDMA49
        BswInterruptEntity_51: implemented-entry=FLS_DMA50_ISR, interrupt-category=CAT-1, interrupt-source=ICDMA50
        BswInterruptEntity_52: implemented-entry=FLS_DMA51_ISR, interrupt-category=CAT-1, interrupt-source=ICDMA51
        BswInterruptEntity_53: implemented-entry=FLS_DMA52_ISR, interrupt-category=CAT-1, interrupt-source=ICDMA52
        BswInterruptEntity_54: implemented-entry=FLS_DMA53_ISR, interrupt-category=CAT-1, interrupt-source=ICDMA53
        BswInterruptEntity_55: implemented-entry=FLS_DMA54_ISR, interrupt-category=CAT-1, interrupt-source=ICDMA54
        BswInterruptEntity_56: implemented-entry=FLS_DMA55_ISR, interrupt-category=CAT-1, interrupt-source=ICDMA55
        BswInterruptEntity_57: implemented-entry=FLS_DMA56_ISR, interrupt-category=CAT-1, interrupt-source=ICDMA56
        BswInterruptEntity_58: implemented-entry=FLS_DMA57_ISR, interrupt-category=CAT-1, interrupt-source=ICDMA57
        BswInterruptEntity_59: implemented-entry=FLS_DMA58_ISR, interrupt-category=CAT-1, interrupt-source=ICDMA58
        BswInterruptEntity_60: implemented-entry=FLS_DMA59_ISR, interrupt-category=CAT-1, interrupt-source=ICDMA59
        BswInterruptEntity_61: implemented-entry=FLS_DMA60_ISR, interrupt-category=CAT-1, interrupt-source=ICDMA60
        BswInterruptEntity_62: implemented-entry=FLS_DMA61_ISR, interrupt-category=CAT-1, interrupt-source=ICDMA61
        BswInterruptEntity_63: implemented-entry=FLS_DMA62_ISR, interrupt-category=CAT-1, interrupt-source=ICDMA62
        BswInterruptEntity_64: implemented-entry=FLS_DMA63_ISR, interrupt-category=CAT-1, interrupt-source=ICDMA63
        BswInterruptEntity_65: implemented-entry=FLS_FLENDNM_CAT2_ISR, interrupt-category=CAT-2, interrupt-source=INTFLENDNM
        BswInterruptEntity_66: implemented-entry=FLS_DMA00_CAT2_ISR, interrupt-category=CAT-2, interrupt-source=ICDMA0
        BswInterruptEntity_67: implemented-entry=FLS_DMA01_CAT2_ISR, interrupt-category=CAT-2, interrupt-source=ICDMA1
        BswInterruptEntity_68: implemented-entry=FLS_DMA02_CAT2_ISR, interrupt-category=CAT-2, interrupt-source=ICDMA2
        BswInterruptEntity_69: implemented-entry=FLS_DMA03_CAT2_ISR, interrupt-category=CAT-2, interrupt-source=ICDMA3
        BswInterruptEntity_70: implemented-entry=FLS_DMA04_CAT2_ISR, interrupt-category=CAT-2, interrupt-source=ICDMA4
        BswInterruptEntity_71: implemented-entry=FLS_DMA05_CAT2_ISR, interrupt-category=CAT-2, interrupt-source=ICDMA5
        BswInterruptEntity_72: implemented-entry=FLS_DMA06_CAT2_ISR, interrupt-category=CAT-2, interrupt-source=ICDMA6
        BswInterruptEntity_73: implemented-entry=FLS_DMA07_CAT2_ISR, interrupt-category=CAT-2, interrupt-source=ICDMA7
        BswInterruptEntity_74: implemented-entry=FLS_DMA08_CAT2_ISR, interrupt-category=CAT-2, interrupt-source=ICDMA8
        BswInterruptEntity_75: implemented-entry=FLS_DMA09_CAT2_ISR, interrupt-category=CAT-2, interrupt-source=ICDMA9
        BswInterruptEntity_76: implemented-entry=FLS_DMA10_CAT2_ISR, interrupt-category=CAT-2, interrupt-source=ICDMA10
        BswInterruptEntity_77: implemented-entry=FLS_DMA11_CAT2_ISR, interrupt-category=CAT-2, interrupt-source=ICDMA11
        BswInterruptEntity_78: implemented-entry=FLS_DMA12_CAT2_ISR, interrupt-category=CAT-2, interrupt-source=ICDMA12
        BswInterruptEntity_79: implemented-entry=FLS_DMA13_CAT2_ISR, interrupt-category=CAT-2, interrupt-source=ICDMA13
        BswInterruptEntity_80: implemented-entry=FLS_DMA14_CAT2_ISR, interrupt-category=CAT-2, interrupt-source=ICDMA14
        BswInterruptEntity_81: implemented-entry=FLS_DMA15_CAT2_ISR, interrupt-category=CAT-2, interrupt-source=ICDMA15
        BswInterruptEntity_82: implemented-entry=FLS_DMA16_CAT2_ISR, interrupt-category=CAT-2, interrupt-source=ICDMA16
        BswInterruptEntity_83: implemented-entry=FLS_DMA17_CAT2_ISR, interrupt-category=CAT-2, interrupt-source=ICDMA17
        BswInterruptEntity_84: implemented-entry=FLS_DMA18_CAT2_ISR, interrupt-category=CAT-2, interrupt-source=ICDMA18
        BswInterruptEntity_85: implemented-entry=FLS_DMA19_CAT2_ISR, interrupt-category=CAT-2, interrupt-source=ICDMA19
        BswInterruptEntity_86: implemented-entry=FLS_DMA20_CAT2_ISR, interrupt-category=CAT-2, interrupt-source=ICDMA20
        BswInterruptEntity_87: implemented-entry=FLS_DMA21_CAT2_ISR, interrupt-category=CAT-2, interrupt-source=ICDMA21
        BswInterruptEntity_88: implemented-entry=FLS_DMA22_CAT2_ISR, interrupt-category=CAT-2, interrupt-source=ICDMA22
        BswInterruptEntity_89: implemented-entry=FLS_DMA23_CAT2_ISR, interrupt-category=CAT-2, interrupt-source=ICDMA23
        BswInterruptEntity_90: implemented-entry=FLS_DMA24_CAT2_ISR, interrupt-category=CAT-2, interrupt-source=ICDMA24
        BswInterruptEntity_91: implemented-entry=FLS_DMA25_CAT2_ISR, interrupt-category=CAT-2, interrupt-source=ICDMA25
        BswInterruptEntity_92: implemented-entry=FLS_DMA26_CAT2_ISR, interrupt-category=CAT-2, interrupt-source=ICDMA26
        BswInterruptEntity_93: implemented-entry=FLS_DMA27_CAT2_ISR, interrupt-category=CAT-2, interrupt-source=ICDMA27
        BswInterruptEntity_94: implemented-entry=FLS_DMA28_CAT2_ISR, interrupt-category=CAT-2, interrupt-source=ICDMA28
        BswInterruptEntity_95: implemented-entry=FLS_DMA29_CAT2_ISR, interrupt-category=CAT-2, interrupt-source=ICDMA29
        BswInterruptEntity_96: implemented-entry=FLS_DMA30_CAT2_ISR, interrupt-category=CAT-2, interrupt-source=ICDMA30
        BswInterruptEntity_97: implemented-entry=FLS_DMA31_CAT2_ISR, interrupt-category=CAT-2, interrupt-source=ICDMA31
        BswInterruptEntity_98: implemented-entry=FLS_DMA32_CAT2_ISR, interrupt-category=CAT-2, interrupt-source=ICDMA32
        BswInterruptEntity_99: implemented-entry=FLS_DMA33_CAT2_ISR, interrupt-category=CAT-2, interrupt-source=ICDMA33
        BswInterruptEntity_100: implemented-entry=FLS_DMA34_CAT2_ISR, interrupt-category=CAT-2, interrupt-source=ICDMA34
        BswInterruptEntity_101: implemented-entry=FLS_DMA35_CAT2_ISR, interrupt-category=CAT-2, interrupt-source=ICDMA35
        BswInterruptEntity_102: implemented-entry=FLS_DMA36_CAT2_ISR, interrupt-category=CAT-2, interrupt-source=ICDMA36
        BswInterruptEntity_103: implemented-entry=FLS_DMA37_CAT2_ISR, interrupt-category=CAT-2, interrupt-source=ICDMA37
        BswInterruptEntity_104: implemented-entry=FLS_DMA38_CAT2_ISR, interrupt-category=CAT-2, interrupt-source=ICDMA38
        BswInterruptEntity_105: implemented-entry=FLS_DMA39_CAT2_ISR, interrupt-category=CAT-2, interrupt-source=ICDMA39
        BswInterruptEntity_106: implemented-entry=FLS_DMA40_CAT2_ISR, interrupt-category=CAT-2, interrupt-source=ICDMA40
        BswInterruptEntity_107: implemented-entry=FLS_DMA41_CAT2_ISR, interrupt-category=CAT-2, interrupt-source=ICDMA41
        BswInterruptEntity_108: implemented-entry=FLS_DMA42_CAT2_ISR, interrupt-category=CAT-2, interrupt-source=ICDMA42
        BswInterruptEntity_109: implemented-entry=FLS_DMA43_CAT2_ISR, interrupt-category=CAT-2, interrupt-source=ICDMA43
        BswInterruptEntity_110: implemented-entry=FLS_DMA44_CAT2_ISR, interrupt-category=CAT-2, interrupt-source=ICDMA44
        BswInterruptEntity_111: implemented-entry=FLS_DMA45_CAT2_ISR, interrupt-category=CAT-2, interrupt-source=ICDMA45
        BswInterruptEntity_112: implemented-entry=FLS_DMA46_CAT2_ISR, interrupt-category=CAT-2, interrupt-source=ICDMA46
        BswInterruptEntity_113: implemented-entry=FLS_DMA47_CAT2_ISR, interrupt-category=CAT-2, interrupt-source=ICDMA47
        BswInterruptEntity_114: implemented-entry=FLS_DMA48_CAT2_ISR, interrupt-category=CAT-2, interrupt-source=ICDMA48
        BswInterruptEntity_115: implemented-entry=FLS_DMA49_CAT2_ISR, interrupt-category=CAT-2, interrupt-source=ICDMA49
        BswInterruptEntity_116: implemented-entry=FLS_DMA50_CAT2_ISR, interrupt-category=CAT-2, interrupt-source=ICDMA50
        BswInterruptEntity_117: implemented-entry=FLS_DMA51_CAT2_ISR, interrupt-category=CAT-2, interrupt-source=ICDMA51
        BswInterruptEntity_118: implemented-entry=FLS_DMA52_CAT2_ISR, interrupt-category=CAT-2, interrupt-source=ICDMA52
        BswInterruptEntity_119: implemented-entry=FLS_DMA53_CAT2_ISR, interrupt-category=CAT-2, interrupt-source=ICDMA53
        BswInterruptEntity_120: implemented-entry=FLS_DMA54_CAT2_ISR, interrupt-category=CAT-2, interrupt-source=ICDMA54
        BswInterruptEntity_121: implemented-entry=FLS_DMA55_CAT2_ISR, interrupt-category=CAT-2, interrupt-source=ICDMA55
        BswInterruptEntity_122: implemented-entry=FLS_DMA56_CAT2_ISR, interrupt-category=CAT-2, interrupt-source=ICDMA56
        BswInterruptEntity_123: implemented-entry=FLS_DMA57_CAT2_ISR, interrupt-category=CAT-2, interrupt-source=ICDMA57
        BswInterruptEntity_124: implemented-entry=FLS_DMA58_CAT2_ISR, interrupt-category=CAT-2, interrupt-source=ICDMA58
        BswInterruptEntity_125: implemented-entry=FLS_DMA59_CAT2_ISR, interrupt-category=CAT-2, interrupt-source=ICDMA59
        BswInterruptEntity_126: implemented-entry=FLS_DMA60_CAT2_ISR, interrupt-category=CAT-2, interrupt-source=ICDMA60
        BswInterruptEntity_127: implemented-entry=FLS_DMA61_CAT2_ISR, interrupt-category=CAT-2, interrupt-source=ICDMA61
        BswInterruptEntity_128: implemented-entry=FLS_DMA62_CAT2_ISR, interrupt-category=CAT-2, interrupt-source=ICDMA62
        BswInterruptEntity_129: implemented-entry=FLS_DMA63_CAT2_ISR, interrupt-category=CAT-2, interrupt-source=ICDMA63
      bsw schedulable entity BSE_Fls_MainFunction: can-enter-exclusive-area=[FLS_REGISTER_PROTECTION, FLS_DRIVERSTATE_DATA_PROTECTION], minimum-start-interval=0.00000085, implemented-entry=Fls_MainFunction
      17 x bsw called entity:
        BswCalledEntity_0: implemented-entry=Fls_GetVersionInfo
        BswCalledEntity_1: can-enter-exclusive-area=[FLS_DRIVERSTATE_DATA_PROTECTION, FLS_REGISTER_PROTECTION], implemented-entry=Fls_Read
        BswCalledEntity_2: can-enter-exclusive-area=FLS_DRIVERSTATE_DATA_PROTECTION, implemented-entry=Fls_BlankCheck
        BswCalledEntity_3: implemented-entry=Fls_SetMode
        BswCalledEntity_4: can-enter-exclusive-area=[FLS_DRIVERSTATE_DATA_PROTECTION, FLS_REGISTER_PROTECTION], implemented-entry=Fls_Erase
        BswCalledEntity_5: implemented-entry=Fls_GetStatus
        BswCalledEntity_6: implemented-entry=Fls_GetJobResult
        BswCalledEntity_7: can-enter-exclusive-area=[FLS_DRIVERSTATE_DATA_PROTECTION, FLS_REGISTER_PROTECTION], implemented-entry=Fls_Write
        BswCalledEntity_8: can-enter-exclusive-area=FLS_REGISTER_PROTECTION, implemented-entry=Fls_Init
        BswCalledEntity_9: can-enter-exclusive-area=FLS_DRIVERSTATE_DATA_PROTECTION, implemented-entry=Fls_Compare
        BswCalledEntity_10: can-enter-exclusive-area=FLS_DRIVERSTATE_DATA_PROTECTION, implemented-entry=Fls_Cancel
        BswCalledEntity_11: can-enter-exclusive-area=FLS_DRIVERSTATE_DATA_PROTECTION, implemented-entry=Fls_ReadImmediate
        BswCalledEntity_12: can-enter-exclusive-area=FLS_DRIVERSTATE_DATA_PROTECTION, implemented-entry=Fls_Suspend
        BswCalledEntity_13: can-enter-exclusive-area=FLS_DRIVERSTATE_DATA_PROTECTION, implemented-entry=Fls_Resume
        BswCalledEntity_14: implemented-entry=Fls_CheckHWConsistency
        BswCalledEntity_15: implemented-entry=Fls_UseFlashControllerPreHook
        BswCalledEntity_16: implemented-entry=Fls_UseFlashControllerEndHook
      bsw timing event TimingEvent_Fls_MainFunction: starts-on-event=BSE_Fls_MainFunction, period=0.00000085
  148 x bsw module entry, all with sw-service-impl-policy=STANDARD:
    FLS_FLENDNM_ISR: is-reentrant=false, is-synchronous=false, call-type=INTERRUPT, execution-context=INTERRUPT-CAT-1
    FLS_DMA{00..63}_ISR: is-reentrant=true, is-synchronous=true, call-type=INTERRUPT, execution-context=INTERRUPT-CAT-1
    FLS_FLENDNM_CAT2_ISR: is-reentrant=false, is-synchronous=false, call-type=INTERRUPT, execution-context=INTERRUPT-CAT-2
    FLS_DMA{00..63}_CAT2_ISR: is-reentrant=true, is-synchronous=true, call-type=INTERRUPT, execution-context=INTERRUPT-CAT-2
    Fls_GetVersionInfo: service-id=10, is-reentrant=true, is-synchronous=true, call-type=REGULAR, execution-context=TASK  # Returns the version information of this module.
    Fls_MainFunction: service-id=6, is-reentrant=false, is-synchronous=true, call-type=SCHEDULED, execution-context=TASK  # Performs the processing of jobs.
    Fls_Read: service-id=7, is-reentrant=false, is-synchronous=false, call-type=REGULAR, execution-context=TASK  # Reads from flash memory.
    Fls_BlankCheck: service-id=12, is-reentrant=false, is-synchronous=false, call-type=REGULAR, execution-context=TASK  # The function Fls_BlankCheck shall verify, whether a given memory area has been erased but not (yet) programmed. The function shall limit the maximum number of checked flash cells per main function cycle to the configured value FlsMaxReadNormalMode or FlsMaxReadFastMode respectively.
    Fls_SetMode: service-id=9, is-reentrant=false, is-synchronous=true, call-type=REGULAR, execution-context=TASK  # Sets the flash driver's operation mode.
    Fls_Erase: service-id=1, is-reentrant=false, is-synchronous=false, call-type=REGULAR, execution-context=TASK  # Erases flash sector(s).
    Fls_GetStatus: service-id=4, is-reentrant=true, is-synchronous=true, call-type=REGULAR, execution-context=TASK  # Returns the driver state.
    Fls_GetJobResult: service-id=5, is-reentrant=true, is-synchronous=true, call-type=REGULAR, execution-context=TASK  # Returns the result of the last job.
    Fls_Write: service-id=2, is-reentrant=false, is-synchronous=false, call-type=REGULAR, execution-context=TASK  # Writes one or more complete flash pages.
    Fls_Init: service-id=0, is-reentrant=false, is-synchronous=true, call-type=REGULAR, execution-context=TASK  # Initializes the Flash Driver.
    Fls_Compare: service-id=8, is-reentrant=false, is-synchronous=false, call-type=REGULAR, execution-context=TASK  # Compares the contents of an area of flash memory with that of an application data buffer.
    Fls_Cancel: service-id=3, is-reentrant=false, is-synchronous=true, call-type=REGULAR, execution-context=TASK  # Cancels an ongoing job.
    Fls_ReadImmediate: service-id=11, is-reentrant=false, is-synchronous=true, call-type=REGULAR, execution-context=TASK  # Performs the reading of the flash memory, without performing blank check before read.
    Fls_Suspend: service-id=13, is-reentrant=false, is-synchronous=false, call-type=REGULAR, execution-context=TASK  # Performs the suspend of the on going job.
    Fls_Resume: service-id=14, is-reentrant=false, is-synchronous=false, call-type=REGULAR, execution-context=TASK  # Resumes the suspended job.
    Fls_CheckHWConsistency: service-id=21, is-reentrant=false, is-synchronous=true, call-type=REGULAR, execution-context=TASK  # API executes registers ram mirroring check.
    Fls_UseFlashControllerPreHook: service-id=15, is-reentrant=false, is-synchronous=false, call-type=REGULAR, execution-context=TASK
    Fls_UseFlashControllerEndHook: service-id=16, is-reentrant=false, is-synchronous=false, call-type=REGULAR, execution-context=TASK
