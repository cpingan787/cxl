AUTOSAR XML (schema 00049)
package /ActiveEcuC
  module config Fls: implementation-config-variant=VARIANT-PRE-COMPILE, module-description=Fls_Impl
    FlsConfigSet:
      FlsAcErase = 0
      FlsAcWrite = 0
      FlsCallCycle = 0.000001
      FlsDefaultMode = MEMIF_MODE_SLOW
      FlsMaxEraseNormalMode = 64
      FlsMaxReadFastMode = 20
      FlsMaxReadNormalMode = 4
      FlsMaxWriteFastMode = 4
      FlsMaxWriteNormalMode = 4
      FlsProtection = 0
      FlsJobEndNotification = JobOkNotification
      FlsJobErrorNotification = JobErrorNotification
      FlsTimeOutCountValue = 10000
      FlsSectorList
        FlsSector: FlsNumberOfSectors=1024, FlsPageSize=4, FlsSectorIndex=0, FlsSectorSize=64, FlsSectorStartaddress=0
    FlsGeneral:
      FlsAcLoadOnJobStart = true
      FlsBaseAddress = 4280287232
      FlsBlankCheckApi = false
      FlsCancelApi = true
      FlsCompareApi = true
      FlsCriticalSectionProtection = true
      FlsDevErrorDetect = false
      FlsDeviceName = R7F701583
      FlsDriverIndex = 0
      FlsEccNotificationInitCheck = true
      FlsFcuWaitCount = 32
      FlsGetJobResultApi = true
      FlsGetStatusApi = true
      FlsRAMMirror = MIRROR_DISABLE
      FlsSetModeApi = true
      FlsTimeoutMonitoring = true
      FlsTotalSize = 65536
      FlsUseInterrupts = false
      FlsUseWriteVerifyErrorInterface = true
      FlsVersionCheckExternalModules = false
      FlsVersionInfoApi = false
      FlsVirtualBoundaryAddress = 65536
      FlsWriteVerify = WV_DISABLE
      FlsUseFlashControllerHook = false
      FlsDataFlash:
        FlsDataFlashSize = 65536
        FlsDFBaseAddress = 4280287232
        FlsDFBlockSize = 64
        FlsDFTotalBlocks = 1024
        FlsReadImmediateApi = true
        FlsResumeApi = true
        FlsSuspendApi = true
        FlsEccDedNotification = EccDedNotification
        FlsEccSedNotification = EccSedNotification
        FlsCpuFrequency = McuClockSettingConfig0
    FlsPublishedInformation:
      FlsAcLocationErase = 0
      FlsAcLocationWrite = 0
      FlsAcSizeErase = 0
      FlsAcSizeWrite = 0
      FlsBlankCheckTime = 0.000213
      FlsCancelTime = 0.00005
      FlsErasedValue = 4294967295
      FlsEraseTime = 0.01
      FlsExpectedHwId = NULL
      FlsSpecifiedEraseCycles = 125000
      FlsSuspendTime = 0.0003
      FlsWriteTime = 0.0017
