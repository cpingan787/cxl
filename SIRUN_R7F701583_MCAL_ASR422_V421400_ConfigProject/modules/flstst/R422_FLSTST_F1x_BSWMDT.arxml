AUTOSAR XML (schema 4-2-2)
# COPYRIGHT
# Copyright(c) 2016 - 2021 Renesas Electronics Corporation
package /Renesas/ModuleDescription_FlsTst
  bsw implementation FlsTst_Impl: programming-language=C, sw-version=2.1.4, vendor-id=59, ar-release-version=4.2.2, behavior=BswInternalBehavior_0, vendor-specific-module-def=FlsTst
    code-descriptors:
      code FlsTst_Code: artifact-descriptors=[{short-label=FlsTst.c, category=SWSRC}, {short-label=FlsTst.h, category=SWHDR}]
    resource consumption ResourceConsumption
      10 x memory section:
        VAR_INIT_32: sw-addrmethod=VAR
        VAR_NO_INIT_32: sw-addrmethod=VAR
        VAR_INIT_UNSPECIFIED: sw-addrmethod=VAR
        VAR_NO_INIT_UNSPECIFIED: sw-addrmethod=VAR
        CONFIG_DATA_UNSPECIFIED: sw-addrmethod=CONFIG_DATA
        DBTOC_DATA_UNSPECIFIED: sw-addrmethod=CONFIG_DATA
        PUBLIC_CODE: sw-addrmethod=CODE
        PRIVATE_CODE: sw-addrmethod=CODE
        APPL_CODE: sw-addrmethod=CODE
        VAR_NO_INIT_BOOLEAN: sw-addrmethod=CODE
  bsw module description FlsTst: module-id=104
    provided-entrys:
      FlsTst_Init
      FlsTst_DeInit
      FlsTst_StartFgnd
      FlsTst_Abort
      FlsTst_Suspend
      FlsTst_Resume
      FlsTst_GetCurrentState
      FlsTst_GetTestResultBgnd
      FlsTst_GetTestResultFgnd
      FlsTst_GetTestSignatureBgnd
      FlsTst_GetTestSignatureFgnd
      FlsTst_GetErrorDetails
      FlsTst_TestEcc
      FlsTst_MainFunction
      FlsTst_CheckHWConsistency
    bsw internal behavior BswInternalBehavior_0
      exclusive area FLSTST_DRIVERSTATE_DATA_PROTECTION
      bsw schedulable entity BSE_FlsTst_MainFunction: can-enter-exclusive-area=FLSTST_DRIVERSTATE_DATA_PROTECTION, minimum-start-interval=0.000006, implemented-entry=FlsTst_MainFunction
      15 x bsw called entity:
        BswCalledEntity_0: implemented-entry=FlsTst_Init
        BswCalledEntity_1: implemented-entry=FlsTst_DeInit
        BswCalledEntity_2: can-enter-exclusive-area=FLSTST_DRIVERSTATE_DATA_PROTECTION, implemented-entry=FlsTst_StartFgnd
        BswCalledEntity_3: can-enter-exclusive-area=FLSTST_DRIVERSTATE_DATA_PROTECTION, implemented-entry=FlsTst_Abort
        BswCalledEntity_4: can-enter-exclusive-area=FLSTST_DRIVERSTATE_DATA_PROTECTION, implemented-entry=FlsTst_Suspend
        BswCalledEntity_5: can-enter-exclusive-area=FLSTST_DRIVERSTATE_DATA_PROTECTION, implemented-entry=FlsTst_Resume
        BswCalledEntity_6: can-enter-exclusive-area=FLSTST_DRIVERSTATE_DATA_PROTECTION, implemented-entry=FlsTst_GetCurrentState
        BswCalledEntity_7: can-enter-exclusive-area=FLSTST_DRIVERSTATE_DATA_PROTECTION, implemented-entry=FlsTst_GetTestResultBgnd
        BswCalledEntity_8: implemented-entry=FlsTst_GetTestResultFgnd
        BswCalledEntity_9: implemented-entry=FlsTst_GetVersionInfo
        BswCalledEntity_10: can-enter-exclusive-area=FLSTST_DRIVERSTATE_DATA_PROTECTION, implemented-entry=FlsTst_GetTestSignatureBgnd
        BswCalledEntity_11: can-enter-exclusive-area=FLSTST_DRIVERSTATE_DATA_PROTECTION, implemented-entry=FlsTst_GetTestSignatureFgnd
        BswCalledEntity_12: implemented-entry=FlsTst_GetErrorDetails
        BswCalledEntity_13: can-enter-exclusive-area=FLSTST_DRIVERSTATE_DATA_PROTECTION, implemented-entry=FlsTst_TestEcc
        BswCalledEntity_14: implemented-entry=FlsTst_CheckHWConsistency
      bsw timing event TimingEvent_FlsTst_MainFunction: starts-on-event=BSE_FlsTst_MainFunction, period=0.000006
  16 x bsw module entry, all with is-synchronous=true, execution-context=TASK, sw-service-impl-policy=STANDARD:
    FlsTst_MainFunction: service-id=13, is-reentrant=false, call-type=SCHEDULED  # Service for executing the Flash Test in background mode.
    FlsTst_Init: service-id=0, is-reentrant=false, call-type=REGULAR  # Service for Flash Test initialization.
    FlsTst_DeInit: service-id=1, is-reentrant=false, call-type=REGULAR  # Service for Flash Test De-Initialization.
    FlsTst_StartFgnd: service-id=2, is-reentrant=false, call-type=REGULAR  # Service for executing foreground Flash Test.
    FlsTst_Abort: service-id=3, is-reentrant=false, call-type=REGULAR  # Service for aborting the Flash Test.
    FlsTst_Suspend: service-id=4, is-reentrant=false, call-type=REGULAR  # Service for suspending current operation of the Flash Test, until FlsTst_Resume is called.
    FlsTst_Resume: service-id=5, is-reentrant=false, call-type=REGULAR  # Service for continuing the Flash Test at the point it was suspended.
    FlsTst_GetCurrentState: service-id=6, is-reentrant=false, call-type=REGULAR  # Service returns the current Flash Test exection state.
    FlsTst_GetTestResultBgnd: service-id=7, is-reentrant=true, call-type=REGULAR  # Service returns the Background Flash Test result.
    FlsTst_GetTestResultFgnd: service-id=15, is-reentrant=true, call-type=REGULAR  # Service returns the Foreground Flash Test result.
    FlsTst_GetVersionInfo: service-id=8, is-reentrant=true, call-type=REGULAR  # Service returns the version information of this module.
    FlsTst_GetTestSignatureBgnd: service-id=9, is-reentrant=true, call-type=REGULAR  # Service returns the Flash Test result in background mode.
    FlsTst_GetTestSignatureFgnd: service-id=10, is-reentrant=true, call-type=REGULAR  # Service returns the Flash Test result in foreground mode.
    FlsTst_GetErrorDetails: service-id=11, is-reentrant=true, call-type=REGULAR  # Service returns error detais monitored from the Flash module.
    FlsTst_TestEcc: service-id=12, is-reentrant=false, call-type=REGULAR  # Service executes a test of ECC hardware. This is only applicable in case the hardware provices such functionality.
    FlsTst_CheckHWConsistency: service-id=16, is-reentrant=false, call-type=REGULAR  # This API will execute registers ram mirroring check.
