AUTOSAR XML (schema 4-2-2)
package /Renesas/EcucDefs_Can
  ecuc value collection ECUConfiguration: ecuc-values=Os0
  module config Os0: definition=Os, implementation-config-variant=VARIANT-PRE-COMPILE
    OsAppMode0 (OsAppMode)
    OsCounter0 (OsCounter): OsCounterMaxAllowedValue=1000, OsCounterMinCycle=, OsCounterTicksPerBase=2, OsCounterType=HARDWARE, OsSecondsPerTick=2, OsCounterAccessingApplication=
