AUTOSAR XML (schema 4-2-2)
# COPYRIGHT
# Copyright(c) 2016-2021 Renesas Electronics Corporation
package /Renesas/ModuleDescription_RamTst
  bsw implementation RamTst_Impl: programming-language=C, sw-version=2.1.5, vendor-id=59, ar-release-version=4.2.2, behavior=BswInternalBehavior_0, vendor-specific-module-def=RamTst
    code-descriptors:
      code RamTst_Code: artifact-descriptors=[{short-label=RamTst.c, category=SWSRC}, {short-label=RamTst.h, category=SWHDR}]
    resource consumption ResourceConsumption
      9 x memory section:
        VAR_INIT_8: sw-addrmethod=VAR
        VAR_INIT_16: sw-addrmethod=VAR
        VAR_INIT_32: sw-addrmethod=VAR
        VAR_POWER_ON_INIT_8: sw-addrmethod=VAR
        VAR_POWER_ON_INIT_UNSPECIFIED: sw-addrmethod=VAR
        VAR_INIT_UNSPECIFIED: sw-addrmethod=VAR
        CONST_16: sw-addrmethod=CONST
        CONFIG_DATA_UNSPECIFIED: sw-addrmethod=CONFIG_DATA
        CODE: sw-addrmethod=CODE
  bsw module description RamTst: module-id=93
    provided-entrys:
      RamTst_Init
      RamTst_MainFunction
      RamTst_Stop
      RamTst_Allow
      RamTst_GetExecutionStatus
      RamTst_GetTestResult
      RamTst_GetTestResultPerBlock
      RamTst_GetTestAlgorithm
      RamTst_ChangeNumberOfTestedCells
      RamTst_GetNumberOfTestedCells
      RamTst_GetVersionInfo
      RamTst_SelectAlgParams
      RamTst_DeInit
      RamTst_Suspend
      RamTst_Resume
      RamTst_RunFullTest
      RamTst_RunPartialTest
      RamTst_GetAlgParams
    bsw internal behavior BswInternalBehavior_0
      exclusive area RAMTST_RAM_DATA_PROTECTION
      bsw schedulable entity BSE_RamTst_MainFunction: minimum-start-interval=0.0000025, implemented-entry=RamTst_MainFunction
      18 x bsw called entity:
        BswCalledEntity_0: implemented-entry=RamTst_Init
        BswCalledEntity_1: can-enter-exclusive-area=RAMTST_RAM_DATA_PROTECTION, implemented-entry=RamTst_MainFunction
        BswCalledEntity_2: implemented-entry=RamTst_Stop
        BswCalledEntity_3: implemented-entry=RamTst_Allow
        BswCalledEntity_4: implemented-entry=RamTst_GetExecutionStatus
        BswCalledEntity_5: implemented-entry=RamTst_GetTestResult
        BswCalledEntity_6: implemented-entry=RamTst_GetTestResultPerBlock
        BswCalledEntity_7: implemented-entry=RamTst_GetTestAlgorithm
        BswCalledEntity_8: implemented-entry=RamTst_ChangeNumberOfTestedCells
        BswCalledEntity_9: implemented-entry=RamTst_GetNumberOfTestedCells
        BswCalledEntity_10: implemented-entry=RamTst_GetVersionInfo
        BswCalledEntity_11: implemented-entry=RamTst_SelectAlgParams
        BswCalledEntity_12: implemented-entry=RamTst_DeInit
        BswCalledEntity_13: implemented-entry=RamTst_Suspend
        BswCalledEntity_14: implemented-entry=RamTst_Resume
        BswCalledEntity_15: can-enter-exclusive-area=RAMTST_RAM_DATA_PROTECTION, implemented-entry=RamTst_RunFullTest
        BswCalledEntity_16: can-enter-exclusive-area=RAMTST_RAM_DATA_PROTECTION, implemented-entry=RamTst_RunPartialTest
        BswCalledEntity_17: implemented-entry=RamTst_GetAlgParams
      bsw timing event Evt_RamTst_MainFunction: starts-on-event=BSE_RamTst_MainFunction, period=0.01
  18 x bsw module entry, all with call-type=REGULAR, execution-context=TASK, sw-service-impl-policy=STANDARD:
    RamTst_Init: service-id=0, is-reentrant=false, is-synchronous=true
    RamTst_MainFunction: service-id=1, is-reentrant=false, is-synchronous=true
    RamTst_Stop: service-id=2, is-reentrant=false, is-synchronous=false
    RamTst_Allow: service-id=3, is-reentrant=false, is-synchronous=false
    RamTst_GetExecutionStatus: service-id=4, is-reentrant=true, is-synchronous=true
    RamTst_GetTestResult: service-id=5, is-reentrant=true, is-synchronous=true
    RamTst_GetTestResultPerBlock: service-id=6, is-reentrant=true, is-synchronous=true
    RamTst_GetTestAlgorithm: service-id=7, is-reentrant=false, is-synchronous=true
    RamTst_ChangeNumberOfTestedCells: service-id=8, is-reentrant=false, is-synchronous=true
    RamTst_GetNumberOfTestedCells: service-id=9, is-reentrant=false, is-synchronous=true
    RamTst_GetVersionInfo: service-id=10, is-reentrant=true, is-synchronous=true
    RamTst_SelectAlgParams: service-id=11, is-reentrant=false, is-synchronous=true
    RamTst_DeInit: service-id=12, is-reentrant=false, is-synchronous=true
    RamTst_Suspend: service-id=13, is-reentrant=false, is-synchronous=false
    RamTst_Resume: service-id=14, is-reentrant=false, is-synchronous=false
    RamTst_RunFullTest: service-id=16, is-reentrant=false, is-synchronous=true
    RamTst_RunPartialTest: service-id=17, is-reentrant=false, is-synchronous=true
    RamTst_GetAlgParams: service-id=18, is-reentrant=false, is-synchronous=true
