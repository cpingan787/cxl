AUTOSAR XML (schema 00048)
package /R7F7015833
  module config SecOC
    SecOCGeneral:
      SecOCDevErrorDetect = true
      SecOCEnableForcedPassOverride = false
      SecOCIgnoreVerificationResult = false
      SecOCMainFunctionPeriodRx = 0.05
      SecOCMainFunctionPeriodTx = 0.05
      SecOCQueryFreshnessValue = CFUNC
      SecOCVersionInfoApi = false
      SecOCVerificationStatusCallout = App_VerificationStatusCallout
    SecOCTxPduProcessing_0x12A_synthesized_IAM_BKPCANFD_20ms_Fr_CONTROLLER_0_IAM_Tx (SecOCTxPduProcessing):
      SecOCAuthInfoTruncLength = 24
      SecOCDataId = 298
      SecOCFreshnessValueId = 298
      SecOCFreshnessValueLength = 64
      SecOCFreshnessValueTruncLength = 8
      SecOCProvideTxTruncatedFreshnessValue = true
      SecOCAuthenticPduBuffLength = 8
      SecOCUseTxConfirmation = true
      SecOCAuthenticationBuildAttempts = 3
      SecOCTxAuthServiceConfigRef = CsmJob_MacGenSyn
      SecOCTxAuthenticPduLayer:
        SecOCPduType = SECOC_IFPDU
        SecOCTxAuthenticLayerPduId = SECOC_TXAUTH_SecOC_synthesized_IAM_BKPCANFD_20ms_Fr_CONTROLLER_0_IAM_TxAuthentic
        SecOCTxAuthenticLayerPduRef = SecOC_synthesized_IAM_BKPCANFD_20ms_Fr_CONTROLLER_0_IAM_TxAuthentic
      SecOCTxSecuredPduLayer
        SecOCTxSecuredPdu:
          SecOCTxSecuredLayerPduId = SECOC_TXSECU_SecOC_synthesized_IAM_BKPCANFD_20ms_Fr_CONTROLLER_0_IAM_TxSecured
          SecOCTxSecuredPduBuffLength = 12
          SecOCTxSecuredLayerPduRef = SecOC_synthesized_IAM_BKPCANFD_20ms_Fr_CONTROLLER_0_IAM_TxSecured
    SecOCRxPduProcessing_SecOC_SyncMsg_0x56F (SecOCRxPduProcessing):
      SecOCAuthInfoTruncLength = 24
      SecOCDataId = 1391
      SecOCFreshnessValueId = 1391
      SecOCFreshnessValueLength = 0
      SecOCFreshnessValueTruncLength = 0
      SecOCReceptionOverflowStrategy = QUEUE
      SecOCUseAuthDataFreshness = false
      SecOCVerificationStatusPropagationMode = FAILURE_ONLY
      SecOCAuthenticPduBuffLength = 5
      SecOCReceptionQueueSize = 8
      SecOCRxAuthServiceConfigRef = CsmJob_MacVerifySyn
      SecOCRxAuthenticPduLayer:
        SecOCPduType = SECOC_IFPDU
        SecOCRxAuthenticLayerPduId = SECOC_RXAUTH_CAN0_Rx_SecOC_SyncMsg_0x56F_SecOC_Authentic
        SecOCRxAuthenticLayerPduRef = CAN0_Rx_SecOC_SyncMsg_0x56F_SecOC_Authentic
      SecOCRxSecuredPduLayer
        SecOCRxSecuredPdu:
          SecOCRxSecuredLayerPduId = SECOC_RXSECU_CAN0_Rx_SecOC_SyncMsg_0x56F_SecOC_Secured
          SecOCSecuredRxPduVerification = true
          SecOCRxSecuredPduBuffLength = 8
          SecOCRxSecuredLayerPduRef = CAN0_Rx_SecOC_SyncMsg_0x56F_SecOC_Secured
    3 x SecOCTxPduProcessing, all with SecOCAuthInfoTruncLength=24, SecOCFreshnessValueLength=64, SecOCFreshnessValueTruncLength=8, SecOCProvideTxTruncatedFreshnessValue=true, SecOCUseTxConfirmation=true, SecOCAuthenticationBuildAttempts=3, SecOCTxAuthServiceConfigRef=CsmJob_MacGenSyn:
      SecOCTxPduProcessing_0xB3_synthesized_IAM_ZONE_CONNCA_0001_CONTROLLER_0_IAM_Tx: SecOCDataId=179, SecOCFreshnessValueId=179, SecOCAuthenticPduBuffLength=48
        SecOCTxAuthenticPduLayer:
          SecOCPduType = SECOC_IFPDU
          SecOCTxAuthenticLayerPduId = SECOC_TXAUTH_SecOC_synthesized_IAM_ZONE_CONNCA_0001_CONTROLLER_0_IAM_TxAuthentic
          SecOCTxAuthenticLayerPduRef = SecOC_synthesized_IAM_ZONE_CONNCA_0001_CONTROLLER_0_IAM_TxAuthentic
        SecOCTxSecuredPduLayer
          SecOCTxSecuredPdu:
            SecOCTxSecuredLayerPduId = SECOC_TXSECU_SecOC_synthesized_IAM_ZONE_CONNCA_0001_CONTROLLER_0_IAM_TxSecured
            SecOCTxSecuredPduBuffLength = 52
            SecOCTxSecuredLayerPduRef = SecOC_synthesized_IAM_ZONE_CONNCA_0001_CONTROLLER_0_IAM_TxSecured
      SecOCTxPduProcessing_0x9F_synthesized_IAM_ZONE_CONNCA_0000_CONTROLLER_0_IAM_Tx: SecOCDataId=159, SecOCFreshnessValueId=159, SecOCAuthenticPduBuffLength=48
        SecOCTxAuthenticPduLayer:
          SecOCPduType = SECOC_IFPDU
          SecOCTxAuthenticLayerPduId = SECOC_TXAUTH_SecOC_synthesized_IAM_ZONE_CONNCA_0000_CONTROLLER_0_IAM_TxAuthentic
          SecOCTxAuthenticLayerPduRef = SecOC_synthesized_IAM_ZONE_CONNCA_0000_CONTROLLER_0_IAM_TxAuthentic
        SecOCTxSecuredPduLayer
          SecOCTxSecuredPdu:
            SecOCTxSecuredLayerPduId = SECOC_TXSECU_SecOC_synthesized_IAM_ZONE_CONNCA_0000_CONTROLLER_0_IAM_TxSecured
            SecOCTxSecuredPduBuffLength = 52
            SecOCTxSecuredLayerPduRef = SecOC_synthesized_IAM_ZONE_CONNCA_0000_CONTROLLER_0_IAM_TxSecured
      SecOCTxPduProcessing_0x7D_synthesized_IAM_ZONE_CONNCANFD_E_CONTROLLER_0_IAM_Tx: SecOCDataId=125, SecOCFreshnessValueId=125, SecOCAuthenticPduBuffLength=16
        SecOCTxAuthenticPduLayer:
          SecOCPduType = SECOC_IFPDU
          SecOCTxAuthenticLayerPduId = SECOC_TXAUTH_SecOC_synthesized_IAM_ZONE_CONNCANFD_E_CONTROLLER_0_IAM_TxAuthentic
          SecOCTxAuthenticLayerPduRef = SecOC_synthesized_IAM_ZONE_CONNCANFD_E_CONTROLLER_0_IAM_TxAuthentic
        SecOCTxSecuredPduLayer
          SecOCTxSecuredPdu:
            SecOCTxSecuredLayerPduId = SECOC_TXSECU_SecOC_synthesized_IAM_ZONE_CONNCANFD_E_CONTROLLER_0_IAM_TxSecured
            SecOCTxSecuredPduBuffLength = 20
            SecOCTxSecuredLayerPduRef = SecOC_synthesized_IAM_ZONE_CONNCANFD_E_CONTROLLER_0_IAM_TxSecured
