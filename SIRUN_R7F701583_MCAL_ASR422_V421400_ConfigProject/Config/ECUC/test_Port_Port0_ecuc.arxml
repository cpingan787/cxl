AUTOSAR XML (schema 00049)
package /Renesas/EcucDefs_Port
  module config Port0: definition=Port, implementation-config-variant=VARIANT-POST-BUILD, module-description=Port_Impl
    PortConfigSet0 (PortConfigSet)
      PortContainer0 (PortContainer): PortNumberOfPortPins=1
        PortPin0 (PortPin):
          PortPinDirection = PORT_PIN_IN
          PortPinDirectionChangeable = false
          PortPinId = 1
          PortPinInitialMode = PORT_PIN_MODE_ADC
          PortPinLevelValue = PORT_PIN_LEVEL_HIGH
          PortPinMode = PORT_PIN_MODE_ADC
          PortPinModeChangeable = false
      PortFilterGroupConfig0 (PortFilterGroupConfig)
      PortGroup00 (PortGroup0)
        PortPin00 (PortPin0):
          PortPinDirectionChangeable = false
          PortPinDioAltModeChangeable = false
          PortPinModeChangeable = false
          PortPinLevelValue = PORT_PIN_LEVEL_LOW
          PortPinInitialMode = CAN0TX_AT2OUT_PFC_PFCE_PMCSR
          PortPinDirection = PORT_PIN_OUT
          PortInputBufferControl = false
          PortBiDirectionControl = false
          PortPullUpOption = false
          PortPullDownOption = false
          PortOpenDrainControl = false
          PortDriveStrengthControl = false
          PortInputSelection = TYPE_1_SUPP_PIS
        PortPin10 (PortPin1):
          PortPinDirectionChangeable = false
          PortPinDioAltModeChangeable = false
          PortPinModeChangeable = false
          PortPinLevelValue = PORT_PIN_LEVEL_LOW
          PortPinInitialMode = CAN0RX_AT2IN
          PortPinDirection = PORT_PIN_IN
          PortInputBufferControl = false
          PortBiDirectionControl = false
          PortPullUpOption = false
          PortPullDownOption = false
          PortOpenDrainControl = false
          PortDriveStrengthControl = false
          PortInputSelection = TYPE_1_SUPP_PIS
        PortPin20 (PortPin2):
          PortPinDirectionChangeable = false
          PortPinDioAltModeChangeable = false
          PortPinModeChangeable = true
          PortPinLevelValue = PORT_PIN_LEVEL_LOW
          PortPinInitialMode = CAN1RX_AT7IN
          PortPinDirection = PORT_PIN_IN
          PortInputBufferControl = false
          PortBiDirectionControl = false
          PortIpControl = false
          PortPullUpOption = false
          PortPullDownOption = false
          PortOpenDrainControl = false
          PortDriveStrengthControl = false
          PortInputSelection = TYPE_1_SUPP_PIS
        PortPin30 (PortPin3):
          PortPinDirectionChangeable = false
          PortPinDioAltModeChangeable = false
          PortPinModeChangeable = false
          PortPinLevelValue = PORT_PIN_LEVEL_LOW
          PortPinInitialMode = CAN1TX_AT2OUT
          PortPinDirection = PORT_PIN_OUT
          PortInputBufferControl = false
          PortBiDirectionControl = false
          PortIpControl = false
          PortPullUpOption = false
          PortPullDownOption = false
          PortOpenDrainControl = false
          PortDriveStrengthControl = false
          PortInputSelection = TYPE_1_SUPP_PIS
        PortPin40 (PortPin4):
          PortPinDirectionChangeable = false
          PortPinDioAltModeChangeable = false
          PortPinModeChangeable = false
          PortPinLevelValue = PORT_PIN_LEVEL_LOW
          PortPinInitialMode = DIO
          PortPinDirection = PORT_PIN_IN
          PortInputBufferControl = true
          PortBiDirectionControl = false
          PortPullUpOption = false
          PortPullDownOption = false
          PortOpenDrainControl = false
          PortDriveStrengthControl = false
          PortInputSelection = TYPE_1_SUPP_PIS
        PortPin50 (PortPin5):
          PortPinDirectionChangeable = true
          PortPinDioAltModeChangeable = false
          PortPinModeChangeable = false
          PortPinLevelValue = PORT_PIN_LEVEL_HIGH
          PortPinInitialMode = DIO
          PortPinDirection = PORT_PIN_OUT
          PortInputBufferControl = false
          PortBiDirectionControl = false
          PortIpControl = false
          PortPullUpOption = false
          PortPullDownOption = false
          PortOpenDrainControl = false
          PortDriveStrengthControl = false
          PortInputSelection = TYPE_1_SUPP_PIS
        PortPin60 (PortPin6):
          PortPinDirectionChangeable = false
          PortPinDioAltModeChangeable = false
          PortPinModeChangeable = false
          PortPinLevelValue = PORT_PIN_LEVEL_LOW
          PortPinInitialMode = DIO
          PortPinDirection = PORT_PIN_IN
          PortInputBufferControl = true
          PortBiDirectionControl = false
          PortIpControl = false
          PortPullUpOption = false
          PortPullDownOption = false
          PortOpenDrainControl = false
          PortDriveStrengthControl = false
          PortInputSelection = TYPE_1_SUPP_PIS
        PortPin70 (PortPin7):
          PortPinDirectionChangeable = false
          PortPinDioAltModeChangeable = false
          PortPinModeChangeable = false
          PortPinLevelValue = PORT_PIN_LEVEL_LOW
          PortPinInitialMode = CAN3RX_AT7IN
          PortPinDirection = PORT_PIN_IN
          PortInputBufferControl = false
          PortBiDirectionControl = false
          PortPullUpOption = false
          PortPullDownOption = false
          PortOpenDrainControl = false
          PortDriveStrengthControl = false
          PortInputSelection = TYPE_1_SUPP_PIS
        PortPin80 (PortPin8):
          PortPinDirectionChangeable = false
          PortPinDioAltModeChangeable = false
          PortPinModeChangeable = false
          PortPinLevelValue = PORT_PIN_LEVEL_LOW
          PortPinInitialMode = CAN3TX_AT5OUT
          PortPinDirection = PORT_PIN_OUT
          PortInputBufferControl = false
          PortBiDirectionControl = false
          PortPullUpOption = false
          PortPullDownOption = false
          PortOpenDrainControl = false
          PortDriveStrengthControl = false
          PortInputSelection = TYPE_2_SUPP_PIS
        PortPin90 (PortPin9):
          PortPinDirectionChangeable = false
          PortPinDioAltModeChangeable = false
          PortPinModeChangeable = false
          PortPinLevelValue = PORT_PIN_LEVEL_LOW
          PortPinInitialMode = DIO
          PortPinDirection = PORT_PIN_IN
          PortInputBufferControl = true
          PortBiDirectionControl = false
          PortPullUpOption = false
          PortPullDownOption = false
          PortOpenDrainControl = false
          PortDriveStrengthControl = false
          PortInputSelection = TYPE_1_SUPP_PIS
        PortPin100 (PortPin10):
          PortPinDirectionChangeable = false
          PortPinDioAltModeChangeable = false
          PortPinModeChangeable = false
          PortPinLevelValue = PORT_PIN_LEVEL_LOW
          PortPinInitialMode = DIO
          PortPinDirection = PORT_PIN_OUT
          PortInputBufferControl = false
          PortBiDirectionControl = false
          PortPullUpOption = false
          PortPullDownOption = false
          PortOpenDrainControl = false
          PortDriveStrengthControl = false
          PortInputSelection = TYPE_2_SUPP_PIS
        PortPin110 (PortPin11):
          PortPinDirectionChangeable = false
          PortPinDioAltModeChangeable = false
          PortPinModeChangeable = false
          PortPinLevelValue = PORT_PIN_LEVEL_LOW
          PortPinInitialMode = DIO_PFC_PFCE_PMCSR
          PortPinDirection = PORT_PIN_OUT
          PortInputBufferControl = false
          PortBiDirectionControl = false
          PortPullUpOption = false
          PortPullDownOption = false
          PortOpenDrainControl = false
          PortDriveStrengthControl = false
          PortInputSelection = TYPE_1_SUPP_PIS
        PortPin120 (PortPin12):
          PortPinDirectionChangeable = false
          PortPinDioAltModeChangeable = false
          PortPinModeChangeable = false
          PortPinLevelValue = PORT_PIN_LEVEL_LOW
          PortPinInitialMode = DIO_PFC_PFCE_PMCSR
          PortPinDirection = PORT_PIN_OUT
          PortInputBufferControl = false
          PortBiDirectionControl = false
          PortPullUpOption = false
          PortPullDownOption = false
          PortOpenDrainControl = false
          PortDriveStrengthControl = false
          PortInputSelection = TYPE_1_SUPP_PIS
        PortPin130 (PortPin13):
          PortPinDirectionChangeable = false
          PortPinDioAltModeChangeable = false
          PortPinModeChangeable = false
          PortPinLevelValue = PORT_PIN_LEVEL_LOW
          PortPinInitialMode = DIO
          PortPinDirection = PORT_PIN_OUT
          PortInputBufferControl = false
          PortBiDirectionControl = false
          PortIpControl = false
          PortPullUpOption = false
          PortOpenDrainControl = false
          PortDriveStrengthControl = false
          PortInputSelection = TYPE_1_SUPP_PIS
          PortPullDownOption = false
        PortPin140 (PortPin14):
          PortPinDirectionChangeable = false
          PortPinDioAltModeChangeable = false
          PortPinModeChangeable = false
          PortPinLevelValue = PORT_PIN_LEVEL_LOW
          PortPinInitialMode = DIO
          PortPinDirection = PORT_PIN_OUT
          PortInputBufferControl = false
          PortBiDirectionControl = false
          PortIpControl = false
          PortPullUpOption = false
          PortOpenDrainControl = false
          PortDriveStrengthControl = false
          PortInputSelection = TYPE_2_SUPP_PIS
          PortPullDownOption = false
      PortGroup80 (PortGroup8)
        PortPin00 (PortPin0):
          PortPinDirectionChangeable = false
          PortPinDioAltModeChangeable = false
          PortPinModeChangeable = false
          PortPinLevelValue = PORT_PIN_LEVEL_LOW
          PortPinInitialMode = DIO_PFC_PFCE_PMCSR
          PortPinDirection = PORT_PIN_OUT
          PortInputBufferControl = false
          PortBiDirectionControl = false
          PortPullUpOption = true
          PortPullDownOption = false
          PortOpenDrainControl = false
          PortInputSelection = TYPE_2_SUPP_PIS
        PortPin10 (PortPin1):
          PortPinDirectionChangeable = false
          PortPinDioAltModeChangeable = false
          PortPinModeChangeable = false
          PortPinLevelValue = PORT_PIN_LEVEL_LOW
          PortPinInitialMode = DIO_PFC_PFCE_PMCSR
          PortPinDirection = PORT_PIN_IN
          PortInputBufferControl = true
          PortBiDirectionControl = false
          PortPullUpOption = false
          PortPullDownOption = true
          PortOpenDrainControl = false
          PortInputSelection = TYPE_2_SUPP_PIS
        PortPin20 (PortPin2):
          PortPinDirectionChangeable = false
          PortPinDioAltModeChangeable = false
          PortPinModeChangeable = false
          PortPinLevelValue = PORT_PIN_LEVEL_LOW
          PortPinInitialMode = DIO_PFC_PFCE_PMCSR
          PortPinDirection = PORT_PIN_IN
          PortInputBufferControl = true
          PortBiDirectionControl = false
          PortPullUpOption = false
          PortPullDownOption = false
          PortOpenDrainControl = false
          PortInputSelection = TYPE_2_SUPP_PIS
        PortPin30 (PortPin3):
          PortPinDirectionChangeable = false
          PortPinDioAltModeChangeable = false
          PortPinModeChangeable = false
          PortPinLevelValue = PORT_PIN_LEVEL_LOW
          PortPinInitialMode = DIO_PFC_PFCE_PMCSR
          PortPinDirection = PORT_PIN_IN
          PortInputBufferControl = true
          PortBiDirectionControl = false
          PortPullUpOption = false
          PortPullDownOption = false
          PortOpenDrainControl = false
          PortInputSelection = TYPE_2_SUPP_PIS
        PortPin40 (PortPin4):
          PortPinDirectionChangeable = false
          PortPinDioAltModeChangeable = false
          PortPinModeChangeable = false
          PortPinLevelValue = PORT_PIN_LEVEL_LOW
          PortPinInitialMode = DIO_PFC_PFCE_PMCSR
          PortPinDirection = PORT_PIN_IN
          PortInputBufferControl = true
          PortBiDirectionControl = false
          PortPullUpOption = false
          PortPullDownOption = false
          PortOpenDrainControl = false
          PortInputSelection = TYPE_2_SUPP_PIS
        PortPin50 (PortPin5):
          PortPinDirectionChangeable = false
          PortPinDioAltModeChangeable = false
          PortPinModeChangeable = false
          PortPinLevelValue = PORT_PIN_LEVEL_LOW
          PortPinInitialMode = DIO_PFC_PFCE_PMCSR
          PortPinDirection = PORT_PIN_IN
          PortInputBufferControl = true
          PortBiDirectionControl = false
          PortPullUpOption = true
          PortPullDownOption = false
          PortOpenDrainControl = false
          PortInputSelection = TYPE_2_SUPP_PIS
        PortPin60 (PortPin6):
          PortPinDirectionChangeable = false
          PortPinDioAltModeChangeable = false
          PortPinModeChangeable = false
          PortPinLevelValue = PORT_PIN_LEVEL_LOW
          PortPinInitialMode = DIO_PFC_PFCE_PMCSR
          PortPinDirection = PORT_PIN_OUT
          PortInputBufferControl = false
          PortBiDirectionControl = false
          PortPullUpOption = false
          PortPullDownOption = false
          PortOpenDrainControl = false
          PortInputSelection = TYPE_2_SUPP_PIS
        PortPin70 (PortPin7):
          PortPinDirectionChangeable = false
          PortPinDioAltModeChangeable = false
          PortPinModeChangeable = false
          PortPinLevelValue = PORT_PIN_LEVEL_LOW
          PortPinInitialMode = CSIH3CSS0_AT1OUT_PFC_PFCE_PMCSR
          PortPinDirection = PORT_PIN_OUT
          PortInputBufferControl = false
          PortBiDirectionControl = false
          PortPullUpOption = false
          PortPullDownOption = false
          PortOpenDrainControl = false
          PortInputSelection = TYPE_2_SUPP_PIS
        PortPin80 (PortPin8):
          PortPinDirectionChangeable = false
          PortPinDioAltModeChangeable = false
          PortPinModeChangeable = false
          PortPinLevelValue = PORT_PIN_LEVEL_LOW
          PortPinInitialMode = DIO_PFC_PFCE_PMCSR
          PortPinDirection = PORT_PIN_IN
          PortInputBufferControl = false
          PortBiDirectionControl = false
          PortPullUpOption = false
          PortPullDownOption = false
          PortOpenDrainControl = false
          PortInputSelection = TYPE_2_SUPP_PIS
        PortPin90 (PortPin9):
          PortPinDirectionChangeable = false
          PortPinDioAltModeChangeable = false
          PortPinModeChangeable = false
          PortPinLevelValue = PORT_PIN_LEVEL_LOW
          PortPinInitialMode = DIO_PFC_PFCE_PMCSR
          PortPinDirection = PORT_PIN_IN
          PortInputBufferControl = true
          PortBiDirectionControl = false
          PortPullUpOption = false
          PortPullDownOption = false
          PortOpenDrainControl = false
          PortInputSelection = TYPE_2_SUPP_PIS
        PortPin100 (PortPin10):
          PortPinDirectionChangeable = false
          PortPinDioAltModeChangeable = false
          PortPinModeChangeable = true
          PortPinLevelValue = PORT_PIN_LEVEL_LOW
          PortPinInitialMode = DIO_PFC_PMCSR
          PortPinDirection = PORT_PIN_IN
          PortInputBufferControl = false
          PortBiDirectionControl = false
          PortPullUpOption = false
          PortPullDownOption = false
          PortOpenDrainControl = false
          PortInputSelection = TYPE_2_SUPP_PIS
        PortPin110 (PortPin11):
          PortPinDirectionChangeable = false
          PortPinDioAltModeChangeable = false
          PortPinModeChangeable = true
          PortPinLevelValue = PORT_PIN_LEVEL_LOW
          PortPinInitialMode = DIO_PFC_PFCE_PMCSR
          PortPinDirection = PORT_PIN_IN
          PortInputBufferControl = false
          PortBiDirectionControl = false
          PortPullUpOption = false
          PortPullDownOption = false
          PortOpenDrainControl = false
          PortInputSelection = TYPE_2_SUPP_PIS
        PortPin120 (PortPin12):
          PortPinDirectionChangeable = false
          PortPinDioAltModeChangeable = false
          PortPinModeChangeable = false
          PortPinLevelValue = PORT_PIN_LEVEL_LOW
          PortPinInitialMode = DIO_PFC_PFCE_PMCSR
          PortPinDirection = PORT_PIN_OUT
          PortInputBufferControl = false
          PortBiDirectionControl = false
          PortPullUpOption = false
          PortPullDownOption = false
          PortOpenDrainControl = false
          PortInputSelection = TYPE_2_SUPP_PIS
      PortGroup90 (PortGroup9)
        PortPin00 (PortPin0):
          PortPinDirectionChangeable = false
          PortPinDioAltModeChangeable = false
          PortPinModeChangeable = false
          PortPinLevelValue = PORT_PIN_LEVEL_LOW
          PortPinInitialMode = DIO_PFC_PFCE_PMCSR
          PortPinDirection = PORT_PIN_OUT
          PortInputBufferControl = false
          PortBiDirectionControl = false
          PortPullUpOption = false
          PortPullDownOption = false
          PortOpenDrainControl = false
          PortInputSelection = TYPE_2_SUPP_PIS
        PortPin10 (PortPin1):
          PortPinDirectionChangeable = false
          PortPinDioAltModeChangeable = false
          PortPinModeChangeable = false
          PortPinLevelValue = PORT_PIN_LEVEL_LOW
          PortPinInitialMode = DIO_PFC_PFCE_PMCSR
          PortPinDirection = PORT_PIN_OUT
          PortInputBufferControl = false
          PortBiDirectionControl = false
          PortPullUpOption = false
          PortPullDownOption = false
          PortOpenDrainControl = false
          PortInputSelection = TYPE_2_SUPP_PIS
        PortPin20 (PortPin2):
          PortPinDirectionChangeable = false
          PortPinDioAltModeChangeable = false
          PortPinModeChangeable = false
          PortPinLevelValue = PORT_PIN_LEVEL_LOW
          PortPinInitialMode = CSIH2CSS2_AT2OUT_PFC_PMCSR
          PortPinDirection = PORT_PIN_OUT
          PortInputBufferControl = false
          PortBiDirectionControl = false
          PortPullUpOption = false
          PortPullDownOption = false
          PortOpenDrainControl = false
          PortInputSelection = TYPE_2_SUPP_PIS
        PortPin30 (PortPin3):
          PortPinDirectionChangeable = false
          PortPinDioAltModeChangeable = false
          PortPinModeChangeable = false
          PortPinLevelValue = PORT_PIN_LEVEL_LOW
          PortPinInitialMode = DIO_PFC_PFCE_PMCSR
          PortPinDirection = PORT_PIN_IN
          PortInputBufferControl = false
          PortBiDirectionControl = false
          PortPullUpOption = false
          PortPullDownOption = false
          PortOpenDrainControl = false
          PortInputSelection = TYPE_2_SUPP_PIS
        PortPin40 (PortPin4):
          PortPinDirectionChangeable = false
          PortPinDioAltModeChangeable = false
          PortPinModeChangeable = false
          PortPinLevelValue = PORT_PIN_LEVEL_LOW
          PortPinInitialMode = DIO_PFC_PFCE_PMCSR
          PortPinDirection = PORT_PIN_IN
          PortInputBufferControl = true
          PortBiDirectionControl = false
          PortPullUpOption = false
          PortPullDownOption = false
          PortOpenDrainControl = false
          PortInputSelection = TYPE_2_SUPP_PIS
        PortPin50 (PortPin5):
          PortPinDirectionChangeable = false
          PortPinDioAltModeChangeable = false
          PortPinModeChangeable = false
          PortPinLevelValue = PORT_PIN_LEVEL_LOW
          PortPinInitialMode = DIO_PFC_PFCE_PMCSR
          PortPinDirection = PORT_PIN_IN
          PortInputBufferControl = true
          PortBiDirectionControl = false
          PortPullUpOption = false
          PortPullDownOption = false
          PortOpenDrainControl = false
          PortInputSelection = TYPE_2_SUPP_PIS
        PortPin60 (PortPin6):
          PortPinDirectionChangeable = false
          PortPinDioAltModeChangeable = false
          PortPinModeChangeable = false
          PortPinLevelValue = PORT_PIN_LEVEL_LOW
          PortPinInitialMode = DIO_PFC_PMCSR
          PortPinDirection = PORT_PIN_OUT
          PortInputBufferControl = false
          PortBiDirectionControl = false
          PortPullUpOption = false
          PortPullDownOption = false
          PortOpenDrainControl = false
          PortInputSelection = TYPE_2_SUPP_PIS
      PortGroup100 (PortGroup10)
        PortPin00 (PortPin0):
          PortPinDirectionChangeable = false
          PortPinDioAltModeChangeable = false
          PortPinModeChangeable = false
          PortPinLevelValue = PORT_PIN_LEVEL_LOW
          PortPinInitialMode = DIO
          PortPinDirection = PORT_PIN_OUT
          PortInputBufferControl = false
          PortBiDirectionControl = false
          PortIpControl = false
          PortPullUpOption = false
          PortPullDownOption = false
          PortOpenDrainControl = false
          PortDriveStrengthControl = false
          PortInputSelection = TYPE_2_SUPP_PIS
        PortPin10 (PortPin1):
          PortPinDirectionChangeable = false
          PortPinDioAltModeChangeable = false
          PortPinModeChangeable = false
          PortPinLevelValue = PORT_PIN_LEVEL_LOW
          PortPinInitialMode = DIO
          PortPinDirection = PORT_PIN_IN
          PortInputBufferControl = false
          PortBiDirectionControl = false
          PortIpControl = false
          PortPullUpOption = false
          PortPullDownOption = false
          PortOpenDrainControl = false
          PortDriveStrengthControl = false
          PortInputSelection = TYPE_2_SUPP_PIS
        PortPin20 (PortPin2):
          PortPinDirectionChangeable = true
          PortPinDioAltModeChangeable = false
          PortPinModeChangeable = false
          PortPinLevelValue = PORT_PIN_LEVEL_LOW
          PortPinInitialMode = RIIC0SDA_AT2OUT
          PortPinDirection = PORT_PIN_OUT
          PortInputBufferControl = false
          PortBiDirectionControl = false
          PortIpControl = false
          PortPullUpOption = false
          PortPullDownOption = false
          PortOpenDrainControl = false
          PortDriveStrengthControl = false
          PortInputSelection = TYPE_2_SUPP_PIS
        PortPin30 (PortPin3):
          PortPinDirectionChangeable = true
          PortPinDioAltModeChangeable = false
          PortPinModeChangeable = true
          PortPinLevelValue = PORT_PIN_LEVEL_LOW
          PortPinInitialMode = RIIC0SCL_AT2OUT
          PortPinDirection = PORT_PIN_OUT
          PortInputBufferControl = false
          PortBiDirectionControl = false
          PortIpControl = false
          PortPullUpOption = false
          PortPullDownOption = false
          PortOpenDrainControl = false
          PortDriveStrengthControl = false
          PortInputSelection = TYPE_2_SUPP_PIS
        PortPin40 (PortPin4):
          PortPinDirectionChangeable = false
          PortPinDioAltModeChangeable = false
          PortPinModeChangeable = false
          PortPinLevelValue = PORT_PIN_LEVEL_LOW
          PortPinInitialMode = DIO
          PortPinDirection = PORT_PIN_OUT
          PortInputBufferControl = false
          PortBiDirectionControl = false
          PortIpControl = false
          PortPullUpOption = false
          PortPullDownOption = false
          PortOpenDrainControl = false
          PortDriveStrengthControl = false
          PortInputSelection = TYPE_2_SUPP_PIS
        PortPin50 (PortPin5):
          PortPinDirectionChangeable = false
          PortPinDioAltModeChangeable = false
          PortPinModeChangeable = false
          PortPinLevelValue = PORT_PIN_LEVEL_LOW
          PortPinInitialMode = DIO
          PortPinDirection = PORT_PIN_OUT
          PortInputBufferControl = false
          PortBiDirectionControl = false
          PortIpControl = false
          PortPullUpOption = false
          PortPullDownOption = false
          PortOpenDrainControl = false
          PortDriveStrengthControl = false
          PortInputSelection = TYPE_2_SUPP_PIS
        PortPin60 (PortPin6):
          PortPinDirectionChangeable = false
          PortPinDioAltModeChangeable = false
          PortPinModeChangeable = false
          PortPinLevelValue = PORT_PIN_LEVEL_LOW
          PortPinInitialMode = DIO
          PortPinDirection = PORT_PIN_IN
          PortInputBufferControl = true
          PortBiDirectionControl = false
          PortIpControl = false
          PortPullUpOption = false
          PortPullDownOption = false
          PortOpenDrainControl = false
          PortDriveStrengthControl = false
          PortInputSelection = TYPE_2_SUPP_PIS
        PortPin70 (PortPin7):
          PortPinDirectionChangeable = false
          PortPinDioAltModeChangeable = false
          PortPinModeChangeable = false
          PortPinLevelValue = PORT_PIN_LEVEL_LOW
          PortPinInitialMode = DIO_PFC_PFCE_PMCSR
          PortPinDirection = PORT_PIN_IN
          PortInputBufferControl = false
          PortBiDirectionControl = false
          PortIpControl = false
          PortPullUpOption = false
          PortPullDownOption = false
          PortOpenDrainControl = false
          PortDriveStrengthControl = false
          PortInputSelection = TYPE_2_SUPP_PIS
        PortPin80 (PortPin8):
          PortPinDirectionChangeable = false
          PortPinDioAltModeChangeable = false
          PortPinModeChangeable = false
          PortPinLevelValue = PORT_PIN_LEVEL_LOW
          PortPinInitialMode = DIO_PFC_PFCE_PMCSR
          PortPinDirection = PORT_PIN_IN
          PortInputBufferControl = false
          PortBiDirectionControl = false
          PortPullUpOption = false
          PortPullDownOption = false
          PortOpenDrainControl = false
          PortDriveStrengthControl = false
          PortInputSelection = TYPE_2_SUPP_PIS
        PortPin90 (PortPin9):
          PortPinDirectionChangeable = false
          PortPinDioAltModeChangeable = false
          PortPinModeChangeable = false
          PortPinLevelValue = PORT_PIN_LEVEL_LOW
          PortPinInitialMode = TAUD0I12_AT1IN
          PortPinDirection = PORT_PIN_IN
          PortInputBufferControl = false
          PortBiDirectionControl = false
          PortPullUpOption = false
          PortPullDownOption = false
          PortOpenDrainControl = false
          PortDriveStrengthControl = false
          PortInputSelection = TYPE_2_SUPP_PIS
        PortPin100 (PortPin10):
          PortPinDirectionChangeable = false
          PortPinDioAltModeChangeable = false
          PortPinModeChangeable = false
          PortPinLevelValue = PORT_PIN_LEVEL_LOW
          PortPinInitialMode = DIO_PFC_PFCE_PMCSR
          PortPinDirection = PORT_PIN_OUT
          PortInputBufferControl = false
          PortBiDirectionControl = false
          PortPullUpOption = false
          PortPullDownOption = false
          PortOpenDrainControl = false
          PortDriveStrengthControl = false
          PortInputSelection = TYPE_2_SUPP_PIS
        PortPin110 (PortPin11):
          PortPinDirectionChangeable = false
          PortPinDioAltModeChangeable = false
          PortPinModeChangeable = false
          PortPinLevelValue = PORT_PIN_LEVEL_LOW
          PortPinInitialMode = RLIN31RX_AT7IN
          PortPinDirection = PORT_PIN_IN
          PortInputBufferControl = false
          PortBiDirectionControl = false
          PortPullUpOption = false
          PortPullDownOption = false
          PortOpenDrainControl = false
          PortDriveStrengthControl = false
          PortInputSelection = TYPE_2_SUPP_PIS
        PortPin120 (PortPin12):
          PortPinDirectionChangeable = false
          PortPinDioAltModeChangeable = false
          PortPinModeChangeable = false
          PortPinLevelValue = PORT_PIN_LEVEL_LOW
          PortPinInitialMode = RLIN31TX_AT2OUT_PFC_PFCE_PMCSR
          PortPinDirection = PORT_PIN_OUT
          PortInputBufferControl = false
          PortBiDirectionControl = false
          PortPullUpOption = false
          PortPullDownOption = false
          PortOpenDrainControl = false
          PortDriveStrengthControl = false
          PortInputSelection = TYPE_2_SUPP_PIS
        PortPin130 (PortPin13):
          PortPinDirectionChangeable = false
          PortPinDioAltModeChangeable = false
          PortPinModeChangeable = false
          PortPinLevelValue = PORT_PIN_LEVEL_LOW
          PortPinInitialMode = DIO
          PortPinDirection = PORT_PIN_IN
          PortInputBufferControl = true
          PortBiDirectionControl = false
          PortPullUpOption = false
          PortPullDownOption = false
          PortOpenDrainControl = false
          PortDriveStrengthControl = false
          PortInputSelection = TYPE_2_SUPP_PIS
        PortPin140 (PortPin14):
          PortPinDirectionChangeable = false
          PortPinDioAltModeChangeable = false
          PortPinModeChangeable = false
          PortPinLevelValue = PORT_PIN_LEVEL_LOW
          PortPinInitialMode = DIO_PFC_PFCE_PMCSR
          PortPinDirection = PORT_PIN_OUT
          PortInputBufferControl = false
          PortBiDirectionControl = false
          PortPullUpOption = false
          PortPullDownOption = false
          PortOpenDrainControl = false
          PortDriveStrengthControl = false
          PortInputSelection = TYPE_2_SUPP_PIS
        PortPin150 (PortPin15):
          PortPinDirectionChangeable = false
          PortPinDioAltModeChangeable = false
          PortPinModeChangeable = true
          PortPinLevelValue = PORT_PIN_LEVEL_LOW
          PortPinInitialMode = DIO_PFC_PFCE_PMCSR
          PortPinDirection = PORT_PIN_OUT
          PortInputBufferControl = false
          PortBiDirectionControl = false
          PortPullUpOption = false
          PortPullDownOption = false
          PortOpenDrainControl = false
          PortDriveStrengthControl = false
          PortInputSelection = TYPE_2_SUPP_PIS
      PortGroup110 (PortGroup11)
        PortPin00 (PortPin0):
          PortPinDirectionChangeable = false
          PortPinDioAltModeChangeable = false
          PortPinModeChangeable = false
          PortPinLevelValue = PORT_PIN_LEVEL_LOW
          PortPinInitialMode = DIO_PFC_PFCE_PMCSR
          PortPinDirection = PORT_PIN_OUT
          PortInputBufferControl = false
          PortBiDirectionControl = false
          PortPullUpOption = false
          PortPullDownOption = false
          PortOpenDrainControl = false
          PortDriveStrengthControl = false
          PortInputSelection = TYPE_2_SUPP_PIS
        PortPin10 (PortPin1):
          PortPinDirectionChangeable = false
          PortPinDioAltModeChangeable = false
          PortPinModeChangeable = false
          PortPinLevelValue = PORT_PIN_LEVEL_LOW
          PortPinInitialMode = DIO_PFC_PFCE_PMCSR
          PortPinDirection = PORT_PIN_OUT
          PortInputBufferControl = false
          PortBiDirectionControl = false
          PortPullUpOption = false
          PortPullDownOption = false
          PortOpenDrainControl = false
          PortDriveStrengthControl = false
          PortInputSelection = TYPE_2_SUPP_PIS
        PortPin20 (PortPin2):
          PortPinDirectionChangeable = false
          PortPinDioAltModeChangeable = false
          PortPinModeChangeable = false
          PortPinLevelValue = PORT_PIN_LEVEL_LOW
          PortPinInitialMode = CSIH2SO_AT1OUT
          PortPinDirection = PORT_PIN_OUT
          PortInputBufferControl = false
          PortBiDirectionControl = false
          PortIpControl = true
          PortPullUpOption = false
          PortPullDownOption = false
          PortOpenDrainControl = false
          PortDriveStrengthControl = false
          PortInputSelection = TYPE_2_SUPP_PIS
        PortPin30 (PortPin3):
          PortPinDirectionChangeable = false
          PortPinDioAltModeChangeable = false
          PortPinModeChangeable = false
          PortPinLevelValue = PORT_PIN_LEVEL_LOW
          PortPinInitialMode = CSIH2SC_AT1OUT
          PortPinDirection = PORT_PIN_OUT
          PortInputBufferControl = false
          PortBiDirectionControl = false
          PortIpControl = true
          PortPullUpOption = false
          PortPullDownOption = false
          PortOpenDrainControl = false
          PortDriveStrengthControl = false
          PortInputSelection = TYPE_2_SUPP_PIS
        PortPin40 (PortPin4):
          PortPinDirectionChangeable = false
          PortPinDioAltModeChangeable = false
          PortPinModeChangeable = false
          PortPinLevelValue = PORT_PIN_LEVEL_LOW
          PortPinInitialMode = CSIH2SI_AT1IN_PFC_PFCE_PMCSR
          PortPinDirection = PORT_PIN_IN
          PortInputBufferControl = false
          PortBiDirectionControl = false
          PortPullUpOption = false
          PortPullDownOption = false
          PortOpenDrainControl = false
          PortDriveStrengthControl = false
          PortInputSelection = TYPE_2_SUPP_PIS
        PortPin50 (PortPin5):
          PortPinDirectionChangeable = false
          PortPinDioAltModeChangeable = false
          PortPinModeChangeable = false
          PortPinLevelValue = PORT_PIN_LEVEL_LOW
          PortPinInitialMode = CSIH3SI_AT3IN
          PortPinDirection = PORT_PIN_OUT
          PortInputBufferControl = false
          PortBiDirectionControl = false
          PortPullUpOption = false
          PortPullDownOption = false
          PortOpenDrainControl = false
          PortDriveStrengthControl = false
          PortInputSelection = TYPE_2_SUPP_PIS
        PortPin60 (PortPin6):
          PortPinDirectionChangeable = false
          PortPinDioAltModeChangeable = false
          PortPinModeChangeable = false
          PortPinLevelValue = PORT_PIN_LEVEL_LOW
          PortPinInitialMode = CSIH3SO_AT3OUT
          PortPinDirection = PORT_PIN_OUT
          PortInputBufferControl = false
          PortBiDirectionControl = false
          PortIpControl = true
          PortPullUpOption = false
          PortPullDownOption = false
          PortOpenDrainControl = false
          PortDriveStrengthControl = false
          PortInputSelection = TYPE_2_SUPP_PIS
        PortPin70 (PortPin7):
          PortPinDirectionChangeable = false
          PortPinDioAltModeChangeable = false
          PortPinModeChangeable = false
          PortPinLevelValue = PORT_PIN_LEVEL_LOW
          PortPinInitialMode = CSIH3SC_AT3OUT_PFC_PFCE_PMCSR
          PortPinDirection = PORT_PIN_OUT
          PortInputBufferControl = false
          PortBiDirectionControl = false
          PortIpControl = true
          PortPullUpOption = false
          PortPullDownOption = false
          PortOpenDrainControl = false
          PortDriveStrengthControl = false
          PortInputSelection = TYPE_2_SUPP_PIS
        PortPin80 (PortPin8):
          PortPinDirectionChangeable = false
          PortPinDioAltModeChangeable = false
          PortPinModeChangeable = false
          PortPinLevelValue = PORT_PIN_LEVEL_LOW
          PortPinInitialMode = CSIG1SSI_AT1IN_PFC_PFCE_PMCSR
          PortPinDirection = PORT_PIN_IN
          PortInputBufferControl = false
          PortBiDirectionControl = false
          PortPullUpOption = false
          PortPullDownOption = false
          PortOpenDrainControl = false
          PortDriveStrengthControl = false
          PortInputSelection = TYPE_2_SUPP_PIS
        PortPin90 (PortPin9):
          PortPinDirectionChangeable = false
          PortPinDioAltModeChangeable = false
          PortPinModeChangeable = false
          PortPinLevelValue = PORT_PIN_LEVEL_LOW
          PortPinInitialMode = CSIG1SO_AT1OUT
          PortPinDirection = PORT_PIN_OUT
          PortInputBufferControl = false
          PortBiDirectionControl = false
          PortIpControl = true
          PortPullUpOption = false
          PortPullDownOption = false
          PortOpenDrainControl = false
          PortDriveStrengthControl = false
          PortInputSelection = TYPE_2_SUPP_PIS
        PortPin100 (PortPin10):
          PortPinDirectionChangeable = false
          PortPinDioAltModeChangeable = false
          PortPinModeChangeable = false
          PortPinLevelValue = PORT_PIN_LEVEL_LOW
          PortPinInitialMode = CSIG1SC_AT1IN_PFC_PFCE_PMCSR
          PortPinDirection = PORT_PIN_IN
          PortInputBufferControl = false
          PortBiDirectionControl = false
          PortIpControl = true
          PortPullUpOption = false
          PortPullDownOption = false
          PortOpenDrainControl = false
          PortDriveStrengthControl = false
          PortInputSelection = TYPE_2_SUPP_PIS
        PortPin110 (PortPin11):
          PortPinDirectionChangeable = false
          PortPinDioAltModeChangeable = false
          PortPinModeChangeable = false
          PortPinLevelValue = PORT_PIN_LEVEL_LOW
          PortPinInitialMode = CSIG1SI_AT1IN_PFC_PFCE_PMCSR
          PortPinDirection = PORT_PIN_IN
          PortInputBufferControl = false
          PortBiDirectionControl = false
          PortPullUpOption = false
          PortPullDownOption = false
          PortOpenDrainControl = false
          PortDriveStrengthControl = false
          PortInputSelection = TYPE_2_SUPP_PIS
        PortPin120 (PortPin12):
          PortPinDirectionChangeable = false
          PortPinDioAltModeChangeable = false
          PortPinModeChangeable = false
          PortPinLevelValue = PORT_PIN_LEVEL_LOW
          PortPinInitialMode = DIO_PFC_PFCE_PMCSR
          PortPinDirection = PORT_PIN_OUT
          PortInputBufferControl = false
          PortBiDirectionControl = false
          PortPullUpOption = false
          PortPullDownOption = false
          PortOpenDrainControl = false
          PortDriveStrengthControl = false
          PortInputSelection = TYPE_2_SUPP_PIS
        PortPin130 (PortPin13):
          PortPinDirectionChangeable = false
          PortPinDioAltModeChangeable = false
          PortPinModeChangeable = false
          PortPinLevelValue = PORT_PIN_LEVEL_LOW
          PortPinInitialMode = RLIN24RX_AT1IN_PFC_PFCE_PMCSR
          PortPinDirection = PORT_PIN_IN
          PortInputBufferControl = false
          PortBiDirectionControl = false
          PortPullUpOption = false
          PortPullDownOption = false
          PortOpenDrainControl = false
          PortDriveStrengthControl = false
          PortInputSelection = TYPE_2_SUPP_PIS
        PortPin140 (PortPin14):
          PortPinDirectionChangeable = false
          PortPinDioAltModeChangeable = false
          PortPinModeChangeable = false
          PortPinLevelValue = PORT_PIN_LEVEL_LOW
          PortPinInitialMode = RLIN24TX_AT1OUT_PFC_PFCE_PMCSR
          PortPinDirection = PORT_PIN_OUT
          PortInputBufferControl = false
          PortBiDirectionControl = false
          PortPullUpOption = false
          PortPullDownOption = false
          PortOpenDrainControl = false
          PortDriveStrengthControl = false
          PortInputSelection = TYPE_2_SUPP_PIS
        PortPin150 (PortPin15):
          PortPinDirectionChangeable = false
          PortPinDioAltModeChangeable = false
          PortPinModeChangeable = false
          PortPinLevelValue = PORT_PIN_LEVEL_LOW
          PortPinInitialMode = DIO
          PortPinDirection = PORT_PIN_OUT
          PortInputBufferControl = false
          PortBiDirectionControl = false
          PortPullUpOption = false
          PortPullDownOption = false
          PortOpenDrainControl = false
          PortDriveStrengthControl = false
          PortInputSelection = TYPE_2_SUPP_PIS
      PortGroup120 (PortGroup12)
        PortPin00 (PortPin0):
          PortPullDownOption = false
          PortPinDirectionChangeable = false
          PortPinDioAltModeChangeable = false
          PortPinModeChangeable = false
          PortPinLevelValue = PORT_PIN_LEVEL_LOW
          PortPinInitialMode = DIO_PFC_PFCE_PMCSR
          PortPinDirection = PORT_PIN_OUT
          PortInputBufferControl = false
          PortBiDirectionControl = false
          PortPullUpOption = false
          PortOpenDrainControl = false
          PortDriveStrengthControl = false
          PortInputSelection = TYPE_2_SUPP_PIS
        PortPin10 (PortPin1):
          PortPullDownOption = false
          PortPinDirectionChangeable = false
          PortPinDioAltModeChangeable = false
          PortPinModeChangeable = false
          PortPinLevelValue = PORT_PIN_LEVEL_LOW
          PortPinInitialMode = RLIN34RX_AT7IN
          PortPinDirection = PORT_PIN_IN
          PortInputBufferControl = false
          PortBiDirectionControl = false
          PortPullUpOption = false
          PortOpenDrainControl = false
          PortDriveStrengthControl = false
          PortInputSelection = TYPE_2_SUPP_PIS
        PortPin20 (PortPin2):
          PortPullDownOption = false
          PortPinDirectionChangeable = false
          PortPinDioAltModeChangeable = false
          PortPinModeChangeable = false
          PortPinLevelValue = PORT_PIN_LEVEL_LOW
          PortPinInitialMode = RLIN34TX_AT1OUT_PFC_PFCE_PMCSR
          PortPinDirection = PORT_PIN_OUT
          PortInputBufferControl = false
          PortBiDirectionControl = false
          PortPullUpOption = false
          PortOpenDrainControl = false
          PortDriveStrengthControl = false
          PortInputSelection = TYPE_2_SUPP_PIS
      PortGroup180 (PortGroup18)
        PortPin00 (PortPin0):
          PortPullDownOption = false
          PortPinDirectionChangeable = false
          PortPinDioAltModeChangeable = false
          PortPinModeChangeable = false
          PortPinLevelValue = PORT_PIN_LEVEL_LOW
          PortPinInitialMode = DIO_PFC_PMCSR
          PortPinDirection = PORT_PIN_OUT
          PortInputBufferControl = false
          PortBiDirectionControl = false
          PortPullUpOption = false
          PortOpenDrainControl = false
          PortDriveStrengthControl = false
          PortInputSelection = TYPE_2_SUPP_PIS
        PortPin10 (PortPin1):
          PortPullDownOption = false
          PortPinDirectionChangeable = false
          PortPinDioAltModeChangeable = false
          PortPinModeChangeable = false
          PortPinLevelValue = PORT_PIN_LEVEL_LOW
          PortPinInitialMode = DIO_PMCSR
          PortPinDirection = PORT_PIN_OUT
          PortInputBufferControl = false
          PortBiDirectionControl = false
          PortPullUpOption = false
          PortOpenDrainControl = false
          PortDriveStrengthControl = false
          PortInputSelection = TYPE_2_SUPP_PIS
        PortPin20 (PortPin2):
          PortPullDownOption = false
          PortPinDirectionChangeable = false
          PortPinDioAltModeChangeable = false
          PortPinModeChangeable = false
          PortPinLevelValue = PORT_PIN_LEVEL_LOW
          PortPinInitialMode = DIO_PMCSR
          PortPinDirection = PORT_PIN_IN
          PortInputBufferControl = false
          PortBiDirectionControl = false
          PortPullUpOption = false
          PortOpenDrainControl = false
          PortDriveStrengthControl = false
          PortInputSelection = TYPE_2_SUPP_PIS
        PortPin30 (PortPin3):
          PortPullDownOption = false
          PortPinDirectionChangeable = false
          PortPinDioAltModeChangeable = false
          PortPinModeChangeable = false
          PortPinLevelValue = PORT_PIN_LEVEL_LOW
          PortPinInitialMode = DIO_PMCSR
          PortPinDirection = PORT_PIN_OUT
          PortInputBufferControl = false
          PortBiDirectionControl = false
          PortPullUpOption = false
          PortOpenDrainControl = false
          PortDriveStrengthControl = false
          PortInputSelection = TYPE_2_SUPP_PIS
      PortGroup200 (PortGroup20)
        PortPin40 (PortPin4):
          PortPullDownOption = false
          PortPinDirectionChangeable = false
          PortPinDioAltModeChangeable = false
          PortPinModeChangeable = false
          PortPinLevelValue = PORT_PIN_LEVEL_LOW
          PortPinInitialMode = DIO_PFC_PMCSR
          PortPinDirection = PORT_PIN_IN
          PortInputBufferControl = false
          PortBiDirectionControl = false
          PortPullUpOption = false
          PortOpenDrainControl = false
          PortDriveStrengthControl = false
          PortInputSelection = TYPE_1_SUPP_PIS
        PortPin50 (PortPin5):
          PortPullDownOption = false
          PortPinDirectionChangeable = false
          PortPinDioAltModeChangeable = false
          PortPinModeChangeable = false
          PortPinLevelValue = PORT_PIN_LEVEL_LOW
          PortPinInitialMode = DIO_PFC_PMCSR
          PortPinDirection = PORT_PIN_OUT
          PortInputBufferControl = false
          PortBiDirectionControl = false
          PortPullUpOption = false
          PortOpenDrainControl = false
          PortDriveStrengthControl = false
          PortInputSelection = TYPE_2_SUPP_PIS
      PortGroupAnalog00 (PortGroupAnalog0)
        PortPin00 (PortPin0):
          PortPinDirectionChangeable = false
          PortPinLevelValue = PORT_PIN_LEVEL_LOW
          PortPinInitialMode = ALT_NOT_SUPPORTED
          PortPinDirection = PORT_PIN_IN
          PortInputBufferControl = false
          PortBiDirectionControl = false
        PortPin10 (PortPin1):
          PortPinDirectionChangeable = false
          PortPinLevelValue = PORT_PIN_LEVEL_LOW
          PortPinInitialMode = ALT_NOT_SUPPORTED
          PortPinDirection = PORT_PIN_IN
          PortInputBufferControl = false
          PortBiDirectionControl = false
        PortPin20 (PortPin2):
          PortPinDirectionChangeable = false
          PortPinLevelValue = PORT_PIN_LEVEL_LOW
          PortPinInitialMode = ALT_NOT_SUPPORTED
          PortPinDirection = PORT_PIN_IN
          PortInputBufferControl = false
          PortBiDirectionControl = false
        PortPin30 (PortPin3):
          PortPinDirectionChangeable = false
          PortPinLevelValue = PORT_PIN_LEVEL_LOW
          PortPinInitialMode = ALT_NOT_SUPPORTED
          PortPinDirection = PORT_PIN_IN
          PortInputBufferControl = false
          PortBiDirectionControl = false
        PortPin40 (PortPin4):
          PortPinDirectionChangeable = false
          PortPinLevelValue = PORT_PIN_LEVEL_LOW
          PortPinInitialMode = ALT_NOT_SUPPORTED
          PortPinDirection = PORT_PIN_IN
          PortInputBufferControl = false
          PortBiDirectionControl = false
        PortPin50 (PortPin5):
          PortPinDirectionChangeable = false
          PortPinLevelValue = PORT_PIN_LEVEL_LOW
          PortPinInitialMode = ALT_NOT_SUPPORTED
          PortPinDirection = PORT_PIN_IN
          PortInputBufferControl = false
          PortBiDirectionControl = false
        PortPin60 (PortPin6):
          PortPinDirectionChangeable = false
          PortPinLevelValue = PORT_PIN_LEVEL_LOW
          PortPinInitialMode = ALT_NOT_SUPPORTED
          PortPinDirection = PORT_PIN_IN
          PortInputBufferControl = false
          PortBiDirectionControl = false
        PortPin70 (PortPin7):
          PortPinDirectionChangeable = false
          PortPinLevelValue = PORT_PIN_LEVEL_LOW
          PortPinInitialMode = ALT_NOT_SUPPORTED
          PortPinDirection = PORT_PIN_IN
          PortInputBufferControl = false
          PortBiDirectionControl = false
        PortPin80 (PortPin8):
          PortPinDirectionChangeable = false
          PortPinLevelValue = PORT_PIN_LEVEL_LOW
          PortPinInitialMode = ALT_NOT_SUPPORTED
          PortPinDirection = PORT_PIN_IN
          PortInputBufferControl = false
          PortBiDirectionControl = false
        PortPin90 (PortPin9):
          PortPinDirectionChangeable = false
          PortPinLevelValue = PORT_PIN_LEVEL_LOW
          PortPinInitialMode = ALT_NOT_SUPPORTED
          PortPinDirection = PORT_PIN_IN
          PortInputBufferControl = false
          PortBiDirectionControl = false
        PortPin100 (PortPin10):
          PortPinDirectionChangeable = false
          PortPinLevelValue = PORT_PIN_LEVEL_LOW
          PortPinInitialMode = ALT_NOT_SUPPORTED
          PortPinDirection = PORT_PIN_IN
          PortInputBufferControl = false
          PortBiDirectionControl = false
        PortPin110 (PortPin11):
          PortPinDirectionChangeable = false
          PortPinLevelValue = PORT_PIN_LEVEL_LOW
          PortPinInitialMode = ALT_NOT_SUPPORTED
          PortPinDirection = PORT_PIN_IN
          PortInputBufferControl = false
          PortBiDirectionControl = false
        PortPin120 (PortPin12):
          PortPinDirectionChangeable = false
          PortPinLevelValue = PORT_PIN_LEVEL_LOW
          PortPinInitialMode = ALT_NOT_SUPPORTED
          PortPinDirection = PORT_PIN_IN
          PortInputBufferControl = false
          PortBiDirectionControl = false
        PortPin130 (PortPin13):
          PortPinDirectionChangeable = false
          PortPinLevelValue = PORT_PIN_LEVEL_LOW
          PortPinInitialMode = ALT_NOT_SUPPORTED
          PortPinDirection = PORT_PIN_IN
          PortInputBufferControl = false
          PortBiDirectionControl = false
        PortPin140 (PortPin14):
          PortPinDirectionChangeable = false
          PortPinLevelValue = PORT_PIN_LEVEL_LOW
          PortPinInitialMode = ALT_NOT_SUPPORTED
          PortPinDirection = PORT_PIN_IN
          PortInputBufferControl = false
          PortBiDirectionControl = false
        PortPin150 (PortPin15):
          PortPinDirectionChangeable = false
          PortPinLevelValue = PORT_PIN_LEVEL_LOW
          PortPinInitialMode = ALT_NOT_SUPPORTED
          PortPinDirection = PORT_PIN_IN
          PortInputBufferControl = false
          PortBiDirectionControl = false
      PortGroupAnalog10 (PortGroupAnalog1)
        PortPin00 (PortPin0):
          PortPinDirectionChangeable = false
          PortPinLevelValue = PORT_PIN_LEVEL_LOW
          PortPinInitialMode = ALT_NOT_SUPPORTED
          PortPinDirection = PORT_PIN_IN
          PortInputBufferControl = false
          PortBiDirectionControl = false
        PortPin10 (PortPin1):
          PortPinDirectionChangeable = false
          PortPinLevelValue = PORT_PIN_LEVEL_LOW
          PortPinInitialMode = ALT_NOT_SUPPORTED
          PortPinDirection = PORT_PIN_IN
          PortInputBufferControl = false
          PortBiDirectionControl = false
        PortPin20 (PortPin2):
          PortPinDirectionChangeable = false
          PortPinLevelValue = PORT_PIN_LEVEL_LOW
          PortPinInitialMode = ALT_NOT_SUPPORTED
          PortPinDirection = PORT_PIN_IN
          PortInputBufferControl = false
          PortBiDirectionControl = false
        PortPin30 (PortPin3):
          PortPinDirectionChangeable = false
          PortPinLevelValue = PORT_PIN_LEVEL_LOW
          PortPinInitialMode = ALT_NOT_SUPPORTED
          PortPinDirection = PORT_PIN_IN
          PortInputBufferControl = false
          PortBiDirectionControl = false
        PortPin40 (PortPin4):
          PortPinDirectionChangeable = false
          PortPinLevelValue = PORT_PIN_LEVEL_LOW
          PortPinInitialMode = ALT_NOT_SUPPORTED
          PortPinDirection = PORT_PIN_IN
          PortInputBufferControl = false
          PortBiDirectionControl = false
        PortPin50 (PortPin5):
          PortPinDirectionChangeable = false
          PortPinLevelValue = PORT_PIN_LEVEL_LOW
          PortPinInitialMode = ALT_NOT_SUPPORTED
          PortPinDirection = PORT_PIN_IN
          PortInputBufferControl = false
          PortBiDirectionControl = false
        PortPin60 (PortPin6):
          PortPinDirectionChangeable = false
          PortPinLevelValue = PORT_PIN_LEVEL_LOW
          PortPinInitialMode = ALT_NOT_SUPPORTED
          PortPinDirection = PORT_PIN_IN
          PortInputBufferControl = false
          PortBiDirectionControl = false
        PortPin70 (PortPin7):
          PortPinDirectionChangeable = false
          PortPinLevelValue = PORT_PIN_LEVEL_LOW
          PortPinInitialMode = ALT_NOT_SUPPORTED
          PortPinDirection = PORT_PIN_IN
          PortInputBufferControl = false
          PortBiDirectionControl = false
      PortGroupInput00 (PortGroupInput0)
        PortPin00 (PortPin0): PortPinInitialMode=ALT_NOT_SUPPORTED, PortInputBufferControl=false
      PortGroupJtag00 (PortGroupJtag0)
        PortPin00 (PortPin0):
          PortPinDirectionChangeable = false
          PortPinDioAltModeChangeable = false
          PortPinModeChangeable = false
          PortPinLevelValue = PORT_PIN_LEVEL_LOW
          PortPinInitialMode = DIO_PFCE_PMCSR
          PortPinDirection = PORT_PIN_IN
          PortInputBufferControl = false
          PortBiDirectionControl = false
          PortPullUpOption = false
          PortPullDownOption = false
          PortOpenDrainControl = false
          PortInputSelection = TYPE_2_SUPP_PIS
        PortPin10 (PortPin1):
          PortPinDirectionChangeable = false
          PortPinDioAltModeChangeable = false
          PortPinModeChangeable = false
          PortPinLevelValue = PORT_PIN_LEVEL_LOW
          PortPinInitialMode = DIO_PFC_PFCE_PMCSR
          PortPinDirection = PORT_PIN_IN
          PortInputBufferControl = false
          PortBiDirectionControl = false
          PortPullUpOption = false
          PortPullDownOption = false
          PortOpenDrainControl = false
          PortDriveStrengthControl = false
          PortInputSelection = TYPE_2_SUPP_PIS
        PortPin20 (PortPin2):
          PortPinDirectionChangeable = false
          PortPinDioAltModeChangeable = false
          PortPinModeChangeable = false
          PortPinLevelValue = PORT_PIN_LEVEL_LOW
          PortPinInitialMode = DIO_PFC_PFCE_PMCSR
          PortPinDirection = PORT_PIN_IN
          PortInputBufferControl = false
          PortBiDirectionControl = false
          PortPullUpOption = false
          PortPullDownOption = false
          PortOpenDrainControl = false
          PortDriveStrengthControl = false
          PortInputSelection = TYPE_2_SUPP_PIS
        PortPin30 (PortPin3):
          PortPinDirectionChangeable = false
          PortPinDioAltModeChangeable = false
          PortPinModeChangeable = false
          PortPinLevelValue = PORT_PIN_LEVEL_LOW
          PortPinInitialMode = DIO_PFC_PMCSR
          PortPinDirection = PORT_PIN_IN
          PortInputBufferControl = false
          PortBiDirectionControl = false
          PortPullUpOption = false
          PortPullDownOption = false
          PortOpenDrainControl = false
          PortDriveStrengthControl = false
          PortInputSelection = TYPE_2_SUPP_PIS
        PortPin40 (PortPin4):
          PortPinDirectionChangeable = false
          PortPinDioAltModeChangeable = false
          PortPinModeChangeable = false
          PortPinLevelValue = PORT_PIN_LEVEL_LOW
          PortPinInitialMode = DIO
          PortPinDirection = PORT_PIN_IN
          PortInputBufferControl = false
          PortBiDirectionControl = false
          PortPullUpOption = false
          PortPullDownOption = false
          PortOpenDrainControl = false
        PortPin50 (PortPin5):
          PortPinDirectionChangeable = false
          PortPinDioAltModeChangeable = false
          PortPinModeChangeable = false
          PortPinLevelValue = PORT_PIN_LEVEL_LOW
          PortPinInitialMode = DIO_PFC_PMCSR
          PortPinDirection = PORT_PIN_IN
          PortInputBufferControl = false
          PortBiDirectionControl = false
          PortPullUpOption = false
          PortPullDownOption = false
          PortOpenDrainControl = false
          PortDriveStrengthControl = false
          PortInputSelection = TYPE_2_SUPP_PIS
        PortPin60 (PortPin6):
          PortPinDirectionChangeable = false
          PortPinDioAltModeChangeable = false
          PortPinModeChangeable = false
          PortPinLevelValue = PORT_PIN_LEVEL_LOW
          PortPinInitialMode = DIO
          PortPinDirection = PORT_PIN_IN
          PortInputBufferControl = false
          PortBiDirectionControl = false
          PortPullUpOption = false
          PortPullDownOption = false
          PortOpenDrainControl = false
          PortDriveStrengthControl = false
          PortInputSelection = TYPE_2_SUPP_PIS
      PortGroup1
        PortPin6:
          PortBiDirectionControl = false
          PortDriveStrengthControl = false
          PortInputBufferControl = false
          PortInputSelection = TYPE_2_SUPP_PIS
          PortOpenDrainControl = false
          PortPinDioAltModeChangeable = false
          PortPinDirection = PORT_PIN_OUT
          PortPinDirectionChangeable = false
          PortPinInitialMode = DIO_PFC_PMCSR
          PortPinLevelValue = PORT_PIN_LEVEL_LOW
          PortPinModeChangeable = false
          PortPullDownOption = false
          PortPullUpOption = false
        PortPin8:
          PortBiDirectionControl = false
          PortDriveStrengthControl = false
          PortInputBufferControl = true
          PortInputSelection = TYPE_2_SUPP_PIS
          PortOpenDrainControl = false
          PortPinDioAltModeChangeable = false
          PortPinDirection = PORT_PIN_IN
          PortPinDirectionChangeable = false
          PortPinInitialMode = INTP14_AT1IN
          PortPinLevelValue = PORT_PIN_LEVEL_LOW
          PortPinModeChangeable = false
          PortPullDownOption = false
          PortPullUpOption = false
        PortPin7:
          PortBiDirectionControl = false
          PortDriveStrengthControl = false
          PortInputBufferControl = false
          PortInputSelection = TYPE_2_SUPP_PIS
          PortOpenDrainControl = false
          PortPinDioAltModeChangeable = false
          PortPinDirection = PORT_PIN_OUT
          PortPinDirectionChangeable = false
          PortPinInitialMode = DIO_PFC_PMCSR
          PortPinLevelValue = PORT_PIN_LEVEL_LOW
          PortPinModeChangeable = false
          PortPullDownOption = false
          PortPullUpOption = false
        PortPin0:
          PortBiDirectionControl = false
          PortDriveStrengthControl = false
          PortInputBufferControl = false
          PortInputSelection = TYPE_2_SUPP_PIS
          PortOpenDrainControl = false
          PortPinDioAltModeChangeable = false
          PortPinDirection = PORT_PIN_OUT
          PortPinDirectionChangeable = false
          PortPinInitialMode = DIO
          PortPinLevelValue = PORT_PIN_LEVEL_LOW
          PortPinModeChangeable = false
          PortPullDownOption = false
          PortPullUpOption = false
        PortPin1:
          PortBiDirectionControl = false
          PortDriveStrengthControl = false
          PortInputBufferControl = false
          PortInputSelection = TYPE_2_SUPP_PIS
          PortOpenDrainControl = false
          PortPinDioAltModeChangeable = false
          PortPinDirection = PORT_PIN_OUT
          PortPinDirectionChangeable = false
          PortPinInitialMode = DIO_PMCSR
          PortPinLevelValue = PORT_PIN_LEVEL_LOW
          PortPinModeChangeable = false
          PortPullDownOption = false
          PortPullUpOption = false
        PortPin2:
          PortBiDirectionControl = false
          PortDriveStrengthControl = false
          PortInputBufferControl = true
          PortInputSelection = TYPE_2_SUPP_PIS
          PortOpenDrainControl = false
          PortPinDioAltModeChangeable = false
          PortPinDirection = PORT_PIN_IN
          PortPinDirectionChangeable = false
          PortPinInitialMode = DIO
          PortPinLevelValue = PORT_PIN_LEVEL_LOW
          PortPinModeChangeable = false
          PortPullDownOption = false
          PortPullUpOption = false
        PortPin3:
          PortBiDirectionControl = false
          PortDriveStrengthControl = false
          PortInputBufferControl = false
          PortInputSelection = TYPE_2_SUPP_PIS
          PortOpenDrainControl = false
          PortPinDioAltModeChangeable = false
          PortPinDirection = PORT_PIN_OUT
          PortPinDirectionChangeable = false
          PortPinInitialMode = DIO_PFC_PMCSR
          PortPinLevelValue = PORT_PIN_LEVEL_LOW
          PortPinModeChangeable = false
          PortPullDownOption = false
          PortPullUpOption = false
        PortPin9:
          PortBiDirectionControl = false
          PortDriveStrengthControl = false
          PortInputBufferControl = true
          PortInputSelection = TYPE_2_SUPP_PIS
          PortOpenDrainControl = false
          PortPinDioAltModeChangeable = false
          PortPinDirection = PORT_PIN_IN
          PortPinDirectionChangeable = false
          PortPinInitialMode = DIO_PFC_PMCSR
          PortPinLevelValue = PORT_PIN_LEVEL_LOW
          PortPinModeChangeable = false
          PortPullDownOption = false
          PortPullUpOption = false
        PortPin10:
          PortBiDirectionControl = false
          PortDriveStrengthControl = false
          PortInputBufferControl = false
          PortInputSelection = TYPE_2_SUPP_PIS
          PortOpenDrainControl = false
          PortPinDioAltModeChangeable = false
          PortPinDirection = PORT_PIN_OUT
          PortPinDirectionChangeable = false
          PortPinInitialMode = DIO_PFC_PMCSR
          PortPinLevelValue = PORT_PIN_LEVEL_LOW
          PortPinModeChangeable = false
          PortPullDownOption = false
          PortPullUpOption = false
        PortPin11:
          PortBiDirectionControl = false
          PortDriveStrengthControl = false
          PortInputBufferControl = false
          PortInputSelection = TYPE_2_SUPP_PIS
          PortOpenDrainControl = false
          PortPinDioAltModeChangeable = false
          PortPinDirection = PORT_PIN_OUT
          PortPinDirectionChangeable = false
          PortPinInitialMode = DIO_PFC_PMCSR
          PortPinLevelValue = PORT_PIN_LEVEL_LOW
          PortPinModeChangeable = false
          PortPullDownOption = false
          PortPullUpOption = false
        PortPin5:
          PortBiDirectionControl = false
          PortDriveStrengthControl = false
          PortInputBufferControl = false
          PortInputSelection = TYPE_2_SUPP_PIS
          PortOpenDrainControl = false
          PortPinDioAltModeChangeable = false
          PortPinDirection = PORT_PIN_OUT
          PortPinDirectionChangeable = false
          PortPinInitialMode = RLIN35TX_AT1OUT_PFC_PMCSR
          PortPinLevelValue = PORT_PIN_LEVEL_LOW
          PortPinModeChangeable = false
          PortPullDownOption = false
          PortPullUpOption = false
        PortPin4:
          PortBiDirectionControl = false
          PortDriveStrengthControl = false
          PortInputBufferControl = false
          PortInputSelection = TYPE_2_SUPP_PIS
          PortOpenDrainControl = false
          PortPinDioAltModeChangeable = false
          PortPinDirection = PORT_PIN_IN
          PortPinDirectionChangeable = false
          PortPinInitialMode = RLIN35RX_AT7IN
          PortPinLevelValue = PORT_PIN_LEVEL_LOW
          PortPinModeChangeable = false
          PortPullDownOption = false
          PortPullUpOption = false
    PortGeneral0 (PortGeneral):
      PortDevErrorDetect = false
      PortSetPinDirectionApi = true
      PortSetPinDefaultDirectionApi = true
      PortSetPinModeApi = true
      PortSetPinDefaultModeApi = true
      PortVersionInfoApi = true
      PortVersionCheckExternalModules = true
      PortDeviceName = R7F701583
      PortCriticalSectionProtection = true
      PortPinStatusBackUp = true
      PortSetToDioAltModeApi = false
      PortMaxMode = 7
      PortWriteVerify = WV_DISABLE
      PortUseWriteVerifyErrorInterface = false
      PortWriteVerifyErrorInterface = PortErrorReportInterface
      PortRAMMirror = ENABLE
      PortUnlockSequenceCount = 20
    PortDemEventParameterRefs0 (PortDemEventParameterRefs): PORT_E_WRITE_TIMEOUT_FAILURE=DemEventParameter0, PORT_E_REG_WRITE_VERIFY=DemEventParameter1
