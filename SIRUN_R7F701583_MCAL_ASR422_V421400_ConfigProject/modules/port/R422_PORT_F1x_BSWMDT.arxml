AUTOSAR XML (schema 4-2-2)
# COPYRIGHT
# Copyright(c) 2016-2021 Renesas Electronics Corporation
package /Renesas/ModuleDescription_Port
  bsw implementation Port_Impl: programming-language=C, sw-version=2.4.19, vendor-id=59, ar-release-version=4.2.2, behavior=BswInternalBehavior_0, vendor-specific-module-def=Port
    code-descriptors:
      code Port_Code: artifact-descriptors=[{short-label=Port.c, category=SWSRC}, {short-label=Port.h, category=SWHDR}]
    resource consumption ResourceConsumption
      5 x memory section:
        VAR_INIT_BOOLEAN: sw-addrmethod=VAR_INIT
        VAR_NO_INIT_UNSPECIFIED: sw-addrmethod=VAR_NO_INIT
        CONST_UNSPECIFIED: sw-addrmethod=CONST
        CONFIG_DATA_UNSPECIFIED: sw-addrmethod=CONFIG_DATA
        CODE: sw-addrmethod=CODE
  bsw module description Port: module-id=124
    provided-entrys:
      Port_Init
      Port_SetPinDirection
      Port_RefreshPortDirection
      Port_GetVersionInfo
      Port_SetPinMode
      Port_SetToDioMode
      Port_SetToAlternateMode
      Port_SetPinDefaultMode
      Port_SetPinDefaultDirection
      Port_CheckHWConsistency
    bsw internal behavior BswInternalBehavior_0
      exclusive area PORT_REGISTER_PROTECTION
      10 x bsw called entity:
        BswCalledEntity_0: implemented-entry=Port_Init
        BswCalledEntity_1: can-enter-exclusive-area=PORT_REGISTER_PROTECTION, implemented-entry=Port_SetPinDirection
        BswCalledEntity_2: can-enter-exclusive-area=PORT_REGISTER_PROTECTION, implemented-entry=Port_RefreshPortDirection
        BswCalledEntity_3: can-enter-exclusive-area=PORT_REGISTER_PROTECTION, implemented-entry=Port_SetPinMode
        BswCalledEntity_4: can-enter-exclusive-area=PORT_REGISTER_PROTECTION, implemented-entry=Port_SetToDioMode
        BswCalledEntity_5: can-enter-exclusive-area=PORT_REGISTER_PROTECTION, implemented-entry=Port_SetToAlternateMode
        BswCalledEntity_6: can-enter-exclusive-area=PORT_REGISTER_PROTECTION, implemented-entry=Port_SetPinDefaultMode
        BswCalledEntity_7: can-enter-exclusive-area=PORT_REGISTER_PROTECTION, implemented-entry=Port_SetPinDefaultDirection
        BswCalledEntity_8: implemented-entry=Port_GetVersionInfo
        BswCalledEntity_9: can-enter-exclusive-area=PORT_REGISTER_PROTECTION, implemented-entry=Port_CheckHWConsistency
  10 x bsw module entry, all with is-synchronous=true, call-type=REGULAR, execution-context=TASK, sw-service-impl-policy=STANDARD:
    Port_Init: service-id=0x00, is-reentrant=false
    Port_SetPinDirection: service-id=0x01, is-reentrant=true
    Port_RefreshPortDirection: service-id=0x02, is-reentrant=false
    Port_GetVersionInfo: service-id=0x03, is-reentrant=false
    Port_SetPinMode: service-id=0x04, is-reentrant=true
    Port_SetToDioMode: service-id=0x05, is-reentrant=true
    Port_SetToAlternateMode: service-id=0x06, is-reentrant=true
    Port_SetPinDefaultMode: service-id=0x07, is-reentrant=true
    Port_SetPinDefaultDirection: service-id=0x08, is-reentrant=true
    Port_CheckHWConsistency: service-id=0x09, is-reentrant=true
