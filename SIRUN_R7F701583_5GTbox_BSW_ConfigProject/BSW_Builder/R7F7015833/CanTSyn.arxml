AUTOSAR XML (schema 00048)
package /R7F7015833
  module config CanTSyn
    CanTSynGeneral:
      CanTSynDevErrorDetect = true
      CanTSynMainFunctionPeriod = 0.01
      CanTSynVersionInfoApi = false
      CanTSynR19CbkVersion = false
      CanTSynMultiplePartitionEnabled = false
    CanTSynGlobalTimeDomain:
      CanTSynGlobalTimeDomainId = 0
      CanTSynUseExtendedMsgFormat = false
      CanTSynSynchronizedTimeBaseRef = StbMSynchronizedTimeBase_Slave
      CanTSynGlobalTimeCanIfRef = CANIF_CONTROLLER_0_IAM
      CanTSynGlobalTimeFupDataIDList
        16 x CanTSynGlobalTimeFupDataIDListElement:
          CanTSynGlobalTimeFupDataIDListElement_0: CanTSynGlobalTimeFupDataIDListIndex=0, CanTSynGlobalTimeFupDataIDListValue=15
          CanTSynGlobalTimeFupDataIDListElement_1: CanTSynGlobalTimeFupDataIDListIndex=1, CanTSynGlobalTimeFupDataIDListValue=14
          CanTSynGlobalTimeFupDataIDListElement_2: CanTSynGlobalTimeFupDataIDListIndex=2, CanTSynGlobalTimeFupDataIDListValue=13
          CanTSynGlobalTimeFupDataIDListElement_3: CanTSynGlobalTimeFupDataIDListIndex=3, CanTSynGlobalTimeFupDataIDListValue=12
          CanTSynGlobalTimeFupDataIDListElement_4: CanTSynGlobalTimeFupDataIDListIndex=4, CanTSynGlobalTimeFupDataIDListValue=11
          CanTSynGlobalTimeFupDataIDListElement_5: CanTSynGlobalTimeFupDataIDListIndex=5, CanTSynGlobalTimeFupDataIDListValue=10
          CanTSynGlobalTimeFupDataIDListElement_6: CanTSynGlobalTimeFupDataIDListIndex=6, CanTSynGlobalTimeFupDataIDListValue=9
          CanTSynGlobalTimeFupDataIDListElement_7: CanTSynGlobalTimeFupDataIDListIndex=7, CanTSynGlobalTimeFupDataIDListValue=8
          CanTSynGlobalTimeFupDataIDListElement_8: CanTSynGlobalTimeFupDataIDListIndex=8, CanTSynGlobalTimeFupDataIDListValue=7
          CanTSynGlobalTimeFupDataIDListElement_9: CanTSynGlobalTimeFupDataIDListIndex=9, CanTSynGlobalTimeFupDataIDListValue=6
          CanTSynGlobalTimeFupDataIDListElement_10: CanTSynGlobalTimeFupDataIDListIndex=10, CanTSynGlobalTimeFupDataIDListValue=5
          CanTSynGlobalTimeFupDataIDListElement_11: CanTSynGlobalTimeFupDataIDListIndex=11, CanTSynGlobalTimeFupDataIDListValue=4
          CanTSynGlobalTimeFupDataIDListElement_12: CanTSynGlobalTimeFupDataIDListIndex=12, CanTSynGlobalTimeFupDataIDListValue=3
          CanTSynGlobalTimeFupDataIDListElement_13: CanTSynGlobalTimeFupDataIDListIndex=13, CanTSynGlobalTimeFupDataIDListValue=2
          CanTSynGlobalTimeFupDataIDListElement_14: CanTSynGlobalTimeFupDataIDListIndex=14, CanTSynGlobalTimeFupDataIDListValue=1
          CanTSynGlobalTimeFupDataIDListElement_15: CanTSynGlobalTimeFupDataIDListIndex=15, CanTSynGlobalTimeFupDataIDListValue=0
      CanTSynGlobalTimeSlave: CanTSynGlobalTimeFollowUpTimeout=2.0, CanTSynGlobalTimeSequenceCounterJumpWidth=1, CanTSynRxCrcValidated=CRC_IGNORED
        CanTSynGlobalTimeSlavePdu: CanTSynGlobalTimeSlavePduRef=RX_PDU_CANTSYNC
      CanTSynGlobalTimeSyncDataIDList
        16 x CanTSynGlobalTimeSyncDataIDListElement:
          CanTSynGlobalTimeSyncDataIDListElement_{0..15}: CanTSynGlobalTimeSyncDataIDListIndex={0..15}, CanTSynGlobalTimeSyncDataIDListValue={0..15}
