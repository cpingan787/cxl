AUTOSAR XML (schema 4-2-2)
# COPYRIGHT
# Copyright(c) 2016-2021 Renesas Electronics Corporation
package /Renesas/ModuleDescription_Pwm
  bsw implementation Pwm_Impl: programming-language=C, sw-version=1.1.7, vendor-id=59, ar-release-version=4.2.2, behavior=BswInternalBehavior_0, vendor-specific-module-def=Pwm
    code-descriptors:
      code Pwm_Code: artifact-descriptors=[{short-label=Pwm.c, category=SWSRC}, {short-label=Pwm.h, category=SWHDR}]
    resource consumption ResourceConsumption
      11 x memory section:
        VAR_INIT_BOOLEAN: sw-addrmethod=VAR
        VAR_NO_INIT_8: sw-addrmethod=VAR
        VAR_NO_INIT_16: sw-addrmethod=VAR
        VAR_NO_INIT_32: sw-addrmethod=VAR
        VAR_NO_INIT_UNSPECIFIED: sw-addrmethod=VAR
        CONFIG_DATA_UNSPECIFIED: sw-addrmethod=CONFIG_DATA
        CONFIG_DATA_32: sw-addrmethod=CONFIG_DATA
        PUBLIC_CODE: sw-addrmethod=CODE
        PRIVATE_CODE: sw-addrmethod=CODE
        CODE_FAST: sw-addrmethod=CODE
        APPL_CODE: sw-addrmethod=CODE
  bsw module description Pwm: module-id=121
    provided-entrys:
      Pwm_Init
      Pwm_DeInit
      Pwm_SetDutyCycle
      Pwm_SetPeriodAndDuty
      Pwm_SetOutputToIdle
      Pwm_GetOutputState
      Pwm_DisableNotification
      Pwm_EnableNotification
      Pwm_SelectChannelClk
      Pwm_SetTriggerDelay
      Pwm_SetChannelOutput
      Pwm_SynchronousInit
      Pwm_SynchronousStart
      Pwm_SynchronousStop
      Pwm_GetVersionInfo
      Pwm_CheckHWConsistency
      Pwm_ControlTriggerOutput
      TAUB0_CH00_ISR
      TAUB0_CH00_CAT2_ISR
      TAUB0_CH01_ISR
      TAUB0_CH01_CAT2_ISR
      TAUB0_CH02_ISR
      TAUB0_CH02_CAT2_ISR
      TAUB0_CH03_ISR
      TAUB0_CH03_CAT2_ISR
      TAUB0_CH04_ISR
      TAUB0_CH04_CAT2_ISR
      TAUB0_CH05_ISR
      TAUB0_CH05_CAT2_ISR
      TAUB0_CH06_ISR
      TAUB0_CH06_CAT2_ISR
      TAUB0_CH07_ISR
      TAUB0_CH07_CAT2_ISR
      TAUB0_CH08_ISR
      TAUB0_CH08_CAT2_ISR
      TAUB0_CH09_ISR
      TAUB0_CH09_CAT2_ISR
      TAUB0_CH10_ISR
      TAUB0_CH10_CAT2_ISR
      TAUB0_CH11_ISR
      TAUB0_CH11_CAT2_ISR
      TAUB0_CH12_ISR
      TAUB0_CH12_CAT2_ISR
      TAUB0_CH13_ISR
      TAUB0_CH13_CAT2_ISR
      TAUB0_CH14_ISR
      TAUB0_CH14_CAT2_ISR
      TAUB0_CH15_ISR
      TAUB0_CH15_CAT2_ISR
      TAUB1_CH00_ISR
      TAUB1_CH00_CAT2_ISR
      TAUB1_CH01_ISR
      TAUB1_CH01_CAT2_ISR
      TAUB1_CH02_ISR
      TAUB1_CH02_CAT2_ISR
      TAUB1_CH03_ISR
      TAUB1_CH03_CAT2_ISR
      TAUB1_CH04_ISR
      TAUB1_CH04_CAT2_ISR
      TAUB1_CH05_ISR
      TAUB1_CH05_CAT2_ISR
      TAUB1_CH06_ISR
      TAUB1_CH06_CAT2_ISR
      TAUB1_CH07_ISR
      TAUB1_CH07_CAT2_ISR
      TAUB1_CH08_ISR
      TAUB1_CH08_CAT2_ISR
      TAUB1_CH09_ISR
      TAUB1_CH09_CAT2_ISR
      TAUB1_CH10_ISR
      TAUB1_CH10_CAT2_ISR
      TAUB1_CH11_ISR
      TAUB1_CH11_CAT2_ISR
      TAUB1_CH12_ISR
      TAUB1_CH12_CAT2_ISR
      TAUB1_CH13_ISR
      TAUB1_CH13_CAT2_ISR
      TAUB1_CH14_ISR
      TAUB1_CH14_CAT2_ISR
      TAUB1_CH15_ISR
      TAUB1_CH15_CAT2_ISR
      TAUD0_CH00_ISR
      TAUD0_CH00_CAT2_ISR
      TAUD0_CH01_ISR
      TAUD0_CH01_CAT2_ISR
      TAUD0_CH02_ISR
      TAUD0_CH02_CAT2_ISR
      TAUD0_CH03_ISR
      TAUD0_CH03_CAT2_ISR
      TAUD0_CH04_ISR
      TAUD0_CH04_CAT2_ISR
      TAUD0_CH05_ISR
      TAUD0_CH05_CAT2_ISR
      TAUD0_CH06_ISR
      TAUD0_CH06_CAT2_ISR
      TAUD0_CH07_ISR
      TAUD0_CH07_CAT2_ISR
      TAUD0_CH08_ISR
      TAUD0_CH08_CAT2_ISR
      TAUD0_CH09_ISR
      TAUD0_CH09_CAT2_ISR
      TAUD0_CH10_ISR
      TAUD0_CH10_CAT2_ISR
      TAUD0_CH11_ISR
      TAUD0_CH11_CAT2_ISR
      TAUD0_CH12_ISR
      TAUD0_CH12_CAT2_ISR
      TAUD0_CH13_ISR
      TAUD0_CH13_CAT2_ISR
      TAUD0_CH14_ISR
      TAUD0_CH14_CAT2_ISR
      TAUD0_CH15_ISR
      TAUD0_CH15_CAT2_ISR
      TAUJ0_CH00_ISR
      TAUJ0_CH00_CAT2_ISR
      TAUJ0_CH01_ISR
      TAUJ0_CH01_CAT2_ISR
      TAUJ0_CH02_ISR
      TAUJ0_CH02_CAT2_ISR
      TAUJ0_CH03_ISR
      TAUJ0_CH03_CAT2_ISR
      TAUJ1_CH00_ISR
      TAUJ1_CH00_CAT2_ISR
      TAUJ1_CH01_ISR
      TAUJ1_CH01_CAT2_ISR
      TAUJ1_CH02_ISR
      TAUJ1_CH02_CAT2_ISR
      TAUJ1_CH03_ISR
      TAUJ1_CH03_CAT2_ISR
      TAUJ2_CH00_ISR
      TAUJ2_CH00_CAT2_ISR
      TAUJ2_CH01_ISR
      TAUJ2_CH01_CAT2_ISR
      TAUJ2_CH02_ISR
      TAUJ2_CH02_CAT2_ISR
      TAUJ2_CH03_ISR
      TAUJ2_CH03_CAT2_ISR
      TAUJ3_CH00_ISR
      TAUJ3_CH00_CAT2_ISR
      TAUJ3_CH01_ISR
      TAUJ3_CH01_CAT2_ISR
      TAUJ3_CH02_ISR
      TAUJ3_CH02_CAT2_ISR
      TAUJ3_CH03_ISR
      TAUJ3_CH03_CAT2_ISR
      PWGA_CH00_ISR
      PWGA_CH00_CAT2_ISR
      PWGA_CH01_ISR
      PWGA_CH01_CAT2_ISR
      PWGA_CH02_ISR
      PWGA_CH02_CAT2_ISR
      PWGA_CH03_ISR
      PWGA_CH03_CAT2_ISR
      PWGA_CH04_ISR
      PWGA_CH04_CAT2_ISR
      PWGA_CH05_ISR
      PWGA_CH05_CAT2_ISR
      PWGA_CH06_ISR
      PWGA_CH06_CAT2_ISR
      PWGA_CH07_ISR
      PWGA_CH07_CAT2_ISR
      PWGA_CH08_ISR
      PWGA_CH08_CAT2_ISR
      PWGA_CH09_ISR
      PWGA_CH09_CAT2_ISR
      PWGA_CH10_ISR
      PWGA_CH10_CAT2_ISR
      PWGA_CH11_ISR
      PWGA_CH11_CAT2_ISR
      PWGA_CH12_ISR
      PWGA_CH12_CAT2_ISR
      PWGA_CH13_ISR
      PWGA_CH13_CAT2_ISR
      PWGA_CH14_ISR
      PWGA_CH14_CAT2_ISR
      PWGA_CH15_ISR
      PWGA_CH15_CAT2_ISR
      PWGA_CH16_ISR
      PWGA_CH16_CAT2_ISR
      PWGA_CH17_ISR
      PWGA_CH17_CAT2_ISR
      PWGA_CH18_ISR
      PWGA_CH18_CAT2_ISR
      PWGA_CH19_ISR
      PWGA_CH19_CAT2_ISR
      PWGA_CH20_ISR
      PWGA_CH20_CAT2_ISR
      PWGA_CH21_ISR
      PWGA_CH21_CAT2_ISR
      PWGA_CH22_ISR
      PWGA_CH22_CAT2_ISR
      PWGA_CH23_ISR
      PWGA_CH23_CAT2_ISR
      PWGA_CH24_ISR
      PWGA_CH24_CAT2_ISR
      PWGA_CH25_ISR
      PWGA_CH25_CAT2_ISR
      PWGA_CH26_ISR
      PWGA_CH26_CAT2_ISR
      PWGA_CH27_ISR
      PWGA_CH27_CAT2_ISR
      PWGA_CH28_ISR
      PWGA_CH28_CAT2_ISR
      PWGA_CH29_ISR
      PWGA_CH29_CAT2_ISR
      PWGA_CH30_ISR
      PWGA_CH30_CAT2_ISR
      PWGA_CH31_ISR
      PWGA_CH31_CAT2_ISR
      PWGA_CH32_ISR
      PWGA_CH32_CAT2_ISR
      PWGA_CH33_ISR
      PWGA_CH33_CAT2_ISR
      PWGA_CH34_ISR
      PWGA_CH34_CAT2_ISR
      PWGA_CH35_ISR
      PWGA_CH35_CAT2_ISR
      PWGA_CH36_ISR
      PWGA_CH36_CAT2_ISR
      PWGA_CH37_ISR
      PWGA_CH37_CAT2_ISR
      PWGA_CH38_ISR
      PWGA_CH38_CAT2_ISR
      PWGA_CH39_ISR
      PWGA_CH39_CAT2_ISR
      PWGA_CH40_ISR
      PWGA_CH40_CAT2_ISR
      PWGA_CH41_ISR
      PWGA_CH41_CAT2_ISR
      PWGA_CH42_ISR
      PWGA_CH42_CAT2_ISR
      PWGA_CH43_ISR
      PWGA_CH43_CAT2_ISR
      PWGA_CH44_ISR
      PWGA_CH44_CAT2_ISR
      PWGA_CH45_ISR
      PWGA_CH45_CAT2_ISR
      PWGA_CH46_ISR
      PWGA_CH46_CAT2_ISR
      PWGA_CH47_ISR
      PWGA_CH47_CAT2_ISR
      PWGA_CH48_ISR
      PWGA_CH48_CAT2_ISR
      PWGA_CH49_ISR
      PWGA_CH49_CAT2_ISR
      PWGA_CH50_ISR
      PWGA_CH50_CAT2_ISR
      PWGA_CH51_ISR
      PWGA_CH51_CAT2_ISR
      PWGA_CH52_ISR
      PWGA_CH52_CAT2_ISR
      PWGA_CH53_ISR
      PWGA_CH53_CAT2_ISR
      PWGA_CH54_ISR
      PWGA_CH54_CAT2_ISR
      PWGA_CH55_ISR
      PWGA_CH55_CAT2_ISR
      PWGA_CH56_ISR
      PWGA_CH56_CAT2_ISR
      PWGA_CH57_ISR
      PWGA_CH57_CAT2_ISR
      PWGA_CH58_ISR
      PWGA_CH58_CAT2_ISR
      PWGA_CH59_ISR
      PWGA_CH59_CAT2_ISR
      PWGA_CH60_ISR
      PWGA_CH60_CAT2_ISR
      PWGA_CH61_ISR
      PWGA_CH61_CAT2_ISR
      PWGA_CH62_ISR
      PWGA_CH62_CAT2_ISR
      PWGA_CH63_ISR
      PWGA_CH63_CAT2_ISR
      PWGA_CH64_ISR
      PWGA_CH64_CAT2_ISR
      PWGA_CH65_ISR
      PWGA_CH65_CAT2_ISR
      PWGA_CH66_ISR
      PWGA_CH66_CAT2_ISR
      PWGA_CH67_ISR
      PWGA_CH67_CAT2_ISR
      PWGA_CH68_ISR
      PWGA_CH68_CAT2_ISR
      PWGA_CH69_ISR
      PWGA_CH69_CAT2_ISR
      PWGA_CH70_ISR
      PWGA_CH70_CAT2_ISR
      PWGA_CH71_ISR
      PWGA_CH71_CAT2_ISR
      PWM_INTPWGAG00_ISR
      PWGA_CHGRP00_CAT2_ISR
      PWM_INTPWGAG01_ISR
      PWGA_CHGRP01_CAT2_ISR
      PWM_INTPWGAG02_ISR
      PWGA_CHGRP02_CAT2_ISR
    bsw internal behavior BswInternalBehavior_0
      exclusive area PWM_REGISTERS_PROTECTION
      278 x bsw interrupt entity, all with can-enter-exclusive-area=PWM_REGISTERS_PROTECTION:
        BswInterruptEntity_0: implemented-entry=TAUB0_CH00_ISR, interrupt-category=CAT-1, interrupt-source=INTTAUB0I0
        BswInterruptEntity_1: implemented-entry=TAUB0_CH00_CAT2_ISR, interrupt-category=CAT-2, interrupt-source=INTTAUB0I0
        BswInterruptEntity_2: implemented-entry=TAUB0_CH01_ISR, interrupt-category=CAT-1, interrupt-source=INTTAUB0I1
        BswInterruptEntity_3: implemented-entry=TAUB0_CH01_CAT2_ISR, interrupt-category=CAT-2, interrupt-source=INTTAUB0I1
        BswInterruptEntity_4: implemented-entry=TAUB0_CH02_ISR, interrupt-category=CAT-1, interrupt-source=INTTAUB0I2
        BswInterruptEntity_5: implemented-entry=TAUB0_CH02_CAT2_ISR, interrupt-category=CAT-2, interrupt-source=INTTAUB0I2
        BswInterruptEntity_6: implemented-entry=TAUB0_CH03_ISR, interrupt-category=CAT-1, interrupt-source=INTTAUB0I3
        BswInterruptEntity_7: implemented-entry=TAUB0_CH03_CAT2_ISR, interrupt-category=CAT-2, interrupt-source=INTTAUB0I3
        BswInterruptEntity_8: implemented-entry=TAUB0_CH04_ISR, interrupt-category=CAT-1, interrupt-source=INTTAUB0I4
        BswInterruptEntity_9: implemented-entry=TAUB0_CH04_CAT2_ISR, interrupt-category=CAT-2, interrupt-source=INTTAUB0I4
        BswInterruptEntity_10: implemented-entry=TAUB0_CH05_ISR, interrupt-category=CAT-1, interrupt-source=INTTAUB0I5
        BswInterruptEntity_11: implemented-entry=TAUB0_CH05_CAT2_ISR, interrupt-category=CAT-2, interrupt-source=INTTAUB0I5
        BswInterruptEntity_12: implemented-entry=TAUB0_CH06_ISR, interrupt-category=CAT-1, interrupt-source=INTTAUB0I6
        BswInterruptEntity_13: implemented-entry=TAUB0_CH06_CAT2_ISR, interrupt-category=CAT-2, interrupt-source=INTTAUB0I6
        BswInterruptEntity_14: implemented-entry=TAUB0_CH07_ISR, interrupt-category=CAT-1, interrupt-source=INTTAUB0I7
        BswInterruptEntity_15: implemented-entry=TAUB0_CH07_CAT2_ISR, interrupt-category=CAT-2, interrupt-source=INTTAUB0I7
        BswInterruptEntity_16: implemented-entry=TAUB0_CH08_ISR, interrupt-category=CAT-1, interrupt-source=INTTAUB0I8
        BswInterruptEntity_17: implemented-entry=TAUB0_CH08_CAT2_ISR, interrupt-category=CAT-2, interrupt-source=INTTAUB0I8
        BswInterruptEntity_18: implemented-entry=TAUB0_CH09_ISR, interrupt-category=CAT-1, interrupt-source=INTTAUB0I9
        BswInterruptEntity_19: implemented-entry=TAUB0_CH09_CAT2_ISR, interrupt-category=CAT-2, interrupt-source=INTTAUB0I9
        BswInterruptEntity_20: implemented-entry=TAUB0_CH10_ISR, interrupt-category=CAT-1, interrupt-source=INTTAUB0I10
        BswInterruptEntity_21: implemented-entry=TAUB0_CH10_CAT2_ISR, interrupt-category=CAT-2, interrupt-source=INTTAUB0I10
        BswInterruptEntity_22: implemented-entry=TAUB0_CH11_ISR, interrupt-category=CAT-1, interrupt-source=INTTAUB0I11
        BswInterruptEntity_23: implemented-entry=TAUB0_CH11_CAT2_ISR, interrupt-category=CAT-2, interrupt-source=INTTAUB0I11
        BswInterruptEntity_24: implemented-entry=TAUB0_CH12_ISR, interrupt-category=CAT-1, interrupt-source=INTTAUB0I12
        BswInterruptEntity_25: implemented-entry=TAUB0_CH12_CAT2_ISR, interrupt-category=CAT-2, interrupt-source=INTTAUB0I12
        BswInterruptEntity_26: implemented-entry=TAUB0_CH13_ISR, interrupt-category=CAT-1, interrupt-source=INTTAUB0I13
        BswInterruptEntity_27: implemented-entry=TAUB0_CH13_CAT2_ISR, interrupt-category=CAT-2, interrupt-source=INTTAUB0I13
        BswInterruptEntity_28: implemented-entry=TAUB0_CH14_ISR, interrupt-category=CAT-1, interrupt-source=INTTAUB0I14
        BswInterruptEntity_29: implemented-entry=TAUB0_CH14_CAT2_ISR, interrupt-category=CAT-2, interrupt-source=INTTAUB0I14
        BswInterruptEntity_30: implemented-entry=TAUB0_CH15_ISR, interrupt-category=CAT-1, interrupt-source=INTTAUB0I15
        BswInterruptEntity_31: implemented-entry=TAUB0_CH15_CAT2_ISR, interrupt-category=CAT-2, interrupt-source=INTTAUB0I15
        BswInterruptEntity_32: implemented-entry=TAUB1_CH00_ISR, interrupt-category=CAT-1, interrupt-source=INTTAUB1I0
        BswInterruptEntity_33: implemented-entry=TAUB1_CH00_CAT2_ISR, interrupt-category=CAT-2, interrupt-source=INTTAUB1I0
        BswInterruptEntity_34: implemented-entry=TAUB1_CH01_ISR, interrupt-category=CAT-1, interrupt-source=INTTAUB1I1
        BswInterruptEntity_35: implemented-entry=TAUB1_CH01_CAT2_ISR, interrupt-category=CAT-2, interrupt-source=INTTAUB1I1
        BswInterruptEntity_36: implemented-entry=TAUB1_CH02_ISR, interrupt-category=CAT-1, interrupt-source=INTTAUB1I2
        BswInterruptEntity_37: implemented-entry=TAUB1_CH02_CAT2_ISR, interrupt-category=CAT-2, interrupt-source=INTTAUB1I2
        BswInterruptEntity_38: implemented-entry=TAUB1_CH03_ISR, interrupt-category=CAT-1, interrupt-source=INTTAUB1I3
        BswInterruptEntity_39: implemented-entry=TAUB1_CH03_CAT2_ISR, interrupt-category=CAT-2, interrupt-source=INTTAUB1I3
        BswInterruptEntity_40: implemented-entry=TAUB1_CH04_ISR, interrupt-category=CAT-1, interrupt-source=INTTAUB1I4
        BswInterruptEntity_41: implemented-entry=TAUB1_CH04_CAT2_ISR, interrupt-category=CAT-2, interrupt-source=INTTAUB1I4
        BswInterruptEntity_42: implemented-entry=TAUB1_CH05_ISR, interrupt-category=CAT-1, interrupt-source=INTTAUB1I5
        BswInterruptEntity_43: implemented-entry=TAUB1_CH05_CAT2_ISR, interrupt-category=CAT-2, interrupt-source=INTTAUB1I5
        BswInterruptEntity_44: implemented-entry=TAUB1_CH06_ISR, interrupt-category=CAT-1, interrupt-source=INTTAUB1I6
        BswInterruptEntity_45: implemented-entry=TAUB1_CH06_CAT2_ISR, interrupt-category=CAT-2, interrupt-source=INTTAUB1I6
        BswInterruptEntity_46: implemented-entry=TAUB1_CH07_ISR, interrupt-category=CAT-1, interrupt-source=INTTAUB1I7
        BswInterruptEntity_47: implemented-entry=TAUB1_CH07_CAT2_ISR, interrupt-category=CAT-2, interrupt-source=INTTAUB1I7
        BswInterruptEntity_48: implemented-entry=TAUB1_CH08_ISR, interrupt-category=CAT-1, interrupt-source=INTTAUB1I8
        BswInterruptEntity_49: implemented-entry=TAUB1_CH08_CAT2_ISR, interrupt-category=CAT-2, interrupt-source=INTTAUB1I8
        BswInterruptEntity_50: implemented-entry=TAUB1_CH09_ISR, interrupt-category=CAT-1, interrupt-source=INTTAUB1I9
        BswInterruptEntity_51: implemented-entry=TAUB1_CH09_CAT2_ISR, interrupt-category=CAT-2, interrupt-source=INTTAUB1I9
        BswInterruptEntity_52: implemented-entry=TAUB1_CH10_ISR, interrupt-category=CAT-1, interrupt-source=INTTAUB1I10
        BswInterruptEntity_53: implemented-entry=TAUB1_CH10_CAT2_ISR, interrupt-category=CAT-2, interrupt-source=INTTAUB1I10
        BswInterruptEntity_54: implemented-entry=TAUB1_CH11_ISR, interrupt-category=CAT-1, interrupt-source=INTTAUB1I11
        BswInterruptEntity_55: implemented-entry=TAUB1_CH11_CAT2_ISR, interrupt-category=CAT-2, interrupt-source=INTTAUB1I11
        BswInterruptEntity_56: implemented-entry=TAUB1_CH12_ISR, interrupt-category=CAT-1, interrupt-source=INTTAUB1I12
        BswInterruptEntity_57: implemented-entry=TAUB1_CH12_CAT2_ISR, interrupt-category=CAT-2, interrupt-source=INTTAUB1I12
        BswInterruptEntity_58: implemented-entry=TAUB1_CH13_ISR, interrupt-category=CAT-1, interrupt-source=INTTAUB1I13
        BswInterruptEntity_59: implemented-entry=TAUB1_CH13_CAT2_ISR, interrupt-category=CAT-2, interrupt-source=INTTAUB1I13
        BswInterruptEntity_60: implemented-entry=TAUB1_CH14_ISR, interrupt-category=CAT-1, interrupt-source=INTTAUB1I14
        BswInterruptEntity_61: implemented-entry=TAUB1_CH14_CAT2_ISR, interrupt-category=CAT-2, interrupt-source=INTTAUB1I14
        BswInterruptEntity_62: implemented-entry=TAUB1_CH15_ISR, interrupt-category=CAT-1, interrupt-source=INTTAUB1I15
        BswInterruptEntity_63: implemented-entry=TAUB1_CH15_CAT2_ISR, interrupt-category=CAT-2, interrupt-source=INTTAUB1I15
        BswInterruptEntity_64: implemented-entry=TAUD0_CH00_ISR, interrupt-category=CAT-1, interrupt-source=INTTAUD0I0
        BswInterruptEntity_65: implemented-entry=TAUD0_CH00_CAT2_ISR, interrupt-category=CAT-2, interrupt-source=INTTAUD0I0
        BswInterruptEntity_66: implemented-entry=TAUD0_CH01_ISR, interrupt-category=CAT-1, interrupt-source=INTTAUD0I1
        BswInterruptEntity_67: implemented-entry=TAUD0_CH01_CAT2_ISR, interrupt-category=CAT-2, interrupt-source=INTTAUD0I1
        BswInterruptEntity_68: implemented-entry=TAUD0_CH02_ISR, interrupt-category=CAT-1, interrupt-source=INTTAUD0I2
        BswInterruptEntity_69: implemented-entry=TAUD0_CH02_CAT2_ISR, interrupt-category=CAT-2, interrupt-source=INTTAUD0I2
        BswInterruptEntity_70: implemented-entry=TAUD0_CH03_ISR, interrupt-category=CAT-1, interrupt-source=INTTAUD0I3
        BswInterruptEntity_71: implemented-entry=TAUD0_CH03_CAT2_ISR, interrupt-category=CAT-2, interrupt-source=INTTAUD0I3
        BswInterruptEntity_72: implemented-entry=TAUD0_CH04_ISR, interrupt-category=CAT-1, interrupt-source=INTTAUD0I4
        BswInterruptEntity_73: implemented-entry=TAUD0_CH04_CAT2_ISR, interrupt-category=CAT-2, interrupt-source=INTTAUD0I4
        BswInterruptEntity_74: implemented-entry=TAUD0_CH05_ISR, interrupt-category=CAT-1, interrupt-source=INTTAUD0I5
        BswInterruptEntity_75: implemented-entry=TAUD0_CH05_CAT2_ISR, interrupt-category=CAT-2, interrupt-source=INTTAUD0I5
        BswInterruptEntity_76: implemented-entry=TAUD0_CH06_ISR, interrupt-category=CAT-1, interrupt-source=INTTAUD0I6
        BswInterruptEntity_77: implemented-entry=TAUD0_CH06_CAT2_ISR, interrupt-category=CAT-2, interrupt-source=INTTAUD0I6
        BswInterruptEntity_78: implemented-entry=TAUD0_CH07_ISR, interrupt-category=CAT-1, interrupt-source=INTTAUD0I7
        BswInterruptEntity_79: implemented-entry=TAUD0_CH07_CAT2_ISR, interrupt-category=CAT-2, interrupt-source=INTTAUD0I7
        BswInterruptEntity_80: implemented-entry=TAUD0_CH08_ISR, interrupt-category=CAT-1, interrupt-source=INTTAUD0I8
        BswInterruptEntity_81: implemented-entry=TAUD0_CH08_CAT2_ISR, interrupt-category=CAT-2, interrupt-source=INTTAUD0I8
        BswInterruptEntity_82: implemented-entry=TAUD0_CH09_ISR, interrupt-category=CAT-1, interrupt-source=INTTAUD0I9
        BswInterruptEntity_83: implemented-entry=TAUD0_CH09_CAT2_ISR, interrupt-category=CAT-2, interrupt-source=INTTAUD0I9
        BswInterruptEntity_84: implemented-entry=TAUD0_CH10_ISR, interrupt-category=CAT-1, interrupt-source=INTTAUD0I10
        BswInterruptEntity_85: implemented-entry=TAUD0_CH10_CAT2_ISR, interrupt-category=CAT-2, interrupt-source=INTTAUD0I10
        BswInterruptEntity_86: implemented-entry=TAUD0_CH11_ISR, interrupt-category=CAT-1, interrupt-source=INTTAUD0I11
        BswInterruptEntity_87: implemented-entry=TAUD0_CH11_CAT2_ISR, interrupt-category=CAT-2, interrupt-source=INTTAUD0I11
        BswInterruptEntity_88: implemented-entry=TAUD0_CH12_ISR, interrupt-category=CAT-1, interrupt-source=INTTAUD0I12
        BswInterruptEntity_89: implemented-entry=TAUD0_CH12_CAT2_ISR, interrupt-category=CAT-2, interrupt-source=INTTAUD0I12
        BswInterruptEntity_90: implemented-entry=TAUD0_CH13_ISR, interrupt-category=CAT-1, interrupt-source=INTTAUD0I13
        BswInterruptEntity_91: implemented-entry=TAUD0_CH13_CAT2_ISR, interrupt-category=CAT-2, interrupt-source=INTTAUD0I13
        BswInterruptEntity_92: implemented-entry=TAUD0_CH14_ISR, interrupt-category=CAT-1, interrupt-source=INTTAUD0I14
        BswInterruptEntity_93: implemented-entry=TAUD0_CH14_CAT2_ISR, interrupt-category=CAT-2, interrupt-source=INTTAUD0I14
        BswInterruptEntity_94: implemented-entry=TAUD0_CH15_ISR, interrupt-category=CAT-1, interrupt-source=INTTAUD0I15
        BswInterruptEntity_95: implemented-entry=TAUD0_CH15_CAT2_ISR, interrupt-category=CAT-2, interrupt-source=INTTAUD0I15
        BswInterruptEntity_96: implemented-entry=TAUJ0_CH00_ISR, interrupt-category=CAT-1, interrupt-source=INTTAUJ0I0
        BswInterruptEntity_97: implemented-entry=TAUJ0_CH00_CAT2_ISR, interrupt-category=CAT-2, interrupt-source=INTTAUJ0I0
        BswInterruptEntity_98: implemented-entry=TAUJ0_CH01_ISR, interrupt-category=CAT-1, interrupt-source=INTTAUJ0I1
        BswInterruptEntity_99: implemented-entry=TAUJ0_CH01_CAT2_ISR, interrupt-category=CAT-2, interrupt-source=INTTAUJ0I1
        BswInterruptEntity_100: implemented-entry=TAUJ0_CH02_ISR, interrupt-category=CAT-1, interrupt-source=INTTAUJ0I2
        BswInterruptEntity_101: implemented-entry=TAUJ0_CH02_CAT2_ISR, interrupt-category=CAT-2, interrupt-source=INTTAUJ0I2
        BswInterruptEntity_102: implemented-entry=TAUJ0_CH03_ISR, interrupt-category=CAT-1, interrupt-source=INTTAUJ0I3
        BswInterruptEntity_103: implemented-entry=TAUJ0_CH03_CAT2_ISR, interrupt-category=CAT-2, interrupt-source=INTTAUJ0I3
        BswInterruptEntity_104: implemented-entry=TAUJ1_CH00_ISR, interrupt-category=CAT-1, interrupt-source=INTTAUJ1I0
        BswInterruptEntity_105: implemented-entry=TAUJ1_CH00_CAT2_ISR, interrupt-category=CAT-2, interrupt-source=INTTAUJ1I0
        BswInterruptEntity_106: implemented-entry=TAUJ1_CH01_ISR, interrupt-category=CAT-1, interrupt-source=INTTAUJ1I1
        BswInterruptEntity_107: implemented-entry=TAUJ1_CH01_CAT2_ISR, interrupt-category=CAT-2, interrupt-source=INTTAUJ1I1
        BswInterruptEntity_108: implemented-entry=TAUJ1_CH02_ISR, interrupt-category=CAT-1, interrupt-source=INTTAUJ1I2
        BswInterruptEntity_109: implemented-entry=TAUJ1_CH02_CAT2_ISR, interrupt-category=CAT-2, interrupt-source=INTTAUJ1I2
        BswInterruptEntity_110: implemented-entry=TAUJ1_CH03_ISR, interrupt-category=CAT-1, interrupt-source=INTTAUJ1I3
        BswInterruptEntity_111: implemented-entry=TAUJ1_CH03_CAT2_ISR, interrupt-category=CAT-2, interrupt-source=INTTAUJ1I3
        BswInterruptEntity_112: implemented-entry=PWGA_CH00_ISR, interrupt-category=CAT-1, interrupt-source=INTPWGA0
        BswInterruptEntity_113: implemented-entry=PWGA_CH00_CAT2_ISR, interrupt-category=CAT-2, interrupt-source=INTPWGA0
        BswInterruptEntity_114: implemented-entry=PWGA_CH01_ISR, interrupt-category=CAT-1, interrupt-source=INTPWGA1
        BswInterruptEntity_115: implemented-entry=PWGA_CH01_CAT2_ISR, interrupt-category=CAT-2, interrupt-source=INTPWGA1
        BswInterruptEntity_116: implemented-entry=PWGA_CH02_ISR, interrupt-category=CAT-1, interrupt-source=INTPWGA2
        BswInterruptEntity_117: implemented-entry=PWGA_CH02_CAT2_ISR, interrupt-category=CAT-2, interrupt-source=INTPWGA2
        BswInterruptEntity_118: implemented-entry=PWGA_CH03_ISR, interrupt-category=CAT-1, interrupt-source=INTPWGA3
        BswInterruptEntity_119: implemented-entry=PWGA_CH03_CAT2_ISR, interrupt-category=CAT-2, interrupt-source=INTPWGA3
        BswInterruptEntity_120: implemented-entry=PWGA_CH04_ISR, interrupt-category=CAT-1, interrupt-source=INTPWGA4
        BswInterruptEntity_121: implemented-entry=PWGA_CH04_CAT2_ISR, interrupt-category=CAT-2, interrupt-source=INTPWGA4
        BswInterruptEntity_122: implemented-entry=PWGA_CH05_ISR, interrupt-category=CAT-1, interrupt-source=INTPWGA5
        BswInterruptEntity_123: implemented-entry=PWGA_CH05_CAT2_ISR, interrupt-category=CAT-2, interrupt-source=INTPWGA5
        BswInterruptEntity_124: implemented-entry=PWGA_CH06_ISR, interrupt-category=CAT-1, interrupt-source=INTPWGA6
        BswInterruptEntity_125: implemented-entry=PWGA_CH06_CAT2_ISR, interrupt-category=CAT-2, interrupt-source=INTPWGA6
        BswInterruptEntity_126: implemented-entry=PWGA_CH07_ISR, interrupt-category=CAT-1, interrupt-source=INTPWGA7
        BswInterruptEntity_127: implemented-entry=PWGA_CH07_CAT2_ISR, interrupt-category=CAT-2, interrupt-source=INTPWGA7
        BswInterruptEntity_128: implemented-entry=PWGA_CH08_ISR, interrupt-category=CAT-1, interrupt-source=INTPWGA8
        BswInterruptEntity_129: implemented-entry=PWGA_CH08_CAT2_ISR, interrupt-category=CAT-2, interrupt-source=INTPWGA8
        BswInterruptEntity_130: implemented-entry=PWGA_CH09_ISR, interrupt-category=CAT-1, interrupt-source=INTPWGA9
        BswInterruptEntity_131: implemented-entry=PWGA_CH09_CAT2_ISR, interrupt-category=CAT-2, interrupt-source=INTPWGA9
        BswInterruptEntity_132: implemented-entry=PWGA_CH10_ISR, interrupt-category=CAT-1, interrupt-source=INTPWGA10
        BswInterruptEntity_133: implemented-entry=PWGA_CH10_CAT2_ISR, interrupt-category=CAT-2, interrupt-source=INTPWGA10
        BswInterruptEntity_134: implemented-entry=PWGA_CH11_ISR, interrupt-category=CAT-1, interrupt-source=INTPWGA11
        BswInterruptEntity_135: implemented-entry=PWGA_CH11_CAT2_ISR, interrupt-category=CAT-2, interrupt-source=INTPWGA11
        BswInterruptEntity_136: implemented-entry=PWGA_CH12_ISR, interrupt-category=CAT-1, interrupt-source=INTPWGA12
        BswInterruptEntity_137: implemented-entry=PWGA_CH12_CAT2_ISR, interrupt-category=CAT-2, interrupt-source=INTPWGA12
        BswInterruptEntity_138: implemented-entry=PWGA_CH13_ISR, interrupt-category=CAT-1, interrupt-source=INTPWGA13
        BswInterruptEntity_139: implemented-entry=PWGA_CH13_CAT2_ISR, interrupt-category=CAT-2, interrupt-source=INTPWGA13
        BswInterruptEntity_140: implemented-entry=PWGA_CH14_ISR, interrupt-category=CAT-1, interrupt-source=INTPWGA14
        BswInterruptEntity_141: implemented-entry=PWGA_CH14_CAT2_ISR, interrupt-category=CAT-2, interrupt-source=INTPWGA14
        BswInterruptEntity_142: implemented-entry=PWGA_CH15_ISR, interrupt-category=CAT-1, interrupt-source=INTPWGA15
        BswInterruptEntity_143: implemented-entry=PWGA_CH15_CAT2_ISR, interrupt-category=CAT-2, interrupt-source=INTPWGA15
        BswInterruptEntity_144: implemented-entry=PWGA_CH16_ISR, interrupt-category=CAT-1, interrupt-source=INTPWGA16
        BswInterruptEntity_145: implemented-entry=PWGA_CH16_CAT2_ISR, interrupt-category=CAT-2, interrupt-source=INTPWGA16
        BswInterruptEntity_146: implemented-entry=PWGA_CH17_ISR, interrupt-category=CAT-1, interrupt-source=INTPWGA17
        BswInterruptEntity_147: implemented-entry=PWGA_CH17_CAT2_ISR, interrupt-category=CAT-2, interrupt-source=INTPWGA17
        BswInterruptEntity_148: implemented-entry=PWGA_CH18_ISR, interrupt-category=CAT-1, interrupt-source=INTPWGA18
        BswInterruptEntity_149: implemented-entry=PWGA_CH18_CAT2_ISR, interrupt-category=CAT-2, interrupt-source=INTPWGA18
        BswInterruptEntity_150: implemented-entry=PWGA_CH19_ISR, interrupt-category=CAT-1, interrupt-source=INTPWGA19
        BswInterruptEntity_151: implemented-entry=PWGA_CH19_CAT2_ISR, interrupt-category=CAT-2, interrupt-source=INTPWGA19
        BswInterruptEntity_152: implemented-entry=PWGA_CH20_ISR, interrupt-category=CAT-1, interrupt-source=INTPWGA20
        BswInterruptEntity_153: implemented-entry=PWGA_CH20_CAT2_ISR, interrupt-category=CAT-2, interrupt-source=INTPWGA20
        BswInterruptEntity_154: implemented-entry=PWGA_CH21_ISR, interrupt-category=CAT-1, interrupt-source=INTPWGA21
        BswInterruptEntity_155: implemented-entry=PWGA_CH21_CAT2_ISR, interrupt-category=CAT-2, interrupt-source=INTPWGA21
        BswInterruptEntity_156: implemented-entry=PWGA_CH22_ISR, interrupt-category=CAT-1, interrupt-source=INTPWGA22
        BswInterruptEntity_157: implemented-entry=PWGA_CH22_CAT2_ISR, interrupt-category=CAT-2, interrupt-source=INTPWGA22
        BswInterruptEntity_158: implemented-entry=PWGA_CH23_ISR, interrupt-category=CAT-1, interrupt-source=INTPWGA23
        BswInterruptEntity_159: implemented-entry=PWGA_CH23_CAT2_ISR, interrupt-category=CAT-2, interrupt-source=INTPWGA23
        BswInterruptEntity_160: implemented-entry=PWGA_CH24_ISR, interrupt-category=CAT-1, interrupt-source=INTPWGA24
        BswInterruptEntity_161: implemented-entry=PWGA_CH24_CAT2_ISR, interrupt-category=CAT-2, interrupt-source=INTPWGA24
        BswInterruptEntity_162: implemented-entry=PWGA_CH25_ISR, interrupt-category=CAT-1, interrupt-source=INTPWGA25
        BswInterruptEntity_163: implemented-entry=PWGA_CH25_CAT2_ISR, interrupt-category=CAT-2, interrupt-source=INTPWGA25
        BswInterruptEntity_164: implemented-entry=PWGA_CH26_ISR, interrupt-category=CAT-1, interrupt-source=INTPWGA26
        BswInterruptEntity_165: implemented-entry=PWGA_CH26_CAT2_ISR, interrupt-category=CAT-2, interrupt-source=INTPWGA26
        BswInterruptEntity_166: implemented-entry=PWGA_CH27_ISR, interrupt-category=CAT-1, interrupt-source=INTPWGA27
        BswInterruptEntity_167: implemented-entry=PWGA_CH27_CAT2_ISR, interrupt-category=CAT-2, interrupt-source=INTPWGA27
        BswInterruptEntity_168: implemented-entry=PWGA_CH28_ISR, interrupt-category=CAT-1, interrupt-source=INTPWGA28
        BswInterruptEntity_169: implemented-entry=PWGA_CH28_CAT2_ISR, interrupt-category=CAT-2, interrupt-source=INTPWGA28
        BswInterruptEntity_170: implemented-entry=PWGA_CH29_ISR, interrupt-category=CAT-1, interrupt-source=INTPWGA29
        BswInterruptEntity_171: implemented-entry=PWGA_CH29_CAT2_ISR, interrupt-category=CAT-2, interrupt-source=INTPWGA29
        BswInterruptEntity_172: implemented-entry=PWGA_CH30_ISR, interrupt-category=CAT-1, interrupt-source=INTPWGA30
        BswInterruptEntity_173: implemented-entry=PWGA_CH30_CAT2_ISR, interrupt-category=CAT-2, interrupt-source=INTPWGA30
        BswInterruptEntity_174: implemented-entry=PWGA_CH31_ISR, interrupt-category=CAT-1, interrupt-source=INTPWGA31
        BswInterruptEntity_175: implemented-entry=PWGA_CH31_CAT2_ISR, interrupt-category=CAT-2, interrupt-source=INTPWGA31
        BswInterruptEntity_176: implemented-entry=PWGA_CH32_ISR, interrupt-category=CAT-1, interrupt-source=INTPWGA32
        BswInterruptEntity_177: implemented-entry=PWGA_CH32_CAT2_ISR, interrupt-category=CAT-2, interrupt-source=INTPWGA32
        BswInterruptEntity_178: implemented-entry=PWGA_CH33_ISR, interrupt-category=CAT-1, interrupt-source=INTPWGA33
        BswInterruptEntity_179: implemented-entry=PWGA_CH33_CAT2_ISR, interrupt-category=CAT-2, interrupt-source=INTPWGA33
        BswInterruptEntity_180: implemented-entry=PWGA_CH34_ISR, interrupt-category=CAT-1, interrupt-source=INTPWGA34
        BswInterruptEntity_181: implemented-entry=PWGA_CH34_CAT2_ISR, interrupt-category=CAT-2, interrupt-source=INTPWGA34
        BswInterruptEntity_182: implemented-entry=PWGA_CH35_ISR, interrupt-category=CAT-1, interrupt-source=INTPWGA35
        BswInterruptEntity_183: implemented-entry=PWGA_CH35_CAT2_ISR, interrupt-category=CAT-2, interrupt-source=INTPWGA35
        BswInterruptEntity_184: implemented-entry=PWGA_CH36_ISR, interrupt-category=CAT-1, interrupt-source=INTPWGA36
        BswInterruptEntity_185: implemented-entry=PWGA_CH36_CAT2_ISR, interrupt-category=CAT-2, interrupt-source=INTPWGA36
        BswInterruptEntity_186: implemented-entry=PWGA_CH37_ISR, interrupt-category=CAT-1, interrupt-source=INTPWGA37
        BswInterruptEntity_187: implemented-entry=PWGA_CH37_CAT2_ISR, interrupt-category=CAT-2, interrupt-source=INTPWGA37
        BswInterruptEntity_188: implemented-entry=PWGA_CH38_ISR, interrupt-category=CAT-1, interrupt-source=INTPWGA38
        BswInterruptEntity_189: implemented-entry=PWGA_CH38_CAT2_ISR, interrupt-category=CAT-2, interrupt-source=INTPWGA38
        BswInterruptEntity_190: implemented-entry=PWGA_CH39_ISR, interrupt-category=CAT-1, interrupt-source=INTPWGA39
        BswInterruptEntity_191: implemented-entry=PWGA_CH39_CAT2_ISR, interrupt-category=CAT-2, interrupt-source=INTPWGA39
        BswInterruptEntity_192: implemented-entry=PWGA_CH40_ISR, interrupt-category=CAT-1, interrupt-source=INTPWGA40
        BswInterruptEntity_193: implemented-entry=PWGA_CH40_CAT2_ISR, interrupt-category=CAT-2, interrupt-source=INTPWGA40
        BswInterruptEntity_194: implemented-entry=PWGA_CH41_ISR, interrupt-category=CAT-1, interrupt-source=INTPWGA41
        BswInterruptEntity_195: implemented-entry=PWGA_CH41_CAT2_ISR, interrupt-category=CAT-2, interrupt-source=INTPWGA41
        BswInterruptEntity_196: implemented-entry=PWGA_CH42_ISR, interrupt-category=CAT-1, interrupt-source=INTPWGA42
        BswInterruptEntity_197: implemented-entry=PWGA_CH42_CAT2_ISR, interrupt-category=CAT-2, interrupt-source=INTPWGA42
        BswInterruptEntity_198: implemented-entry=PWGA_CH43_ISR, interrupt-category=CAT-1, interrupt-source=INTPWGA43
        BswInterruptEntity_199: implemented-entry=PWGA_CH43_CAT2_ISR, interrupt-category=CAT-2, interrupt-source=INTPWGA43
        BswInterruptEntity_200: implemented-entry=PWGA_CH44_ISR, interrupt-category=CAT-1, interrupt-source=INTPWGA44
        BswInterruptEntity_201: implemented-entry=PWGA_CH44_CAT2_ISR, interrupt-category=CAT-2, interrupt-source=INTPWGA44
        BswInterruptEntity_202: implemented-entry=PWGA_CH45_ISR, interrupt-category=CAT-1, interrupt-source=INTPWGA45
        BswInterruptEntity_203: implemented-entry=PWGA_CH45_CAT2_ISR, interrupt-category=CAT-2, interrupt-source=INTPWGA45
        BswInterruptEntity_204: implemented-entry=PWGA_CH46_ISR, interrupt-category=CAT-1, interrupt-source=INTPWGA46
        BswInterruptEntity_205: implemented-entry=PWGA_CH46_CAT2_ISR, interrupt-category=CAT-2, interrupt-source=INTPWGA46
        BswInterruptEntity_206: implemented-entry=PWGA_CH47_ISR, interrupt-category=CAT-1, interrupt-source=INTPWGA47
        BswInterruptEntity_207: implemented-entry=PWGA_CH47_CAT2_ISR, interrupt-category=CAT-2, interrupt-source=INTPWGA47
        BswInterruptEntity_208: implemented-entry=PWGA_CH48_ISR, interrupt-category=CAT-1, interrupt-source=INTPWGA48
        BswInterruptEntity_209: implemented-entry=PWGA_CH48_CAT2_ISR, interrupt-category=CAT-2, interrupt-source=INTPWGA48
        BswInterruptEntity_210: implemented-entry=PWGA_CH49_ISR, interrupt-category=CAT-1, interrupt-source=INTPWGA49
        BswInterruptEntity_211: implemented-entry=PWGA_CH49_CAT2_ISR, interrupt-category=CAT-2, interrupt-source=INTPWGA49
        BswInterruptEntity_212: implemented-entry=PWGA_CH50_ISR, interrupt-category=CAT-1, interrupt-source=INTPWGA50
        BswInterruptEntity_213: implemented-entry=PWGA_CH50_CAT2_ISR, interrupt-category=CAT-2, interrupt-source=INTPWGA50
        BswInterruptEntity_214: implemented-entry=PWGA_CH51_ISR, interrupt-category=CAT-1, interrupt-source=INTPWGA51
        BswInterruptEntity_215: implemented-entry=PWGA_CH51_CAT2_ISR, interrupt-category=CAT-2, interrupt-source=INTPWGA51
        BswInterruptEntity_216: implemented-entry=PWGA_CH52_ISR, interrupt-category=CAT-1, interrupt-source=INTPWGA52
        BswInterruptEntity_217: implemented-entry=PWGA_CH52_CAT2_ISR, interrupt-category=CAT-2, interrupt-source=INTPWGA52
        BswInterruptEntity_218: implemented-entry=PWGA_CH53_ISR, interrupt-category=CAT-1, interrupt-source=INTPWGA53
        BswInterruptEntity_219: implemented-entry=PWGA_CH53_CAT2_ISR, interrupt-category=CAT-2, interrupt-source=INTPWGA53
        BswInterruptEntity_220: implemented-entry=PWGA_CH54_ISR, interrupt-category=CAT-1, interrupt-source=INTPWGA54
        BswInterruptEntity_221: implemented-entry=PWGA_CH54_CAT2_ISR, interrupt-category=CAT-2, interrupt-source=INTPWGA54
        BswInterruptEntity_222: implemented-entry=PWGA_CH55_ISR, interrupt-category=CAT-1, interrupt-source=INTPWGA55
        BswInterruptEntity_223: implemented-entry=PWGA_CH55_CAT2_ISR, interrupt-category=CAT-2, interrupt-source=INTPWGA55
        BswInterruptEntity_224: implemented-entry=PWGA_CH56_ISR, interrupt-category=CAT-1, interrupt-source=INTPWGA56
        BswInterruptEntity_225: implemented-entry=PWGA_CH56_CAT2_ISR, interrupt-category=CAT-2, interrupt-source=INTPWGA56
        BswInterruptEntity_226: implemented-entry=PWGA_CH57_ISR, interrupt-category=CAT-1, interrupt-source=INTPWGA57
        BswInterruptEntity_227: implemented-entry=PWGA_CH57_CAT2_ISR, interrupt-category=CAT-2, interrupt-source=INTPWGA57
        BswInterruptEntity_228: implemented-entry=PWGA_CH58_ISR, interrupt-category=CAT-1, interrupt-source=INTPWGA58
        BswInterruptEntity_229: implemented-entry=PWGA_CH58_CAT2_ISR, interrupt-category=CAT-2, interrupt-source=INTPWGA58
        BswInterruptEntity_230: implemented-entry=PWGA_CH59_ISR, interrupt-category=CAT-1, interrupt-source=INTPWGA59
        BswInterruptEntity_231: implemented-entry=PWGA_CH59_CAT2_ISR, interrupt-category=CAT-2, interrupt-source=INTPWGA59
        BswInterruptEntity_232: implemented-entry=PWGA_CH60_ISR, interrupt-category=CAT-1, interrupt-source=INTPWGA60
        BswInterruptEntity_233: implemented-entry=PWGA_CH60_CAT2_ISR, interrupt-category=CAT-2, interrupt-source=INTPWGA60
        BswInterruptEntity_234: implemented-entry=PWGA_CH61_ISR, interrupt-category=CAT-1, interrupt-source=INTPWGA61
        BswInterruptEntity_235: implemented-entry=PWGA_CH61_CAT2_ISR, interrupt-category=CAT-2, interrupt-source=INTPWGA61
        BswInterruptEntity_236: implemented-entry=PWGA_CH62_ISR, interrupt-category=CAT-1, interrupt-source=INTPWGA62
        BswInterruptEntity_237: implemented-entry=PWGA_CH62_CAT2_ISR, interrupt-category=CAT-2, interrupt-source=INTPWGA62
        BswInterruptEntity_238: implemented-entry=PWGA_CH63_ISR, interrupt-category=CAT-1, interrupt-source=INTPWGA63
        BswInterruptEntity_239: implemented-entry=PWGA_CH63_CAT2_ISR, interrupt-category=CAT-2, interrupt-source=INTPWGA63
        BswInterruptEntity_240: implemented-entry=PWGA_CH64_ISR, interrupt-category=CAT-1, interrupt-source=INTPWGA64
        BswInterruptEntity_241: implemented-entry=PWGA_CH64_CAT2_ISR, interrupt-category=CAT-2, interrupt-source=INTPWGA64
        BswInterruptEntity_242: implemented-entry=PWGA_CH65_ISR, interrupt-category=CAT-1, interrupt-source=INTPWGA65
        BswInterruptEntity_243: implemented-entry=PWGA_CH65_CAT2_ISR, interrupt-category=CAT-2, interrupt-source=INTPWGA65
        BswInterruptEntity_244: implemented-entry=PWGA_CH66_ISR, interrupt-category=CAT-1, interrupt-source=INTPWGA66
        BswInterruptEntity_245: implemented-entry=PWGA_CH66_CAT2_ISR, interrupt-category=CAT-2, interrupt-source=INTPWGA66
        BswInterruptEntity_246: implemented-entry=PWGA_CH67_ISR, interrupt-category=CAT-1, interrupt-source=INTPWGA67
        BswInterruptEntity_247: implemented-entry=PWGA_CH67_CAT2_ISR, interrupt-category=CAT-2, interrupt-source=INTPWGA67
        BswInterruptEntity_248: implemented-entry=PWGA_CH68_ISR, interrupt-category=CAT-1, interrupt-source=INTPWGA68
        BswInterruptEntity_249: implemented-entry=PWGA_CH68_CAT2_ISR, interrupt-category=CAT-2, interrupt-source=INTPWGA68
        BswInterruptEntity_250: implemented-entry=PWGA_CH69_ISR, interrupt-category=CAT-1, interrupt-source=INTPWGA69
        BswInterruptEntity_251: implemented-entry=PWGA_CH69_CAT2_ISR, interrupt-category=CAT-2, interrupt-source=INTPWGA69
        BswInterruptEntity_252: implemented-entry=PWGA_CH70_ISR, interrupt-category=CAT-1, interrupt-source=INTPWGA70
        BswInterruptEntity_253: implemented-entry=PWGA_CH70_CAT2_ISR, interrupt-category=CAT-2, interrupt-source=INTPWGA70
        BswInterruptEntity_254: implemented-entry=PWGA_CH71_ISR, interrupt-category=CAT-1, interrupt-source=INTPWGA71
        BswInterruptEntity_255: implemented-entry=PWGA_CH71_CAT2_ISR, interrupt-category=CAT-2, interrupt-source=INTPWGA71
        BswInterruptEntity_256: implemented-entry=TAUJ2_CH00_ISR, interrupt-category=CAT-1, interrupt-source=INTTAUJ2I0
        BswInterruptEntity_257: implemented-entry=TAUJ2_CH00_CAT2_ISR, interrupt-category=CAT-2, interrupt-source=INTTAUJ2I0
        BswInterruptEntity_258: implemented-entry=TAUJ2_CH01_ISR, interrupt-category=CAT-1, interrupt-source=INTTAUJ2I1
        BswInterruptEntity_259: implemented-entry=TAUJ2_CH01_CAT2_ISR, interrupt-category=CAT-2, interrupt-source=INTTAUJ2I1
        BswInterruptEntity_260: implemented-entry=TAUJ2_CH02_ISR, interrupt-category=CAT-1, interrupt-source=INTTAUJ2I2
        BswInterruptEntity_261: implemented-entry=TAUJ2_CH02_CAT2_ISR, interrupt-category=CAT-2, interrupt-source=INTTAUJ2I2
        BswInterruptEntity_262: implemented-entry=TAUJ2_CH03_ISR, interrupt-category=CAT-1, interrupt-source=INTTAUJ2I3
        BswInterruptEntity_263: implemented-entry=TAUJ2_CH03_CAT2_ISR, interrupt-category=CAT-2, interrupt-source=INTTAUJ2I3
        BswInterruptEntity_264: implemented-entry=TAUJ3_CH00_ISR, interrupt-category=CAT-1, interrupt-source=INTTAUJ3I0
        BswInterruptEntity_265: implemented-entry=TAUJ3_CH00_CAT2_ISR, interrupt-category=CAT-2, interrupt-source=INTTAUJ3I0
        BswInterruptEntity_266: implemented-entry=TAUJ3_CH01_ISR, interrupt-category=CAT-1, interrupt-source=INTTAUJ3I1
        BswInterruptEntity_267: implemented-entry=TAUJ3_CH01_CAT2_ISR, interrupt-category=CAT-2, interrupt-source=INTTAUJ3I1
        BswInterruptEntity_268: implemented-entry=TAUJ3_CH02_ISR, interrupt-category=CAT-1, interrupt-source=INTTAUJ3I2
        BswInterruptEntity_269: implemented-entry=TAUJ3_CH02_CAT2_ISR, interrupt-category=CAT-2, interrupt-source=INTTAUJ3I2
        BswInterruptEntity_270: implemented-entry=TAUJ3_CH03_ISR, interrupt-category=CAT-1, interrupt-source=INTTAUJ3I3
        BswInterruptEntity_271: implemented-entry=TAUJ3_CH03_CAT2_ISR, interrupt-category=CAT-2, interrupt-source=INTTAUJ3I3
        BswInterruptEntity_272: implemented-entry=PWM_INTPWGAG00_ISR, interrupt-category=CAT-1, interrupt-source=INTPWGAG00
        BswInterruptEntity_273: implemented-entry=PWGA_CHGRP00_CAT2_ISR, interrupt-category=CAT-2, interrupt-source=INTPWGAG00
        BswInterruptEntity_274: implemented-entry=PWM_INTPWGAG01_ISR, interrupt-category=CAT-1, interrupt-source=INTPWGAG01
        BswInterruptEntity_275: implemented-entry=PWGA_CHGRP01_CAT2_ISR, interrupt-category=CAT-2, interrupt-source=INTPWGAG01
        BswInterruptEntity_276: implemented-entry=PWM_INTPWGAG02_ISR, interrupt-category=CAT-1, interrupt-source=INTPWGAG02
        BswInterruptEntity_277: implemented-entry=PWGA_CHGRP02_CAT2_ISR, interrupt-category=CAT-2, interrupt-source=INTPWGAG02
      17 x bsw called entity:
        BswCalledEntity_0: implemented-entry=Pwm_Init
        BswCalledEntity_1: implemented-entry=Pwm_DeInit
        BswCalledEntity_2: can-enter-exclusive-area=PWM_REGISTERS_PROTECTION, implemented-entry=Pwm_SetDutyCycle
        BswCalledEntity_3: can-enter-exclusive-area=PWM_REGISTERS_PROTECTION, implemented-entry=Pwm_SetPeriodAndDuty
        BswCalledEntity_4: can-enter-exclusive-area=PWM_REGISTERS_PROTECTION, implemented-entry=Pwm_SetOutputToIdle
        BswCalledEntity_5: can-enter-exclusive-area=PWM_REGISTERS_PROTECTION, implemented-entry=Pwm_GetOutputState
        BswCalledEntity_6: implemented-entry=Pwm_DisableNotification
        BswCalledEntity_7: implemented-entry=Pwm_EnableNotification
        BswCalledEntity_8: implemented-entry=Pwm_GetVersionInfo
        BswCalledEntity_9: can-enter-exclusive-area=PWM_REGISTERS_PROTECTION, implemented-entry=Pwm_SelectChannelClk
        BswCalledEntity_10: can-enter-exclusive-area=PWM_REGISTERS_PROTECTION, implemented-entry=Pwm_SetTriggerDelay
        BswCalledEntity_11: can-enter-exclusive-area=PWM_REGISTERS_PROTECTION, implemented-entry=Pwm_SetChannelOutput
        BswCalledEntity_12: can-enter-exclusive-area=PWM_REGISTERS_PROTECTION, implemented-entry=Pwm_SynchronousInit
        BswCalledEntity_13: can-enter-exclusive-area=PWM_REGISTERS_PROTECTION, implemented-entry=Pwm_SynchronousStart
        BswCalledEntity_14: can-enter-exclusive-area=PWM_REGISTERS_PROTECTION, implemented-entry=Pwm_SynchronousStop
        BswCalledEntity_15: implemented-entry=Pwm_CheckHWConsistency
        BswCalledEntity_16: implemented-entry=Pwm_ControlTriggerOutput
  295 x bsw module entry, all with is-synchronous=true, sw-service-impl-policy=STANDARD:
    TAUB0_CH00_ISR: is-reentrant=false, call-type=INTERRUPT, execution-context=INTERRUPT-CAT-1
    TAUB0_CH00_CAT2_ISR: is-reentrant=false, call-type=INTERRUPT, execution-context=INTERRUPT-CAT-2
    TAUB0_CH01_ISR: is-reentrant=false, call-type=INTERRUPT, execution-context=INTERRUPT-CAT-1
    TAUB0_CH01_CAT2_ISR: is-reentrant=false, call-type=INTERRUPT, execution-context=INTERRUPT-CAT-2
    TAUB0_CH02_ISR: is-reentrant=false, call-type=INTERRUPT, execution-context=INTERRUPT-CAT-1
    TAUB0_CH02_CAT2_ISR: is-reentrant=false, call-type=INTERRUPT, execution-context=INTERRUPT-CAT-2
    TAUB0_CH03_ISR: is-reentrant=false, call-type=INTERRUPT, execution-context=INTERRUPT-CAT-1
    TAUB0_CH03_CAT2_ISR: is-reentrant=false, call-type=INTERRUPT, execution-context=INTERRUPT-CAT-2
    TAUB0_CH04_ISR: is-reentrant=false, call-type=INTERRUPT, execution-context=INTERRUPT-CAT-1
    TAUB0_CH04_CAT2_ISR: is-reentrant=false, call-type=INTERRUPT, execution-context=INTERRUPT-CAT-2
    TAUB0_CH05_ISR: is-reentrant=false, call-type=INTERRUPT, execution-context=INTERRUPT-CAT-1
    TAUB0_CH05_CAT2_ISR: is-reentrant=false, call-type=INTERRUPT, execution-context=INTERRUPT-CAT-2
    TAUB0_CH06_ISR: is-reentrant=false, call-type=INTERRUPT, execution-context=INTERRUPT-CAT-1
    TAUB0_CH06_CAT2_ISR: is-reentrant=false, call-type=INTERRUPT, execution-context=INTERRUPT-CAT-2
    TAUB0_CH07_ISR: is-reentrant=false, call-type=INTERRUPT, execution-context=INTERRUPT-CAT-1
    TAUB0_CH07_CAT2_ISR: is-reentrant=false, call-type=INTERRUPT, execution-context=INTERRUPT-CAT-2
    TAUB0_CH08_ISR: is-reentrant=false, call-type=INTERRUPT, execution-context=INTERRUPT-CAT-1
    TAUB0_CH08_CAT2_ISR: is-reentrant=false, call-type=INTERRUPT, execution-context=INTERRUPT-CAT-2
    TAUB0_CH09_ISR: is-reentrant=false, call-type=INTERRUPT, execution-context=INTERRUPT-CAT-1
    TAUB0_CH09_CAT2_ISR: is-reentrant=false, call-type=INTERRUPT, execution-context=INTERRUPT-CAT-2
    TAUB0_CH10_ISR: is-reentrant=false, call-type=INTERRUPT, execution-context=INTERRUPT-CAT-1
    TAUB0_CH10_CAT2_ISR: is-reentrant=false, call-type=INTERRUPT, execution-context=INTERRUPT-CAT-2
    TAUB0_CH11_ISR: is-reentrant=false, call-type=INTERRUPT, execution-context=INTERRUPT-CAT-1
    TAUB0_CH11_CAT2_ISR: is-reentrant=false, call-type=INTERRUPT, execution-context=INTERRUPT-CAT-2
    TAUB0_CH12_ISR: is-reentrant=false, call-type=INTERRUPT, execution-context=INTERRUPT-CAT-1
    TAUB0_CH12_CAT2_ISR: is-reentrant=false, call-type=INTERRUPT, execution-context=INTERRUPT-CAT-2
    TAUB0_CH13_ISR: is-reentrant=false, call-type=INTERRUPT, execution-context=INTERRUPT-CAT-1
    TAUB0_CH13_CAT2_ISR: is-reentrant=false, call-type=INTERRUPT, execution-context=INTERRUPT-CAT-2
    TAUB0_CH14_ISR: is-reentrant=false, call-type=INTERRUPT, execution-context=INTERRUPT-CAT-1
    TAUB0_CH14_CAT2_ISR: is-reentrant=false, call-type=INTERRUPT, execution-context=INTERRUPT-CAT-2
    TAUB0_CH15_ISR: is-reentrant=false, call-type=INTERRUPT, execution-context=INTERRUPT-CAT-1
    TAUB0_CH15_CAT2_ISR: is-reentrant=false, call-type=INTERRUPT, execution-context=INTERRUPT-CAT-2
    TAUB1_CH00_ISR: is-reentrant=false, call-type=INTERRUPT, execution-context=INTERRUPT-CAT-1
    TAUB1_CH00_CAT2_ISR: is-reentrant=false, call-type=INTERRUPT, execution-context=INTERRUPT-CAT-2
    TAUB1_CH01_ISR: is-reentrant=false, call-type=INTERRUPT, execution-context=INTERRUPT-CAT-1
    TAUB1_CH01_CAT2_ISR: is-reentrant=false, call-type=INTERRUPT, execution-context=INTERRUPT-CAT-2
    TAUB1_CH02_ISR: is-reentrant=false, call-type=INTERRUPT, execution-context=INTERRUPT-CAT-1
    TAUB1_CH02_CAT2_ISR: is-reentrant=false, call-type=INTERRUPT, execution-context=INTERRUPT-CAT-2
    TAUB1_CH03_ISR: is-reentrant=false, call-type=INTERRUPT, execution-context=INTERRUPT-CAT-1
    TAUB1_CH03_CAT2_ISR: is-reentrant=false, call-type=INTERRUPT, execution-context=INTERRUPT-CAT-2
    TAUB1_CH04_ISR: is-reentrant=false, call-type=INTERRUPT, execution-context=INTERRUPT-CAT-1
    TAUB1_CH04_CAT2_ISR: is-reentrant=false, call-type=INTERRUPT, execution-context=INTERRUPT-CAT-2
    TAUB1_CH05_ISR: is-reentrant=false, call-type=INTERRUPT, execution-context=INTERRUPT-CAT-1
    TAUB1_CH05_CAT2_ISR: is-reentrant=false, call-type=INTERRUPT, execution-context=INTERRUPT-CAT-2
    TAUB1_CH06_ISR: is-reentrant=false, call-type=INTERRUPT, execution-context=INTERRUPT-CAT-1
    TAUB1_CH06_CAT2_ISR: is-reentrant=false, call-type=INTERRUPT, execution-context=INTERRUPT-CAT-2
    TAUB1_CH07_ISR: is-reentrant=false, call-type=INTERRUPT, execution-context=INTERRUPT-CAT-1
    TAUB1_CH07_CAT2_ISR: is-reentrant=false, call-type=INTERRUPT, execution-context=INTERRUPT-CAT-2
    TAUB1_CH08_ISR: is-reentrant=false, call-type=INTERRUPT, execution-context=INTERRUPT-CAT-1
    TAUB1_CH08_CAT2_ISR: is-reentrant=false, call-type=INTERRUPT, execution-context=INTERRUPT-CAT-2
    TAUB1_CH09_ISR: is-reentrant=false, call-type=INTERRUPT, execution-context=INTERRUPT-CAT-1
    TAUB1_CH09_CAT2_ISR: is-reentrant=false, call-type=INTERRUPT, execution-context=INTERRUPT-CAT-2
    TAUB1_CH10_ISR: is-reentrant=false, call-type=INTERRUPT, execution-context=INTERRUPT-CAT-1
    TAUB1_CH10_CAT2_ISR: is-reentrant=false, call-type=INTERRUPT, execution-context=INTERRUPT-CAT-2
    TAUB1_CH11_ISR: is-reentrant=false, call-type=INTERRUPT, execution-context=INTERRUPT-CAT-1
    TAUB1_CH11_CAT2_ISR: is-reentrant=false, call-type=INTERRUPT, execution-context=INTERRUPT-CAT-2
    TAUB1_CH12_ISR: is-reentrant=false, call-type=INTERRUPT, execution-context=INTERRUPT-CAT-1
    TAUB1_CH12_CAT2_ISR: is-reentrant=false, call-type=INTERRUPT, execution-context=INTERRUPT-CAT-2
    TAUB1_CH13_ISR: is-reentrant=false, call-type=INTERRUPT, execution-context=INTERRUPT-CAT-1
    TAUB1_CH13_CAT2_ISR: is-reentrant=false, call-type=INTERRUPT, execution-context=INTERRUPT-CAT-2
    TAUB1_CH14_ISR: is-reentrant=false, call-type=INTERRUPT, execution-context=INTERRUPT-CAT-1
    TAUB1_CH14_CAT2_ISR: is-reentrant=false, call-type=INTERRUPT, execution-context=INTERRUPT-CAT-2
    TAUB1_CH15_ISR: is-reentrant=false, call-type=INTERRUPT, execution-context=INTERRUPT-CAT-1
    TAUB1_CH15_CAT2_ISR: is-reentrant=false, call-type=INTERRUPT, execution-context=INTERRUPT-CAT-2
    TAUD0_CH00_ISR: is-reentrant=false, call-type=INTERRUPT, execution-context=INTERRUPT-CAT-1
    TAUD0_CH00_CAT2_ISR: is-reentrant=false, call-type=INTERRUPT, execution-context=INTERRUPT-CAT-2
    TAUD0_CH01_ISR: is-reentrant=false, call-type=INTERRUPT, execution-context=INTERRUPT-CAT-1
    TAUD0_CH01_CAT2_ISR: is-reentrant=false, call-type=INTERRUPT, execution-context=INTERRUPT-CAT-2
    TAUD0_CH02_ISR: is-reentrant=false, call-type=INTERRUPT, execution-context=INTERRUPT-CAT-1
    TAUD0_CH02_CAT2_ISR: is-reentrant=false, call-type=INTERRUPT, execution-context=INTERRUPT-CAT-2
    TAUD0_CH03_ISR: is-reentrant=false, call-type=INTERRUPT, execution-context=INTERRUPT-CAT-1
    TAUD0_CH03_CAT2_ISR: is-reentrant=false, call-type=INTERRUPT, execution-context=INTERRUPT-CAT-2
    TAUD0_CH04_ISR: is-reentrant=false, call-type=INTERRUPT, execution-context=INTERRUPT-CAT-1
    TAUD0_CH04_CAT2_ISR: is-reentrant=false, call-type=INTERRUPT, execution-context=INTERRUPT-CAT-2
    TAUD0_CH05_ISR: is-reentrant=false, call-type=INTERRUPT, execution-context=INTERRUPT-CAT-1
    TAUD0_CH05_CAT2_ISR: is-reentrant=false, call-type=INTERRUPT, execution-context=INTERRUPT-CAT-2
    TAUD0_CH06_ISR: is-reentrant=false, call-type=INTERRUPT, execution-context=INTERRUPT-CAT-1
    TAUD0_CH06_CAT2_ISR: is-reentrant=false, call-type=INTERRUPT, execution-context=INTERRUPT-CAT-2
    TAUD0_CH07_ISR: is-reentrant=false, call-type=INTERRUPT, execution-context=INTERRUPT-CAT-1
    TAUD0_CH07_CAT2_ISR: is-reentrant=false, call-type=INTERRUPT, execution-context=INTERRUPT-CAT-2
    TAUD0_CH08_ISR: is-reentrant=false, call-type=INTERRUPT, execution-context=INTERRUPT-CAT-1
    TAUD0_CH08_CAT2_ISR: is-reentrant=false, call-type=INTERRUPT, execution-context=INTERRUPT-CAT-2
    TAUD0_CH09_ISR: is-reentrant=false, call-type=INTERRUPT, execution-context=INTERRUPT-CAT-1
    TAUD0_CH09_CAT2_ISR: is-reentrant=false, call-type=INTERRUPT, execution-context=INTERRUPT-CAT-2
    TAUD0_CH10_ISR: is-reentrant=false, call-type=INTERRUPT, execution-context=INTERRUPT-CAT-1
    TAUD0_CH10_CAT2_ISR: is-reentrant=false, call-type=INTERRUPT, execution-context=INTERRUPT-CAT-2
    TAUD0_CH11_ISR: is-reentrant=false, call-type=INTERRUPT, execution-context=INTERRUPT-CAT-1
    TAUD0_CH11_CAT2_ISR: is-reentrant=false, call-type=INTERRUPT, execution-context=INTERRUPT-CAT-2
    TAUD0_CH12_ISR: is-reentrant=false, call-type=INTERRUPT, execution-context=INTERRUPT-CAT-1
    TAUD0_CH12_CAT2_ISR: is-reentrant=false, call-type=INTERRUPT, execution-context=INTERRUPT-CAT-2
    TAUD0_CH13_ISR: is-reentrant=false, call-type=INTERRUPT, execution-context=INTERRUPT-CAT-1
    TAUD0_CH13_CAT2_ISR: is-reentrant=false, call-type=INTERRUPT, execution-context=INTERRUPT-CAT-2
    TAUD0_CH14_ISR: is-reentrant=false, call-type=INTERRUPT, execution-context=INTERRUPT-CAT-1
    TAUD0_CH14_CAT2_ISR: is-reentrant=false, call-type=INTERRUPT, execution-context=INTERRUPT-CAT-2
    TAUD0_CH15_ISR: is-reentrant=false, call-type=INTERRUPT, execution-context=INTERRUPT-CAT-1
    TAUD0_CH15_CAT2_ISR: is-reentrant=false, call-type=INTERRUPT, execution-context=INTERRUPT-CAT-2
    TAUJ0_CH00_ISR: is-reentrant=false, call-type=INTERRUPT, execution-context=INTERRUPT-CAT-1
    TAUJ0_CH00_CAT2_ISR: is-reentrant=false, call-type=INTERRUPT, execution-context=INTERRUPT-CAT-2
    TAUJ0_CH01_ISR: is-reentrant=false, call-type=INTERRUPT, execution-context=INTERRUPT-CAT-1
    TAUJ0_CH01_CAT2_ISR: is-reentrant=false, call-type=INTERRUPT, execution-context=INTERRUPT-CAT-2
    TAUJ0_CH02_ISR: is-reentrant=false, call-type=INTERRUPT, execution-context=INTERRUPT-CAT-1
    TAUJ0_CH02_CAT2_ISR: is-reentrant=false, call-type=INTERRUPT, execution-context=INTERRUPT-CAT-2
    TAUJ0_CH03_ISR: is-reentrant=false, call-type=INTERRUPT, execution-context=INTERRUPT-CAT-1
    TAUJ0_CH03_CAT2_ISR: is-reentrant=false, call-type=INTERRUPT, execution-context=INTERRUPT-CAT-2
    TAUJ1_CH00_ISR: is-reentrant=false, call-type=INTERRUPT, execution-context=INTERRUPT-CAT-1
    TAUJ1_CH00_CAT2_ISR: is-reentrant=false, call-type=INTERRUPT, execution-context=INTERRUPT-CAT-2
    TAUJ1_CH01_ISR: is-reentrant=false, call-type=INTERRUPT, execution-context=INTERRUPT-CAT-1
    TAUJ1_CH01_CAT2_ISR: is-reentrant=false, call-type=INTERRUPT, execution-context=INTERRUPT-CAT-2
    TAUJ1_CH02_ISR: is-reentrant=false, call-type=INTERRUPT, execution-context=INTERRUPT-CAT-1
    TAUJ1_CH02_CAT2_ISR: is-reentrant=false, call-type=INTERRUPT, execution-context=INTERRUPT-CAT-2
    TAUJ1_CH03_ISR: is-reentrant=false, call-type=INTERRUPT, execution-context=INTERRUPT-CAT-1
    TAUJ1_CH03_CAT2_ISR: is-reentrant=false, call-type=INTERRUPT, execution-context=INTERRUPT-CAT-2
    TAUJ2_CH00_ISR: is-reentrant=false, call-type=INTERRUPT, execution-context=INTERRUPT-CAT-1
    TAUJ2_CH00_CAT2_ISR: is-reentrant=false, call-type=INTERRUPT, execution-context=INTERRUPT-CAT-2
    TAUJ2_CH01_ISR: is-reentrant=false, call-type=INTERRUPT, execution-context=INTERRUPT-CAT-1
    TAUJ2_CH01_CAT2_ISR: is-reentrant=false, call-type=INTERRUPT, execution-context=INTERRUPT-CAT-2
    TAUJ2_CH02_ISR: is-reentrant=false, call-type=INTERRUPT, execution-context=INTERRUPT-CAT-1
    TAUJ2_CH02_CAT2_ISR: is-reentrant=false, call-type=INTERRUPT, execution-context=INTERRUPT-CAT-2
    TAUJ2_CH03_ISR: is-reentrant=false, call-type=INTERRUPT, execution-context=INTERRUPT-CAT-1
    TAUJ2_CH03_CAT2_ISR: is-reentrant=false, call-type=INTERRUPT, execution-context=INTERRUPT-CAT-2
    TAUJ3_CH00_ISR: is-reentrant=false, call-type=INTERRUPT, execution-context=INTERRUPT-CAT-1
    TAUJ3_CH00_CAT2_ISR: is-reentrant=false, call-type=INTERRUPT, execution-context=INTERRUPT-CAT-2
    TAUJ3_CH01_ISR: is-reentrant=false, call-type=INTERRUPT, execution-context=INTERRUPT-CAT-1
    TAUJ3_CH01_CAT2_ISR: is-reentrant=false, call-type=INTERRUPT, execution-context=INTERRUPT-CAT-2
    TAUJ3_CH02_ISR: is-reentrant=false, call-type=INTERRUPT, execution-context=INTERRUPT-CAT-1
    TAUJ3_CH02_CAT2_ISR: is-reentrant=false, call-type=INTERRUPT, execution-context=INTERRUPT-CAT-2
    TAUJ3_CH03_ISR: is-reentrant=false, call-type=INTERRUPT, execution-context=INTERRUPT-CAT-1
    TAUJ3_CH03_CAT2_ISR: is-reentrant=false, call-type=INTERRUPT, execution-context=INTERRUPT-CAT-2
    PWGA_CH00_ISR: is-reentrant=false, call-type=INTERRUPT, execution-context=INTERRUPT-CAT-1
    PWGA_CH00_CAT2_ISR: is-reentrant=false, call-type=INTERRUPT, execution-context=INTERRUPT-CAT-2
    PWGA_CH01_ISR: is-reentrant=false, call-type=INTERRUPT, execution-context=INTERRUPT-CAT-1
    PWGA_CH01_CAT2_ISR: is-reentrant=false, call-type=INTERRUPT, execution-context=INTERRUPT-CAT-2
    PWGA_CH02_ISR: is-reentrant=false, call-type=INTERRUPT, execution-context=INTERRUPT-CAT-1
    PWGA_CH02_CAT2_ISR: is-reentrant=false, call-type=INTERRUPT, execution-context=INTERRUPT-CAT-2
    PWGA_CH03_ISR: is-reentrant=false, call-type=INTERRUPT, execution-context=INTERRUPT-CAT-1
    PWGA_CH03_CAT2_ISR: is-reentrant=false, call-type=INTERRUPT, execution-context=INTERRUPT-CAT-2
    PWGA_CH04_ISR: is-reentrant=false, call-type=INTERRUPT, execution-context=INTERRUPT-CAT-1
    PWGA_CH04_CAT2_ISR: is-reentrant=false, call-type=INTERRUPT, execution-context=INTERRUPT-CAT-2
    PWGA_CH05_ISR: is-reentrant=false, call-type=INTERRUPT, execution-context=INTERRUPT-CAT-1
    PWGA_CH05_CAT2_ISR: is-reentrant=false, call-type=INTERRUPT, execution-context=INTERRUPT-CAT-2
    PWGA_CH06_ISR: is-reentrant=false, call-type=INTERRUPT, execution-context=INTERRUPT-CAT-1
    PWGA_CH06_CAT2_ISR: is-reentrant=false, call-type=INTERRUPT, execution-context=INTERRUPT-CAT-2
    PWGA_CH07_ISR: is-reentrant=false, call-type=INTERRUPT, execution-context=INTERRUPT-CAT-1
    PWGA_CH07_CAT2_ISR: is-reentrant=false, call-type=INTERRUPT, execution-context=INTERRUPT-CAT-2
    PWGA_CH08_ISR: is-reentrant=false, call-type=INTERRUPT, execution-context=INTERRUPT-CAT-1
    PWGA_CH08_CAT2_ISR: is-reentrant=false, call-type=INTERRUPT, execution-context=INTERRUPT-CAT-2
    PWGA_CH09_ISR: is-reentrant=false, call-type=INTERRUPT, execution-context=INTERRUPT-CAT-1
    PWGA_CH09_CAT2_ISR: is-reentrant=false, call-type=INTERRUPT, execution-context=INTERRUPT-CAT-2
    PWGA_CH10_ISR: is-reentrant=false, call-type=INTERRUPT, execution-context=INTERRUPT-CAT-1
    PWGA_CH10_CAT2_ISR: is-reentrant=false, call-type=INTERRUPT, execution-context=INTERRUPT-CAT-2
    PWGA_CH11_ISR: is-reentrant=false, call-type=INTERRUPT, execution-context=INTERRUPT-CAT-1
    PWGA_CH11_CAT2_ISR: is-reentrant=false, call-type=INTERRUPT, execution-context=INTERRUPT-CAT-2
    PWGA_CH12_ISR: is-reentrant=false, call-type=INTERRUPT, execution-context=INTERRUPT-CAT-1
    PWGA_CH12_CAT2_ISR: is-reentrant=false, call-type=INTERRUPT, execution-context=INTERRUPT-CAT-2
    PWGA_CH13_ISR: is-reentrant=false, call-type=INTERRUPT, execution-context=INTERRUPT-CAT-1
    PWGA_CH13_CAT2_ISR: is-reentrant=false, call-type=INTERRUPT, execution-context=INTERRUPT-CAT-2
    PWGA_CH14_ISR: is-reentrant=false, call-type=INTERRUPT, execution-context=INTERRUPT-CAT-1
    PWGA_CH14_CAT2_ISR: is-reentrant=false, call-type=INTERRUPT, execution-context=INTERRUPT-CAT-2
    PWGA_CH15_ISR: is-reentrant=false, call-type=INTERRUPT, execution-context=INTERRUPT-CAT-1
    PWGA_CH15_CAT2_ISR: is-reentrant=false, call-type=INTERRUPT, execution-context=INTERRUPT-CAT-2
    PWGA_CH16_ISR: is-reentrant=false, call-type=INTERRUPT, execution-context=INTERRUPT-CAT-1
    PWGA_CH16_CAT2_ISR: is-reentrant=false, call-type=INTERRUPT, execution-context=INTERRUPT-CAT-2
    PWGA_CH17_ISR: is-reentrant=false, call-type=INTERRUPT, execution-context=INTERRUPT-CAT-1
    PWGA_CH17_CAT2_ISR: is-reentrant=false, call-type=INTERRUPT, execution-context=INTERRUPT-CAT-2
    PWGA_CH18_ISR: is-reentrant=false, call-type=INTERRUPT, execution-context=INTERRUPT-CAT-1
    PWGA_CH18_CAT2_ISR: is-reentrant=false, call-type=INTERRUPT, execution-context=INTERRUPT-CAT-2
    PWGA_CH19_ISR: is-reentrant=false, call-type=INTERRUPT, execution-context=INTERRUPT-CAT-1
    PWGA_CH19_CAT2_ISR: is-reentrant=false, call-type=INTERRUPT, execution-context=INTERRUPT-CAT-2
    PWGA_CH20_ISR: is-reentrant=false, call-type=INTERRUPT, execution-context=INTERRUPT-CAT-1
    PWGA_CH20_CAT2_ISR: is-reentrant=false, call-type=INTERRUPT, execution-context=INTERRUPT-CAT-2
    PWGA_CH21_ISR: is-reentrant=false, call-type=INTERRUPT, execution-context=INTERRUPT-CAT-1
    PWGA_CH21_CAT2_ISR: is-reentrant=false, call-type=INTERRUPT, execution-context=INTERRUPT-CAT-2
    PWGA_CH22_ISR: is-reentrant=false, call-type=INTERRUPT, execution-context=INTERRUPT-CAT-1
    PWGA_CH22_CAT2_ISR: is-reentrant=false, call-type=INTERRUPT, execution-context=INTERRUPT-CAT-2
    PWGA_CH23_ISR: is-reentrant=false, call-type=INTERRUPT, execution-context=INTERRUPT-CAT-1
    PWGA_CH23_CAT2_ISR: is-reentrant=false, call-type=INTERRUPT, execution-context=INTERRUPT-CAT-2
    PWGA_CH24_ISR: is-reentrant=false, call-type=INTERRUPT, execution-context=INTERRUPT-CAT-1
    PWGA_CH24_CAT2_ISR: is-reentrant=false, call-type=INTERRUPT, execution-context=INTERRUPT-CAT-2
    PWGA_CH25_ISR: is-reentrant=false, call-type=INTERRUPT, execution-context=INTERRUPT-CAT-1
    PWGA_CH25_CAT2_ISR: is-reentrant=false, call-type=INTERRUPT, execution-context=INTERRUPT-CAT-2
    PWGA_CH26_ISR: is-reentrant=false, call-type=INTERRUPT, execution-context=INTERRUPT-CAT-1
    PWGA_CH26_CAT2_ISR: is-reentrant=false, call-type=INTERRUPT, execution-context=INTERRUPT-CAT-2
    PWGA_CH27_ISR: is-reentrant=false, call-type=INTERRUPT, execution-context=INTERRUPT-CAT-1
    PWGA_CH27_CAT2_ISR: is-reentrant=false, call-type=INTERRUPT, execution-context=INTERRUPT-CAT-2
    PWGA_CH28_ISR: is-reentrant=false, call-type=INTERRUPT, execution-context=INTERRUPT-CAT-1
    PWGA_CH28_CAT2_ISR: is-reentrant=false, call-type=INTERRUPT, execution-context=INTERRUPT-CAT-2
    PWGA_CH29_ISR: is-reentrant=false, call-type=INTERRUPT, execution-context=INTERRUPT-CAT-1
    PWGA_CH29_CAT2_ISR: is-reentrant=false, call-type=INTERRUPT, execution-context=INTERRUPT-CAT-2
    PWGA_CH30_ISR: is-reentrant=false, call-type=INTERRUPT, execution-context=INTERRUPT-CAT-1
    PWGA_CH30_CAT2_ISR: is-reentrant=false, call-type=INTERRUPT, execution-context=INTERRUPT-CAT-2
    PWGA_CH31_ISR: is-reentrant=false, call-type=INTERRUPT, execution-context=INTERRUPT-CAT-1
    PWGA_CH31_CAT2_ISR: is-reentrant=false, call-type=INTERRUPT, execution-context=INTERRUPT-CAT-2
    PWGA_CH32_ISR: is-reentrant=false, call-type=INTERRUPT, execution-context=INTERRUPT-CAT-1
    PWGA_CH32_CAT2_ISR: is-reentrant=false, call-type=INTERRUPT, execution-context=INTERRUPT-CAT-2
    PWGA_CH33_ISR: is-reentrant=false, call-type=INTERRUPT, execution-context=INTERRUPT-CAT-1
    PWGA_CH33_CAT2_ISR: is-reentrant=false, call-type=INTERRUPT, execution-context=INTERRUPT-CAT-2
    PWGA_CH34_ISR: is-reentrant=false, call-type=INTERRUPT, execution-context=INTERRUPT-CAT-1
    PWGA_CH34_CAT2_ISR: is-reentrant=false, call-type=INTERRUPT, execution-context=INTERRUPT-CAT-2
    PWGA_CH35_ISR: is-reentrant=false, call-type=INTERRUPT, execution-context=INTERRUPT-CAT-1
    PWGA_CH35_CAT2_ISR: is-reentrant=false, call-type=INTERRUPT, execution-context=INTERRUPT-CAT-2
    PWGA_CH36_ISR: is-reentrant=false, call-type=INTERRUPT, execution-context=INTERRUPT-CAT-1
    PWGA_CH36_CAT2_ISR: is-reentrant=false, call-type=INTERRUPT, execution-context=INTERRUPT-CAT-2
    PWGA_CH37_ISR: is-reentrant=false, call-type=INTERRUPT, execution-context=INTERRUPT-CAT-1
    PWGA_CH37_CAT2_ISR: is-reentrant=false, call-type=INTERRUPT, execution-context=INTERRUPT-CAT-2
    PWGA_CH38_ISR: is-reentrant=false, call-type=INTERRUPT, execution-context=INTERRUPT-CAT-1
    PWGA_CH38_CAT2_ISR: is-reentrant=false, call-type=INTERRUPT, execution-context=INTERRUPT-CAT-2
    PWGA_CH39_ISR: is-reentrant=false, call-type=INTERRUPT, execution-context=INTERRUPT-CAT-1
    PWGA_CH39_CAT2_ISR: is-reentrant=false, call-type=INTERRUPT, execution-context=INTERRUPT-CAT-2
    PWGA_CH40_ISR: is-reentrant=false, call-type=INTERRUPT, execution-context=INTERRUPT-CAT-1
    PWGA_CH40_CAT2_ISR: is-reentrant=false, call-type=INTERRUPT, execution-context=INTERRUPT-CAT-2
    PWGA_CH41_ISR: is-reentrant=false, call-type=INTERRUPT, execution-context=INTERRUPT-CAT-1
    PWGA_CH41_CAT2_ISR: is-reentrant=false, call-type=INTERRUPT, execution-context=INTERRUPT-CAT-2
    PWGA_CH42_ISR: is-reentrant=false, call-type=INTERRUPT, execution-context=INTERRUPT-CAT-1
    PWGA_CH42_CAT2_ISR: is-reentrant=false, call-type=INTERRUPT, execution-context=INTERRUPT-CAT-2
    PWGA_CH43_ISR: is-reentrant=false, call-type=INTERRUPT, execution-context=INTERRUPT-CAT-1
    PWGA_CH43_CAT2_ISR: is-reentrant=false, call-type=INTERRUPT, execution-context=INTERRUPT-CAT-2
    PWGA_CH44_ISR: is-reentrant=false, call-type=INTERRUPT, execution-context=INTERRUPT-CAT-1
    PWGA_CH44_CAT2_ISR: is-reentrant=false, call-type=INTERRUPT, execution-context=INTERRUPT-CAT-2
    PWGA_CH45_ISR: is-reentrant=false, call-type=INTERRUPT, execution-context=INTERRUPT-CAT-1
    PWGA_CH45_CAT2_ISR: is-reentrant=false, call-type=INTERRUPT, execution-context=INTERRUPT-CAT-2
    PWGA_CH46_ISR: is-reentrant=false, call-type=INTERRUPT, execution-context=INTERRUPT-CAT-1
    PWGA_CH46_CAT2_ISR: is-reentrant=false, call-type=INTERRUPT, execution-context=INTERRUPT-CAT-2
    PWGA_CH47_ISR: is-reentrant=false, call-type=INTERRUPT, execution-context=INTERRUPT-CAT-1
    PWGA_CH47_CAT2_ISR: is-reentrant=false, call-type=INTERRUPT, execution-context=INTERRUPT-CAT-2
    PWGA_CH48_ISR: is-reentrant=false, call-type=INTERRUPT, execution-context=INTERRUPT-CAT-1
    PWGA_CH48_CAT2_ISR: is-reentrant=false, call-type=INTERRUPT, execution-context=INTERRUPT-CAT-2
    PWGA_CH49_ISR: is-reentrant=false, call-type=INTERRUPT, execution-context=INTERRUPT-CAT-1
    PWGA_CH49_CAT2_ISR: is-reentrant=false, call-type=INTERRUPT, execution-context=INTERRUPT-CAT-2
    PWGA_CH50_ISR: is-reentrant=false, call-type=INTERRUPT, execution-context=INTERRUPT-CAT-1
    PWGA_CH50_CAT2_ISR: is-reentrant=false, call-type=INTERRUPT, execution-context=INTERRUPT-CAT-2
    PWGA_CH51_ISR: is-reentrant=false, call-type=INTERRUPT, execution-context=INTERRUPT-CAT-1
    PWGA_CH51_CAT2_ISR: is-reentrant=false, call-type=INTERRUPT, execution-context=INTERRUPT-CAT-2
    PWGA_CH52_ISR: is-reentrant=false, call-type=INTERRUPT, execution-context=INTERRUPT-CAT-1
    PWGA_CH52_CAT2_ISR: is-reentrant=false, call-type=INTERRUPT, execution-context=INTERRUPT-CAT-2
    PWGA_CH53_ISR: is-reentrant=false, call-type=INTERRUPT, execution-context=INTERRUPT-CAT-1
    PWGA_CH53_CAT2_ISR: is-reentrant=false, call-type=INTERRUPT, execution-context=INTERRUPT-CAT-2
    PWGA_CH54_ISR: is-reentrant=false, call-type=INTERRUPT, execution-context=INTERRUPT-CAT-1
    PWGA_CH54_CAT2_ISR: is-reentrant=false, call-type=INTERRUPT, execution-context=INTERRUPT-CAT-2
    PWGA_CH55_ISR: is-reentrant=false, call-type=INTERRUPT, execution-context=INTERRUPT-CAT-1
    PWGA_CH55_CAT2_ISR: is-reentrant=false, call-type=INTERRUPT, execution-context=INTERRUPT-CAT-2
    PWGA_CH56_ISR: is-reentrant=false, call-type=INTERRUPT, execution-context=INTERRUPT-CAT-1
    PWGA_CH56_CAT2_ISR: is-reentrant=false, call-type=INTERRUPT, execution-context=INTERRUPT-CAT-2
    PWGA_CH57_ISR: is-reentrant=false, call-type=INTERRUPT, execution-context=INTERRUPT-CAT-1
    PWGA_CH57_CAT2_ISR: is-reentrant=false, call-type=INTERRUPT, execution-context=INTERRUPT-CAT-2
    PWGA_CH58_ISR: is-reentrant=false, call-type=INTERRUPT, execution-context=INTERRUPT-CAT-1
    PWGA_CH58_CAT2_ISR: is-reentrant=false, call-type=INTERRUPT, execution-context=INTERRUPT-CAT-2
    PWGA_CH59_ISR: is-reentrant=false, call-type=INTERRUPT, execution-context=INTERRUPT-CAT-1
    PWGA_CH59_CAT2_ISR: is-reentrant=false, call-type=INTERRUPT, execution-context=INTERRUPT-CAT-2
    PWGA_CH60_ISR: is-reentrant=false, call-type=INTERRUPT, execution-context=INTERRUPT-CAT-1
    PWGA_CH60_CAT2_ISR: is-reentrant=false, call-type=INTERRUPT, execution-context=INTERRUPT-CAT-2
    PWGA_CH61_ISR: is-reentrant=false, call-type=INTERRUPT, execution-context=INTERRUPT-CAT-1
    PWGA_CH61_CAT2_ISR: is-reentrant=false, call-type=INTERRUPT, execution-context=INTERRUPT-CAT-2
    PWGA_CH62_ISR: is-reentrant=false, call-type=INTERRUPT, execution-context=INTERRUPT-CAT-1
    PWGA_CH62_CAT2_ISR: is-reentrant=false, call-type=INTERRUPT, execution-context=INTERRUPT-CAT-2
    PWGA_CH63_ISR: is-reentrant=false, call-type=INTERRUPT, execution-context=INTERRUPT-CAT-1
    PWGA_CH63_CAT2_ISR: is-reentrant=false, call-type=INTERRUPT, execution-context=INTERRUPT-CAT-2
    PWGA_CH64_ISR: is-reentrant=false, call-type=INTERRUPT, execution-context=INTERRUPT-CAT-1
    PWGA_CH64_CAT2_ISR: is-reentrant=false, call-type=INTERRUPT, execution-context=INTERRUPT-CAT-2
    PWGA_CH65_ISR: is-reentrant=false, call-type=INTERRUPT, execution-context=INTERRUPT-CAT-1
    PWGA_CH65_CAT2_ISR: is-reentrant=false, call-type=INTERRUPT, execution-context=INTERRUPT-CAT-2
    PWGA_CH66_ISR: is-reentrant=false, call-type=INTERRUPT, execution-context=INTERRUPT-CAT-1
    PWGA_CH66_CAT2_ISR: is-reentrant=false, call-type=INTERRUPT, execution-context=INTERRUPT-CAT-2
    PWGA_CH67_ISR: is-reentrant=false, call-type=INTERRUPT, execution-context=INTERRUPT-CAT-1
    PWGA_CH67_CAT2_ISR: is-reentrant=false, call-type=INTERRUPT, execution-context=INTERRUPT-CAT-2
    PWGA_CH68_ISR: is-reentrant=false, call-type=INTERRUPT, execution-context=INTERRUPT-CAT-1
    PWGA_CH68_CAT2_ISR: is-reentrant=false, call-type=INTERRUPT, execution-context=INTERRUPT-CAT-2
    PWGA_CH69_ISR: is-reentrant=false, call-type=INTERRUPT, execution-context=INTERRUPT-CAT-1
    PWGA_CH69_CAT2_ISR: is-reentrant=false, call-type=INTERRUPT, execution-context=INTERRUPT-CAT-2
    PWGA_CH70_ISR: is-reentrant=false, call-type=INTERRUPT, execution-context=INTERRUPT-CAT-1
    PWGA_CH70_CAT2_ISR: is-reentrant=false, call-type=INTERRUPT, execution-context=INTERRUPT-CAT-2
    PWGA_CH71_ISR: is-reentrant=false, call-type=INTERRUPT, execution-context=INTERRUPT-CAT-1
    PWGA_CH71_CAT2_ISR: is-reentrant=false, call-type=INTERRUPT, execution-context=INTERRUPT-CAT-2
    PWM_INTPWGAG00_ISR: is-reentrant=false, call-type=INTERRUPT, execution-context=INTERRUPT-CAT-1
    PWGA_CHGRP00_CAT2_ISR: is-reentrant=false, call-type=INTERRUPT, execution-context=INTERRUPT-CAT-2
    PWM_INTPWGAG01_ISR: is-reentrant=false, call-type=INTERRUPT, execution-context=INTERRUPT-CAT-1
    PWGA_CHGRP01_CAT2_ISR: is-reentrant=false, call-type=INTERRUPT, execution-context=INTERRUPT-CAT-2
    PWM_INTPWGAG02_ISR: is-reentrant=false, call-type=INTERRUPT, execution-context=INTERRUPT-CAT-1
    PWGA_CHGRP02_CAT2_ISR: is-reentrant=false, call-type=INTERRUPT, execution-context=INTERRUPT-CAT-2
    Pwm_Init: service-id=0, is-reentrant=false, call-type=REGULAR, execution-context=TASK
    Pwm_DeInit: service-id=1, is-reentrant=false, call-type=REGULAR, execution-context=TASK
    Pwm_SetDutyCycle: service-id=2, is-reentrant=true, call-type=REGULAR, execution-context=TASK
    Pwm_SetPeriodAndDuty: service-id=3, is-reentrant=true, call-type=REGULAR, execution-context=TASK
    Pwm_SetOutputToIdle: service-id=4, is-reentrant=true, call-type=REGULAR, execution-context=TASK
    Pwm_GetOutputState: service-id=5, is-reentrant=true, call-type=REGULAR, execution-context=TASK
    Pwm_DisableNotification: service-id=6, is-reentrant=true, call-type=REGULAR, execution-context=TASK
    Pwm_EnableNotification: service-id=7, is-reentrant=true, call-type=REGULAR, execution-context=TASK
    Pwm_GetVersionInfo: service-id=8, is-reentrant=true, call-type=REGULAR, execution-context=TASK
    Pwm_SelectChannelClk: service-id=9, is-reentrant=true, call-type=REGULAR, execution-context=TASK
    Pwm_SetTriggerDelay: service-id=10, is-reentrant=true, call-type=REGULAR, execution-context=TASK
    Pwm_SetChannelOutput: service-id=11, is-reentrant=true, call-type=REGULAR, execution-context=TASK
    Pwm_SynchronousInit: service-id=12, is-reentrant=true, call-type=REGULAR, execution-context=TASK
    Pwm_SynchronousStart: service-id=13, is-reentrant=true, call-type=REGULAR, execution-context=TASK
    Pwm_SynchronousStop: service-id=14, is-reentrant=true, call-type=REGULAR, execution-context=TASK
    Pwm_CheckHWConsistency: service-id=15, is-reentrant=true, call-type=REGULAR, execution-context=TASK
    Pwm_ControlTriggerOutput: service-id=16, is-reentrant=true, call-type=REGULAR, execution-context=TASK
