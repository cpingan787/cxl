AUTOSAR XML (schema 00048)
package /R7F7015833
  module config Can: implementation-config-variant=VARIANT-POST-BUILD, module-description=Can_Impl
    CanConfigSet0 (CanConfigSet)
      CanController:
        CanBusoffProcessing = INTERRUPT
        CanControllerActivation = true
        CanControllerBaseAddress = 0
        CanControllerId = 0
        CanRxProcessing = INTERRUPT
        CanTxProcessing = INTERRUPT
        CanWakeupFunctionalityAPI = false
        CanWakeupProcessing = INTERRUPT
        CanWakeupSupport = false
        CanControllerDefaultBaudrate = CanControllerBaudrateConfig
        CanCpuClockRef = McuClockReferencePoint0
        CanControllerBaudrateConfig:
          CanControllerBaudRate = 500
          CanControllerBaudRateConfigID = 0
          CanControllerPropSeg = 1
          CanControllerSeg1 = 23
          CanControllerSeg2 = 8
          CanControllerSyncJumpWidth = 1
          CanControllerFdBaudrateConfig:
            CanControllerFdBaudRate = 2000
            CanControllerPropSeg = 1
            CanControllerSeg1 = 5
            CanControllerSeg2 = 2
            CanControllerSyncJumpWidth = 1
            CanControllerTxBitRateSwitch = true
      4 x CanHardwareObject, all with CanHandleType=BASIC, CanHwObjectCount=16, CanIdType=STANDARD, CanFdPaddingValue=0, CanControllerRef=CanController:
        CanHardwareObject_Rx0: CanObjectId=0, CanObjectType=RECEIVE
          CanHwFilter: CanHwFilterCode=0, CanHwFilterMask=0
        CanHardwareObject_Rx1: CanObjectId=1, CanObjectType=RECEIVE
          CanHwFilter: CanHwFilterCode=0, CanHwFilterMask=0
        CanHardwareObject_Tx0: CanObjectId=2, CanObjectType=TRANSMIT, CanMainFunctionRWPeriodRef=CanMainFunctionRWPeriods
        CanHardwareObject_Tx1: CanObjectId=3, CanObjectType=TRANSMIT, CanMainFunctionRWPeriodRef=CanMainFunctionRWPeriods
    Can (CanGeneral):
      CanDevErrorDetection = true
      CanIndex = 0
      CanMainFunctionModePeriod = 1.0
      CanMultiplexedTransmission = false
      CanPublicIcomSupport = false
      CanTimeoutDuration = 10.0
      CanVersionInfoApi = true
      CanLPduReceiveCalloutFunction = 
      CanMainFunctionBusoffPeriod = 1.0
      CanMainFunctionWakeupPeriod = 2.0
      CanSetBaudrateApi = true
      CanSupportTTCANRef = CanIfPrivateCfg
      CanOsCounterRef = (unset)
      CanMainFunctionRWPeriods: CanMainFunctionPeriod=1
