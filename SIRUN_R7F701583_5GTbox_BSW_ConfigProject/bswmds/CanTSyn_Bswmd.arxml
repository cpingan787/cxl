AUTOSAR XML (schema 00048)
package /AUTOSAR/BswOverviews
  bsw module description CanTSyn: category=BSW_MODULE, implemented-entrys=CanTSyn_MainFunction, module-id=161
    bsw internal behavior CanTSynBehavior
      exclusive area Context
      bsw schedulable entity CanTSyn_MainFunction: implemented-entry=CanTSyn_MainFunction
      bsw timing event TimingEvent_MainFunction: starts-on-event=CanTSyn_MainFunction, period=0.01
      bsw distinguished partition CanTSyn
package /AUTOSAR/BswImplementations
  bsw implementation CanTSynImplementation: programming-language=C, sw-version=1.0.0, vendor-id=62, ar-release-version=1.0.0, behavior=CanTSynBehavior
package /AUTOSAR/BswInterfaces
  bsw module entry CanTSyn_MainFunction: service-id=6, is-synchronous=true, call-type=SCHEDULED, execution-context=TASK, sw-service-impl-policy=STANDARD
