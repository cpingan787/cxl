AUTOSAR XML (schema 00048)
package /R7F7015833
  module config CryIf
    CryIfGeneral: CryIfDevErrorDetect=true, CryIfVersionInfoApi=false, CryIfMulDriverSupport=false
    CryIfChannel_0 (CryIfChannel): CryIfChannelId=0, CryptoDriverInterfaceName=CAMC, CryIfDriverObjectRef=CryptoDriverObject_CMCA
    CryIfKey_SecOCKey (CryIfKey): CryIfKeyId=0, CryIfKeyRef=CryptoKey_SecOC_CMAC
    CryIfIncludes
      CryIfInclude_0 (CryIfInclude): IncludeName=Crypto_ISoft
