AUTOSAR XML (schema 4-2-2)
# COPYRIGHT
# Copyright(c) 2016-2021 Renesas Electronics Corporation
package /Renesas/ModuleDescription_Lin
  bsw implementation Lin_Impl: programming-language=C, sw-version=1.1.8, vendor-id=59, ar-release-version=4.2.2, behavior=BswInternalBehavior_0, vendor-specific-module-def=Lin
    code-descriptors:
      code Lin_Code: artifact-descriptors=[{short-label=Lin.c, category=SWSRC}, {short-label=Lin.h, category=SWHDR}]
    resource consumption ResourceConsumption
      7 x memory section:
        VAR_NO_INIT_UNSPECIFIED: sw-addrmethod=VAR
        VAR_INIT_BOOLEAN: sw-addrmethod=VAR
        CONST_UNSPECIFIED: sw-addrmethod=CONST
        CONFIG_DATA_UNSPECIFIED: sw-addrmethod=CONFIG_DATA
        CODE: sw-addrmethod=CODE
        CODE_FAST: sw-addrmethod=CODE
        CALLOUT_CODE: sw-addrmethod=CODE
  bsw module description Lin: module-id=82
    provided-entrys:
      Lin_Init
      Lin_SendFrame
      Lin_Wakeup
      Lin_GetVersionInfo
      Lin_CheckWakeup
      Lin_GoToSleep
      Lin_GoToSleepInternal
      Lin_GetStatus
      Lin_SelfTest
      Lin_DeInitSelfTest
      Lin_CheckHWConsistency
      Lin_WakeupInternal
      LIN_CHANNEL{00..23}_ISR
      LIN_CHANNEL{00..23}_CAT2_ISR
    bsw internal behavior BswInternalBehavior_0
      exclusive area LIN_RAM_DATA_PROTECTION
      exclusive area LIN_REGISTER_PROTECTION
      48 x bsw interrupt entity, all with can-enter-exclusive-area=LIN_REGISTER_PROTECTION:
        BswInterruptEntity_0: implemented-entry=LIN_CHANNEL00_ISR, interrupt-category=CAT-1, interrupt-source=INTRLIN20
        BswInterruptEntity_1: implemented-entry=LIN_CHANNEL01_ISR, interrupt-category=CAT-1, interrupt-source=INTRLIN21
        BswInterruptEntity_2: implemented-entry=LIN_CHANNEL02_ISR, interrupt-category=CAT-1, interrupt-source=INTRLIN22
        BswInterruptEntity_3: implemented-entry=LIN_CHANNEL03_ISR, interrupt-category=CAT-1, interrupt-source=INTRLIN23
        BswInterruptEntity_4: implemented-entry=LIN_CHANNEL04_ISR, interrupt-category=CAT-1, interrupt-source=INTRLIN24
        BswInterruptEntity_5: implemented-entry=LIN_CHANNEL05_ISR, interrupt-category=CAT-1, interrupt-source=INTRLIN25
        BswInterruptEntity_6: implemented-entry=LIN_CHANNEL06_ISR, interrupt-category=CAT-1, interrupt-source=INTRLIN26
        BswInterruptEntity_7: implemented-entry=LIN_CHANNEL07_ISR, interrupt-category=CAT-1, interrupt-source=INTRLIN27
        BswInterruptEntity_8: implemented-entry=LIN_CHANNEL08_ISR, interrupt-category=CAT-1, interrupt-source=INTRLIN28
        BswInterruptEntity_9: implemented-entry=LIN_CHANNEL09_ISR, interrupt-category=CAT-1, interrupt-source=INTRLIN29
        BswInterruptEntity_10: implemented-entry=LIN_CHANNEL10_ISR, interrupt-category=CAT-1, interrupt-source=INTRLIN210
        BswInterruptEntity_11: implemented-entry=LIN_CHANNEL11_ISR, interrupt-category=CAT-1, interrupt-source=INTRLIN211
        BswInterruptEntity_12: implemented-entry=LIN_CHANNEL12_ISR, interrupt-category=CAT-1, interrupt-source=INTRLIN212
        BswInterruptEntity_13: implemented-entry=LIN_CHANNEL13_ISR, interrupt-category=CAT-1, interrupt-source=INTRLIN213
        BswInterruptEntity_14: implemented-entry=LIN_CHANNEL14_ISR, interrupt-category=CAT-1, interrupt-source=INTRLIN214
        BswInterruptEntity_15: implemented-entry=LIN_CHANNEL15_ISR, interrupt-category=CAT-1, interrupt-source=INTRLIN215
        BswInterruptEntity_16: implemented-entry=LIN_CHANNEL16_ISR, interrupt-category=CAT-1, interrupt-source=INTRLIN30
        BswInterruptEntity_17: implemented-entry=LIN_CHANNEL17_ISR, interrupt-category=CAT-1, interrupt-source=INTRLIN31
        BswInterruptEntity_18: implemented-entry=LIN_CHANNEL18_ISR, interrupt-category=CAT-1, interrupt-source=INTRLIN32
        BswInterruptEntity_19: implemented-entry=LIN_CHANNEL19_ISR, interrupt-category=CAT-1, interrupt-source=INTRLIN33
        BswInterruptEntity_20: implemented-entry=LIN_CHANNEL20_ISR, interrupt-category=CAT-1, interrupt-source=INTRLIN34
        BswInterruptEntity_21: implemented-entry=LIN_CHANNEL21_ISR, interrupt-category=CAT-1, interrupt-source=INTRLIN35
        BswInterruptEntity_22: implemented-entry=LIN_CHANNEL22_ISR, interrupt-category=CAT-1, interrupt-source=INTRLIN36
        BswInterruptEntity_23: implemented-entry=LIN_CHANNEL23_ISR, interrupt-category=CAT-1, interrupt-source=INTRLIN37
        BswInterruptEntity_24: implemented-entry=LIN_CHANNEL00_CAT2_ISR, interrupt-category=CAT-2, interrupt-source=INTRLIN20
        BswInterruptEntity_25: implemented-entry=LIN_CHANNEL01_CAT2_ISR, interrupt-category=CAT-2, interrupt-source=INTRLIN21
        BswInterruptEntity_26: implemented-entry=LIN_CHANNEL02_CAT2_ISR, interrupt-category=CAT-2, interrupt-source=INTRLIN22
        BswInterruptEntity_27: implemented-entry=LIN_CHANNEL03_CAT2_ISR, interrupt-category=CAT-2, interrupt-source=INTRLIN23
        BswInterruptEntity_28: implemented-entry=LIN_CHANNEL04_CAT2_ISR, interrupt-category=CAT-2, interrupt-source=INTRLIN24
        BswInterruptEntity_29: implemented-entry=LIN_CHANNEL05_CAT2_ISR, interrupt-category=CAT-2, interrupt-source=INTRLIN25
        BswInterruptEntity_30: implemented-entry=LIN_CHANNEL06_CAT2_ISR, interrupt-category=CAT-2, interrupt-source=INTRLIN26
        BswInterruptEntity_31: implemented-entry=LIN_CHANNEL07_CAT2_ISR, interrupt-category=CAT-2, interrupt-source=INTRLIN27
        BswInterruptEntity_32: implemented-entry=LIN_CHANNEL08_CAT2_ISR, interrupt-category=CAT-2, interrupt-source=INTRLIN28
        BswInterruptEntity_33: implemented-entry=LIN_CHANNEL09_CAT2_ISR, interrupt-category=CAT-2, interrupt-source=INTRLIN29
        BswInterruptEntity_34: implemented-entry=LIN_CHANNEL10_CAT2_ISR, interrupt-category=CAT-2, interrupt-source=INTRLIN210
        BswInterruptEntity_35: implemented-entry=LIN_CHANNEL11_CAT2_ISR, interrupt-category=CAT-2, interrupt-source=INTRLIN211
        BswInterruptEntity_36: implemented-entry=LIN_CHANNEL12_CAT2_ISR, interrupt-category=CAT-2, interrupt-source=INTRLIN212
        BswInterruptEntity_37: implemented-entry=LIN_CHANNEL13_CAT2_ISR, interrupt-category=CAT-2, interrupt-source=INTRLIN213
        BswInterruptEntity_38: implemented-entry=LIN_CHANNEL14_CAT2_ISR, interrupt-category=CAT-2, interrupt-source=INTRLIN214
        BswInterruptEntity_39: implemented-entry=LIN_CHANNEL15_CAT2_ISR, interrupt-category=CAT-2, interrupt-source=INTRLIN215
        BswInterruptEntity_40: implemented-entry=LIN_CHANNEL16_CAT2_ISR, interrupt-category=CAT-2, interrupt-source=INTRLIN30
        BswInterruptEntity_41: implemented-entry=LIN_CHANNEL17_CAT2_ISR, interrupt-category=CAT-2, interrupt-source=INTRLIN31
        BswInterruptEntity_42: implemented-entry=LIN_CHANNEL18_CAT2_ISR, interrupt-category=CAT-2, interrupt-source=INTRLIN32
        BswInterruptEntity_43: implemented-entry=LIN_CHANNEL19_CAT2_ISR, interrupt-category=CAT-2, interrupt-source=INTRLIN33
        BswInterruptEntity_44: implemented-entry=LIN_CHANNEL20_CAT2_ISR, interrupt-category=CAT-2, interrupt-source=INTRLIN34
        BswInterruptEntity_45: implemented-entry=LIN_CHANNEL21_CAT2_ISR, interrupt-category=CAT-2, interrupt-source=INTRLIN35
        BswInterruptEntity_46: implemented-entry=LIN_CHANNEL22_CAT2_ISR, interrupt-category=CAT-2, interrupt-source=INTRLIN36
        BswInterruptEntity_47: implemented-entry=LIN_CHANNEL23_CAT2_ISR, interrupt-category=CAT-2, interrupt-source=INTRLIN37
      12 x bsw called entity:
        BswCalledEntity_0: implemented-entry=Lin_Init
        BswCalledEntity_1: can-enter-exclusive-area=[LIN_RAM_DATA_PROTECTION, LIN_REGISTER_PROTECTION], implemented-entry=Lin_SendFrame
        BswCalledEntity_2: can-enter-exclusive-area=LIN_REGISTER_PROTECTION, implemented-entry=Lin_Wakeup
        BswCalledEntity_3: can-enter-exclusive-area=LIN_REGISTER_PROTECTION, implemented-entry=Lin_CheckWakeup
        BswCalledEntity_4: can-enter-exclusive-area=LIN_RAM_DATA_PROTECTION, implemented-entry=Lin_GoToSleep
        BswCalledEntity_5: can-enter-exclusive-area=LIN_RAM_DATA_PROTECTION, implemented-entry=Lin_GetStatus
        BswCalledEntity_6: can-enter-exclusive-area=LIN_REGISTER_PROTECTION, implemented-entry=Lin_GoToSleepInternal
        BswCalledEntity_7: implemented-entry=Lin_GetVersionInfo
        BswCalledEntity_8: can-enter-exclusive-area=[LIN_REGISTER_PROTECTION, LIN_RAM_DATA_PROTECTION], implemented-entry=Lin_SelfTest
        BswCalledEntity_9: can-enter-exclusive-area=LIN_REGISTER_PROTECTION, implemented-entry=Lin_DeInitSelfTest
        BswCalledEntity_10: can-enter-exclusive-area=LIN_REGISTER_PROTECTION, implemented-entry=Lin_CheckHWConsistency
        BswCalledEntity_11: can-enter-exclusive-area=LIN_REGISTER_PROTECTION, implemented-entry=Lin_WakeupInternal
  60 x bsw module entry, all with is-reentrant=false, sw-service-impl-policy=STANDARD:
    LIN_CHANNEL{00..23}_ISR: is-synchronous=true, call-type=INTERRUPT, execution-context=INTERRUPT-CAT-1
    LIN_CHANNEL{00..23}_CAT2_ISR: is-synchronous=true, call-type=INTERRUPT, execution-context=INTERRUPT-CAT-2
    Lin_Init: service-id=0, is-synchronous=true, call-type=REGULAR, execution-context=TASK
    Lin_GetVersionInfo: service-id=1, is-synchronous=true, call-type=REGULAR, execution-context=TASK
    Lin_SendFrame: service-id=4, is-synchronous=false, call-type=REGULAR, execution-context=TASK
    Lin_GoToSleep: service-id=6, is-synchronous=false, call-type=REGULAR, execution-context=TASK
    Lin_Wakeup: service-id=7, is-synchronous=false, call-type=REGULAR, execution-context=TASK
    Lin_GetStatus: service-id=8, is-synchronous=true, call-type=REGULAR, execution-context=TASK
    Lin_GoToSleepInternal: service-id=9, is-synchronous=true, call-type=REGULAR, execution-context=TASK
    Lin_CheckWakeup: service-id=10, is-synchronous=true, call-type=REGULAR, execution-context=TASK
    Lin_WakeupInternal: service-id=11, is-synchronous=true, call-type=REGULAR, execution-context=TASK
    Lin_DeInitSelfTest: service-id=12, is-synchronous=true, call-type=REGULAR, execution-context=TASK
    Lin_CheckHWConsistency: service-id=13, is-synchronous=true, call-type=REGULAR, execution-context=TASK
    Lin_SelfTest: service-id=14, is-synchronous=true, call-type=REGULAR, execution-context=TASK
