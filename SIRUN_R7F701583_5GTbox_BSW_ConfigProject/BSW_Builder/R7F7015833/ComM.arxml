AUTOSAR XML (schema 00048)
package /R7F7015833
  module config ComM
    ComMGeneral:
      ComMDevErrorDetect = false
      ComMEcuGroupClassification = 3
      ComMModeLimitationEnabled = false
      ComMPncSupport = false
      ComMResetAfterForcingNoComm = false
      ComMSynchronousWakeUp = false
      ComMVersionInfoApi = false
      ComMWakeupInhibitionEnabled = false
      ComMMultiplePartitionEnabled = false
      ComMDirectUserMapping = true
    ComMConfigSet
      ComMChannel_0 (ComMChannel):
        ComMBusType = COMM_BUS_TYPE_CAN
        ComMChannelId = ComMChannel_0
        ComMFullCommRequestNotificationEnabled = false
        ComMMainFunctionPeriod = 0.01
        ComMNoCom = false
        ComMNoWakeup = false
        ComMNoWakeUpInhibitionNvmStorage = false
        ComMNetworkManagement: ComMNmVariant=FULL, ComMPncNmRequest=false
        ComMUserPerChannel_0 (ComMUserPerChannel): ComMUserChannel=ComMUser_0
      ComMUser_0 (ComMUser): ComMUserIdentifier=ComMUser_0
