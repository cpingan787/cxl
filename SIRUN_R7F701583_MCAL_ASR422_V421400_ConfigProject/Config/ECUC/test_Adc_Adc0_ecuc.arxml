AUTOSAR XML (schema 00049)
package /Renesas/EcucDefs_Adc
  module config Adc0: definition=Adc, implementation-config-variant=VARIANT-POST-BUILD, module-description=Adc_Impl
    AdcPublished0 (AdcPublishedInformation): AdcChannelValueSigned=false, AdcGroupFirstChannelFixed=false, AdcMaxChannelResolution=12, AdcDmaTypeUsed=ADC_DMA_TYPE_TWO
    AdcDemEventParameterRefs0 (AdcDemEventParameterRefs): ADC_E_QUEUE_FULL=DemEventParameter0, ADC_E_LOOP_TIMEOUT=DemEventParameter1, ADC_E_REG_WRITE_VERIFY=DemEventParameter2
    AdcGeneral:
      AdcVersionCheckExternalModules = true
      AdcDeInitApi = true
      AdcDevErrorDetect = false
      AdcDemErrorDetect = true
      AdcEnableLimitCheck = false
      AdcEnableTrackHold = false
      AdcEnableQueuing = true
      AdcEnableStartStopGroupApi = true
      AdcGrpNotifCapability = true
      AdcHwTriggerApi = true
      AdcPriorityImplementation = ADC_PRIORITY_NONE
      AdcReadGroupApi = true
      AdcGetStreamLastPointerApi = true
      AdcDmaMode = false
      AdcCriticalSectionProtection = true
      AdcResultAlignment = ADC_ALIGN_RIGHT
      AdcDeviceName = R7F701583
      AdcVersionInfoApi = true
      AdcSoftStop = true
      AdcPwmDiagnosticSupport = false
      AdcPwmDiagDoubleBuff = false
      AdcExternalMuxSupport = false
      AdcEnableDisableChSupport = true
      AdcAlreadyInitDetCheck = true
      AdcEnableBufferAllocation = false
      AdcHwUnitVirtualChannel = ADC_50_36
      AdcEnableStreaming = false
      AdcFunctionalityMode = ADC_INTERRUPT_MODE
      AdcFlexibleThreshold = false
      AdcPwsaQueFullIrqCallback = Adc_FullIrqCallback
      AdcEnableSelfDiag = false
      AdcWakeUpFactorClearIsr = false
      AdcAdcaWriteVerify = WV_INIT_RUNTIME
      AdcPwmDiagWriteVerify = WV_DISABLE
      AdcDmacWriteVerify = WV_DISABLE
      AdcWufWriteVerify = WV_DISABLE
      AdcAdcaRAMMirror = ENABLE
      AdcPwmDiagRAMMirror = DISABLE
      AdcDmacRAMMirror = DISABLE
      AdcUseWriteVerifyErrorInterface = false
      AdcWriteVerifyErrorInterface = Adc_WVErrInterface
      AdcLoopTimeOut = 65535
      AdcEnableClkImmediateValue = false
      AdcSelfDiagDelayClkSrc = (unset)
    AdcConfigSet0 (AdcConfigSet)
      AdcHwUnit0 (AdcHwUnit):
        AdcClockSource = NOT_USED
        AdcHwUnitId = ADC_HWUNIT_0
        AdcPrescale = 0
        AdcHwUnitResolution = ADC_12_BIT
        AdcSamplingTime = ADC_SAMPLING_12H
        AdcSuspendMode = ADC_SYNCHRONOUS_SUSPEND
        AdcMaxNoOfDiagRunTime = 1
        AdcPwmDiagProtLength = 0
        AdcEnableOverWriteInterrupt = false
        AdcEnableLimitCheckInterrupt = false
        AdcErrorNotification = NULL
        AdcHwScanGroup0 (AdcHwScanGroup): AdcSgQueueSize=1, AdcSgProcessingMode=ADC_INTERRUPT_MODE, AdcSgId=2, AdcSgDmaChannel=DMA00, AdcSgDmaChannel2=DMA00
        5 x AdcChannel, all with AdcChannelConvTime=0, AdcChannelHighLimit=4095, AdcChannelLimitCheck=false, AdcChannelTrackHold=ADC_TH_DISABLED, AdcChannelLowLimit=0, AdcChannelRangeSelect=ADC_RANGE_ALWAYS, AdcChannelRefVoltsrcHigh=NOT_USED, AdcChannelRefVoltsrcLow=NOT_USED, AdcChannelResolution=1, AdcChannelSampTime=0, AdcExtMuxDelayCounter=0, AdcSelectDiagCh=false, AdcSelfDiagChSel=false, AdcEnablePullDown=false:
          AdcChannel{0..4}: AdcChannelId={0..4}
        AdcGroup0 (AdcGroup):
          AdcGroupAccessMode = ADC_ACCESS_MODE_SINGLE
          AdcGroupConversionMode = ADC_CONV_MODE_CONTINUOUS
          AdcGroupId = 0
          AdcScanGroup = 2
          AdcGroupPriority = 4
          AdcGroupReplacement = ADC_GROUP_REPL_ABORT_RESTART
          AdcGroupTriggSrc = ADC_TRIGG_SRC_SW
          AdcHwTrigSignal = ADC_HW_TRIG_BOTH_EDGES
          AdcHwTrigTimer = 0
          AdcNotification = IoHwAb_Adc_Notification_Group0
          AdcStreamingBufferMode = ADC_STREAM_BUFFER_LINEAR
          AdcStreamingNumSamples = 1
          AdcResultAccessMode = ADC_ISR_ACCESS
          AdcPwmDiagnosticGroup = false
          AdcSelfDiagMode = ADC_SELF_DIAG_OFF
          AdcSelfDiagVolLevSel = SEL0
          AdcGroupDefinition = AdcHwUnit0/AdcChannel{0..7}
          AdcGroupDefinition = AdcChannel{8..15}
        AdcGroup2 (AdcGroup):
          AdcGroupAccessMode = ADC_ACCESS_MODE_SINGLE
          AdcGroupConversionMode = ADC_CONV_MODE_CONTINUOUS
          AdcGroupId = 2
          AdcScanGroup = 2
          AdcGroupPriority = 11
          AdcGroupReplacement = ADC_GROUP_REPL_ABORT_RESTART
          AdcGroupTriggSrc = ADC_TRIGG_SRC_SW
          AdcHwTrigSignal = ADC_HW_TRIG_BOTH_EDGES
          AdcHwTrigTimer = 0
          AdcNotification = IoHwAb_Adc_Notification_Group2
          AdcStreamingBufferMode = ADC_STREAM_BUFFER_LINEAR
          AdcStreamingNumSamples = 1
          AdcResultAccessMode = ADC_ISR_ACCESS
          AdcPwmDiagnosticGroup = false
          AdcSelfDiagMode = ADC_SELF_DIAG_OFF
          AdcSelfDiagVolLevSel = SEL0
          AdcGroupDefinition = AdcHwUnit0/AdcChannel{0..3}
          AdcGroupHwTriggerSource = AdcHwTriggerConfig0
          AdcGroupDefinition = AdcHwUnit0/AdcChannel4
        AdcHwTriggerConfig0 (AdcHwTriggerConfig): AdcHwTrigger=ADCATTIN100
        AdcHwTriggerConfig1 (AdcHwTriggerConfig): AdcHwTrigger=DIAG_CH00
        11 x AdcChannel, all with AdcChannelConvTime=0, AdcChannelHighLimit=4095, AdcChannelLimitCheck=false, AdcChannelTrackHold=ADC_TH_DISABLED, AdcChannelLowLimit=0, AdcChannelRangeSelect=ADC_RANGE_ALWAYS, AdcChannelRefVoltsrcHigh=NOT_USED, AdcChannelRefVoltsrcLow=NOT_USED, AdcChannelResolution=1, AdcChannelSampTime=0, AdcExtMuxDelayCounter=0, AdcSelectDiagCh=false, AdcSelfDiagChSel=false, AdcEnablePullDown=false:
          AdcChannel{5..15}: AdcChannelId={5..15}
      AdcHwUnit1 (AdcHwUnit):
        AdcClockSource = NOT_USED
        AdcHwUnitId = ADC_HWUNIT_1
        AdcPrescale = 0
        AdcHwUnitResolution = ADC_12_BIT
        AdcSamplingTime = ADC_SAMPLING_12H
        AdcSuspendMode = ADC_SYNCHRONOUS_SUSPEND
        AdcMaxNoOfDiagRunTime = 0
        AdcPwmDiagProtLength = 0
        AdcEnableOverWriteInterrupt = false
        AdcEnableLimitCheckInterrupt = false
        AdcErrorNotification = NULL
        AdcHwScanGroup0 (AdcHwScanGroup): AdcSgQueueSize=0, AdcSgProcessingMode=ADC_INTERRUPT_MODE, AdcSgId=2, AdcSgDmaChannel=DMA00, AdcSgDmaChannel2=DMA00
        AdcChannel0 (AdcChannel):
          AdcChannelConvTime = 0
          AdcChannelHighLimit = 4095
          AdcChannelId = 0
          AdcChannelLimitCheck = false
          AdcChannelTrackHold = ADC_TH_DISABLED
          AdcChannelLowLimit = 0
          AdcChannelRangeSelect = ADC_RANGE_ALWAYS
          AdcChannelRefVoltsrcHigh = NOT_USED
          AdcChannelRefVoltsrcLow = NOT_USED
          AdcChannelResolution = 1
          AdcChannelSampTime = 0
          AdcExtMuxDelayCounter = 0
          AdcSelectDiagCh = false
          AdcSelfDiagChSel = false
          AdcEnablePullDown = false
        AdcGroup1 (AdcGroup):
          AdcGroupAccessMode = ADC_ACCESS_MODE_SINGLE
          AdcGroupConversionMode = ADC_CONV_MODE_CONTINUOUS
          AdcGroupId = 1
          AdcScanGroup = 2
          AdcGroupPriority = 10
          AdcGroupReplacement = ADC_GROUP_REPL_ABORT_RESTART
          AdcGroupTriggSrc = ADC_TRIGG_SRC_SW
          AdcHwTrigSignal = ADC_HW_TRIG_BOTH_EDGES
          AdcHwTrigTimer = 0
          AdcNotification = IoHwAb_Adc_Notification_Group1
          AdcStreamingBufferMode = ADC_STREAM_BUFFER_LINEAR
          AdcStreamingNumSamples = 1
          AdcResultAccessMode = ADC_ISR_ACCESS
          AdcPwmDiagnosticGroup = false
          AdcSelfDiagMode = ADC_SELF_DIAG_OFF
          AdcSelfDiagVolLevSel = SEL0
          AdcGroupDefinition = AdcHwUnit1/AdcChannel{0..7}
        7 x AdcChannel, all with AdcChannelConvTime=0, AdcChannelHighLimit=4095, AdcChannelLimitCheck=false, AdcChannelTrackHold=ADC_TH_DISABLED, AdcChannelLowLimit=0, AdcChannelRangeSelect=ADC_RANGE_ALWAYS, AdcChannelRefVoltsrcHigh=NOT_USED, AdcChannelRefVoltsrcLow=NOT_USED, AdcChannelResolution=1, AdcChannelSampTime=0, AdcExtMuxDelayCounter=0, AdcSelectDiagCh=false, AdcSelfDiagChSel=false, AdcEnablePullDown=false:
          AdcChannel{1..7}: AdcChannelId={1..7}
