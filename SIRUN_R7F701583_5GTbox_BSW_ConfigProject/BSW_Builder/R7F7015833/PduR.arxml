AUTOSAR XML (schema 00048)
package /R7F7015833
  module config PduR
    PduRGeneral:
      PduRConfigType = PC_CONFIG
      PduRDevErrorDetect = false
      PduRMetaDataSupport = false
      PduRVersionInfoApi = false
      PduRZeroCostOperation = false
      PduRMultiplePartitionEnabled = false
    PduRRoutingPaths: PduRConfigurationId=0, PduRMaxRoutingPathCnt=255, PduRMaxRoutingPathGroupCnt=0, PduRMaxRoutingTableCnt=1
      PDUR_ROUTING_DIAG_DTCInfo_IAM_CONTROLLER_0_IAM_Tx (PduRRoutingPath):
        PduRRouteType = IF
        PduRDestPduRRef = PduRDestPdu_DIAG_DTCInfo_IAM_CONTROLLER_0_IAM_Tx
        PduRSrcPduRRef = PduRSrcPdu_DIAG_DTCInfo_IAM_CONTROLLER_0_IAM_Tx
      PduRSrcPdu_DIAG_DTCInfo_IAM_CONTROLLER_0_IAM_Tx (PduRSrcPdu):
        PduRSourcePduHandleId = PDUR_SRCPDU_COM_DIAG_DTCInfo_IAM_CONTROLLER_0_IAM_Tx
        PduRSrcPduUpTxConf = true
        PduRSrcPduRef = COM_DIAG_DTCInfo_IAM_CONTROLLER_0_IAM_Tx
      PduRDestPdu_DIAG_DTCInfo_IAM_CONTROLLER_0_IAM_Tx (PduRDestPdu):
        PduRDestPduDataProvision = PDUR_DIRECT
        PduRDestPduHandleId = PDUR_DESTPDU_CANIF_DIAG_DTCInfo_IAM_CONTROLLER_0_IAM_Tx
        PduRTransmissionConfirmation = true
        PduRDestPduRef = CANIF_DIAG_DTCInfo_IAM_CONTROLLER_0_IAM_Tx
      PDUR_ROUTING_IAM_BKPCANFD_1000ms_FrP60_CONTROLLER_0_IAM_Tx (PduRRoutingPath):
        PduRRouteType = IF
        PduRDestPduRRef = PduRDestPdu_IAM_BKPCANFD_1000ms_FrP60_CONTROLLER_0_IAM_Tx
        PduRSrcPduRRef = PduRSrcPdu_IAM_BKPCANFD_1000ms_FrP60_CONTROLLER_0_IAM_Tx
      PduRSrcPdu_IAM_BKPCANFD_1000ms_FrP60_CONTROLLER_0_IAM_Tx (PduRSrcPdu):
        PduRSourcePduHandleId = PDUR_SRCPDU_COM_IAM_BKPCANFD_1000ms_FrP60_CONTROLLER_0_IAM_Tx
        PduRSrcPduUpTxConf = true
        PduRSrcPduRef = COM_IAM_BKPCANFD_1000ms_FrP60_CONTROLLER_0_IAM_Tx
      PduRDestPdu_IAM_BKPCANFD_1000ms_FrP60_CONTROLLER_0_IAM_Tx (PduRDestPdu):
        PduRDestPduDataProvision = PDUR_DIRECT
        PduRDestPduHandleId = PDUR_DESTPDU_CANIF_IAM_BKPCANFD_1000ms_FrP60_CONTROLLER_0_IAM_Tx
        PduRTransmissionConfirmation = true
        PduRDestPduRef = CANIF_IAM_BKPCANFD_1000ms_FrP60_CONTROLLER_0_IAM_Tx
      PDUR_ROUTING_IAM_BKPCANFD_1000ms_FrP61_CONTROLLER_0_IAM_Tx (PduRRoutingPath):
        PduRRouteType = IF
        PduRDestPduRRef = PduRDestPdu_IAM_BKPCANFD_1000ms_FrP61_CONTROLLER_0_IAM_Tx
        PduRSrcPduRRef = PduRSrcPdu_IAM_BKPCANFD_1000ms_FrP61_CONTROLLER_0_IAM_Tx
      PduRSrcPdu_IAM_BKPCANFD_1000ms_FrP61_CONTROLLER_0_IAM_Tx (PduRSrcPdu):
        PduRSourcePduHandleId = PDUR_SRCPDU_COM_IAM_BKPCANFD_1000ms_FrP61_CONTROLLER_0_IAM_Tx
        PduRSrcPduUpTxConf = true
        PduRSrcPduRef = COM_IAM_BKPCANFD_1000ms_FrP61_CONTROLLER_0_IAM_Tx
      PduRDestPdu_IAM_BKPCANFD_1000ms_FrP61_CONTROLLER_0_IAM_Tx (PduRDestPdu):
        PduRDestPduDataProvision = PDUR_DIRECT
        PduRDestPduHandleId = PDUR_DESTPDU_CANIF_IAM_BKPCANFD_1000ms_FrP61_CONTROLLER_0_IAM_Tx
        PduRTransmissionConfirmation = true
        PduRDestPduRef = CANIF_IAM_BKPCANFD_1000ms_FrP61_CONTROLLER_0_IAM_Tx
      PDUR_ROUTING_IAM_BKPCANFD_1000ms_FrP62_CONTROLLER_0_IAM_Tx (PduRRoutingPath):
        PduRRouteType = IF
        PduRDestPduRRef = PduRDestPdu_IAM_BKPCANFD_1000ms_FrP62_CONTROLLER_0_IAM_Tx
        PduRSrcPduRRef = PduRSrcPdu_IAM_BKPCANFD_1000ms_FrP62_CONTROLLER_0_IAM_Tx
      PduRSrcPdu_IAM_BKPCANFD_1000ms_FrP62_CONTROLLER_0_IAM_Tx (PduRSrcPdu):
        PduRSourcePduHandleId = PDUR_SRCPDU_COM_IAM_BKPCANFD_1000ms_FrP62_CONTROLLER_0_IAM_Tx
        PduRSrcPduUpTxConf = true
        PduRSrcPduRef = COM_IAM_BKPCANFD_1000ms_FrP62_CONTROLLER_0_IAM_Tx
      PduRDestPdu_IAM_BKPCANFD_1000ms_FrP62_CONTROLLER_0_IAM_Tx (PduRDestPdu):
        PduRDestPduDataProvision = PDUR_DIRECT
        PduRDestPduHandleId = PDUR_DESTPDU_CANIF_IAM_BKPCANFD_1000ms_FrP62_CONTROLLER_0_IAM_Tx
        PduRTransmissionConfirmation = true
        PduRDestPduRef = CANIF_IAM_BKPCANFD_1000ms_FrP62_CONTROLLER_0_IAM_Tx
      PDUR_ROUTING_IAM_BKPCANFD_1000ms_FrP63_CONTROLLER_0_IAM_Tx (PduRRoutingPath):
        PduRRouteType = IF
        PduRDestPduRRef = PduRDestPdu_IAM_BKPCANFD_1000ms_FrP63_CONTROLLER_0_IAM_Tx
        PduRSrcPduRRef = PduRSrcPdu_IAM_BKPCANFD_1000ms_FrP63_CONTROLLER_0_IAM_Tx
      PduRSrcPdu_IAM_BKPCANFD_1000ms_FrP63_CONTROLLER_0_IAM_Tx (PduRSrcPdu):
        PduRSourcePduHandleId = PDUR_SRCPDU_COM_IAM_BKPCANFD_1000ms_FrP63_CONTROLLER_0_IAM_Tx
        PduRSrcPduUpTxConf = true
        PduRSrcPduRef = COM_IAM_BKPCANFD_1000ms_FrP63_CONTROLLER_0_IAM_Tx
      PduRDestPdu_IAM_BKPCANFD_1000ms_FrP63_CONTROLLER_0_IAM_Tx (PduRDestPdu):
        PduRDestPduDataProvision = PDUR_DIRECT
        PduRDestPduHandleId = PDUR_DESTPDU_CANIF_IAM_BKPCANFD_1000ms_FrP63_CONTROLLER_0_IAM_Tx
        PduRTransmissionConfirmation = true
        PduRDestPduRef = CANIF_IAM_BKPCANFD_1000ms_FrP63_CONTROLLER_0_IAM_Tx
      PDUR_ROUTING_IAM_BKPCANFD_1000ms_FrP64_CONTROLLER_0_IAM_Tx (PduRRoutingPath):
        PduRRouteType = IF
        PduRDestPduRRef = PduRDestPdu_IAM_BKPCANFD_1000ms_FrP64_CONTROLLER_0_IAM_Tx
        PduRSrcPduRRef = PduRSrcPdu_IAM_BKPCANFD_1000ms_FrP64_CONTROLLER_0_IAM_Tx
      PduRSrcPdu_IAM_BKPCANFD_1000ms_FrP64_CONTROLLER_0_IAM_Tx (PduRSrcPdu):
        PduRSourcePduHandleId = PDUR_SRCPDU_COM_IAM_BKPCANFD_1000ms_FrP64_CONTROLLER_0_IAM_Tx
        PduRSrcPduUpTxConf = true
        PduRSrcPduRef = COM_IAM_BKPCANFD_1000ms_FrP64_CONTROLLER_0_IAM_Tx
      PduRDestPdu_IAM_BKPCANFD_1000ms_FrP64_CONTROLLER_0_IAM_Tx (PduRDestPdu):
        PduRDestPduDataProvision = PDUR_DIRECT
        PduRDestPduHandleId = PDUR_DESTPDU_CANIF_IAM_BKPCANFD_1000ms_FrP64_CONTROLLER_0_IAM_Tx
        PduRTransmissionConfirmation = true
        PduRDestPduRef = CANIF_IAM_BKPCANFD_1000ms_FrP64_CONTROLLER_0_IAM_Tx
      PDUR_ROUTING_IAM_BKPCANFD_1000ms_FrP65_CONTROLLER_0_IAM_Tx (PduRRoutingPath):
        PduRRouteType = IF
        PduRDestPduRRef = PduRDestPdu_IAM_BKPCANFD_1000ms_FrP65_CONTROLLER_0_IAM_Tx
        PduRSrcPduRRef = PduRSrcPdu_IAM_BKPCANFD_1000ms_FrP65_CONTROLLER_0_IAM_Tx
      PduRSrcPdu_IAM_BKPCANFD_1000ms_FrP65_CONTROLLER_0_IAM_Tx (PduRSrcPdu):
        PduRSourcePduHandleId = PDUR_SRCPDU_COM_IAM_BKPCANFD_1000ms_FrP65_CONTROLLER_0_IAM_Tx
        PduRSrcPduUpTxConf = true
        PduRSrcPduRef = COM_IAM_BKPCANFD_1000ms_FrP65_CONTROLLER_0_IAM_Tx
      PduRDestPdu_IAM_BKPCANFD_1000ms_FrP65_CONTROLLER_0_IAM_Tx (PduRDestPdu):
        PduRDestPduDataProvision = PDUR_DIRECT
        PduRDestPduHandleId = PDUR_DESTPDU_CANIF_IAM_BKPCANFD_1000ms_FrP65_CONTROLLER_0_IAM_Tx
        PduRTransmissionConfirmation = true
        PduRDestPduRef = CANIF_IAM_BKPCANFD_1000ms_FrP65_CONTROLLER_0_IAM_Tx
      PDUR_ROUTING_IAM_BKPCANFD_1000ms_FrP66_CONTROLLER_0_IAM_Tx (PduRRoutingPath):
        PduRRouteType = IF
        PduRDestPduRRef = PduRDestPdu_IAM_BKPCANFD_1000ms_FrP66_CONTROLLER_0_IAM_Tx
        PduRSrcPduRRef = PduRSrcPdu_IAM_BKPCANFD_1000ms_FrP66_CONTROLLER_0_IAM_Tx
      PduRSrcPdu_IAM_BKPCANFD_1000ms_FrP66_CONTROLLER_0_IAM_Tx (PduRSrcPdu):
        PduRSourcePduHandleId = PDUR_SRCPDU_COM_IAM_BKPCANFD_1000ms_FrP66_CONTROLLER_0_IAM_Tx
        PduRSrcPduUpTxConf = true
        PduRSrcPduRef = COM_IAM_BKPCANFD_1000ms_FrP66_CONTROLLER_0_IAM_Tx
      PduRDestPdu_IAM_BKPCANFD_1000ms_FrP66_CONTROLLER_0_IAM_Tx (PduRDestPdu):
        PduRDestPduDataProvision = PDUR_DIRECT
        PduRDestPduHandleId = PDUR_DESTPDU_CANIF_IAM_BKPCANFD_1000ms_FrP66_CONTROLLER_0_IAM_Tx
        PduRTransmissionConfirmation = true
        PduRDestPduRef = CANIF_IAM_BKPCANFD_1000ms_FrP66_CONTROLLER_0_IAM_Tx
      PDUR_ROUTING_IAM_CONNCAN_100ms_FrP18_CONTROLLER_0_IAM_Tx (PduRRoutingPath):
        PduRRouteType = IF
        PduRDestPduRRef = PduRDestPdu_IAM_CONNCAN_100ms_FrP18_CONTROLLER_0_IAM_Tx
        PduRSrcPduRRef = PduRSrcPdu_IAM_CONNCAN_100ms_FrP18_CONTROLLER_0_IAM_Tx
      PduRSrcPdu_IAM_CONNCAN_100ms_FrP18_CONTROLLER_0_IAM_Tx (PduRSrcPdu):
        PduRSourcePduHandleId = PDUR_SRCPDU_COM_IAM_CONNCAN_100ms_FrP18_CONTROLLER_0_IAM_Tx
        PduRSrcPduUpTxConf = true
        PduRSrcPduRef = COM_IAM_CONNCAN_100ms_FrP18_CONTROLLER_0_IAM_Tx
      PduRDestPdu_IAM_CONNCAN_100ms_FrP18_CONTROLLER_0_IAM_Tx (PduRDestPdu):
        PduRDestPduDataProvision = PDUR_DIRECT
        PduRDestPduHandleId = PDUR_DESTPDU_CANIF_IAM_CONNCAN_100ms_FrP18_CONTROLLER_0_IAM_Tx
        PduRTransmissionConfirmation = true
        PduRDestPduRef = CANIF_IAM_CONNCAN_100ms_FrP18_CONTROLLER_0_IAM_Tx
      PDUR_ROUTING_IAM_CONNCAN_200ms_FrP01_CONTROLLER_0_IAM_Tx (PduRRoutingPath):
        PduRRouteType = IF
        PduRDestPduRRef = PduRDestPdu_IAM_CONNCAN_200ms_FrP01_CONTROLLER_0_IAM_Tx
        PduRSrcPduRRef = PduRSrcPdu_IAM_CONNCAN_200ms_FrP01_CONTROLLER_0_IAM_Tx
      PduRSrcPdu_IAM_CONNCAN_200ms_FrP01_CONTROLLER_0_IAM_Tx (PduRSrcPdu):
        PduRSourcePduHandleId = PDUR_SRCPDU_COM_IAM_CONNCAN_200ms_FrP01_CONTROLLER_0_IAM_Tx
        PduRSrcPduUpTxConf = true
        PduRSrcPduRef = COM_IAM_CONNCAN_200ms_FrP01_CONTROLLER_0_IAM_Tx
      PduRDestPdu_IAM_CONNCAN_200ms_FrP01_CONTROLLER_0_IAM_Tx (PduRDestPdu):
        PduRDestPduDataProvision = PDUR_DIRECT
        PduRDestPduHandleId = PDUR_DESTPDU_CANIF_IAM_CONNCAN_200ms_FrP01_CONTROLLER_0_IAM_Tx
        PduRTransmissionConfirmation = true
        PduRDestPduRef = CANIF_IAM_CONNCAN_200ms_FrP01_CONTROLLER_0_IAM_Tx
      PDUR_ROUTING_IAM_CONNCAN_200ms_FrP02_CONTROLLER_0_IAM_Tx (PduRRoutingPath):
        PduRRouteType = IF
        PduRDestPduRRef = PduRDestPdu_IAM_CONNCAN_200ms_FrP02_CONTROLLER_0_IAM_Tx
        PduRSrcPduRRef = PduRSrcPdu_IAM_CONNCAN_200ms_FrP02_CONTROLLER_0_IAM_Tx
      PduRSrcPdu_IAM_CONNCAN_200ms_FrP02_CONTROLLER_0_IAM_Tx (PduRSrcPdu):
        PduRSourcePduHandleId = PDUR_SRCPDU_COM_IAM_CONNCAN_200ms_FrP02_CONTROLLER_0_IAM_Tx
        PduRSrcPduUpTxConf = true
        PduRSrcPduRef = COM_IAM_CONNCAN_200ms_FrP02_CONTROLLER_0_IAM_Tx
      PduRDestPdu_IAM_CONNCAN_200ms_FrP02_CONTROLLER_0_IAM_Tx (PduRDestPdu):
        PduRDestPduDataProvision = PDUR_DIRECT
        PduRDestPduHandleId = PDUR_DESTPDU_CANIF_IAM_CONNCAN_200ms_FrP02_CONTROLLER_0_IAM_Tx
        PduRTransmissionConfirmation = true
        PduRDestPduRef = CANIF_IAM_CONNCAN_200ms_FrP02_CONTROLLER_0_IAM_Tx
      PDUR_ROUTING_IAM_CONNCAN_Event_FrS20_CONTROLLER_0_IAM_Tx (PduRRoutingPath):
        PduRRouteType = IF
        PduRDestPduRRef = PduRDestPdu_IAM_CONNCAN_Event_FrS20_CONTROLLER_0_IAM_Tx
        PduRSrcPduRRef = PduRSrcPdu_IAM_CONNCAN_Event_FrS20_CONTROLLER_0_IAM_Tx
      PduRSrcPdu_IAM_CONNCAN_Event_FrS20_CONTROLLER_0_IAM_Tx (PduRSrcPdu):
        PduRSourcePduHandleId = PDUR_SRCPDU_COM_IAM_CONNCAN_Event_FrS20_CONTROLLER_0_IAM_Tx
        PduRSrcPduUpTxConf = true
        PduRSrcPduRef = COM_IAM_CONNCAN_Event_FrS20_CONTROLLER_0_IAM_Tx
      PduRDestPdu_IAM_CONNCAN_Event_FrS20_CONTROLLER_0_IAM_Tx (PduRDestPdu):
        PduRDestPduDataProvision = PDUR_DIRECT
        PduRDestPduHandleId = PDUR_DESTPDU_CANIF_IAM_CONNCAN_Event_FrS20_CONTROLLER_0_IAM_Tx
        PduRTransmissionConfirmation = true
        PduRDestPduRef = CANIF_IAM_CONNCAN_Event_FrS20_CONTROLLER_0_IAM_Tx
      PDUR_ROUTING_IAM_CONNCAN_Event_FrS21_CONTROLLER_0_IAM_Tx (PduRRoutingPath):
        PduRRouteType = IF
        PduRDestPduRRef = PduRDestPdu_IAM_CONNCAN_Event_FrS21_CONTROLLER_0_IAM_Tx
        PduRSrcPduRRef = PduRSrcPdu_IAM_CONNCAN_Event_FrS21_CONTROLLER_0_IAM_Tx
      PduRSrcPdu_IAM_CONNCAN_Event_FrS21_CONTROLLER_0_IAM_Tx (PduRSrcPdu):
        PduRSourcePduHandleId = PDUR_SRCPDU_COM_IAM_CONNCAN_Event_FrS21_CONTROLLER_0_IAM_Tx
        PduRSrcPduUpTxConf = true
        PduRSrcPduRef = COM_IAM_CONNCAN_Event_FrS21_CONTROLLER_0_IAM_Tx
      PduRDestPdu_IAM_CONNCAN_Event_FrS21_CONTROLLER_0_IAM_Tx (PduRDestPdu):
        PduRDestPduDataProvision = PDUR_DIRECT
        PduRDestPduHandleId = PDUR_DESTPDU_CANIF_IAM_CONNCAN_Event_FrS21_CONTROLLER_0_IAM_Tx
        PduRTransmissionConfirmation = true
        PduRDestPduRef = CANIF_IAM_CONNCAN_Event_FrS21_CONTROLLER_0_IAM_Tx
      PDUR_ROUTING_IAM_CONNCANFD_100ms_FrP19_CONTROLLER_0_IAM_Tx (PduRRoutingPath):
        PduRRouteType = IF
        PduRDestPduRRef = PduRDestPdu_IAM_CONNCANFD_100ms_FrP19_CONTROLLER_0_IAM_Tx
        PduRSrcPduRRef = PduRSrcPdu_IAM_CONNCANFD_100ms_FrP19_CONTROLLER_0_IAM_Tx
      PduRSrcPdu_IAM_CONNCANFD_100ms_FrP19_CONTROLLER_0_IAM_Tx (PduRSrcPdu):
        PduRSourcePduHandleId = PDUR_SRCPDU_COM_IAM_CONNCANFD_100ms_FrP19_CONTROLLER_0_IAM_Tx
        PduRSrcPduUpTxConf = true
        PduRSrcPduRef = COM_IAM_CONNCANFD_100ms_FrP19_CONTROLLER_0_IAM_Tx
      PduRDestPdu_IAM_CONNCANFD_100ms_FrP19_CONTROLLER_0_IAM_Tx (PduRDestPdu):
        PduRDestPduDataProvision = PDUR_DIRECT
        PduRDestPduHandleId = PDUR_DESTPDU_CANIF_IAM_CONNCANFD_100ms_FrP19_CONTROLLER_0_IAM_Tx
        PduRTransmissionConfirmation = true
        PduRDestPduRef = CANIF_IAM_CONNCANFD_100ms_FrP19_CONTROLLER_0_IAM_Tx
      PDUR_ROUTING_IAM_CONNCANFD_Event_FrS04_CONTROLLER_0_IAM_Tx (PduRRoutingPath):
        PduRRouteType = IF
        PduRDestPduRRef = PduRDestPdu_IAM_CONNCANFD_Event_FrS04_CONTROLLER_0_IAM_Tx
        PduRSrcPduRRef = PduRSrcPdu_IAM_CONNCANFD_Event_FrS04_CONTROLLER_0_IAM_Tx
      PduRSrcPdu_IAM_CONNCANFD_Event_FrS04_CONTROLLER_0_IAM_Tx (PduRSrcPdu):
        PduRSourcePduHandleId = PDUR_SRCPDU_COM_IAM_CONNCANFD_Event_FrS04_CONTROLLER_0_IAM_Tx
        PduRSrcPduUpTxConf = true
        PduRSrcPduRef = COM_IAM_CONNCANFD_Event_FrS04_CONTROLLER_0_IAM_Tx
      PduRDestPdu_IAM_CONNCANFD_Event_FrS04_CONTROLLER_0_IAM_Tx (PduRDestPdu):
        PduRDestPduDataProvision = PDUR_DIRECT
        PduRDestPduHandleId = PDUR_DESTPDU_CANIF_IAM_CONNCANFD_Event_FrS04_CONTROLLER_0_IAM_Tx
        PduRTransmissionConfirmation = true
        PduRDestPduRef = CANIF_IAM_CONNCANFD_Event_FrS04_CONTROLLER_0_IAM_Tx
      PDUR_ROUTING_IAM_CONNCANFD_Event_FrS42_CONTROLLER_0_IAM_Tx (PduRRoutingPath):
        PduRRouteType = IF
        PduRDestPduRRef = PduRDestPdu_IAM_CONNCANFD_Event_FrS42_CONTROLLER_0_IAM_Tx
        PduRSrcPduRRef = PduRSrcPdu_IAM_CONNCANFD_Event_FrS42_CONTROLLER_0_IAM_Tx
      PduRSrcPdu_IAM_CONNCANFD_Event_FrS42_CONTROLLER_0_IAM_Tx (PduRSrcPdu):
        PduRSourcePduHandleId = PDUR_SRCPDU_COM_IAM_CONNCANFD_Event_FrS42_CONTROLLER_0_IAM_Tx
        PduRSrcPduUpTxConf = true
        PduRSrcPduRef = COM_IAM_CONNCANFD_Event_FrS42_CONTROLLER_0_IAM_Tx
      PduRDestPdu_IAM_CONNCANFD_Event_FrS42_CONTROLLER_0_IAM_Tx (PduRDestPdu):
        PduRDestPduDataProvision = PDUR_DIRECT
        PduRDestPduHandleId = PDUR_DESTPDU_CANIF_IAM_CONNCANFD_Event_FrS42_CONTROLLER_0_IAM_Tx
        PduRTransmissionConfirmation = true
        PduRDestPduRef = CANIF_IAM_CONNCANFD_Event_FrS42_CONTROLLER_0_IAM_Tx
      PDUR_ROUTING_IAM_CONNCANFD_Event_FrS43_CONTROLLER_0_IAM_Tx (PduRRoutingPath):
        PduRRouteType = IF
        PduRDestPduRRef = PduRDestPdu_IAM_CONNCANFD_Event_FrS43_CONTROLLER_0_IAM_Tx
        PduRSrcPduRRef = PduRSrcPdu_IAM_CONNCANFD_Event_FrS43_CONTROLLER_0_IAM_Tx
      PduRSrcPdu_IAM_CONNCANFD_Event_FrS43_CONTROLLER_0_IAM_Tx (PduRSrcPdu):
        PduRSourcePduHandleId = PDUR_SRCPDU_COM_IAM_CONNCANFD_Event_FrS43_CONTROLLER_0_IAM_Tx
        PduRSrcPduUpTxConf = true
        PduRSrcPduRef = COM_IAM_CONNCANFD_Event_FrS43_CONTROLLER_0_IAM_Tx
      PduRDestPdu_IAM_CONNCANFD_Event_FrS43_CONTROLLER_0_IAM_Tx (PduRDestPdu):
        PduRDestPduDataProvision = PDUR_DIRECT
        PduRDestPduHandleId = PDUR_DESTPDU_CANIF_IAM_CONNCANFD_Event_FrS43_CONTROLLER_0_IAM_Tx
        PduRTransmissionConfirmation = true
        PduRDestPduRef = CANIF_IAM_CONNCANFD_Event_FrS43_CONTROLLER_0_IAM_Tx
      PDUR_ROUTING_IAM_CONNCANFD_Event_FrS44_CONTROLLER_0_IAM_Tx (PduRRoutingPath):
        PduRRouteType = IF
        PduRDestPduRRef = PduRDestPdu_IAM_CONNCANFD_Event_FrS44_CONTROLLER_0_IAM_Tx
        PduRSrcPduRRef = PduRSrcPdu_IAM_CONNCANFD_Event_FrS44_CONTROLLER_0_IAM_Tx
      PduRSrcPdu_IAM_CONNCANFD_Event_FrS44_CONTROLLER_0_IAM_Tx (PduRSrcPdu):
        PduRSourcePduHandleId = PDUR_SRCPDU_COM_IAM_CONNCANFD_Event_FrS44_CONTROLLER_0_IAM_Tx
        PduRSrcPduUpTxConf = true
        PduRSrcPduRef = COM_IAM_CONNCANFD_Event_FrS44_CONTROLLER_0_IAM_Tx
      PduRDestPdu_IAM_CONNCANFD_Event_FrS44_CONTROLLER_0_IAM_Tx (PduRDestPdu):
        PduRDestPduDataProvision = PDUR_DIRECT
        PduRDestPduHandleId = PDUR_DESTPDU_CANIF_IAM_CONNCANFD_Event_FrS44_CONTROLLER_0_IAM_Tx
        PduRTransmissionConfirmation = true
        PduRDestPduRef = CANIF_IAM_CONNCANFD_Event_FrS44_CONTROLLER_0_IAM_Tx
      PDUR_ROUTING_IAM_CONNCANFD_EvtInfo_CONTROLLER_0_IAM_Tx (PduRRoutingPath):
        PduRRouteType = IF
        PduRDestPduRRef = PduRDestPdu_IAM_CONNCANFD_EvtInfo_CONTROLLER_0_IAM_Tx
        PduRSrcPduRRef = PduRSrcPdu_IAM_CONNCANFD_EvtInfo_CONTROLLER_0_IAM_Tx
      PduRSrcPdu_IAM_CONNCANFD_EvtInfo_CONTROLLER_0_IAM_Tx (PduRSrcPdu):
        PduRSourcePduHandleId = PDUR_SRCPDU_COM_IAM_CONNCANFD_EvtInfo_CONTROLLER_0_IAM_Tx
        PduRSrcPduUpTxConf = true
        PduRSrcPduRef = COM_IAM_CONNCANFD_EvtInfo_CONTROLLER_0_IAM_Tx
      PduRDestPdu_IAM_CONNCANFD_EvtInfo_CONTROLLER_0_IAM_Tx (PduRDestPdu):
        PduRDestPduDataProvision = PDUR_DIRECT
        PduRDestPduHandleId = PDUR_DESTPDU_CANIF_IAM_CONNCANFD_EvtInfo_CONTROLLER_0_IAM_Tx
        PduRTransmissionConfirmation = true
        PduRDestPduRef = CANIF_IAM_CONNCANFD_EvtInfo_CONTROLLER_0_IAM_Tx
      PduRSrcPdu_COM_0x98_synthesized_IAM_ComKeyResp_CONTROLLER_0_IAM_Tx (PduRSrcPdu):
        PduRSourcePduHandleId = PDUR_SRCPDU_COM_IAM_SecOC_ComKeyResp_CONTROLLER_0_IAM_Tx
        PduRSrcPduUpTxConf = true
        PduRSrcPduRef = COM_IAM_SecOC_ComKeyResp_CONTROLLER_0_IAM_Tx
      PsduRDestPdu_CANIF_0x98_synthesized_IAM_ComKeyResp_CONTROLLER_0_IAM_Tx (PduRDestPdu):
        PduRDestPduDataProvision = PDUR_DIRECT
        PduRDestPduHandleId = PDUR_DESTPDU_CANIF_IAM_SecOC_ComKeyResp_CONTROLLER_0_IAM_Tx
        PduRTransmissionConfirmation = true
        PduRDestPduRef = CANIF_IAM_SecOC_ComKeyResp_CONTROLLER_0_IAM_Tx
      PDUR_ROUTING_IAM_SecOC_Log_CONTROLLER_0_IAM_Tx (PduRRoutingPath): PduRRouteType=IF, PduRDestPduRRef=PduRDestPdu_IAM_SecOC_Log_CONTROLLER_0_IAM_Tx, PduRSrcPduRRef=PduRSrcPdu_IAM_SecOC_Log_CONTROLLER_0_IAM_Tx
      PduRSrcPdu_IAM_SecOC_Log_CONTROLLER_0_IAM_Tx (PduRSrcPdu):
        PduRSourcePduHandleId = PDUR_SRCPDU_COM_IAM_SecOC_Log_CONTROLLER_0_IAM_Tx
        PduRSrcPduUpTxConf = true
        PduRSrcPduRef = COM_IAM_SecOC_Log_CONTROLLER_0_IAM_Tx
      PduRDestPdu_IAM_SecOC_Log_CONTROLLER_0_IAM_Tx (PduRDestPdu):
        PduRDestPduDataProvision = PDUR_DIRECT
        PduRDestPduHandleId = PDUR_DESTPDU_CANIF_IAM_SecOC_Log_CONTROLLER_0_IAM_Tx
        PduRTransmissionConfirmation = true
        PduRDestPduRef = CANIF_IAM_SecOC_Log_CONTROLLER_0_IAM_Tx
      PDUR_ROUTING_IAM_ZONE_CONNCANFD_100ms_FrP56_CONTROLLER_0_IAM_Tx (PduRRoutingPath):
        PduRRouteType = IF
        PduRDestPduRRef = PduRDestPdu_IAM_ZONE_CONNCANFD_100ms_FrP56_CONTROLLER_0_IAM_Tx
        PduRSrcPduRRef = PduRSrcPdu_IAM_ZONE_CONNCANFD_100ms_FrP56_CONTROLLER_0_IAM_Tx
      PduRSrcPdu_IAM_ZONE_CONNCANFD_100ms_FrP56_CONTROLLER_0_IAM_Tx (PduRSrcPdu):
        PduRSourcePduHandleId = PDUR_SRCPDU_COM_IAM_ZONE_CONNCANFD_100ms_FrP56_CONTROLLER_0_IAM_Tx
        PduRSrcPduUpTxConf = true
        PduRSrcPduRef = COM_IAM_ZONE_CONNCANFD_100ms_FrP56_CONTROLLER_0_IAM_Tx
      PduRDestPdu_IAM_ZONE_CONNCANFD_100ms_FrP56_CONTROLLER_0_IAM_Tx (PduRDestPdu):
        PduRDestPduDataProvision = PDUR_DIRECT
        PduRDestPduHandleId = PDUR_DESTPDU_CANIF_IAM_ZONE_CONNCANFD_100ms_FrP56_CONTROLLER_0_IAM_Tx
        PduRTransmissionConfirmation = true
        PduRDestPduRef = CANIF_IAM_ZONE_CONNCANFD_100ms_FrP56_CONTROLLER_0_IAM_Tx
      PDUR_ROUTING_TBOX_CONNCAN_20ms_FrP02_CONTROLLER_0_IAM_Tx (PduRRoutingPath):
        PduRRouteType = IF
        PduRDestPduRRef = PduRDestPdu_TBOX_CONNCAN_20ms_FrP02_CONTROLLER_0_IAM_Tx
        PduRSrcPduRRef = PduRSrcPdu_TBOX_CONNCAN_20ms_FrP02_CONTROLLER_0_IAM_Tx
      PduRSrcPdu_TBOX_CONNCAN_20ms_FrP02_CONTROLLER_0_IAM_Tx (PduRSrcPdu):
        PduRSourcePduHandleId = PDUR_SRCPDU_COM_TBOX_CONNCAN_20ms_FrP02_CONTROLLER_0_IAM_Tx
        PduRSrcPduUpTxConf = true
        PduRSrcPduRef = COM_TBOX_CONNCAN_20ms_FrP02_CONTROLLER_0_IAM_Tx
      PduRDestPdu_TBOX_CONNCAN_20ms_FrP02_CONTROLLER_0_IAM_Tx (PduRDestPdu):
        PduRDestPduDataProvision = PDUR_DIRECT
        PduRDestPduHandleId = PDUR_DESTPDU_CANIF_TBOX_CONNCAN_20ms_FrP02_CONTROLLER_0_IAM_Tx
        PduRTransmissionConfirmation = true
        PduRDestPduRef = CANIF_TBOX_CONNCAN_20ms_FrP02_CONTROLLER_0_IAM_Tx
      PDUR_ROUTING_IAM_BKPCANFD_1000ms_FrP49_CONTROLLER_0_IAM_Tx (PduRRoutingPath):
        PduRRouteType = IF
        PduRDestPduRRef = PduRDestPdu_IAM_BKPCANFD_1000ms_FrP49_CONTROLLER_0_IAM_Tx
        PduRSrcPduRRef = PduRSrcPdu_IAM_BKPCANFD_1000ms_FrP49_CONTROLLER_0_IAM_Tx
      PduRSrcPdu_IAM_BKPCANFD_1000ms_FrP49_CONTROLLER_0_IAM_Tx (PduRSrcPdu):
        PduRSourcePduHandleId = PDUR_SRCPDU_COM_IAM_BKPCANFD_1000ms_FrP49_CONTROLLER_0_IAM_Tx
        PduRSrcPduUpTxConf = true
        PduRSrcPduRef = COM_IAM_BKPCANFD_1000ms_FrP49_CONTROLLER_0_IAM_Tx
      PduRDestPdu_IAM_BKPCANFD_1000ms_FrP49_CONTROLLER_0_IAM_Tx (PduRDestPdu):
        PduRDestPduDataProvision = PDUR_DIRECT
        PduRDestPduHandleId = PDUR_DESTPDU_CANIF_IAM_BKPCANFD_1000ms_FrP49_CONTROLLER_0_IAM_Tx
        PduRTransmissionConfirmation = true
        PduRDestPduRef = CANIF_IAM_BKPCANFD_1000ms_FrP49_CONTROLLER_0_IAM_Tx
      PDUR_ROUTING_IAM_BKPCANFD_1000ms_FrP55_CONTROLLER_0_IAM_Tx (PduRRoutingPath):
        PduRRouteType = IF
        PduRDestPduRRef = PduRDestPdu_IAM_BKPCANFD_1000ms_FrP55_CONTROLLER_0_IAM_Tx
        PduRSrcPduRRef = PduRSrcPdu_IAM_BKPCANFD_1000ms_FrP55_CONTROLLER_0_IAM_Tx
      PduRSrcPdu_IAM_BKPCANFD_1000ms_FrP55_CONTROLLER_0_IAM_Tx (PduRSrcPdu):
        PduRSourcePduHandleId = PDUR_SRCPDU_COM_IAM_BKPCANFD_1000ms_FrP55_CONTROLLER_0_IAM_Tx
        PduRSrcPduUpTxConf = true
        PduRSrcPduRef = COM_IAM_BKPCANFD_1000ms_FrP55_CONTROLLER_0_IAM_Tx
      PduRDestPdu_IAM_BKPCANFD_1000ms_FrP55_CONTROLLER_0_IAM_Tx (PduRDestPdu):
        PduRDestPduDataProvision = PDUR_DIRECT
        PduRDestPduHandleId = PDUR_DESTPDU_CANIF_IAM_BKPCANFD_1000ms_FrP55_CONTROLLER_0_IAM_Tx
        PduRTransmissionConfirmation = true
        PduRDestPduRef = CANIF_IAM_BKPCANFD_1000ms_FrP55_CONTROLLER_0_IAM_Tx
      PDUR_ROUTING_IAM_BKPCANFD_1000ms_FrP58_CONTROLLER_0_IAM_Tx (PduRRoutingPath):
        PduRRouteType = IF
        PduRDestPduRRef = PduRDestPdu_IAM_BKPCANFD_1000ms_FrP58_CONTROLLER_0_IAM_Tx
        PduRSrcPduRRef = PduRSrcPdu_IAM_BKPCANFD_1000ms_FrP58_CONTROLLER_0_IAM_Tx
      PduRSrcPdu_IAM_BKPCANFD_1000ms_FrP58_CONTROLLER_0_IAM_Tx (PduRSrcPdu):
        PduRSourcePduHandleId = PDUR_SRCPDU_COM_IAM_BKPCANFD_1000ms_FrP58_CONTROLLER_0_IAM_Tx
        PduRSrcPduUpTxConf = true
        PduRSrcPduRef = COM_IAM_BKPCANFD_1000ms_FrP58_CONTROLLER_0_IAM_Tx
      PduRDestPdu_IAM_BKPCANFD_1000ms_FrP58_CONTROLLER_0_IAM_Tx (PduRDestPdu):
        PduRDestPduDataProvision = PDUR_DIRECT
        PduRDestPduHandleId = PDUR_DESTPDU_CANIF_IAM_BKPCANFD_1000ms_FrP58_CONTROLLER_0_IAM_Tx
        PduRTransmissionConfirmation = true
        PduRDestPduRef = CANIF_IAM_BKPCANFD_1000ms_FrP58_CONTROLLER_0_IAM_Tx
      PDUR_ROUTING_IAM_BKPCANFD_1000ms_FrP59_CONTROLLER_0_IAM_Tx (PduRRoutingPath):
        PduRRouteType = IF
        PduRDestPduRRef = PduRDestPdu_IAM_BKPCANFD_1000ms_FrP59_CONTROLLER_0_IAM_Tx
        PduRSrcPduRRef = PduRSrcPdu_IAM_BKPCANFD_1000ms_FrP59_CONTROLLER_0_IAM_Tx
      PduRSrcPdu_IAM_BKPCANFD_1000ms_FrP59_CONTROLLER_0_IAM_Tx (PduRSrcPdu):
        PduRSourcePduHandleId = PDUR_SRCPDU_COM_IAM_BKPCANFD_1000ms_FrP59_CONTROLLER_0_IAM_Tx
        PduRSrcPduUpTxConf = true
        PduRSrcPduRef = COM_IAM_BKPCANFD_1000ms_FrP59_CONTROLLER_0_IAM_Tx
      PduRDestPdu_IAM_BKPCANFD_1000ms_FrP59_CONTROLLER_0_IAM_Tx (PduRDestPdu):
        PduRDestPduDataProvision = PDUR_DIRECT
        PduRDestPduHandleId = PDUR_DESTPDU_CANIF_IAM_BKPCANFD_1000ms_FrP59_CONTROLLER_0_IAM_Tx
        PduRTransmissionConfirmation = true
        PduRDestPduRef = CANIF_IAM_BKPCANFD_1000ms_FrP59_CONTROLLER_0_IAM_Tx
      PDUR_ROUTING_Com2Sec_synthesized_IAM_ZONE_CONNCANFD_E_0x7D_CONTROLLER_0_IAM_Tx_Authentic (PduRRoutingPath):
        PduRRouteType = IF
        PduRDestPduRRef = PsduRDestPdu_SecOC_0x7D_synthesized_IAM_ZONE_CONNCANFD_E_CONTROLLER_0_IAM_TxAuthentic
        PduRSrcPduRRef = PduRSrcPdu_COM_0x7D_synthesized_IAM_ZONE_CONNCANFD_E_CONTROLLER_0_IAM_Tx
      PduRSrcPdu_COM_0x7D_synthesized_IAM_ZONE_CONNCANFD_E_CONTROLLER_0_IAM_Tx (PduRSrcPdu):
        PduRSourcePduHandleId = PDUR_SRCPDU_COM_synthesized_IAM_ZONE_CONNCANFD_E_CONTROLLER_0_IAM_Tx
        PduRSrcPduUpTxConf = true
        PduRSrcPduRef = COM_synthesized_IAM_ZONE_CONNCANFD_E_CONTROLLER_0_IAM_Tx
      PsduRDestPdu_CANIF_0x7D_synthesized_IAM_ZONE_CONNCANFD_E_CONTROLLER_0_IAM_Tx (PduRDestPdu):
        PduRDestPduDataProvision = PDUR_DIRECT
        PduRDestPduHandleId = PDUR_DESTPDU_CANIF_synthesized_IAM_ZONE_CONNCANFD_E_CONTROLLER_0_IAM_Tx
        PduRTransmissionConfirmation = true
        PduRDestPduRef = CANIF_synthesized_IAM_ZONE_CONNCANFD_E_CONTROLLER_0_IAM_Tx
      PDUR_ROUTING_Com2Sec_synthesized_IAM_ZONE_CONNCA_0000_0x9F_CONTROLLER_0_IAM_Tx_Authentic (PduRRoutingPath):
        PduRRouteType = IF
        PduRDestPduRRef = PsduRDestPdu_SecOC_0x9F_synthesized_IAM_ZONE_CONNCA_0000_CONTROLLER_0_IAM_TxAuthentic
        PduRSrcPduRRef = PduRSrcPdu_COM_0x9F_synthesized_IAM_ZONE_CONNCA_0000_CONTROLLER_0_IAM_Tx
      PduRSrcPdu_COM_0x9F_synthesized_IAM_ZONE_CONNCA_0000_CONTROLLER_0_IAM_Tx (PduRSrcPdu):
        PduRSourcePduHandleId = PDUR_SRCPDU_COM_synthesized_IAM_ZONE_CONNCA_0000_CONTROLLER_0_IAM_Tx
        PduRSrcPduUpTxConf = true
        PduRSrcPduRef = COM_synthesized_IAM_ZONE_CONNCA_0000_CONTROLLER_0_IAM_Tx
      PsduRDestPdu_CANIF_0x9F_synthesized_IAM_ZONE_CONNCA_0000_CONTROLLER_0_IAM_Tx (PduRDestPdu):
        PduRDestPduDataProvision = PDUR_DIRECT
        PduRDestPduHandleId = PDUR_DESTPDU_CANIF_synthesized_IAM_ZONE_CONNCA_0000_CONTROLLER_0_IAM_Tx
        PduRTransmissionConfirmation = true
        PduRDestPduRef = CANIF_synthesized_IAM_ZONE_CONNCA_0000_CONTROLLER_0_IAM_Tx
      PDUR_ROUTING_Com2Sec_synthesized_IAM_ZONE_CONNCA_0001_0xB3_CONTROLLER_0_IAM_Tx_Authentic (PduRRoutingPath):
        PduRRouteType = IF
        PduRDestPduRRef = PsduRDestPdu_SecOC_0xB3_synthesized_IAM_ZONE_CONNCA_0001_CONTROLLER_0_IAM_TxAuthentic
        PduRSrcPduRRef = PduRSrcPdu_COM_0xB3_synthesized_IAM_ZONE_CONNCA_0001_CONTROLLER_0_IAM_Tx
      PduRSrcPdu_COM_0xB3_synthesized_IAM_ZONE_CONNCA_0001_CONTROLLER_0_IAM_Tx (PduRSrcPdu):
        PduRSourcePduHandleId = PDUR_SRCPDU_COM_synthesized_IAM_ZONE_CONNCA_0001_CONTROLLER_0_IAM_Tx
        PduRSrcPduUpTxConf = true
        PduRSrcPduRef = COM_synthesized_IAM_ZONE_CONNCA_0001_CONTROLLER_0_IAM_Tx
      PsduRDestPdu_CANIF_0xB3_synthesized_IAM_ZONE_CONNCA_0001_CONTROLLER_0_IAM_Tx (PduRDestPdu):
        PduRDestPduDataProvision = PDUR_DIRECT
        PduRDestPduHandleId = PDUR_DESTPDU_CANIF_synthesized_IAM_ZONE_CONNCA_0001_CONTROLLER_0_IAM_Tx
        PduRTransmissionConfirmation = true
        PduRDestPduRef = CANIF_synthesized_IAM_ZONE_CONNCA_0001_CONTROLLER_0_IAM_Tx
      PDUR_ROUTING_Com2Sec_synthesized_IAM_BKPCANFD_20ms_Fr_0x12A_CONTROLLER_0_IAM_Tx_Authentic (PduRRoutingPath):
        PduRRouteType = IF
        PduRDestPduRRef = PsduRDestPdu_SecOC_0x12A_synthesized_IAM_BKPCANFD_20ms_Fr_CONTROLLER_0_IAM_TxAuthentic
        PduRSrcPduRRef = PduRSrcPdu_COM_0x12A_synthesized_IAM_BKPCANFD_20ms_Fr_CONTROLLER_0_IAM_Tx
      PduRSrcPdu_COM_0x12A_synthesized_IAM_BKPCANFD_20ms_Fr_CONTROLLER_0_IAM_Tx (PduRSrcPdu):
        PduRSourcePduHandleId = PDUR_SRCPDU_COM_synthesized_IAM_BKPCANFD_20ms_Fr_CONTROLLER_0_IAM_Tx
        PduRSrcPduUpTxConf = true
        PduRSrcPduRef = COM_synthesized_IAM_BKPCANFD_20ms_Fr_CONTROLLER_0_IAM_Tx
      PsduRDestPdu_CANIF_0x12A_synthesized_IAM_BKPCANFD_20ms_Fr_CONTROLLER_0_IAM_Tx (PduRDestPdu):
        PduRDestPduDataProvision = PDUR_DIRECT
        PduRDestPduHandleId = PDUR_DESTPDU_CANIF_synthesized_IAM_BKPCANFD_20ms_Fr_CONTROLLER_0_IAM_Tx
        PduRTransmissionConfirmation = true
        PduRDestPduRef = CANIF_synthesized_IAM_BKPCANFD_20ms_Fr_CONTROLLER_0_IAM_Tx
      PDUR_ROUTING_Diag_CONNCANFD_PhyResp_IAM_CONTROLLER_0_IAM_Tx (PduRRoutingPath):
        PduRRouteType = TP
        PduRDestPduRRef = PduRDestPdu_Diag_CONNCANFD_PhyResp_IAM_CONTROLLER_0_IAM_Tx
        PduRSrcPduRRef = PduRSrcPdu_Diag_CONNCANFD_PhyResp_IAM_CONTROLLER_0_IAM_Tx
      PduRSrcPdu_Diag_CONNCANFD_PhyResp_IAM_CONTROLLER_0_IAM_Tx (PduRSrcPdu): PduRSourcePduHandleId=PDUR_SRCPDU_Dcm_phy_tx_0x719, PduRSrcPduUpTxConf=true, PduRSrcPduRef=Dcm_phy_tx_0x719
      PduRDestPdu_Diag_CONNCANFD_PhyResp_IAM_CONTROLLER_0_IAM_Tx (PduRDestPdu):
        PduRDestPduDataProvision = PDUR_DIRECT
        PduRDestPduHandleId = PDUR_DESTPDU_CanTp_phy_tx_0x719
        PduRTransmissionConfirmation = true
        PduRDestPduRef = CanTp_phy_tx_0x719
      PDUR_ROUTING_SDM_SFCANFD_Event_FrS14_CONTROLLER_0_IAM_Rx (PduRRoutingPath):
        PduRRouteType = IF
        PduRDestPduRRef = PduRDestPdu_SDM_SFCANFD_Event_FrS14_CONTROLLER_0_IAM_Rx
        PduRSrcPduRRef = PduRSrcPdu_SDM_SFCANFD_Event_FrS14_CONTROLLER_0_IAM_Rx
      PduRSrcPdu_SDM_SFCANFD_Event_FrS14_CONTROLLER_0_IAM_Rx (PduRSrcPdu):
        PduRSourcePduHandleId = PDUR_SRCPDU_CANIF_SDM_SFCANFD_Event_FrS14_CONTROLLER_0_IAM_Rx
        PduRSrcPduUpTxConf = true
        PduRSrcPduRef = CANIF_SDM_SFCANFD_Event_FrS14_CONTROLLER_0_IAM_Rx
      PduRDestPdu_SDM_SFCANFD_Event_FrS14_CONTROLLER_0_IAM_Rx (PduRDestPdu):
        PduRDestPduDataProvision = PDUR_DIRECT
        PduRDestPduHandleId = PDUR_DESTPDU_COM_SDM_SFCANFD_Event_FrS14_CONTROLLER_0_IAM_Rx
        PduRTransmissionConfirmation = true
        PduRDestPduRef = COM_SDM_SFCANFD_Event_FrS14_CONTROLLER_0_IAM_Rx
      PDUR_ROUTING_ICBAD_BKPCANFD_Event_FrS04_CONTROLLER_0_IAM_Rx (PduRRoutingPath):
        PduRRouteType = IF
        PduRDestPduRRef = PduRDestPdu_ICBAD_BKPCANFD_Event_FrS04_CONTROLLER_0_IAM_Rx
        PduRSrcPduRRef = PduRSrcPdu_ICBAD_BKPCANFD_Event_FrS04_CONTROLLER_0_IAM_Rx
      PduRSrcPdu_ICBAD_BKPCANFD_Event_FrS04_CONTROLLER_0_IAM_Rx (PduRSrcPdu):
        PduRSourcePduHandleId = PDUR_SRCPDU_CANIF_ICBAD_BKPCANFD_Event_FrS04_CONTROLLER_0_IAM_Rx
        PduRSrcPduUpTxConf = true
        PduRSrcPduRef = CANIF_ICBAD_BKPCANFD_Event_FrS04_CONTROLLER_0_IAM_Rx
      PduRDestPdu_ICBAD_BKPCANFD_Event_FrS04_CONTROLLER_0_IAM_Rx (PduRDestPdu):
        PduRDestPduDataProvision = PDUR_DIRECT
        PduRDestPduHandleId = PDUR_DESTPDU_COM_ICBAD_BKPCANFD_Event_FrS04_CONTROLLER_0_IAM_Rx
        PduRTransmissionConfirmation = true
        PduRDestPduRef = COM_ICBAD_BKPCANFD_Event_FrS04_CONTROLLER_0_IAM_Rx
      PDUR_ROUTING_ICBAD_BKPCANFD_Event_FrS05_CONTROLLER_0_IAM_Rx (PduRRoutingPath):
        PduRRouteType = IF
        PduRDestPduRRef = PduRDestPdu_ICBAD_BKPCANFD_Event_FrS05_CONTROLLER_0_IAM_Rx
        PduRSrcPduRRef = PduRSrcPdu_ICBAD_BKPCANFD_Event_FrS05_CONTROLLER_0_IAM_Rx
      PduRSrcPdu_ICBAD_BKPCANFD_Event_FrS05_CONTROLLER_0_IAM_Rx (PduRSrcPdu):
        PduRSourcePduHandleId = PDUR_SRCPDU_CANIF_ICBAD_BKPCANFD_Event_FrS05_CONTROLLER_0_IAM_Rx
        PduRSrcPduUpTxConf = true
        PduRSrcPduRef = CANIF_ICBAD_BKPCANFD_Event_FrS05_CONTROLLER_0_IAM_Rx
      PduRDestPdu_ICBAD_BKPCANFD_Event_FrS05_CONTROLLER_0_IAM_Rx (PduRDestPdu):
        PduRDestPduDataProvision = PDUR_DIRECT
        PduRDestPduHandleId = PDUR_DESTPDU_COM_ICBAD_BKPCANFD_Event_FrS05_CONTROLLER_0_IAM_Rx
        PduRTransmissionConfirmation = true
        PduRDestPduRef = COM_ICBAD_BKPCANFD_Event_FrS05_CONTROLLER_0_IAM_Rx
      PDUR_ROUTING_ICBVC_SecOC_ComKeyReq_CONTROLLER_0_IAM_Rx (PduRRoutingPath):
        PduRRouteType = IF
        PduRDestPduRRef = PduRDestPdu_ICBVC_SecOC_ComKeyReq_CONTROLLER_0_IAM_Rx
        PduRSrcPduRRef = PduRSrcPdu_ICBVC_SecOC_ComKeyReq_CONTROLLER_0_IAM_Rx
      PduRSrcPdu_ICBVC_SecOC_ComKeyReq_CONTROLLER_0_IAM_Rx (PduRSrcPdu):
        PduRSourcePduHandleId = PDUR_SRCPDU_CANIF_ICBVC_SecOC_ComKeyReq_CONTROLLER_0_IAM_Rx
        PduRSrcPduUpTxConf = true
        PduRSrcPduRef = CANIF_ICBVC_SecOC_ComKeyReq_CONTROLLER_0_IAM_Rx
      PduRDestPdu_ICBVC_SecOC_ComKeyReq_CONTROLLER_0_IAM_Rx (PduRDestPdu):
        PduRDestPduDataProvision = PDUR_DIRECT
        PduRDestPduHandleId = PDUR_DESTPDU_COM_ICBVC_SecOC_ComKeyReq_CONTROLLER_0_IAM_Rx
        PduRTransmissionConfirmation = true
        PduRDestPduRef = COM_ICBVC_SecOC_ComKeyReq_CONTROLLER_0_IAM_Rx
      PDUR_ROUTING_ICBAD_ZONE_CHCANFD_20ms_FrP13_CONTROLLER_0_IAM_Rx (PduRRoutingPath):
        PduRRouteType = IF
        PduRDestPduRRef = PduRDestPdu_ICBAD_ZONE_CHCANFD_20ms_FrP13_CONTROLLER_0_IAM_Rx
        PduRSrcPduRRef = PduRSrcPdu_ICBAD_ZONE_CHCANFD_20ms_FrP13_CONTROLLER_0_IAM_Rx
      PduRSrcPdu_ICBAD_ZONE_CHCANFD_20ms_FrP13_CONTROLLER_0_IAM_Rx (PduRSrcPdu):
        PduRSourcePduHandleId = PDUR_SRCPDU_CANIF_ICBAD_ZONE_CHCANFD_20ms_FrP13_CONTROLLER_0_IAM_Rx
        PduRSrcPduUpTxConf = true
        PduRSrcPduRef = CANIF_ICBAD_ZONE_CHCANFD_20ms_FrP13_CONTROLLER_0_IAM_Rx
      PduRDestPdu_ICBAD_ZONE_CHCANFD_20ms_FrP13_CONTROLLER_0_IAM_Rx (PduRDestPdu):
        PduRDestPduDataProvision = PDUR_DIRECT
        PduRDestPduHandleId = PDUR_DESTPDU_COM_ICBAD_ZONE_CHCANFD_20ms_FrP13_CONTROLLER_0_IAM_Rx
        PduRTransmissionConfirmation = true
        PduRDestPduRef = COM_ICBAD_ZONE_CHCANFD_20ms_FrP13_CONTROLLER_0_IAM_Rx
      PDUR_ROUTING_TC_ZONE_PTCANFD_10ms_FrP01_CONTROLLER_0_IAM_Rx (PduRRoutingPath):
        PduRRouteType = IF
        PduRDestPduRRef = PduRDestPdu_TC_ZONE_PTCANFD_10ms_FrP01_CONTROLLER_0_IAM_Rx
        PduRSrcPduRRef = PduRSrcPdu_TC_ZONE_PTCANFD_10ms_FrP01_CONTROLLER_0_IAM_Rx
      PduRSrcPdu_TC_ZONE_PTCANFD_10ms_FrP01_CONTROLLER_0_IAM_Rx (PduRSrcPdu):
        PduRSourcePduHandleId = PDUR_SRCPDU_CANIF_TC_ZONE_PTCANFD_10ms_FrP01_CONTROLLER_0_IAM_Rx
        PduRSrcPduUpTxConf = true
        PduRSrcPduRef = CANIF_TC_ZONE_PTCANFD_10ms_FrP01_CONTROLLER_0_IAM_Rx
      PduRDestPdu_TC_ZONE_PTCANFD_10ms_FrP01_CONTROLLER_0_IAM_Rx (PduRDestPdu):
        PduRDestPduDataProvision = PDUR_DIRECT
        PduRDestPduHandleId = PDUR_DESTPDU_COM_TC_ZONE_PTCANFD_10ms_FrP01_CONTROLLER_0_IAM_Rx
        PduRTransmissionConfirmation = true
        PduRDestPduRef = COM_TC_ZONE_PTCANFD_10ms_FrP01_CONTROLLER_0_IAM_Rx
      PDUR_ROUTING_ICM_INFOCANFD_EvtInfo_CONTROLLER_0_IAM_Rx (PduRRoutingPath):
        PduRRouteType = IF
        PduRDestPduRRef = PduRDestPdu_ICM_INFOCANFD_EvtInfo_CONTROLLER_0_IAM_Rx
        PduRSrcPduRRef = PduRSrcPdu_ICM_INFOCANFD_EvtInfo_CONTROLLER_0_IAM_Rx
      PduRSrcPdu_ICM_INFOCANFD_EvtInfo_CONTROLLER_0_IAM_Rx (PduRSrcPdu):
        PduRSourcePduHandleId = PDUR_SRCPDU_CANIF_ICM_INFOCANFD_EvtInfo_CONTROLLER_0_IAM_Rx
        PduRSrcPduUpTxConf = true
        PduRSrcPduRef = CANIF_ICM_INFOCANFD_EvtInfo_CONTROLLER_0_IAM_Rx
      PduRDestPdu_ICM_INFOCANFD_EvtInfo_CONTROLLER_0_IAM_Rx (PduRDestPdu):
        PduRDestPduDataProvision = PDUR_DIRECT
        PduRDestPduHandleId = PDUR_DESTPDU_COM_ICM_INFOCANFD_EvtInfo_CONTROLLER_0_IAM_Rx
        PduRTransmissionConfirmation = true
        PduRDestPduRef = COM_ICM_INFOCANFD_EvtInfo_CONTROLLER_0_IAM_Rx
      PDUR_ROUTING_AMP_INFOCAN_EvtInfo_CONTROLLER_0_IAM_Rx (PduRRoutingPath):
        PduRRouteType = IF
        PduRDestPduRRef = PduRDestPdu_AMP_INFOCAN_EvtInfo_CONTROLLER_0_IAM_Rx
        PduRSrcPduRRef = PduRSrcPdu_AMP_INFOCAN_EvtInfo_CONTROLLER_0_IAM_Rx
      PduRSrcPdu_AMP_INFOCAN_EvtInfo_CONTROLLER_0_IAM_Rx (PduRSrcPdu):
        PduRSourcePduHandleId = PDUR_SRCPDU_CANIF_AMP_INFOCAN_EvtInfo_CONTROLLER_0_IAM_Rx
        PduRSrcPduUpTxConf = true
        PduRSrcPduRef = CANIF_AMP_INFOCAN_EvtInfo_CONTROLLER_0_IAM_Rx
      PduRDestPdu_AMP_INFOCAN_EvtInfo_CONTROLLER_0_IAM_Rx (PduRDestPdu):
        PduRDestPduDataProvision = PDUR_DIRECT
        PduRDestPduHandleId = PDUR_DESTPDU_COM_AMP_INFOCAN_EvtInfo_CONTROLLER_0_IAM_Rx
        PduRTransmissionConfirmation = true
        PduRDestPduRef = COM_AMP_INFOCAN_EvtInfo_CONTROLLER_0_IAM_Rx
      PDUR_ROUTING_ECM_ERCANFD_10ms_FrP00_CONTROLLER_0_IAM_Rx (PduRRoutingPath):
        PduRRouteType = IF
        PduRDestPduRRef = PduRDestPdu_ECM_ERCANFD_10ms_FrP00_CONTROLLER_0_IAM_Rx
        PduRSrcPduRRef = PduRSrcPdu_ECM_ERCANFD_10ms_FrP00_CONTROLLER_0_IAM_Rx
      PduRSrcPdu_ECM_ERCANFD_10ms_FrP00_CONTROLLER_0_IAM_Rx (PduRSrcPdu):
        PduRSourcePduHandleId = PDUR_SRCPDU_CANIF_ECM_ERCANFD_10ms_FrP00_CONTROLLER_0_IAM_Rx
        PduRSrcPduUpTxConf = true
        PduRSrcPduRef = CANIF_ECM_ERCANFD_10ms_FrP00_CONTROLLER_0_IAM_Rx
      PduRDestPdu_ECM_ERCANFD_10ms_FrP00_CONTROLLER_0_IAM_Rx (PduRDestPdu):
        PduRDestPduDataProvision = PDUR_DIRECT
        PduRDestPduHandleId = PDUR_DESTPDU_COM_ECM_ERCANFD_10ms_FrP00_CONTROLLER_0_IAM_Rx
        PduRTransmissionConfirmation = true
        PduRDestPduRef = COM_ECM_ERCANFD_10ms_FrP00_CONTROLLER_0_IAM_Rx
      PDUR_ROUTING_LHZCU_LHBKBCANFD_10ms_FrP01_CONTROLLER_0_IAM_Rx (PduRRoutingPath):
        PduRRouteType = IF
        PduRDestPduRRef = PduRDestPdu_LHZCU_LHBKBCANFD_10ms_FrP01_CONTROLLER_0_IAM_Rx
        PduRSrcPduRRef = PduRSrcPdu_LHZCU_LHBKBCANFD_10ms_FrP01_CONTROLLER_0_IAM_Rx
      PduRSrcPdu_LHZCU_LHBKBCANFD_10ms_FrP01_CONTROLLER_0_IAM_Rx (PduRSrcPdu):
        PduRSourcePduHandleId = PDUR_SRCPDU_CANIF_LHZCU_LHBKBCANFD_10ms_FrP01_CONTROLLER_0_IAM_Rx
        PduRSrcPduUpTxConf = true
        PduRSrcPduRef = CANIF_LHZCU_LHBKBCANFD_10ms_FrP01_CONTROLLER_0_IAM_Rx
      PduRDestPdu_LHZCU_LHBKBCANFD_10ms_FrP01_CONTROLLER_0_IAM_Rx (PduRDestPdu):
        PduRDestPduDataProvision = PDUR_DIRECT
        PduRDestPduHandleId = PDUR_DESTPDU_COM_LHZCU_LHBKBCANFD_10ms_FrP01_CONTROLLER_0_IAM_Rx
        PduRTransmissionConfirmation = true
        PduRDestPduRef = COM_LHZCU_LHBKBCANFD_10ms_FrP01_CONTROLLER_0_IAM_Rx
      PDUR_ROUTING_RZCU_PTCANFD_10ms_FrP01_CONTROLLER_0_IAM_Rx (PduRRoutingPath):
        PduRRouteType = IF
        PduRDestPduRRef = PduRDestPdu_RZCU_PTCANFD_10ms_FrP01_CONTROLLER_0_IAM_Rx
        PduRSrcPduRRef = PduRSrcPdu_RZCU_PTCANFD_10ms_FrP01_CONTROLLER_0_IAM_Rx
      PduRSrcPdu_RZCU_PTCANFD_10ms_FrP01_CONTROLLER_0_IAM_Rx (PduRSrcPdu):
        PduRSourcePduHandleId = PDUR_SRCPDU_CANIF_RZCU_PTCANFD_10ms_FrP01_CONTROLLER_0_IAM_Rx
        PduRSrcPduUpTxConf = true
        PduRSrcPduRef = CANIF_RZCU_PTCANFD_10ms_FrP01_CONTROLLER_0_IAM_Rx
      PduRDestPdu_RZCU_PTCANFD_10ms_FrP01_CONTROLLER_0_IAM_Rx (PduRDestPdu):
        PduRDestPduDataProvision = PDUR_DIRECT
        PduRDestPduHandleId = PDUR_DESTPDU_COM_RZCU_PTCANFD_10ms_FrP01_CONTROLLER_0_IAM_Rx
        PduRTransmissionConfirmation = true
        PduRDestPduRef = COM_RZCU_PTCANFD_10ms_FrP01_CONTROLLER_0_IAM_Rx
      PDUR_ROUTING_IBS_CHCANFD_10ms_FrP04_CONTROLLER_0_IAM_Rx (PduRRoutingPath):
        PduRRouteType = IF
        PduRDestPduRRef = PduRDestPdu_IBS_CHCANFD_10ms_FrP04_CONTROLLER_0_IAM_Rx
        PduRSrcPduRRef = PduRSrcPdu_IBS_CHCANFD_10ms_FrP04_CONTROLLER_0_IAM_Rx
      PduRSrcPdu_IBS_CHCANFD_10ms_FrP04_CONTROLLER_0_IAM_Rx (PduRSrcPdu):
        PduRSourcePduHandleId = PDUR_SRCPDU_CANIF_IBS_CHCANFD_10ms_FrP04_CONTROLLER_0_IAM_Rx
        PduRSrcPduUpTxConf = true
        PduRSrcPduRef = CANIF_IBS_CHCANFD_10ms_FrP04_CONTROLLER_0_IAM_Rx
      PduRDestPdu_IBS_CHCANFD_10ms_FrP04_CONTROLLER_0_IAM_Rx (PduRDestPdu):
        PduRDestPduDataProvision = PDUR_DIRECT
        PduRDestPduHandleId = PDUR_DESTPDU_COM_IBS_CHCANFD_10ms_FrP04_CONTROLLER_0_IAM_Rx
        PduRTransmissionConfirmation = true
        PduRDestPduRef = COM_IBS_CHCANFD_10ms_FrP04_CONTROLLER_0_IAM_Rx
      PDUR_ROUTING_PEU_PTCANFD_10ms_FrP04_SigGWtoCO_CONTROLLER_0_IAM_Rx (PduRRoutingPath):
        PduRRouteType = IF
        PduRDestPduRRef = PduRDestPdu_PEU_PTCANFD_10ms_FrP04_SigGWtoCO_CONTROLLER_0_IAM_Rx
        PduRSrcPduRRef = PduRSrcPdu_PEU_PTCANFD_10ms_FrP04_SigGWtoCO_CONTROLLER_0_IAM_Rx
      PduRSrcPdu_PEU_PTCANFD_10ms_FrP04_SigGWtoCO_CONTROLLER_0_IAM_Rx (PduRSrcPdu):
        PduRSourcePduHandleId = PDUR_SRCPDU_CANIF_PEU_PTCANFD_10ms_FrP04_SigGWtoCO_CONTROLLER_0_IAM_Rx
        PduRSrcPduUpTxConf = true
        PduRSrcPduRef = CANIF_PEU_PTCANFD_10ms_FrP04_SigGWtoCO_CONTROLLER_0_IAM_Rx
      PduRDestPdu_PEU_PTCANFD_10ms_FrP04_SigGWtoCO_CONTROLLER_0_IAM_Rx (PduRDestPdu):
        PduRDestPduDataProvision = PDUR_DIRECT
        PduRDestPduHandleId = PDUR_DESTPDU_COM_PEU_PTCANFD_10ms_FrP04_SigGWtoCO_CONTROLLER_0_IAM_Rx
        PduRTransmissionConfirmation = true
        PduRDestPduRef = COM_PEU_PTCANFD_10ms_FrP04_SigGWtoCO_CONTROLLER_0_IAM_Rx
      PDUR_ROUTING_DLP_BDCAN_EvtInfo_CONTROLLER_0_IAM_Rx (PduRRoutingPath):
        PduRRouteType = IF
        PduRDestPduRRef = PduRDestPdu_DLP_BDCAN_EvtInfo_CONTROLLER_0_IAM_Rx
        PduRSrcPduRRef = PduRSrcPdu_DLP_BDCAN_EvtInfo_CONTROLLER_0_IAM_Rx
      PduRSrcPdu_DLP_BDCAN_EvtInfo_CONTROLLER_0_IAM_Rx (PduRSrcPdu):
        PduRSourcePduHandleId = PDUR_SRCPDU_CANIF_DLP_BDCAN_EvtInfo_CONTROLLER_0_IAM_Rx
        PduRSrcPduUpTxConf = true
        PduRSrcPduRef = CANIF_DLP_BDCAN_EvtInfo_CONTROLLER_0_IAM_Rx
      PduRDestPdu_DLP_BDCAN_EvtInfo_CONTROLLER_0_IAM_Rx (PduRDestPdu):
        PduRDestPduDataProvision = PDUR_DIRECT
        PduRDestPduHandleId = PDUR_DESTPDU_COM_DLP_BDCAN_EvtInfo_CONTROLLER_0_IAM_Rx
        PduRTransmissionConfirmation = true
        PduRDestPduRef = COM_DLP_BDCAN_EvtInfo_CONTROLLER_0_IAM_Rx
      PDUR_ROUTING_PEU_PTCANFD_5ms_FrP02_SigGwTOCON_CONTROLLER_0_IAM_Rx (PduRRoutingPath):
        PduRRouteType = IF
        PduRDestPduRRef = PduRDestPdu_PEU_PTCANFD_5ms_FrP02_SigGwTOCON_CONTROLLER_0_IAM_Rx
        PduRSrcPduRRef = PduRSrcPdu_PEU_PTCANFD_5ms_FrP02_SigGwTOCON_CONTROLLER_0_IAM_Rx
      PduRSrcPdu_PEU_PTCANFD_5ms_FrP02_SigGwTOCON_CONTROLLER_0_IAM_Rx (PduRSrcPdu):
        PduRSourcePduHandleId = PDUR_SRCPDU_CANIF_PEU_PTCANFD_5ms_FrP02_SigGwTOCON_CONTROLLER_0_IAM_Rx
        PduRSrcPduUpTxConf = true
        PduRSrcPduRef = CANIF_PEU_PTCANFD_5ms_FrP02_SigGwTOCON_CONTROLLER_0_IAM_Rx
      PduRDestPdu_PEU_PTCANFD_5ms_FrP02_SigGwTOCON_CONTROLLER_0_IAM_Rx (PduRDestPdu):
        PduRDestPduDataProvision = PDUR_DIRECT
        PduRDestPduHandleId = PDUR_DESTPDU_COM_PEU_PTCANFD_5ms_FrP02_SigGwTOCON_CONTROLLER_0_IAM_Rx
        PduRTransmissionConfirmation = true
        PduRDestPduRef = COM_PEU_PTCANFD_5ms_FrP02_SigGwTOCON_CONTROLLER_0_IAM_Rx
      PDUR_ROUTING_TC_PTCANFD_10ms_FrP01_SigGWTORZC_CONTROLLER_0_IAM_Rx (PduRRoutingPath):
        PduRRouteType = IF
        PduRDestPduRRef = PduRDestPdu_TC_PTCANFD_10ms_FrP01_SigGWTORZC_CONTROLLER_0_IAM_Rx
        PduRSrcPduRRef = PduRSrcPdu_TC_PTCANFD_10ms_FrP01_SigGWTORZC_CONTROLLER_0_IAM_Rx
      PduRSrcPdu_TC_PTCANFD_10ms_FrP01_SigGWTORZC_CONTROLLER_0_IAM_Rx (PduRSrcPdu):
        PduRSourcePduHandleId = PDUR_SRCPDU_CANIF_TC_PTCANFD_10ms_FrP01_SigGWTORZC_CONTROLLER_0_IAM_Rx
        PduRSrcPduUpTxConf = true
        PduRSrcPduRef = CANIF_TC_PTCANFD_10ms_FrP01_SigGWTORZC_CONTROLLER_0_IAM_Rx
      PduRDestPdu_TC_PTCANFD_10ms_FrP01_SigGWTORZC_CONTROLLER_0_IAM_Rx (PduRDestPdu):
        PduRDestPduDataProvision = PDUR_DIRECT
        PduRDestPduHandleId = PDUR_DESTPDU_COM_TC_PTCANFD_10ms_FrP01_SigGWTORZC_CONTROLLER_0_IAM_Rx
        PduRTransmissionConfirmation = true
        PduRDestPduRef = COM_TC_PTCANFD_10ms_FrP01_SigGWTORZC_CONTROLLER_0_IAM_Rx
      PDUR_ROUTING_RZCU_RZCUCANFD_10ms_FrP22_NoSecO_CONTROLLER_0_IAM_Rx (PduRRoutingPath):
        PduRRouteType = IF
        PduRDestPduRRef = PduRDestPdu_RZCU_RZCUCANFD_10ms_FrP22_NoSecO_CONTROLLER_0_IAM_Rx
        PduRSrcPduRRef = PduRSrcPdu_RZCU_RZCUCANFD_10ms_FrP22_NoSecO_CONTROLLER_0_IAM_Rx
      PduRSrcPdu_RZCU_RZCUCANFD_10ms_FrP22_NoSecO_CONTROLLER_0_IAM_Rx (PduRSrcPdu):
        PduRSourcePduHandleId = PDUR_SRCPDU_CANIF_RZCU_RZCUCANFD_10ms_FrP22_NoSecO_CONTROLLER_0_IAM_Rx
        PduRSrcPduUpTxConf = true
        PduRSrcPduRef = CANIF_RZCU_RZCUCANFD_10ms_FrP22_NoSecO_CONTROLLER_0_IAM_Rx
      PduRDestPdu_RZCU_RZCUCANFD_10ms_FrP22_NoSecO_CONTROLLER_0_IAM_Rx (PduRDestPdu):
        PduRDestPduDataProvision = PDUR_DIRECT
        PduRDestPduHandleId = PDUR_DESTPDU_COM_RZCU_RZCUCANFD_10ms_FrP22_NoSecO_CONTROLLER_0_IAM_Rx
        PduRTransmissionConfirmation = true
        PduRDestPduRef = COM_RZCU_RZCUCANFD_10ms_FrP22_NoSecO_CONTROLLER_0_IAM_Rx
      PDUR_ROUTING_ESS_PTCANFD_20ms_FrP01_CONTROLLER_0_IAM_Rx (PduRRoutingPath):
        PduRRouteType = IF
        PduRDestPduRRef = PduRDestPdu_ESS_PTCANFD_20ms_FrP01_CONTROLLER_0_IAM_Rx
        PduRSrcPduRRef = PduRSrcPdu_ESS_PTCANFD_20ms_FrP01_CONTROLLER_0_IAM_Rx
      PduRSrcPdu_ESS_PTCANFD_20ms_FrP01_CONTROLLER_0_IAM_Rx (PduRSrcPdu):
        PduRSourcePduHandleId = PDUR_SRCPDU_CANIF_ESS_PTCANFD_20ms_FrP01_CONTROLLER_0_IAM_Rx
        PduRSrcPduUpTxConf = true
        PduRSrcPduRef = CANIF_ESS_PTCANFD_20ms_FrP01_CONTROLLER_0_IAM_Rx
      PduRDestPdu_ESS_PTCANFD_20ms_FrP01_CONTROLLER_0_IAM_Rx (PduRDestPdu):
        PduRDestPduDataProvision = PDUR_DIRECT
        PduRDestPduHandleId = PDUR_DESTPDU_COM_ESS_PTCANFD_20ms_FrP01_CONTROLLER_0_IAM_Rx
        PduRTransmissionConfirmation = true
        PduRDestPduRef = COM_ESS_PTCANFD_20ms_FrP01_CONTROLLER_0_IAM_Rx
      PDUR_ROUTING_ESS_PTCANFD_20ms_FrP02_CONTROLLER_0_IAM_Rx (PduRRoutingPath):
        PduRRouteType = IF
        PduRDestPduRRef = PduRDestPdu_ESS_PTCANFD_20ms_FrP02_CONTROLLER_0_IAM_Rx
        PduRSrcPduRRef = PduRSrcPdu_ESS_PTCANFD_20ms_FrP02_CONTROLLER_0_IAM_Rx
      PduRSrcPdu_ESS_PTCANFD_20ms_FrP02_CONTROLLER_0_IAM_Rx (PduRSrcPdu):
        PduRSourcePduHandleId = PDUR_SRCPDU_CANIF_ESS_PTCANFD_20ms_FrP02_CONTROLLER_0_IAM_Rx
        PduRSrcPduUpTxConf = true
        PduRSrcPduRef = CANIF_ESS_PTCANFD_20ms_FrP02_CONTROLLER_0_IAM_Rx
      PduRDestPdu_ESS_PTCANFD_20ms_FrP02_CONTROLLER_0_IAM_Rx (PduRDestPdu):
        PduRDestPduDataProvision = PDUR_DIRECT
        PduRDestPduHandleId = PDUR_DESTPDU_COM_ESS_PTCANFD_20ms_FrP02_CONTROLLER_0_IAM_Rx
        PduRTransmissionConfirmation = true
        PduRDestPduRef = COM_ESS_PTCANFD_20ms_FrP02_CONTROLLER_0_IAM_Rx
      PDUR_ROUTING_ICBAD_CHCANFD_20ms_FrP08_CONTROLLER_0_IAM_Rx (PduRRoutingPath):
        PduRRouteType = IF
        PduRDestPduRRef = PduRDestPdu_ICBAD_CHCANFD_20ms_FrP08_CONTROLLER_0_IAM_Rx
        PduRSrcPduRRef = PduRSrcPdu_ICBAD_CHCANFD_20ms_FrP08_CONTROLLER_0_IAM_Rx
      PduRSrcPdu_ICBAD_CHCANFD_20ms_FrP08_CONTROLLER_0_IAM_Rx (PduRSrcPdu):
        PduRSourcePduHandleId = PDUR_SRCPDU_CANIF_ICBAD_CHCANFD_20ms_FrP08_CONTROLLER_0_IAM_Rx
        PduRSrcPduUpTxConf = true
        PduRSrcPduRef = CANIF_ICBAD_CHCANFD_20ms_FrP08_CONTROLLER_0_IAM_Rx
      PduRDestPdu_ICBAD_CHCANFD_20ms_FrP08_CONTROLLER_0_IAM_Rx (PduRDestPdu):
        PduRDestPduDataProvision = PDUR_DIRECT
        PduRDestPduHandleId = PDUR_DESTPDU_COM_ICBAD_CHCANFD_20ms_FrP08_CONTROLLER_0_IAM_Rx
        PduRTransmissionConfirmation = true
        PduRDestPduRef = COM_ICBAD_CHCANFD_20ms_FrP08_CONTROLLER_0_IAM_Rx
      PDUR_ROUTING_PEU_ERCANFD_20ms_FrP33_CONTROLLER_0_IAM_Rx (PduRRoutingPath):
        PduRRouteType = IF
        PduRDestPduRRef = PduRDestPdu_PEU_ERCANFD_20ms_FrP33_CONTROLLER_0_IAM_Rx
        PduRSrcPduRRef = PduRSrcPdu_PEU_ERCANFD_20ms_FrP33_CONTROLLER_0_IAM_Rx
      PduRSrcPdu_PEU_ERCANFD_20ms_FrP33_CONTROLLER_0_IAM_Rx (PduRSrcPdu):
        PduRSourcePduHandleId = PDUR_SRCPDU_CANIF_PEU_ERCANFD_20ms_FrP33_CONTROLLER_0_IAM_Rx
        PduRSrcPduUpTxConf = true
        PduRSrcPduRef = CANIF_PEU_ERCANFD_20ms_FrP33_CONTROLLER_0_IAM_Rx
      PduRDestPdu_PEU_ERCANFD_20ms_FrP33_CONTROLLER_0_IAM_Rx (PduRDestPdu):
        PduRDestPduDataProvision = PDUR_DIRECT
        PduRDestPduHandleId = PDUR_DESTPDU_COM_PEU_ERCANFD_20ms_FrP33_CONTROLLER_0_IAM_Rx
        PduRTransmissionConfirmation = true
        PduRDestPduRef = COM_PEU_ERCANFD_20ms_FrP33_CONTROLLER_0_IAM_Rx
      PDUR_ROUTING_SDM_CHCANFD_20ms_FrP01_CONTROLLER_0_IAM_Rx (PduRRoutingPath):
        PduRRouteType = IF
        PduRDestPduRRef = PduRDestPdu_SDM_CHCANFD_20ms_FrP01_CONTROLLER_0_IAM_Rx
        PduRSrcPduRRef = PduRSrcPdu_SDM_CHCANFD_20ms_FrP01_CONTROLLER_0_IAM_Rx
      PduRSrcPdu_SDM_CHCANFD_20ms_FrP01_CONTROLLER_0_IAM_Rx (PduRSrcPdu):
        PduRSourcePduHandleId = PDUR_SRCPDU_CANIF_SDM_CHCANFD_20ms_FrP01_CONTROLLER_0_IAM_Rx
        PduRSrcPduUpTxConf = true
        PduRSrcPduRef = CANIF_SDM_CHCANFD_20ms_FrP01_CONTROLLER_0_IAM_Rx
      PduRDestPdu_SDM_CHCANFD_20ms_FrP01_CONTROLLER_0_IAM_Rx (PduRDestPdu):
        PduRDestPduDataProvision = PDUR_DIRECT
        PduRDestPduHandleId = PDUR_DESTPDU_COM_SDM_CHCANFD_20ms_FrP01_CONTROLLER_0_IAM_Rx
        PduRTransmissionConfirmation = true
        PduRDestPduRef = COM_SDM_CHCANFD_20ms_FrP01_CONTROLLER_0_IAM_Rx
      PDUR_ROUTING_ICBVC_RZCUCANFD_20ms_FrP00_CONTROLLER_0_IAM_Rx (PduRRoutingPath):
        PduRRouteType = IF
        PduRDestPduRRef = PduRDestPdu_ICBVC_RZCUCANFD_20ms_FrP00_CONTROLLER_0_IAM_Rx
        PduRSrcPduRRef = PduRSrcPdu_ICBVC_RZCUCANFD_20ms_FrP00_CONTROLLER_0_IAM_Rx
      PduRSrcPdu_ICBVC_RZCUCANFD_20ms_FrP00_CONTROLLER_0_IAM_Rx (PduRSrcPdu):
        PduRSourcePduHandleId = PDUR_SRCPDU_CANIF_ICBVC_RZCUCANFD_20ms_FrP00_CONTROLLER_0_IAM_Rx
        PduRSrcPduUpTxConf = true
        PduRSrcPduRef = CANIF_ICBVC_RZCUCANFD_20ms_FrP00_CONTROLLER_0_IAM_Rx
      PduRDestPdu_ICBVC_RZCUCANFD_20ms_FrP00_CONTROLLER_0_IAM_Rx (PduRDestPdu):
        PduRDestPduDataProvision = PDUR_DIRECT
        PduRDestPduHandleId = PDUR_DESTPDU_COM_ICBVC_RZCUCANFD_20ms_FrP00_CONTROLLER_0_IAM_Rx
        PduRTransmissionConfirmation = true
        PduRDestPduRef = COM_ICBVC_RZCUCANFD_20ms_FrP00_CONTROLLER_0_IAM_Rx
      PDUR_ROUTING_PEU_PTCANFD_100ms_FrP03_CONTROLLER_0_IAM_Rx (PduRRoutingPath):
        PduRRouteType = IF
        PduRDestPduRRef = PduRDestPdu_PEU_PTCANFD_100ms_FrP03_CONTROLLER_0_IAM_Rx
        PduRSrcPduRRef = PduRSrcPdu_PEU_PTCANFD_100ms_FrP03_CONTROLLER_0_IAM_Rx
      PduRSrcPdu_PEU_PTCANFD_100ms_FrP03_CONTROLLER_0_IAM_Rx (PduRSrcPdu):
        PduRSourcePduHandleId = PDUR_SRCPDU_CANIF_PEU_PTCANFD_100ms_FrP03_CONTROLLER_0_IAM_Rx
        PduRSrcPduUpTxConf = true
        PduRSrcPduRef = CANIF_PEU_PTCANFD_100ms_FrP03_CONTROLLER_0_IAM_Rx
      PduRDestPdu_PEU_PTCANFD_100ms_FrP03_CONTROLLER_0_IAM_Rx (PduRDestPdu):
        PduRDestPduDataProvision = PDUR_DIRECT
        PduRDestPduHandleId = PDUR_DESTPDU_COM_PEU_PTCANFD_100ms_FrP03_CONTROLLER_0_IAM_Rx
        PduRTransmissionConfirmation = true
        PduRDestPduRef = COM_PEU_PTCANFD_100ms_FrP03_CONTROLLER_0_IAM_Rx
      PDUR_ROUTING_ICBAD_BKPCANFD_20ms_FrP07_CONTROLLER_0_IAM_Rx (PduRRoutingPath):
        PduRRouteType = IF
        PduRDestPduRRef = PduRDestPdu_ICBAD_BKPCANFD_20ms_FrP07_CONTROLLER_0_IAM_Rx
        PduRSrcPduRRef = PduRSrcPdu_ICBAD_BKPCANFD_20ms_FrP07_CONTROLLER_0_IAM_Rx
      PduRSrcPdu_ICBAD_BKPCANFD_20ms_FrP07_CONTROLLER_0_IAM_Rx (PduRSrcPdu):
        PduRSourcePduHandleId = PDUR_SRCPDU_CANIF_ICBAD_BKPCANFD_20ms_FrP07_CONTROLLER_0_IAM_Rx
        PduRSrcPduUpTxConf = true
        PduRSrcPduRef = CANIF_ICBAD_BKPCANFD_20ms_FrP07_CONTROLLER_0_IAM_Rx
      PduRDestPdu_ICBAD_BKPCANFD_20ms_FrP07_CONTROLLER_0_IAM_Rx (PduRDestPdu):
        PduRDestPduDataProvision = PDUR_DIRECT
        PduRDestPduHandleId = PDUR_DESTPDU_COM_ICBAD_BKPCANFD_20ms_FrP07_CONTROLLER_0_IAM_Rx
        PduRTransmissionConfirmation = true
        PduRDestPduRef = COM_ICBAD_BKPCANFD_20ms_FrP07_CONTROLLER_0_IAM_Rx
      PDUR_ROUTING_SDM_CHCANFD_20ms_FrP02_CONTROLLER_0_IAM_Rx (PduRRoutingPath):
        PduRRouteType = IF
        PduRDestPduRRef = PduRDestPdu_SDM_CHCANFD_20ms_FrP02_CONTROLLER_0_IAM_Rx
        PduRSrcPduRRef = PduRSrcPdu_SDM_CHCANFD_20ms_FrP02_CONTROLLER_0_IAM_Rx
      PduRSrcPdu_SDM_CHCANFD_20ms_FrP02_CONTROLLER_0_IAM_Rx (PduRSrcPdu):
        PduRSourcePduHandleId = PDUR_SRCPDU_CANIF_SDM_CHCANFD_20ms_FrP02_CONTROLLER_0_IAM_Rx
        PduRSrcPduUpTxConf = true
        PduRSrcPduRef = CANIF_SDM_CHCANFD_20ms_FrP02_CONTROLLER_0_IAM_Rx
      PduRDestPdu_SDM_CHCANFD_20ms_FrP02_CONTROLLER_0_IAM_Rx (PduRDestPdu):
        PduRDestPduDataProvision = PDUR_DIRECT
        PduRDestPduHandleId = PDUR_DESTPDU_COM_SDM_CHCANFD_20ms_FrP02_CONTROLLER_0_IAM_Rx
        PduRTransmissionConfirmation = true
        PduRDestPduRef = COM_SDM_CHCANFD_20ms_FrP02_CONTROLLER_0_IAM_Rx
      PDUR_ROUTING_RZCU_PTCANFD_20ms_FrP06_CONTROLLER_0_IAM_Rx (PduRRoutingPath):
        PduRRouteType = IF
        PduRDestPduRRef = PduRDestPdu_RZCU_PTCANFD_20ms_FrP06_CONTROLLER_0_IAM_Rx
        PduRSrcPduRRef = PduRSrcPdu_RZCU_PTCANFD_20ms_FrP06_CONTROLLER_0_IAM_Rx
      PduRSrcPdu_RZCU_PTCANFD_20ms_FrP06_CONTROLLER_0_IAM_Rx (PduRSrcPdu):
        PduRSourcePduHandleId = PDUR_SRCPDU_CANIF_RZCU_PTCANFD_20ms_FrP06_CONTROLLER_0_IAM_Rx
        PduRSrcPduUpTxConf = true
        PduRSrcPduRef = CANIF_RZCU_PTCANFD_20ms_FrP06_CONTROLLER_0_IAM_Rx
      PduRDestPdu_RZCU_PTCANFD_20ms_FrP06_CONTROLLER_0_IAM_Rx (PduRDestPdu):
        PduRDestPduDataProvision = PDUR_DIRECT
        PduRDestPduHandleId = PDUR_DESTPDU_COM_RZCU_PTCANFD_20ms_FrP06_CONTROLLER_0_IAM_Rx
        PduRTransmissionConfirmation = true
        PduRDestPduRef = COM_RZCU_PTCANFD_20ms_FrP06_CONTROLLER_0_IAM_Rx
      PDUR_ROUTING_IBS_CHCANFD_20ms_FrP07_CONTROLLER_0_IAM_Rx (PduRRoutingPath):
        PduRRouteType = IF
        PduRDestPduRRef = PduRDestPdu_IBS_CHCANFD_20ms_FrP07_CONTROLLER_0_IAM_Rx
        PduRSrcPduRRef = PduRSrcPdu_IBS_CHCANFD_20ms_FrP07_CONTROLLER_0_IAM_Rx
      PduRSrcPdu_IBS_CHCANFD_20ms_FrP07_CONTROLLER_0_IAM_Rx (PduRSrcPdu):
        PduRSourcePduHandleId = PDUR_SRCPDU_CANIF_IBS_CHCANFD_20ms_FrP07_CONTROLLER_0_IAM_Rx
        PduRSrcPduUpTxConf = true
        PduRSrcPduRef = CANIF_IBS_CHCANFD_20ms_FrP07_CONTROLLER_0_IAM_Rx
      PduRDestPdu_IBS_CHCANFD_20ms_FrP07_CONTROLLER_0_IAM_Rx (PduRDestPdu):
        PduRDestPduDataProvision = PDUR_DIRECT
        PduRDestPduHandleId = PDUR_DESTPDU_COM_IBS_CHCANFD_20ms_FrP07_CONTROLLER_0_IAM_Rx
        PduRTransmissionConfirmation = true
        PduRDestPduRef = COM_IBS_CHCANFD_20ms_FrP07_CONTROLLER_0_IAM_Rx
      PDUR_ROUTING_ICBAD_RZCUCANFD_20ms_FrP12_CONTROLLER_0_IAM_Rx (PduRRoutingPath):
        PduRRouteType = IF
        PduRDestPduRRef = PduRDestPdu_ICBAD_RZCUCANFD_20ms_FrP12_CONTROLLER_0_IAM_Rx
        PduRSrcPduRRef = PduRSrcPdu_ICBAD_RZCUCANFD_20ms_FrP12_CONTROLLER_0_IAM_Rx
      PduRSrcPdu_ICBAD_RZCUCANFD_20ms_FrP12_CONTROLLER_0_IAM_Rx (PduRSrcPdu):
        PduRSourcePduHandleId = PDUR_SRCPDU_CANIF_ICBAD_RZCUCANFD_20ms_FrP12_CONTROLLER_0_IAM_Rx
        PduRSrcPduUpTxConf = true
        PduRSrcPduRef = CANIF_ICBAD_RZCUCANFD_20ms_FrP12_CONTROLLER_0_IAM_Rx
      PduRDestPdu_ICBAD_RZCUCANFD_20ms_FrP12_CONTROLLER_0_IAM_Rx (PduRDestPdu):
        PduRDestPduDataProvision = PDUR_DIRECT
        PduRDestPduHandleId = PDUR_DESTPDU_COM_ICBAD_RZCUCANFD_20ms_FrP12_CONTROLLER_0_IAM_Rx
        PduRTransmissionConfirmation = true
        PduRDestPduRef = COM_ICBAD_RZCUCANFD_20ms_FrP12_CONTROLLER_0_IAM_Rx
      PDUR_ROUTING_IBS_CHCANFD_20ms_FrP11_CONTROLLER_0_IAM_Rx (PduRRoutingPath):
        PduRRouteType = IF
        PduRDestPduRRef = PduRDestPdu_IBS_CHCANFD_20ms_FrP11_CONTROLLER_0_IAM_Rx
        PduRSrcPduRRef = PduRSrcPdu_IBS_CHCANFD_20ms_FrP11_CONTROLLER_0_IAM_Rx
      PduRSrcPdu_IBS_CHCANFD_20ms_FrP11_CONTROLLER_0_IAM_Rx (PduRSrcPdu):
        PduRSourcePduHandleId = PDUR_SRCPDU_CANIF_IBS_CHCANFD_20ms_FrP11_CONTROLLER_0_IAM_Rx
        PduRSrcPduUpTxConf = true
        PduRSrcPduRef = CANIF_IBS_CHCANFD_20ms_FrP11_CONTROLLER_0_IAM_Rx
      PduRDestPdu_IBS_CHCANFD_20ms_FrP11_CONTROLLER_0_IAM_Rx (PduRDestPdu):
        PduRDestPduDataProvision = PDUR_DIRECT
        PduRDestPduHandleId = PDUR_DESTPDU_COM_IBS_CHCANFD_20ms_FrP11_CONTROLLER_0_IAM_Rx
        PduRTransmissionConfirmation = true
        PduRDestPduRef = COM_IBS_CHCANFD_20ms_FrP11_CONTROLLER_0_IAM_Rx
      PDUR_ROUTING_ESS_PTCANFD_20ms_FrP04_CONTROLLER_0_IAM_Rx (PduRRoutingPath):
        PduRRouteType = IF
        PduRDestPduRRef = PduRDestPdu_ESS_PTCANFD_20ms_FrP04_CONTROLLER_0_IAM_Rx
        PduRSrcPduRRef = PduRSrcPdu_ESS_PTCANFD_20ms_FrP04_CONTROLLER_0_IAM_Rx
      PduRSrcPdu_ESS_PTCANFD_20ms_FrP04_CONTROLLER_0_IAM_Rx (PduRSrcPdu):
        PduRSourcePduHandleId = PDUR_SRCPDU_CANIF_ESS_PTCANFD_20ms_FrP04_CONTROLLER_0_IAM_Rx
        PduRSrcPduUpTxConf = true
        PduRSrcPduRef = CANIF_ESS_PTCANFD_20ms_FrP04_CONTROLLER_0_IAM_Rx
      PduRDestPdu_ESS_PTCANFD_20ms_FrP04_CONTROLLER_0_IAM_Rx (PduRDestPdu):
        PduRDestPduDataProvision = PDUR_DIRECT
        PduRDestPduHandleId = PDUR_DESTPDU_COM_ESS_PTCANFD_20ms_FrP04_CONTROLLER_0_IAM_Rx
        PduRTransmissionConfirmation = true
        PduRDestPduRef = COM_ESS_PTCANFD_20ms_FrP04_CONTROLLER_0_IAM_Rx
      PDUR_ROUTING_ICBVC_RZCUCANFD_20ms_FrP03_CONTROLLER_0_IAM_Rx (PduRRoutingPath):
        PduRRouteType = IF
        PduRDestPduRRef = PduRDestPdu_ICBVC_RZCUCANFD_20ms_FrP03_CONTROLLER_0_IAM_Rx
        PduRSrcPduRRef = PduRSrcPdu_ICBVC_RZCUCANFD_20ms_FrP03_CONTROLLER_0_IAM_Rx
      PduRSrcPdu_ICBVC_RZCUCANFD_20ms_FrP03_CONTROLLER_0_IAM_Rx (PduRSrcPdu):
        PduRSourcePduHandleId = PDUR_SRCPDU_CANIF_ICBVC_RZCUCANFD_20ms_FrP03_CONTROLLER_0_IAM_Rx
        PduRSrcPduUpTxConf = true
        PduRSrcPduRef = CANIF_ICBVC_RZCUCANFD_20ms_FrP03_CONTROLLER_0_IAM_Rx
      PduRDestPdu_ICBVC_RZCUCANFD_20ms_FrP03_CONTROLLER_0_IAM_Rx (PduRDestPdu):
        PduRDestPduDataProvision = PDUR_DIRECT
        PduRDestPduHandleId = PDUR_DESTPDU_COM_ICBVC_RZCUCANFD_20ms_FrP03_CONTROLLER_0_IAM_Rx
        PduRTransmissionConfirmation = true
        PduRDestPduRef = COM_ICBVC_RZCUCANFD_20ms_FrP03_CONTROLLER_0_IAM_Rx
      PDUR_ROUTING_PEU_PTCANFD_50ms_FrP05_CONTROLLER_0_IAM_Rx (PduRRoutingPath):
        PduRRouteType = IF
        PduRDestPduRRef = PduRDestPdu_PEU_PTCANFD_50ms_FrP05_CONTROLLER_0_IAM_Rx
        PduRSrcPduRRef = PduRSrcPdu_PEU_PTCANFD_50ms_FrP05_CONTROLLER_0_IAM_Rx
      PduRSrcPdu_PEU_PTCANFD_50ms_FrP05_CONTROLLER_0_IAM_Rx (PduRSrcPdu):
        PduRSourcePduHandleId = PDUR_SRCPDU_CANIF_PEU_PTCANFD_50ms_FrP05_CONTROLLER_0_IAM_Rx
        PduRSrcPduUpTxConf = true
        PduRSrcPduRef = CANIF_PEU_PTCANFD_50ms_FrP05_CONTROLLER_0_IAM_Rx
      PduRDestPdu_PEU_PTCANFD_50ms_FrP05_CONTROLLER_0_IAM_Rx (PduRDestPdu):
        PduRDestPduDataProvision = PDUR_DIRECT
        PduRDestPduHandleId = PDUR_DESTPDU_COM_PEU_PTCANFD_50ms_FrP05_CONTROLLER_0_IAM_Rx
        PduRTransmissionConfirmation = true
        PduRDestPduRef = COM_PEU_PTCANFD_50ms_FrP05_CONTROLLER_0_IAM_Rx
      PDUR_ROUTING_ESS_PTCANFD_50ms_FrP14_CONTROLLER_0_IAM_Rx (PduRRoutingPath):
        PduRRouteType = IF
        PduRDestPduRRef = PduRDestPdu_ESS_PTCANFD_50ms_FrP14_CONTROLLER_0_IAM_Rx
        PduRSrcPduRRef = PduRSrcPdu_ESS_PTCANFD_50ms_FrP14_CONTROLLER_0_IAM_Rx
      PduRSrcPdu_ESS_PTCANFD_50ms_FrP14_CONTROLLER_0_IAM_Rx (PduRSrcPdu):
        PduRSourcePduHandleId = PDUR_SRCPDU_CANIF_ESS_PTCANFD_50ms_FrP14_CONTROLLER_0_IAM_Rx
        PduRSrcPduUpTxConf = true
        PduRSrcPduRef = CANIF_ESS_PTCANFD_50ms_FrP14_CONTROLLER_0_IAM_Rx
      PduRDestPdu_ESS_PTCANFD_50ms_FrP14_CONTROLLER_0_IAM_Rx (PduRDestPdu):
        PduRDestPduDataProvision = PDUR_DIRECT
        PduRDestPduHandleId = PDUR_DESTPDU_COM_ESS_PTCANFD_50ms_FrP14_CONTROLLER_0_IAM_Rx
        PduRTransmissionConfirmation = true
        PduRDestPduRef = COM_ESS_PTCANFD_50ms_FrP14_CONTROLLER_0_IAM_Rx
      PDUR_ROUTING_ESS_PTCANFD_100ms_FrP29_CONTROLLER_0_IAM_Rx (PduRRoutingPath):
        PduRRouteType = IF
        PduRDestPduRRef = PduRDestPdu_ESS_PTCANFD_100ms_FrP29_CONTROLLER_0_IAM_Rx
        PduRSrcPduRRef = PduRSrcPdu_ESS_PTCANFD_100ms_FrP29_CONTROLLER_0_IAM_Rx
      PduRSrcPdu_ESS_PTCANFD_100ms_FrP29_CONTROLLER_0_IAM_Rx (PduRSrcPdu):
        PduRSourcePduHandleId = PDUR_SRCPDU_CANIF_ESS_PTCANFD_100ms_FrP29_CONTROLLER_0_IAM_Rx
        PduRSrcPduUpTxConf = true
        PduRSrcPduRef = CANIF_ESS_PTCANFD_100ms_FrP29_CONTROLLER_0_IAM_Rx
      PduRDestPdu_ESS_PTCANFD_100ms_FrP29_CONTROLLER_0_IAM_Rx (PduRDestPdu):
        PduRDestPduDataProvision = PDUR_DIRECT
        PduRDestPduHandleId = PDUR_DESTPDU_COM_ESS_PTCANFD_100ms_FrP29_CONTROLLER_0_IAM_Rx
        PduRTransmissionConfirmation = true
        PduRDestPduRef = COM_ESS_PTCANFD_100ms_FrP29_CONTROLLER_0_IAM_Rx
      PDUR_ROUTING_ESS_PTCANFD_100ms_FrP26_CONTROLLER_0_IAM_Rx (PduRRoutingPath):
        PduRRouteType = IF
        PduRDestPduRRef = PduRDestPdu_ESS_PTCANFD_100ms_FrP26_CONTROLLER_0_IAM_Rx
        PduRSrcPduRRef = PduRSrcPdu_ESS_PTCANFD_100ms_FrP26_CONTROLLER_0_IAM_Rx
      PduRSrcPdu_ESS_PTCANFD_100ms_FrP26_CONTROLLER_0_IAM_Rx (PduRSrcPdu):
        PduRSourcePduHandleId = PDUR_SRCPDU_CANIF_ESS_PTCANFD_100ms_FrP26_CONTROLLER_0_IAM_Rx
        PduRSrcPduUpTxConf = true
        PduRSrcPduRef = CANIF_ESS_PTCANFD_100ms_FrP26_CONTROLLER_0_IAM_Rx
      PduRDestPdu_ESS_PTCANFD_100ms_FrP26_CONTROLLER_0_IAM_Rx (PduRDestPdu):
        PduRDestPduDataProvision = PDUR_DIRECT
        PduRDestPduHandleId = PDUR_DESTPDU_COM_ESS_PTCANFD_100ms_FrP26_CONTROLLER_0_IAM_Rx
        PduRTransmissionConfirmation = true
        PduRDestPduRef = COM_ESS_PTCANFD_100ms_FrP26_CONTROLLER_0_IAM_Rx
      PDUR_ROUTING_ESS_PTCANFD_50ms_FrP06_CONTROLLER_0_IAM_Rx (PduRRoutingPath):
        PduRRouteType = IF
        PduRDestPduRRef = PduRDestPdu_ESS_PTCANFD_50ms_FrP06_CONTROLLER_0_IAM_Rx
        PduRSrcPduRRef = PduRSrcPdu_ESS_PTCANFD_50ms_FrP06_CONTROLLER_0_IAM_Rx
      PduRSrcPdu_ESS_PTCANFD_50ms_FrP06_CONTROLLER_0_IAM_Rx (PduRSrcPdu):
        PduRSourcePduHandleId = PDUR_SRCPDU_CANIF_ESS_PTCANFD_50ms_FrP06_CONTROLLER_0_IAM_Rx
        PduRSrcPduUpTxConf = true
        PduRSrcPduRef = CANIF_ESS_PTCANFD_50ms_FrP06_CONTROLLER_0_IAM_Rx
      PduRDestPdu_ESS_PTCANFD_50ms_FrP06_CONTROLLER_0_IAM_Rx (PduRDestPdu):
        PduRDestPduDataProvision = PDUR_DIRECT
        PduRDestPduHandleId = PDUR_DESTPDU_COM_ESS_PTCANFD_50ms_FrP06_CONTROLLER_0_IAM_Rx
        PduRTransmissionConfirmation = true
        PduRDestPduRef = COM_ESS_PTCANFD_50ms_FrP06_CONTROLLER_0_IAM_Rx
      PDUR_ROUTING_ESS_PTCANFD_50ms_FrP07_CONTROLLER_0_IAM_Rx (PduRRoutingPath):
        PduRRouteType = IF
        PduRDestPduRRef = PduRDestPdu_ESS_PTCANFD_50ms_FrP07_CONTROLLER_0_IAM_Rx
        PduRSrcPduRRef = PduRSrcPdu_ESS_PTCANFD_50ms_FrP07_CONTROLLER_0_IAM_Rx
      PduRSrcPdu_ESS_PTCANFD_50ms_FrP07_CONTROLLER_0_IAM_Rx (PduRSrcPdu):
        PduRSourcePduHandleId = PDUR_SRCPDU_CANIF_ESS_PTCANFD_50ms_FrP07_CONTROLLER_0_IAM_Rx
        PduRSrcPduUpTxConf = true
        PduRSrcPduRef = CANIF_ESS_PTCANFD_50ms_FrP07_CONTROLLER_0_IAM_Rx
      PduRDestPdu_ESS_PTCANFD_50ms_FrP07_CONTROLLER_0_IAM_Rx (PduRDestPdu):
        PduRDestPduDataProvision = PDUR_DIRECT
        PduRDestPduHandleId = PDUR_DESTPDU_COM_ESS_PTCANFD_50ms_FrP07_CONTROLLER_0_IAM_Rx
        PduRTransmissionConfirmation = true
        PduRDestPduRef = COM_ESS_PTCANFD_50ms_FrP07_CONTROLLER_0_IAM_Rx
      PDUR_ROUTING_ESS_PTCANFD_50ms_FrP09_CONTROLLER_0_IAM_Rx (PduRRoutingPath):
        PduRRouteType = IF
        PduRDestPduRRef = PduRDestPdu_ESS_PTCANFD_50ms_FrP09_CONTROLLER_0_IAM_Rx
        PduRSrcPduRRef = PduRSrcPdu_ESS_PTCANFD_50ms_FrP09_CONTROLLER_0_IAM_Rx
      PduRSrcPdu_ESS_PTCANFD_50ms_FrP09_CONTROLLER_0_IAM_Rx (PduRSrcPdu):
        PduRSourcePduHandleId = PDUR_SRCPDU_CANIF_ESS_PTCANFD_50ms_FrP09_CONTROLLER_0_IAM_Rx
        PduRSrcPduUpTxConf = true
        PduRSrcPduRef = CANIF_ESS_PTCANFD_50ms_FrP09_CONTROLLER_0_IAM_Rx
      PduRDestPdu_ESS_PTCANFD_50ms_FrP09_CONTROLLER_0_IAM_Rx (PduRDestPdu):
        PduRDestPduDataProvision = PDUR_DIRECT
        PduRDestPduHandleId = PDUR_DESTPDU_COM_ESS_PTCANFD_50ms_FrP09_CONTROLLER_0_IAM_Rx
        PduRTransmissionConfirmation = true
        PduRDestPduRef = COM_ESS_PTCANFD_50ms_FrP09_CONTROLLER_0_IAM_Rx
      PDUR_ROUTING_ESS_PTCANFD_50ms_FrP13_CONTROLLER_0_IAM_Rx (PduRRoutingPath):
        PduRRouteType = IF
        PduRDestPduRRef = PduRDestPdu_ESS_PTCANFD_50ms_FrP13_CONTROLLER_0_IAM_Rx
        PduRSrcPduRRef = PduRSrcPdu_ESS_PTCANFD_50ms_FrP13_CONTROLLER_0_IAM_Rx
      PduRSrcPdu_ESS_PTCANFD_50ms_FrP13_CONTROLLER_0_IAM_Rx (PduRSrcPdu):
        PduRSourcePduHandleId = PDUR_SRCPDU_CANIF_ESS_PTCANFD_50ms_FrP13_CONTROLLER_0_IAM_Rx
        PduRSrcPduUpTxConf = true
        PduRSrcPduRef = CANIF_ESS_PTCANFD_50ms_FrP13_CONTROLLER_0_IAM_Rx
      PduRDestPdu_ESS_PTCANFD_50ms_FrP13_CONTROLLER_0_IAM_Rx (PduRDestPdu):
        PduRDestPduDataProvision = PDUR_DIRECT
        PduRDestPduHandleId = PDUR_DESTPDU_COM_ESS_PTCANFD_50ms_FrP13_CONTROLLER_0_IAM_Rx
        PduRTransmissionConfirmation = true
        PduRDestPduRef = COM_ESS_PTCANFD_50ms_FrP13_CONTROLLER_0_IAM_Rx
      PDUR_ROUTING_ESS_PTCANFD_50ms_FrP08_CONTROLLER_0_IAM_Rx (PduRRoutingPath):
        PduRRouteType = IF
        PduRDestPduRRef = PduRDestPdu_ESS_PTCANFD_50ms_FrP08_CONTROLLER_0_IAM_Rx
        PduRSrcPduRRef = PduRSrcPdu_ESS_PTCANFD_50ms_FrP08_CONTROLLER_0_IAM_Rx
      PduRSrcPdu_ESS_PTCANFD_50ms_FrP08_CONTROLLER_0_IAM_Rx (PduRSrcPdu):
        PduRSourcePduHandleId = PDUR_SRCPDU_CANIF_ESS_PTCANFD_50ms_FrP08_CONTROLLER_0_IAM_Rx
        PduRSrcPduUpTxConf = true
        PduRSrcPduRef = CANIF_ESS_PTCANFD_50ms_FrP08_CONTROLLER_0_IAM_Rx
      PduRDestPdu_ESS_PTCANFD_50ms_FrP08_CONTROLLER_0_IAM_Rx (PduRDestPdu):
        PduRDestPduDataProvision = PDUR_DIRECT
        PduRDestPduHandleId = PDUR_DESTPDU_COM_ESS_PTCANFD_50ms_FrP08_CONTROLLER_0_IAM_Rx
        PduRTransmissionConfirmation = true
        PduRDestPduRef = COM_ESS_PTCANFD_50ms_FrP08_CONTROLLER_0_IAM_Rx
      PDUR_ROUTING_ESS_PTCANFD_100ms_FrP21_CONTROLLER_0_IAM_Rx (PduRRoutingPath):
        PduRRouteType = IF
        PduRDestPduRRef = PduRDestPdu_ESS_PTCANFD_100ms_FrP21_CONTROLLER_0_IAM_Rx
        PduRSrcPduRRef = PduRSrcPdu_ESS_PTCANFD_100ms_FrP21_CONTROLLER_0_IAM_Rx
      PduRSrcPdu_ESS_PTCANFD_100ms_FrP21_CONTROLLER_0_IAM_Rx (PduRSrcPdu):
        PduRSourcePduHandleId = PDUR_SRCPDU_CANIF_ESS_PTCANFD_100ms_FrP21_CONTROLLER_0_IAM_Rx
        PduRSrcPduUpTxConf = true
        PduRSrcPduRef = CANIF_ESS_PTCANFD_100ms_FrP21_CONTROLLER_0_IAM_Rx
      PduRDestPdu_ESS_PTCANFD_100ms_FrP21_CONTROLLER_0_IAM_Rx (PduRDestPdu):
        PduRDestPduDataProvision = PDUR_DIRECT
        PduRDestPduHandleId = PDUR_DESTPDU_COM_ESS_PTCANFD_100ms_FrP21_CONTROLLER_0_IAM_Rx
        PduRTransmissionConfirmation = true
        PduRDestPduRef = COM_ESS_PTCANFD_100ms_FrP21_CONTROLLER_0_IAM_Rx
      PDUR_ROUTING_RZCU_LHBKBCANFD_50ms_FrP37_CONTROLLER_0_IAM_Rx (PduRRoutingPath):
        PduRRouteType = IF
        PduRDestPduRRef = PduRDestPdu_RZCU_LHBKBCANFD_50ms_FrP37_CONTROLLER_0_IAM_Rx
        PduRSrcPduRRef = PduRSrcPdu_RZCU_LHBKBCANFD_50ms_FrP37_CONTROLLER_0_IAM_Rx
      PduRSrcPdu_RZCU_LHBKBCANFD_50ms_FrP37_CONTROLLER_0_IAM_Rx (PduRSrcPdu):
        PduRSourcePduHandleId = PDUR_SRCPDU_CANIF_RZCU_LHBKBCANFD_50ms_FrP37_CONTROLLER_0_IAM_Rx
        PduRSrcPduUpTxConf = true
        PduRSrcPduRef = CANIF_RZCU_LHBKBCANFD_50ms_FrP37_CONTROLLER_0_IAM_Rx
      PduRDestPdu_RZCU_LHBKBCANFD_50ms_FrP37_CONTROLLER_0_IAM_Rx (PduRDestPdu):
        PduRDestPduDataProvision = PDUR_DIRECT
        PduRDestPduHandleId = PDUR_DESTPDU_COM_RZCU_LHBKBCANFD_50ms_FrP37_CONTROLLER_0_IAM_Rx
        PduRTransmissionConfirmation = true
        PduRDestPduRef = COM_RZCU_LHBKBCANFD_50ms_FrP37_CONTROLLER_0_IAM_Rx
      PDUR_ROUTING_LHZCU_LHBKBCANFD_50ms_FrP04_CONTROLLER_0_IAM_Rx (PduRRoutingPath):
        PduRRouteType = IF
        PduRDestPduRRef = PduRDestPdu_LHZCU_LHBKBCANFD_50ms_FrP04_CONTROLLER_0_IAM_Rx
        PduRSrcPduRRef = PduRSrcPdu_LHZCU_LHBKBCANFD_50ms_FrP04_CONTROLLER_0_IAM_Rx
      PduRSrcPdu_LHZCU_LHBKBCANFD_50ms_FrP04_CONTROLLER_0_IAM_Rx (PduRSrcPdu):
        PduRSourcePduHandleId = PDUR_SRCPDU_CANIF_LHZCU_LHBKBCANFD_50ms_FrP04_CONTROLLER_0_IAM_Rx
        PduRSrcPduUpTxConf = true
        PduRSrcPduRef = CANIF_LHZCU_LHBKBCANFD_50ms_FrP04_CONTROLLER_0_IAM_Rx
      PduRDestPdu_LHZCU_LHBKBCANFD_50ms_FrP04_CONTROLLER_0_IAM_Rx (PduRDestPdu):
        PduRDestPduDataProvision = PDUR_DIRECT
        PduRDestPduHandleId = PDUR_DESTPDU_COM_LHZCU_LHBKBCANFD_50ms_FrP04_CONTROLLER_0_IAM_Rx
        PduRTransmissionConfirmation = true
        PduRDestPduRef = COM_LHZCU_LHBKBCANFD_50ms_FrP04_CONTROLLER_0_IAM_Rx
      PDUR_ROUTING_LHZCU_BKBCANFD_50ms_FrP24_CONTROLLER_0_IAM_Rx (PduRRoutingPath):
        PduRRouteType = IF
        PduRDestPduRRef = PduRDestPdu_LHZCU_BKBCANFD_50ms_FrP24_CONTROLLER_0_IAM_Rx
        PduRSrcPduRRef = PduRSrcPdu_LHZCU_BKBCANFD_50ms_FrP24_CONTROLLER_0_IAM_Rx
      PduRSrcPdu_LHZCU_BKBCANFD_50ms_FrP24_CONTROLLER_0_IAM_Rx (PduRSrcPdu):
        PduRSourcePduHandleId = PDUR_SRCPDU_CANIF_LHZCU_BKBCANFD_50ms_FrP24_CONTROLLER_0_IAM_Rx
        PduRSrcPduUpTxConf = true
        PduRSrcPduRef = CANIF_LHZCU_BKBCANFD_50ms_FrP24_CONTROLLER_0_IAM_Rx
      PduRDestPdu_LHZCU_BKBCANFD_50ms_FrP24_CONTROLLER_0_IAM_Rx (PduRDestPdu):
        PduRDestPduDataProvision = PDUR_DIRECT
        PduRDestPduHandleId = PDUR_DESTPDU_COM_LHZCU_BKBCANFD_50ms_FrP24_CONTROLLER_0_IAM_Rx
        PduRTransmissionConfirmation = true
        PduRDestPduRef = COM_LHZCU_BKBCANFD_50ms_FrP24_CONTROLLER_0_IAM_Rx
      PDUR_ROUTING_LHZCU_LHBKBCANFD_50ms_FrP06_CONTROLLER_0_IAM_Rx (PduRRoutingPath):
        PduRRouteType = IF
        PduRDestPduRRef = PduRDestPdu_LHZCU_LHBKBCANFD_50ms_FrP06_CONTROLLER_0_IAM_Rx
        PduRSrcPduRRef = PduRSrcPdu_LHZCU_LHBKBCANFD_50ms_FrP06_CONTROLLER_0_IAM_Rx
      PduRSrcPdu_LHZCU_LHBKBCANFD_50ms_FrP06_CONTROLLER_0_IAM_Rx (PduRSrcPdu):
        PduRSourcePduHandleId = PDUR_SRCPDU_CANIF_LHZCU_LHBKBCANFD_50ms_FrP06_CONTROLLER_0_IAM_Rx
        PduRSrcPduUpTxConf = true
        PduRSrcPduRef = CANIF_LHZCU_LHBKBCANFD_50ms_FrP06_CONTROLLER_0_IAM_Rx
      PduRDestPdu_LHZCU_LHBKBCANFD_50ms_FrP06_CONTROLLER_0_IAM_Rx (PduRDestPdu):
        PduRDestPduDataProvision = PDUR_DIRECT
        PduRDestPduHandleId = PDUR_DESTPDU_COM_LHZCU_LHBKBCANFD_50ms_FrP06_CONTROLLER_0_IAM_Rx
        PduRTransmissionConfirmation = true
        PduRDestPduRef = COM_LHZCU_LHBKBCANFD_50ms_FrP06_CONTROLLER_0_IAM_Rx
      PDUR_ROUTING_ESS_PTEXTDCAN_100ms_FrP33_CONTROLLER_0_IAM_Rx (PduRRoutingPath):
        PduRRouteType = IF
        PduRDestPduRRef = PduRDestPdu_ESS_PTEXTDCAN_100ms_FrP33_CONTROLLER_0_IAM_Rx
        PduRSrcPduRRef = PduRSrcPdu_ESS_PTEXTDCAN_100ms_FrP33_CONTROLLER_0_IAM_Rx
      PduRSrcPdu_ESS_PTEXTDCAN_100ms_FrP33_CONTROLLER_0_IAM_Rx (PduRSrcPdu):
        PduRSourcePduHandleId = PDUR_SRCPDU_CANIF_ESS_PTEXTDCAN_100ms_FrP33_CONTROLLER_0_IAM_Rx
        PduRSrcPduUpTxConf = true
        PduRSrcPduRef = CANIF_ESS_PTEXTDCAN_100ms_FrP33_CONTROLLER_0_IAM_Rx
      PduRDestPdu_ESS_PTEXTDCAN_100ms_FrP33_CONTROLLER_0_IAM_Rx (PduRDestPdu):
        PduRDestPduDataProvision = PDUR_DIRECT
        PduRDestPduHandleId = PDUR_DESTPDU_COM_ESS_PTEXTDCAN_100ms_FrP33_CONTROLLER_0_IAM_Rx
        PduRTransmissionConfirmation = true
        PduRDestPduRef = COM_ESS_PTEXTDCAN_100ms_FrP33_CONTROLLER_0_IAM_Rx
      PDUR_ROUTING_PEU_ERCANFD_50ms_FrP10_CONTROLLER_0_IAM_Rx (PduRRoutingPath):
        PduRRouteType = IF
        PduRDestPduRRef = PduRDestPdu_PEU_ERCANFD_50ms_FrP10_CONTROLLER_0_IAM_Rx
        PduRSrcPduRRef = PduRSrcPdu_PEU_ERCANFD_50ms_FrP10_CONTROLLER_0_IAM_Rx
      PduRSrcPdu_PEU_ERCANFD_50ms_FrP10_CONTROLLER_0_IAM_Rx (PduRSrcPdu):
        PduRSourcePduHandleId = PDUR_SRCPDU_CANIF_PEU_ERCANFD_50ms_FrP10_CONTROLLER_0_IAM_Rx
        PduRSrcPduUpTxConf = true
        PduRSrcPduRef = CANIF_PEU_ERCANFD_50ms_FrP10_CONTROLLER_0_IAM_Rx
      PduRDestPdu_PEU_ERCANFD_50ms_FrP10_CONTROLLER_0_IAM_Rx (PduRDestPdu):
        PduRDestPduDataProvision = PDUR_DIRECT
        PduRDestPduHandleId = PDUR_DESTPDU_COM_PEU_ERCANFD_50ms_FrP10_CONTROLLER_0_IAM_Rx
        PduRTransmissionConfirmation = true
        PduRDestPduRef = COM_PEU_ERCANFD_50ms_FrP10_CONTROLLER_0_IAM_Rx
      PDUR_ROUTING_LVBM_PTEXTDCAN_100ms_FrP01_CONTROLLER_0_IAM_Rx (PduRRoutingPath):
        PduRRouteType = IF
        PduRDestPduRRef = PduRDestPdu_LVBM_PTEXTDCAN_100ms_FrP01_CONTROLLER_0_IAM_Rx
        PduRSrcPduRRef = PduRSrcPdu_LVBM_PTEXTDCAN_100ms_FrP01_CONTROLLER_0_IAM_Rx
      PduRSrcPdu_LVBM_PTEXTDCAN_100ms_FrP01_CONTROLLER_0_IAM_Rx (PduRSrcPdu):
        PduRSourcePduHandleId = PDUR_SRCPDU_CANIF_LVBM_PTEXTDCAN_100ms_FrP01_CONTROLLER_0_IAM_Rx
        PduRSrcPduUpTxConf = true
        PduRSrcPduRef = CANIF_LVBM_PTEXTDCAN_100ms_FrP01_CONTROLLER_0_IAM_Rx
      PduRDestPdu_LVBM_PTEXTDCAN_100ms_FrP01_CONTROLLER_0_IAM_Rx (PduRDestPdu):
        PduRDestPduDataProvision = PDUR_DIRECT
        PduRDestPduHandleId = PDUR_DESTPDU_COM_LVBM_PTEXTDCAN_100ms_FrP01_CONTROLLER_0_IAM_Rx
        PduRTransmissionConfirmation = true
        PduRDestPduRef = COM_LVBM_PTEXTDCAN_100ms_FrP01_CONTROLLER_0_IAM_Rx
      PDUR_ROUTING_ICBAD_BKPCANFD_100ms_FrP42_CONTROLLER_0_IAM_Rx (PduRRoutingPath):
        PduRRouteType = IF
        PduRDestPduRRef = PduRDestPdu_ICBAD_BKPCANFD_100ms_FrP42_CONTROLLER_0_IAM_Rx
        PduRSrcPduRRef = PduRSrcPdu_ICBAD_BKPCANFD_100ms_FrP42_CONTROLLER_0_IAM_Rx
      PduRSrcPdu_ICBAD_BKPCANFD_100ms_FrP42_CONTROLLER_0_IAM_Rx (PduRSrcPdu):
        PduRSourcePduHandleId = PDUR_SRCPDU_CANIF_ICBAD_BKPCANFD_100ms_FrP42_CONTROLLER_0_IAM_Rx
        PduRSrcPduUpTxConf = true
        PduRSrcPduRef = CANIF_ICBAD_BKPCANFD_100ms_FrP42_CONTROLLER_0_IAM_Rx
      PduRDestPdu_ICBAD_BKPCANFD_100ms_FrP42_CONTROLLER_0_IAM_Rx (PduRDestPdu):
        PduRDestPduDataProvision = PDUR_DIRECT
        PduRDestPduHandleId = PDUR_DESTPDU_COM_ICBAD_BKPCANFD_100ms_FrP42_CONTROLLER_0_IAM_Rx
        PduRTransmissionConfirmation = true
        PduRDestPduRef = COM_ICBAD_BKPCANFD_100ms_FrP42_CONTROLLER_0_IAM_Rx
      PDUR_ROUTING_PEU_ERCANFD_100ms_FrP15_CONTROLLER_0_IAM_Rx (PduRRoutingPath):
        PduRRouteType = IF
        PduRDestPduRRef = PduRDestPdu_PEU_ERCANFD_100ms_FrP15_CONTROLLER_0_IAM_Rx
        PduRSrcPduRRef = PduRSrcPdu_PEU_ERCANFD_100ms_FrP15_CONTROLLER_0_IAM_Rx
      PduRSrcPdu_PEU_ERCANFD_100ms_FrP15_CONTROLLER_0_IAM_Rx (PduRSrcPdu):
        PduRSourcePduHandleId = PDUR_SRCPDU_CANIF_PEU_ERCANFD_100ms_FrP15_CONTROLLER_0_IAM_Rx
        PduRSrcPduUpTxConf = true
        PduRSrcPduRef = CANIF_PEU_ERCANFD_100ms_FrP15_CONTROLLER_0_IAM_Rx
      PduRDestPdu_PEU_ERCANFD_100ms_FrP15_CONTROLLER_0_IAM_Rx (PduRDestPdu):
        PduRDestPduDataProvision = PDUR_DIRECT
        PduRDestPduHandleId = PDUR_DESTPDU_COM_PEU_ERCANFD_100ms_FrP15_CONTROLLER_0_IAM_Rx
        PduRTransmissionConfirmation = true
        PduRDestPduRef = COM_PEU_ERCANFD_100ms_FrP15_CONTROLLER_0_IAM_Rx
      PDUR_ROUTING_IPD_BKPCANFD_100ms_FrP50_CONTROLLER_0_IAM_Rx (PduRRoutingPath):
        PduRRouteType = IF
        PduRDestPduRRef = PduRDestPdu_IPD_BKPCANFD_100ms_FrP50_CONTROLLER_0_IAM_Rx
        PduRSrcPduRRef = PduRSrcPdu_IPD_BKPCANFD_100ms_FrP50_CONTROLLER_0_IAM_Rx
      PduRSrcPdu_IPD_BKPCANFD_100ms_FrP50_CONTROLLER_0_IAM_Rx (PduRSrcPdu):
        PduRSourcePduHandleId = PDUR_SRCPDU_CANIF_IPD_BKPCANFD_100ms_FrP50_CONTROLLER_0_IAM_Rx
        PduRSrcPduUpTxConf = true
        PduRSrcPduRef = CANIF_IPD_BKPCANFD_100ms_FrP50_CONTROLLER_0_IAM_Rx
      PduRDestPdu_IPD_BKPCANFD_100ms_FrP50_CONTROLLER_0_IAM_Rx (PduRDestPdu):
        PduRDestPduDataProvision = PDUR_DIRECT
        PduRDestPduHandleId = PDUR_DESTPDU_COM_IPD_BKPCANFD_100ms_FrP50_CONTROLLER_0_IAM_Rx
        PduRTransmissionConfirmation = true
        PduRDestPduRef = COM_IPD_BKPCANFD_100ms_FrP50_CONTROLLER_0_IAM_Rx
      PDUR_ROUTING_ESS_PTCANFD_100ms_FrP28_CONTROLLER_0_IAM_Rx (PduRRoutingPath):
        PduRRouteType = IF
        PduRDestPduRRef = PduRDestPdu_ESS_PTCANFD_100ms_FrP28_CONTROLLER_0_IAM_Rx
        PduRSrcPduRRef = PduRSrcPdu_ESS_PTCANFD_100ms_FrP28_CONTROLLER_0_IAM_Rx
      PduRSrcPdu_ESS_PTCANFD_100ms_FrP28_CONTROLLER_0_IAM_Rx (PduRSrcPdu):
        PduRSourcePduHandleId = PDUR_SRCPDU_CANIF_ESS_PTCANFD_100ms_FrP28_CONTROLLER_0_IAM_Rx
        PduRSrcPduUpTxConf = true
        PduRSrcPduRef = CANIF_ESS_PTCANFD_100ms_FrP28_CONTROLLER_0_IAM_Rx
      PduRDestPdu_ESS_PTCANFD_100ms_FrP28_CONTROLLER_0_IAM_Rx (PduRDestPdu):
        PduRDestPduDataProvision = PDUR_DIRECT
        PduRDestPduHandleId = PDUR_DESTPDU_COM_ESS_PTCANFD_100ms_FrP28_CONTROLLER_0_IAM_Rx
        PduRTransmissionConfirmation = true
        PduRDestPduRef = COM_ESS_PTCANFD_100ms_FrP28_CONTROLLER_0_IAM_Rx
      PDUR_ROUTING_ESS_ZONE_PTCANFD_100ms_FrP16_CONTROLLER_0_IAM_Rx (PduRRoutingPath):
        PduRRouteType = IF
        PduRDestPduRRef = PduRDestPdu_ESS_ZONE_PTCANFD_100ms_FrP16_CONTROLLER_0_IAM_Rx
        PduRSrcPduRRef = PduRSrcPdu_ESS_ZONE_PTCANFD_100ms_FrP16_CONTROLLER_0_IAM_Rx
      PduRSrcPdu_ESS_ZONE_PTCANFD_100ms_FrP16_CONTROLLER_0_IAM_Rx (PduRSrcPdu):
        PduRSourcePduHandleId = PDUR_SRCPDU_CANIF_ESS_ZONE_PTCANFD_100ms_FrP16_CONTROLLER_0_IAM_Rx
        PduRSrcPduUpTxConf = true
        PduRSrcPduRef = CANIF_ESS_ZONE_PTCANFD_100ms_FrP16_CONTROLLER_0_IAM_Rx
      PduRDestPdu_ESS_ZONE_PTCANFD_100ms_FrP16_CONTROLLER_0_IAM_Rx (PduRDestPdu):
        PduRDestPduDataProvision = PDUR_DIRECT
        PduRDestPduHandleId = PDUR_DESTPDU_COM_ESS_ZONE_PTCANFD_100ms_FrP16_CONTROLLER_0_IAM_Rx
        PduRTransmissionConfirmation = true
        PduRDestPduRef = COM_ESS_ZONE_PTCANFD_100ms_FrP16_CONTROLLER_0_IAM_Rx
      PDUR_ROUTING_ESS_PTCANFD_100ms_FrP22_CONTROLLER_0_IAM_Rx (PduRRoutingPath):
        PduRRouteType = IF
        PduRDestPduRRef = PduRDestPdu_ESS_PTCANFD_100ms_FrP22_CONTROLLER_0_IAM_Rx
        PduRSrcPduRRef = PduRSrcPdu_ESS_PTCANFD_100ms_FrP22_CONTROLLER_0_IAM_Rx
      PduRSrcPdu_ESS_PTCANFD_100ms_FrP22_CONTROLLER_0_IAM_Rx (PduRSrcPdu):
        PduRSourcePduHandleId = PDUR_SRCPDU_CANIF_ESS_PTCANFD_100ms_FrP22_CONTROLLER_0_IAM_Rx
        PduRSrcPduUpTxConf = true
        PduRSrcPduRef = CANIF_ESS_PTCANFD_100ms_FrP22_CONTROLLER_0_IAM_Rx
      PduRDestPdu_ESS_PTCANFD_100ms_FrP22_CONTROLLER_0_IAM_Rx (PduRDestPdu):
        PduRDestPduDataProvision = PDUR_DIRECT
        PduRDestPduHandleId = PDUR_DESTPDU_COM_ESS_PTCANFD_100ms_FrP22_CONTROLLER_0_IAM_Rx
        PduRTransmissionConfirmation = true
        PduRDestPduRef = COM_ESS_PTCANFD_100ms_FrP22_CONTROLLER_0_IAM_Rx
      PDUR_ROUTING_ESS_PTCANFD_100ms_FrP20_CONTROLLER_0_IAM_Rx (PduRRoutingPath):
        PduRRouteType = IF
        PduRDestPduRRef = PduRDestPdu_ESS_PTCANFD_100ms_FrP20_CONTROLLER_0_IAM_Rx
        PduRSrcPduRRef = PduRSrcPdu_ESS_PTCANFD_100ms_FrP20_CONTROLLER_0_IAM_Rx
      PduRSrcPdu_ESS_PTCANFD_100ms_FrP20_CONTROLLER_0_IAM_Rx (PduRSrcPdu):
        PduRSourcePduHandleId = PDUR_SRCPDU_CANIF_ESS_PTCANFD_100ms_FrP20_CONTROLLER_0_IAM_Rx
        PduRSrcPduUpTxConf = true
        PduRSrcPduRef = CANIF_ESS_PTCANFD_100ms_FrP20_CONTROLLER_0_IAM_Rx
      PduRDestPdu_ESS_PTCANFD_100ms_FrP20_CONTROLLER_0_IAM_Rx (PduRDestPdu):
        PduRDestPduDataProvision = PDUR_DIRECT
        PduRDestPduHandleId = PDUR_DESTPDU_COM_ESS_PTCANFD_100ms_FrP20_CONTROLLER_0_IAM_Rx
        PduRTransmissionConfirmation = true
        PduRDestPduRef = COM_ESS_PTCANFD_100ms_FrP20_CONTROLLER_0_IAM_Rx
      PDUR_ROUTING_RZCU_PTCANFD_100ms_FrP10_CONTROLLER_0_IAM_Rx (PduRRoutingPath):
        PduRRouteType = IF
        PduRDestPduRRef = PduRDestPdu_RZCU_PTCANFD_100ms_FrP10_CONTROLLER_0_IAM_Rx
        PduRSrcPduRRef = PduRSrcPdu_RZCU_PTCANFD_100ms_FrP10_CONTROLLER_0_IAM_Rx
      PduRSrcPdu_RZCU_PTCANFD_100ms_FrP10_CONTROLLER_0_IAM_Rx (PduRSrcPdu):
        PduRSourcePduHandleId = PDUR_SRCPDU_CANIF_RZCU_PTCANFD_100ms_FrP10_CONTROLLER_0_IAM_Rx
        PduRSrcPduUpTxConf = true
        PduRSrcPduRef = CANIF_RZCU_PTCANFD_100ms_FrP10_CONTROLLER_0_IAM_Rx
      PduRDestPdu_RZCU_PTCANFD_100ms_FrP10_CONTROLLER_0_IAM_Rx (PduRDestPdu):
        PduRDestPduDataProvision = PDUR_DIRECT
        PduRDestPduHandleId = PDUR_DESTPDU_COM_RZCU_PTCANFD_100ms_FrP10_CONTROLLER_0_IAM_Rx
        PduRTransmissionConfirmation = true
        PduRDestPduRef = COM_RZCU_PTCANFD_100ms_FrP10_CONTROLLER_0_IAM_Rx
      PDUR_ROUTING_ESS_PTCANFD_100ms_FrP35_CONTROLLER_0_IAM_Rx (PduRRoutingPath):
        PduRRouteType = IF
        PduRDestPduRRef = PduRDestPdu_ESS_PTCANFD_100ms_FrP35_CONTROLLER_0_IAM_Rx
        PduRSrcPduRRef = PduRSrcPdu_ESS_PTCANFD_100ms_FrP35_CONTROLLER_0_IAM_Rx
      PduRSrcPdu_ESS_PTCANFD_100ms_FrP35_CONTROLLER_0_IAM_Rx (PduRSrcPdu):
        PduRSourcePduHandleId = PDUR_SRCPDU_CANIF_ESS_PTCANFD_100ms_FrP35_CONTROLLER_0_IAM_Rx
        PduRSrcPduUpTxConf = true
        PduRSrcPduRef = CANIF_ESS_PTCANFD_100ms_FrP35_CONTROLLER_0_IAM_Rx
      PduRDestPdu_ESS_PTCANFD_100ms_FrP35_CONTROLLER_0_IAM_Rx (PduRDestPdu):
        PduRDestPduDataProvision = PDUR_DIRECT
        PduRDestPduHandleId = PDUR_DESTPDU_COM_ESS_PTCANFD_100ms_FrP35_CONTROLLER_0_IAM_Rx
        PduRTransmissionConfirmation = true
        PduRDestPduRef = COM_ESS_PTCANFD_100ms_FrP35_CONTROLLER_0_IAM_Rx
      PDUR_ROUTING_LHZCU_LHBKBCANFD_100ms_FrP12_CONTROLLER_0_IAM_Rx (PduRRoutingPath):
        PduRRouteType = IF
        PduRDestPduRRef = PduRDestPdu_LHZCU_LHBKBCANFD_100ms_FrP12_CONTROLLER_0_IAM_Rx
        PduRSrcPduRRef = PduRSrcPdu_LHZCU_LHBKBCANFD_100ms_FrP12_CONTROLLER_0_IAM_Rx
      PduRSrcPdu_LHZCU_LHBKBCANFD_100ms_FrP12_CONTROLLER_0_IAM_Rx (PduRSrcPdu):
        PduRSourcePduHandleId = PDUR_SRCPDU_CANIF_LHZCU_LHBKBCANFD_100ms_FrP12_CONTROLLER_0_IAM_Rx
        PduRSrcPduUpTxConf = true
        PduRSrcPduRef = CANIF_LHZCU_LHBKBCANFD_100ms_FrP12_CONTROLLER_0_IAM_Rx
      PduRDestPdu_LHZCU_LHBKBCANFD_100ms_FrP12_CONTROLLER_0_IAM_Rx (PduRDestPdu):
        PduRDestPduDataProvision = PDUR_DIRECT
        PduRDestPduHandleId = PDUR_DESTPDU_COM_LHZCU_LHBKBCANFD_100ms_FrP12_CONTROLLER_0_IAM_Rx
        PduRTransmissionConfirmation = true
        PduRDestPduRef = COM_LHZCU_LHBKBCANFD_100ms_FrP12_CONTROLLER_0_IAM_Rx
      PDUR_ROUTING_ESS_PTEXTDCAN_100ms_FrP23_CONTROLLER_0_IAM_Rx (PduRRoutingPath):
        PduRRouteType = IF
        PduRDestPduRRef = PduRDestPdu_ESS_PTEXTDCAN_100ms_FrP23_CONTROLLER_0_IAM_Rx
        PduRSrcPduRRef = PduRSrcPdu_ESS_PTEXTDCAN_100ms_FrP23_CONTROLLER_0_IAM_Rx
      PduRSrcPdu_ESS_PTEXTDCAN_100ms_FrP23_CONTROLLER_0_IAM_Rx (PduRSrcPdu):
        PduRSourcePduHandleId = PDUR_SRCPDU_CANIF_ESS_PTEXTDCAN_100ms_FrP23_CONTROLLER_0_IAM_Rx
        PduRSrcPduUpTxConf = true
        PduRSrcPduRef = CANIF_ESS_PTEXTDCAN_100ms_FrP23_CONTROLLER_0_IAM_Rx
      PduRDestPdu_ESS_PTEXTDCAN_100ms_FrP23_CONTROLLER_0_IAM_Rx (PduRDestPdu):
        PduRDestPduDataProvision = PDUR_DIRECT
        PduRDestPduHandleId = PDUR_DESTPDU_COM_ESS_PTEXTDCAN_100ms_FrP23_CONTROLLER_0_IAM_Rx
        PduRTransmissionConfirmation = true
        PduRDestPduRef = COM_ESS_PTEXTDCAN_100ms_FrP23_CONTROLLER_0_IAM_Rx
      PDUR_ROUTING_ESS_PTCANFD_100ms_FrP36_CONTROLLER_0_IAM_Rx (PduRRoutingPath):
        PduRRouteType = IF
        PduRDestPduRRef = PduRDestPdu_ESS_PTCANFD_100ms_FrP36_CONTROLLER_0_IAM_Rx
        PduRSrcPduRRef = PduRSrcPdu_ESS_PTCANFD_100ms_FrP36_CONTROLLER_0_IAM_Rx
      PduRSrcPdu_ESS_PTCANFD_100ms_FrP36_CONTROLLER_0_IAM_Rx (PduRSrcPdu):
        PduRSourcePduHandleId = PDUR_SRCPDU_CANIF_ESS_PTCANFD_100ms_FrP36_CONTROLLER_0_IAM_Rx
        PduRSrcPduUpTxConf = true
        PduRSrcPduRef = CANIF_ESS_PTCANFD_100ms_FrP36_CONTROLLER_0_IAM_Rx
      PduRDestPdu_ESS_PTCANFD_100ms_FrP36_CONTROLLER_0_IAM_Rx (PduRDestPdu):
        PduRDestPduDataProvision = PDUR_DIRECT
        PduRDestPduHandleId = PDUR_DESTPDU_COM_ESS_PTCANFD_100ms_FrP36_CONTROLLER_0_IAM_Rx
        PduRTransmissionConfirmation = true
        PduRDestPduRef = COM_ESS_PTCANFD_100ms_FrP36_CONTROLLER_0_IAM_Rx
      PDUR_ROUTING_ICBVC_FOTASts_100ms_FrP47_CONTROLLER_0_IAM_Rx (PduRRoutingPath):
        PduRRouteType = IF
        PduRDestPduRRef = PduRDestPdu_ICBVC_FOTASts_100ms_FrP47_CONTROLLER_0_IAM_Rx
        PduRSrcPduRRef = PduRSrcPdu_ICBVC_FOTASts_100ms_FrP47_CONTROLLER_0_IAM_Rx
      PduRSrcPdu_ICBVC_FOTASts_100ms_FrP47_CONTROLLER_0_IAM_Rx (PduRSrcPdu):
        PduRSourcePduHandleId = PDUR_SRCPDU_CANIF_ICBVC_FOTASts_100ms_FrP47_CONTROLLER_0_IAM_Rx
        PduRSrcPduUpTxConf = true
        PduRSrcPduRef = CANIF_ICBVC_FOTASts_100ms_FrP47_CONTROLLER_0_IAM_Rx
      PduRDestPdu_ICBVC_FOTASts_100ms_FrP47_CONTROLLER_0_IAM_Rx (PduRDestPdu):
        PduRDestPduDataProvision = PDUR_DIRECT
        PduRDestPduHandleId = PDUR_DESTPDU_COM_ICBVC_FOTASts_100ms_FrP47_CONTROLLER_0_IAM_Rx
        PduRTransmissionConfirmation = true
        PduRDestPduRef = COM_ICBVC_FOTASts_100ms_FrP47_CONTROLLER_0_IAM_Rx
      PDUR_ROUTING_CCU_PTCANFD_100ms_FrP02_CONTROLLER_0_IAM_Rx (PduRRoutingPath):
        PduRRouteType = IF
        PduRDestPduRRef = PduRDestPdu_CCU_PTCANFD_100ms_FrP02_CONTROLLER_0_IAM_Rx
        PduRSrcPduRRef = PduRSrcPdu_CCU_PTCANFD_100ms_FrP02_CONTROLLER_0_IAM_Rx
      PduRSrcPdu_CCU_PTCANFD_100ms_FrP02_CONTROLLER_0_IAM_Rx (PduRSrcPdu):
        PduRSourcePduHandleId = PDUR_SRCPDU_CANIF_CCU_PTCANFD_100ms_FrP02_CONTROLLER_0_IAM_Rx
        PduRSrcPduUpTxConf = true
        PduRSrcPduRef = CANIF_CCU_PTCANFD_100ms_FrP02_CONTROLLER_0_IAM_Rx
      PduRDestPdu_CCU_PTCANFD_100ms_FrP02_CONTROLLER_0_IAM_Rx (PduRDestPdu):
        PduRDestPduDataProvision = PDUR_DIRECT
        PduRDestPduHandleId = PDUR_DESTPDU_COM_CCU_PTCANFD_100ms_FrP02_CONTROLLER_0_IAM_Rx
        PduRTransmissionConfirmation = true
        PduRDestPduRef = COM_CCU_PTCANFD_100ms_FrP02_CONTROLLER_0_IAM_Rx
      PDUR_ROUTING_ICBVC_RZCUCANFD_100ms_FrP45_CONTROLLER_0_IAM_Rx (PduRRoutingPath):
        PduRRouteType = IF
        PduRDestPduRRef = PduRDestPdu_ICBVC_RZCUCANFD_100ms_FrP45_CONTROLLER_0_IAM_Rx
        PduRSrcPduRRef = PduRSrcPdu_ICBVC_RZCUCANFD_100ms_FrP45_CONTROLLER_0_IAM_Rx
      PduRSrcPdu_ICBVC_RZCUCANFD_100ms_FrP45_CONTROLLER_0_IAM_Rx (PduRSrcPdu):
        PduRSourcePduHandleId = PDUR_SRCPDU_CANIF_ICBVC_RZCUCANFD_100ms_FrP45_CONTROLLER_0_IAM_Rx
        PduRSrcPduUpTxConf = true
        PduRSrcPduRef = CANIF_ICBVC_RZCUCANFD_100ms_FrP45_CONTROLLER_0_IAM_Rx
      PduRDestPdu_ICBVC_RZCUCANFD_100ms_FrP45_CONTROLLER_0_IAM_Rx (PduRDestPdu):
        PduRDestPduDataProvision = PDUR_DIRECT
        PduRDestPduHandleId = PDUR_DESTPDU_COM_ICBVC_RZCUCANFD_100ms_FrP45_CONTROLLER_0_IAM_Rx
        PduRTransmissionConfirmation = true
        PduRDestPduRef = COM_ICBVC_RZCUCANFD_100ms_FrP45_CONTROLLER_0_IAM_Rx
      PDUR_ROUTING_ESS_PTCANFD_100ms_FrP15_CONTROLLER_0_IAM_Rx (PduRRoutingPath):
        PduRRouteType = IF
        PduRDestPduRRef = PduRDestPdu_ESS_PTCANFD_100ms_FrP15_CONTROLLER_0_IAM_Rx
        PduRSrcPduRRef = PduRSrcPdu_ESS_PTCANFD_100ms_FrP15_CONTROLLER_0_IAM_Rx
      PduRSrcPdu_ESS_PTCANFD_100ms_FrP15_CONTROLLER_0_IAM_Rx (PduRSrcPdu):
        PduRSourcePduHandleId = PDUR_SRCPDU_CANIF_ESS_PTCANFD_100ms_FrP15_CONTROLLER_0_IAM_Rx
        PduRSrcPduUpTxConf = true
        PduRSrcPduRef = CANIF_ESS_PTCANFD_100ms_FrP15_CONTROLLER_0_IAM_Rx
      PduRDestPdu_ESS_PTCANFD_100ms_FrP15_CONTROLLER_0_IAM_Rx (PduRDestPdu):
        PduRDestPduDataProvision = PDUR_DIRECT
        PduRDestPduHandleId = PDUR_DESTPDU_COM_ESS_PTCANFD_100ms_FrP15_CONTROLLER_0_IAM_Rx
        PduRTransmissionConfirmation = true
        PduRDestPduRef = COM_ESS_PTCANFD_100ms_FrP15_CONTROLLER_0_IAM_Rx
      PDUR_ROUTING_ESS_PTCANFD_100ms_FrP32_CONTROLLER_0_IAM_Rx (PduRRoutingPath):
        PduRRouteType = IF
        PduRDestPduRRef = PduRDestPdu_ESS_PTCANFD_100ms_FrP32_CONTROLLER_0_IAM_Rx
        PduRSrcPduRRef = PduRSrcPdu_ESS_PTCANFD_100ms_FrP32_CONTROLLER_0_IAM_Rx
      PduRSrcPdu_ESS_PTCANFD_100ms_FrP32_CONTROLLER_0_IAM_Rx (PduRSrcPdu):
        PduRSourcePduHandleId = PDUR_SRCPDU_CANIF_ESS_PTCANFD_100ms_FrP32_CONTROLLER_0_IAM_Rx
        PduRSrcPduUpTxConf = true
        PduRSrcPduRef = CANIF_ESS_PTCANFD_100ms_FrP32_CONTROLLER_0_IAM_Rx
      PduRDestPdu_ESS_PTCANFD_100ms_FrP32_CONTROLLER_0_IAM_Rx (PduRDestPdu):
        PduRDestPduDataProvision = PDUR_DIRECT
        PduRDestPduHandleId = PDUR_DESTPDU_COM_ESS_PTCANFD_100ms_FrP32_CONTROLLER_0_IAM_Rx
        PduRTransmissionConfirmation = true
        PduRDestPduRef = COM_ESS_PTCANFD_100ms_FrP32_CONTROLLER_0_IAM_Rx
      PDUR_ROUTING_RHZCU_RHBKBCANFD_100ms_FrP12_CONTROLLER_0_IAM_Rx (PduRRoutingPath):
        PduRRouteType = IF
        PduRDestPduRRef = PduRDestPdu_RHZCU_RHBKBCANFD_100ms_FrP12_CONTROLLER_0_IAM_Rx
        PduRSrcPduRRef = PduRSrcPdu_RHZCU_RHBKBCANFD_100ms_FrP12_CONTROLLER_0_IAM_Rx
      PduRSrcPdu_RHZCU_RHBKBCANFD_100ms_FrP12_CONTROLLER_0_IAM_Rx (PduRSrcPdu):
        PduRSourcePduHandleId = PDUR_SRCPDU_CANIF_RHZCU_RHBKBCANFD_100ms_FrP12_CONTROLLER_0_IAM_Rx
        PduRSrcPduUpTxConf = true
        PduRSrcPduRef = CANIF_RHZCU_RHBKBCANFD_100ms_FrP12_CONTROLLER_0_IAM_Rx
      PduRDestPdu_RHZCU_RHBKBCANFD_100ms_FrP12_CONTROLLER_0_IAM_Rx (PduRDestPdu):
        PduRDestPduDataProvision = PDUR_DIRECT
        PduRDestPduHandleId = PDUR_DESTPDU_COM_RHZCU_RHBKBCANFD_100ms_FrP12_CONTROLLER_0_IAM_Rx
        PduRTransmissionConfirmation = true
        PduRDestPduRef = COM_RHZCU_RHBKBCANFD_100ms_FrP12_CONTROLLER_0_IAM_Rx
      PDUR_ROUTING_RHZCU_RHBKBCANFD_100ms_FrP15_CONTROLLER_0_IAM_Rx (PduRRoutingPath):
        PduRRouteType = IF
        PduRDestPduRRef = PduRDestPdu_RHZCU_RHBKBCANFD_100ms_FrP15_CONTROLLER_0_IAM_Rx
        PduRSrcPduRRef = PduRSrcPdu_RHZCU_RHBKBCANFD_100ms_FrP15_CONTROLLER_0_IAM_Rx
      PduRSrcPdu_RHZCU_RHBKBCANFD_100ms_FrP15_CONTROLLER_0_IAM_Rx (PduRSrcPdu):
        PduRSourcePduHandleId = PDUR_SRCPDU_CANIF_RHZCU_RHBKBCANFD_100ms_FrP15_CONTROLLER_0_IAM_Rx
        PduRSrcPduUpTxConf = true
        PduRSrcPduRef = CANIF_RHZCU_RHBKBCANFD_100ms_FrP15_CONTROLLER_0_IAM_Rx
      PduRDestPdu_RHZCU_RHBKBCANFD_100ms_FrP15_CONTROLLER_0_IAM_Rx (PduRDestPdu):
        PduRDestPduDataProvision = PDUR_DIRECT
        PduRDestPduHandleId = PDUR_DESTPDU_COM_RHZCU_RHBKBCANFD_100ms_FrP15_CONTROLLER_0_IAM_Rx
        PduRTransmissionConfirmation = true
        PduRDestPduRef = COM_RHZCU_RHBKBCANFD_100ms_FrP15_CONTROLLER_0_IAM_Rx
      PDUR_ROUTING_ICBVC_RZCUCANFD_100ms_FrP39_CONTROLLER_0_IAM_Rx (PduRRoutingPath):
        PduRRouteType = IF
        PduRDestPduRRef = PduRDestPdu_ICBVC_RZCUCANFD_100ms_FrP39_CONTROLLER_0_IAM_Rx
        PduRSrcPduRRef = PduRSrcPdu_ICBVC_RZCUCANFD_100ms_FrP39_CONTROLLER_0_IAM_Rx
      PduRSrcPdu_ICBVC_RZCUCANFD_100ms_FrP39_CONTROLLER_0_IAM_Rx (PduRSrcPdu):
        PduRSourcePduHandleId = PDUR_SRCPDU_CANIF_ICBVC_RZCUCANFD_100ms_FrP39_CONTROLLER_0_IAM_Rx
        PduRSrcPduUpTxConf = true
        PduRSrcPduRef = CANIF_ICBVC_RZCUCANFD_100ms_FrP39_CONTROLLER_0_IAM_Rx
      PduRDestPdu_ICBVC_RZCUCANFD_100ms_FrP39_CONTROLLER_0_IAM_Rx (PduRDestPdu):
        PduRDestPduDataProvision = PDUR_DIRECT
        PduRDestPduHandleId = PDUR_DESTPDU_COM_ICBVC_RZCUCANFD_100ms_FrP39_CONTROLLER_0_IAM_Rx
        PduRTransmissionConfirmation = true
        PduRDestPduRef = COM_ICBVC_RZCUCANFD_100ms_FrP39_CONTROLLER_0_IAM_Rx
      PDUR_ROUTING_RZCU_LHBKBCANFD_100ms_FrP32_CONTROLLER_0_IAM_Rx (PduRRoutingPath):
        PduRRouteType = IF
        PduRDestPduRRef = PduRDestPdu_RZCU_LHBKBCANFD_100ms_FrP32_CONTROLLER_0_IAM_Rx
        PduRSrcPduRRef = PduRSrcPdu_RZCU_LHBKBCANFD_100ms_FrP32_CONTROLLER_0_IAM_Rx
      PduRSrcPdu_RZCU_LHBKBCANFD_100ms_FrP32_CONTROLLER_0_IAM_Rx (PduRSrcPdu):
        PduRSourcePduHandleId = PDUR_SRCPDU_CANIF_RZCU_LHBKBCANFD_100ms_FrP32_CONTROLLER_0_IAM_Rx
        PduRSrcPduUpTxConf = true
        PduRSrcPduRef = CANIF_RZCU_LHBKBCANFD_100ms_FrP32_CONTROLLER_0_IAM_Rx
      PduRDestPdu_RZCU_LHBKBCANFD_100ms_FrP32_CONTROLLER_0_IAM_Rx (PduRDestPdu):
        PduRDestPduDataProvision = PDUR_DIRECT
        PduRDestPduHandleId = PDUR_DESTPDU_COM_RZCU_LHBKBCANFD_100ms_FrP32_CONTROLLER_0_IAM_Rx
        PduRTransmissionConfirmation = true
        PduRDestPduRef = COM_RZCU_LHBKBCANFD_100ms_FrP32_CONTROLLER_0_IAM_Rx
      PDUR_ROUTING_RHZCU_RHBKBCANFD_100ms_FrP14_CONTROLLER_0_IAM_Rx (PduRRoutingPath):
        PduRRouteType = IF
        PduRDestPduRRef = PduRDestPdu_RHZCU_RHBKBCANFD_100ms_FrP14_CONTROLLER_0_IAM_Rx
        PduRSrcPduRRef = PduRSrcPdu_RHZCU_RHBKBCANFD_100ms_FrP14_CONTROLLER_0_IAM_Rx
      PduRSrcPdu_RHZCU_RHBKBCANFD_100ms_FrP14_CONTROLLER_0_IAM_Rx (PduRSrcPdu):
        PduRSourcePduHandleId = PDUR_SRCPDU_CANIF_RHZCU_RHBKBCANFD_100ms_FrP14_CONTROLLER_0_IAM_Rx
        PduRSrcPduUpTxConf = true
        PduRSrcPduRef = CANIF_RHZCU_RHBKBCANFD_100ms_FrP14_CONTROLLER_0_IAM_Rx
      PduRDestPdu_RHZCU_RHBKBCANFD_100ms_FrP14_CONTROLLER_0_IAM_Rx (PduRDestPdu):
        PduRDestPduDataProvision = PDUR_DIRECT
        PduRDestPduHandleId = PDUR_DESTPDU_COM_RHZCU_RHBKBCANFD_100ms_FrP14_CONTROLLER_0_IAM_Rx
        PduRTransmissionConfirmation = true
        PduRDestPduRef = COM_RHZCU_RHBKBCANFD_100ms_FrP14_CONTROLLER_0_IAM_Rx
      PDUR_ROUTING_ESS_PTEXTDCAN_100ms_FrP27_CONTROLLER_0_IAM_Rx (PduRRoutingPath):
        PduRRouteType = IF
        PduRDestPduRRef = PduRDestPdu_ESS_PTEXTDCAN_100ms_FrP27_CONTROLLER_0_IAM_Rx
        PduRSrcPduRRef = PduRSrcPdu_ESS_PTEXTDCAN_100ms_FrP27_CONTROLLER_0_IAM_Rx
      PduRSrcPdu_ESS_PTEXTDCAN_100ms_FrP27_CONTROLLER_0_IAM_Rx (PduRSrcPdu):
        PduRSourcePduHandleId = PDUR_SRCPDU_CANIF_ESS_PTEXTDCAN_100ms_FrP27_CONTROLLER_0_IAM_Rx
        PduRSrcPduUpTxConf = true
        PduRSrcPduRef = CANIF_ESS_PTEXTDCAN_100ms_FrP27_CONTROLLER_0_IAM_Rx
      PduRDestPdu_ESS_PTEXTDCAN_100ms_FrP27_CONTROLLER_0_IAM_Rx (PduRDestPdu):
        PduRDestPduDataProvision = PDUR_DIRECT
        PduRDestPduHandleId = PDUR_DESTPDU_COM_ESS_PTEXTDCAN_100ms_FrP27_CONTROLLER_0_IAM_Rx
        PduRTransmissionConfirmation = true
        PduRDestPduRef = COM_ESS_PTEXTDCAN_100ms_FrP27_CONTROLLER_0_IAM_Rx
      PDUR_ROUTING_ICBAD_BKPCANFD_100ms_FrP36_CONTROLLER_0_IAM_Rx (PduRRoutingPath):
        PduRRouteType = IF
        PduRDestPduRRef = PduRDestPdu_ICBAD_BKPCANFD_100ms_FrP36_CONTROLLER_0_IAM_Rx
        PduRSrcPduRRef = PduRSrcPdu_ICBAD_BKPCANFD_100ms_FrP36_CONTROLLER_0_IAM_Rx
      PduRSrcPdu_ICBAD_BKPCANFD_100ms_FrP36_CONTROLLER_0_IAM_Rx (PduRSrcPdu):
        PduRSourcePduHandleId = PDUR_SRCPDU_CANIF_ICBAD_BKPCANFD_100ms_FrP36_CONTROLLER_0_IAM_Rx
        PduRSrcPduUpTxConf = true
        PduRSrcPduRef = CANIF_ICBAD_BKPCANFD_100ms_FrP36_CONTROLLER_0_IAM_Rx
      PduRDestPdu_ICBAD_BKPCANFD_100ms_FrP36_CONTROLLER_0_IAM_Rx (PduRDestPdu):
        PduRDestPduDataProvision = PDUR_DIRECT
        PduRDestPduHandleId = PDUR_DESTPDU_COM_ICBAD_BKPCANFD_100ms_FrP36_CONTROLLER_0_IAM_Rx
        PduRTransmissionConfirmation = true
        PduRDestPduRef = COM_ICBAD_BKPCANFD_100ms_FrP36_CONTROLLER_0_IAM_Rx
      PDUR_ROUTING_PEU_ERCANFD_100ms_FrP11_CONTROLLER_0_IAM_Rx (PduRRoutingPath):
        PduRRouteType = IF
        PduRDestPduRRef = PduRDestPdu_PEU_ERCANFD_100ms_FrP11_CONTROLLER_0_IAM_Rx
        PduRSrcPduRRef = PduRSrcPdu_PEU_ERCANFD_100ms_FrP11_CONTROLLER_0_IAM_Rx
      PduRSrcPdu_PEU_ERCANFD_100ms_FrP11_CONTROLLER_0_IAM_Rx (PduRSrcPdu):
        PduRSourcePduHandleId = PDUR_SRCPDU_CANIF_PEU_ERCANFD_100ms_FrP11_CONTROLLER_0_IAM_Rx
        PduRSrcPduUpTxConf = true
        PduRSrcPduRef = CANIF_PEU_ERCANFD_100ms_FrP11_CONTROLLER_0_IAM_Rx
      PduRDestPdu_PEU_ERCANFD_100ms_FrP11_CONTROLLER_0_IAM_Rx (PduRDestPdu):
        PduRDestPduDataProvision = PDUR_DIRECT
        PduRDestPduHandleId = PDUR_DESTPDU_COM_PEU_ERCANFD_100ms_FrP11_CONTROLLER_0_IAM_Rx
        PduRTransmissionConfirmation = true
        PduRDestPduRef = COM_PEU_ERCANFD_100ms_FrP11_CONTROLLER_0_IAM_Rx
      PDUR_ROUTING_ICB_BKBCANFD_100ms_FrP221_CONTROLLER_0_IAM_Rx (PduRRoutingPath):
        PduRRouteType = IF
        PduRDestPduRRef = PduRDestPdu_ICB_BKBCANFD_100ms_FrP221_CONTROLLER_0_IAM_Rx
        PduRSrcPduRRef = PduRSrcPdu_ICB_BKBCANFD_100ms_FrP221_CONTROLLER_0_IAM_Rx
      PduRSrcPdu_ICB_BKBCANFD_100ms_FrP221_CONTROLLER_0_IAM_Rx (PduRSrcPdu):
        PduRSourcePduHandleId = PDUR_SRCPDU_CANIF_ICB_BKBCANFD_100ms_FrP221_CONTROLLER_0_IAM_Rx
        PduRSrcPduUpTxConf = true
        PduRSrcPduRef = CANIF_ICB_BKBCANFD_100ms_FrP221_CONTROLLER_0_IAM_Rx
      PduRDestPdu_ICB_BKBCANFD_100ms_FrP221_CONTROLLER_0_IAM_Rx (PduRDestPdu):
        PduRDestPduDataProvision = PDUR_DIRECT
        PduRDestPduHandleId = PDUR_DESTPDU_COM_ICB_BKBCANFD_100ms_FrP221_CONTROLLER_0_IAM_Rx
        PduRTransmissionConfirmation = true
        PduRDestPduRef = COM_ICB_BKBCANFD_100ms_FrP221_CONTROLLER_0_IAM_Rx
      PDUR_ROUTING_RHZCU_RHBKBCANFD_100ms_FrP13_CONTROLLER_0_IAM_Rx (PduRRoutingPath):
        PduRRouteType = IF
        PduRDestPduRRef = PduRDestPdu_RHZCU_RHBKBCANFD_100ms_FrP13_CONTROLLER_0_IAM_Rx
        PduRSrcPduRRef = PduRSrcPdu_RHZCU_RHBKBCANFD_100ms_FrP13_CONTROLLER_0_IAM_Rx
      PduRSrcPdu_RHZCU_RHBKBCANFD_100ms_FrP13_CONTROLLER_0_IAM_Rx (PduRSrcPdu):
        PduRSourcePduHandleId = PDUR_SRCPDU_CANIF_RHZCU_RHBKBCANFD_100ms_FrP13_CONTROLLER_0_IAM_Rx
        PduRSrcPduUpTxConf = true
        PduRSrcPduRef = CANIF_RHZCU_RHBKBCANFD_100ms_FrP13_CONTROLLER_0_IAM_Rx
      PduRDestPdu_RHZCU_RHBKBCANFD_100ms_FrP13_CONTROLLER_0_IAM_Rx (PduRDestPdu):
        PduRDestPduDataProvision = PDUR_DIRECT
        PduRDestPduHandleId = PDUR_DESTPDU_COM_RHZCU_RHBKBCANFD_100ms_FrP13_CONTROLLER_0_IAM_Rx
        PduRTransmissionConfirmation = true
        PduRDestPduRef = COM_RHZCU_RHBKBCANFD_100ms_FrP13_CONTROLLER_0_IAM_Rx
      PDUR_ROUTING_ICBVC_RZCUCANFD_100ms_FrP80_CONTROLLER_0_IAM_Rx (PduRRoutingPath):
        PduRRouteType = IF
        PduRDestPduRRef = PduRDestPdu_ICBVC_RZCUCANFD_100ms_FrP80_CONTROLLER_0_IAM_Rx
        PduRSrcPduRRef = PduRSrcPdu_ICBVC_RZCUCANFD_100ms_FrP80_CONTROLLER_0_IAM_Rx
      PduRSrcPdu_ICBVC_RZCUCANFD_100ms_FrP80_CONTROLLER_0_IAM_Rx (PduRSrcPdu):
        PduRSourcePduHandleId = PDUR_SRCPDU_CANIF_ICBVC_RZCUCANFD_100ms_FrP80_CONTROLLER_0_IAM_Rx
        PduRSrcPduUpTxConf = true
        PduRSrcPduRef = CANIF_ICBVC_RZCUCANFD_100ms_FrP80_CONTROLLER_0_IAM_Rx
      PduRDestPdu_ICBVC_RZCUCANFD_100ms_FrP80_CONTROLLER_0_IAM_Rx (PduRDestPdu):
        PduRDestPduDataProvision = PDUR_DIRECT
        PduRDestPduHandleId = PDUR_DESTPDU_COM_ICBVC_RZCUCANFD_100ms_FrP80_CONTROLLER_0_IAM_Rx
        PduRTransmissionConfirmation = true
        PduRDestPduRef = COM_ICBVC_RZCUCANFD_100ms_FrP80_CONTROLLER_0_IAM_Rx
      PDUR_ROUTING_ESS_PTEXTDCAN_100ms_FrP24_CONTROLLER_0_IAM_Rx (PduRRoutingPath):
        PduRRouteType = IF
        PduRDestPduRRef = PduRDestPdu_ESS_PTEXTDCAN_100ms_FrP24_CONTROLLER_0_IAM_Rx
        PduRSrcPduRRef = PduRSrcPdu_ESS_PTEXTDCAN_100ms_FrP24_CONTROLLER_0_IAM_Rx
      PduRSrcPdu_ESS_PTEXTDCAN_100ms_FrP24_CONTROLLER_0_IAM_Rx (PduRSrcPdu):
        PduRSourcePduHandleId = PDUR_SRCPDU_CANIF_ESS_PTEXTDCAN_100ms_FrP24_CONTROLLER_0_IAM_Rx
        PduRSrcPduUpTxConf = true
        PduRSrcPduRef = CANIF_ESS_PTEXTDCAN_100ms_FrP24_CONTROLLER_0_IAM_Rx
      PduRDestPdu_ESS_PTEXTDCAN_100ms_FrP24_CONTROLLER_0_IAM_Rx (PduRDestPdu):
        PduRDestPduDataProvision = PDUR_DIRECT
        PduRDestPduHandleId = PDUR_DESTPDU_COM_ESS_PTEXTDCAN_100ms_FrP24_CONTROLLER_0_IAM_Rx
        PduRTransmissionConfirmation = true
        PduRDestPduRef = COM_ESS_PTEXTDCAN_100ms_FrP24_CONTROLLER_0_IAM_Rx
      PDUR_ROUTING_RZCU_RZCUCANFD_100ms_FrP82_CONTROLLER_0_IAM_Rx (PduRRoutingPath):
        PduRRouteType = IF
        PduRDestPduRRef = PduRDestPdu_RZCU_RZCUCANFD_100ms_FrP82_CONTROLLER_0_IAM_Rx
        PduRSrcPduRRef = PduRSrcPdu_RZCU_RZCUCANFD_100ms_FrP82_CONTROLLER_0_IAM_Rx
      PduRSrcPdu_RZCU_RZCUCANFD_100ms_FrP82_CONTROLLER_0_IAM_Rx (PduRSrcPdu):
        PduRSourcePduHandleId = PDUR_SRCPDU_CANIF_RZCU_RZCUCANFD_100ms_FrP82_CONTROLLER_0_IAM_Rx
        PduRSrcPduUpTxConf = true
        PduRSrcPduRef = CANIF_RZCU_RZCUCANFD_100ms_FrP82_CONTROLLER_0_IAM_Rx
      PduRDestPdu_RZCU_RZCUCANFD_100ms_FrP82_CONTROLLER_0_IAM_Rx (PduRDestPdu):
        PduRDestPduDataProvision = PDUR_DIRECT
        PduRDestPduHandleId = PDUR_DESTPDU_COM_RZCU_RZCUCANFD_100ms_FrP82_CONTROLLER_0_IAM_Rx
        PduRTransmissionConfirmation = true
        PduRDestPduRef = COM_RZCU_RZCUCANFD_100ms_FrP82_CONTROLLER_0_IAM_Rx
      PDUR_ROUTING_RHZCU_RHBKBCANFD_100ms_FrP19_CONTROLLER_0_IAM_Rx (PduRRoutingPath):
        PduRRouteType = IF
        PduRDestPduRRef = PduRDestPdu_RHZCU_RHBKBCANFD_100ms_FrP19_CONTROLLER_0_IAM_Rx
        PduRSrcPduRRef = PduRSrcPdu_RHZCU_RHBKBCANFD_100ms_FrP19_CONTROLLER_0_IAM_Rx
      PduRSrcPdu_RHZCU_RHBKBCANFD_100ms_FrP19_CONTROLLER_0_IAM_Rx (PduRSrcPdu):
        PduRSourcePduHandleId = PDUR_SRCPDU_CANIF_RHZCU_RHBKBCANFD_100ms_FrP19_CONTROLLER_0_IAM_Rx
        PduRSrcPduUpTxConf = true
        PduRSrcPduRef = CANIF_RHZCU_RHBKBCANFD_100ms_FrP19_CONTROLLER_0_IAM_Rx
      PduRDestPdu_RHZCU_RHBKBCANFD_100ms_FrP19_CONTROLLER_0_IAM_Rx (PduRDestPdu):
        PduRDestPduDataProvision = PDUR_DIRECT
        PduRDestPduHandleId = PDUR_DESTPDU_COM_RHZCU_RHBKBCANFD_100ms_FrP19_CONTROLLER_0_IAM_Rx
        PduRTransmissionConfirmation = true
        PduRDestPduRef = COM_RHZCU_RHBKBCANFD_100ms_FrP19_CONTROLLER_0_IAM_Rx
      PDUR_ROUTING_LVBM_PTEXTDCAN_100ms_FrP04_CONTROLLER_0_IAM_Rx (PduRRoutingPath):
        PduRRouteType = IF
        PduRDestPduRRef = PduRDestPdu_LVBM_PTEXTDCAN_100ms_FrP04_CONTROLLER_0_IAM_Rx
        PduRSrcPduRRef = PduRSrcPdu_LVBM_PTEXTDCAN_100ms_FrP04_CONTROLLER_0_IAM_Rx
      PduRSrcPdu_LVBM_PTEXTDCAN_100ms_FrP04_CONTROLLER_0_IAM_Rx (PduRSrcPdu):
        PduRSourcePduHandleId = PDUR_SRCPDU_CANIF_LVBM_PTEXTDCAN_100ms_FrP04_CONTROLLER_0_IAM_Rx
        PduRSrcPduUpTxConf = true
        PduRSrcPduRef = CANIF_LVBM_PTEXTDCAN_100ms_FrP04_CONTROLLER_0_IAM_Rx
      PduRDestPdu_LVBM_PTEXTDCAN_100ms_FrP04_CONTROLLER_0_IAM_Rx (PduRDestPdu):
        PduRDestPduDataProvision = PDUR_DIRECT
        PduRDestPduHandleId = PDUR_DESTPDU_COM_LVBM_PTEXTDCAN_100ms_FrP04_CONTROLLER_0_IAM_Rx
        PduRTransmissionConfirmation = true
        PduRDestPduRef = COM_LVBM_PTEXTDCAN_100ms_FrP04_CONTROLLER_0_IAM_Rx
      PDUR_ROUTING_TC_PTCANFD_100ms_FrP05_CONTROLLER_0_IAM_Rx (PduRRoutingPath):
        PduRRouteType = IF
        PduRDestPduRRef = PduRDestPdu_TC_PTCANFD_100ms_FrP05_CONTROLLER_0_IAM_Rx
        PduRSrcPduRRef = PduRSrcPdu_TC_PTCANFD_100ms_FrP05_CONTROLLER_0_IAM_Rx
      PduRSrcPdu_TC_PTCANFD_100ms_FrP05_CONTROLLER_0_IAM_Rx (PduRSrcPdu):
        PduRSourcePduHandleId = PDUR_SRCPDU_CANIF_TC_PTCANFD_100ms_FrP05_CONTROLLER_0_IAM_Rx
        PduRSrcPduUpTxConf = true
        PduRSrcPduRef = CANIF_TC_PTCANFD_100ms_FrP05_CONTROLLER_0_IAM_Rx
      PduRDestPdu_TC_PTCANFD_100ms_FrP05_CONTROLLER_0_IAM_Rx (PduRDestPdu):
        PduRDestPduDataProvision = PDUR_DIRECT
        PduRDestPduHandleId = PDUR_DESTPDU_COM_TC_PTCANFD_100ms_FrP05_CONTROLLER_0_IAM_Rx
        PduRTransmissionConfirmation = true
        PduRDestPduRef = COM_TC_PTCANFD_100ms_FrP05_CONTROLLER_0_IAM_Rx
      PDUR_ROUTING_RZCU_PTCANFD_100ms_FrP12_CONTROLLER_0_IAM_Rx (PduRRoutingPath):
        PduRRouteType = IF
        PduRDestPduRRef = PduRDestPdu_RZCU_PTCANFD_100ms_FrP12_CONTROLLER_0_IAM_Rx
        PduRSrcPduRRef = PduRSrcPdu_RZCU_PTCANFD_100ms_FrP12_CONTROLLER_0_IAM_Rx
      PduRSrcPdu_RZCU_PTCANFD_100ms_FrP12_CONTROLLER_0_IAM_Rx (PduRSrcPdu):
        PduRSourcePduHandleId = PDUR_SRCPDU_CANIF_RZCU_PTCANFD_100ms_FrP12_CONTROLLER_0_IAM_Rx
        PduRSrcPduUpTxConf = true
        PduRSrcPduRef = CANIF_RZCU_PTCANFD_100ms_FrP12_CONTROLLER_0_IAM_Rx
      PduRDestPdu_RZCU_PTCANFD_100ms_FrP12_CONTROLLER_0_IAM_Rx (PduRDestPdu):
        PduRDestPduDataProvision = PDUR_DIRECT
        PduRDestPduHandleId = PDUR_DESTPDU_COM_RZCU_PTCANFD_100ms_FrP12_CONTROLLER_0_IAM_Rx
        PduRTransmissionConfirmation = true
        PduRDestPduRef = COM_RZCU_PTCANFD_100ms_FrP12_CONTROLLER_0_IAM_Rx
      PDUR_ROUTING_ICBVC_INFOCANFD_250ms_FrP52_CONTROLLER_0_IAM_Rx (PduRRoutingPath):
        PduRRouteType = IF
        PduRDestPduRRef = PduRDestPdu_ICBVC_INFOCANFD_250ms_FrP52_CONTROLLER_0_IAM_Rx
        PduRSrcPduRRef = PduRSrcPdu_ICBVC_INFOCANFD_250ms_FrP52_CONTROLLER_0_IAM_Rx
      PduRSrcPdu_ICBVC_INFOCANFD_250ms_FrP52_CONTROLLER_0_IAM_Rx (PduRSrcPdu):
        PduRSourcePduHandleId = PDUR_SRCPDU_CANIF_ICBVC_INFOCANFD_250ms_FrP52_CONTROLLER_0_IAM_Rx
        PduRSrcPduUpTxConf = true
        PduRSrcPduRef = CANIF_ICBVC_INFOCANFD_250ms_FrP52_CONTROLLER_0_IAM_Rx
      PduRDestPdu_ICBVC_INFOCANFD_250ms_FrP52_CONTROLLER_0_IAM_Rx (PduRDestPdu):
        PduRDestPduDataProvision = PDUR_DIRECT
        PduRDestPduHandleId = PDUR_DESTPDU_COM_ICBVC_INFOCANFD_250ms_FrP52_CONTROLLER_0_IAM_Rx
        PduRTransmissionConfirmation = true
        PduRDestPduRef = COM_ICBVC_INFOCANFD_250ms_FrP52_CONTROLLER_0_IAM_Rx
      PDUR_ROUTING_ICB_RZCUCANFD_100ms_FrP144_CONTROLLER_0_IAM_Rx (PduRRoutingPath):
        PduRRouteType = IF
        PduRDestPduRRef = PduRDestPdu_ICB_RZCUCANFD_100ms_FrP144_CONTROLLER_0_IAM_Rx
        PduRSrcPduRRef = PduRSrcPdu_ICB_RZCUCANFD_100ms_FrP144_CONTROLLER_0_IAM_Rx
      PduRSrcPdu_ICB_RZCUCANFD_100ms_FrP144_CONTROLLER_0_IAM_Rx (PduRSrcPdu):
        PduRSourcePduHandleId = PDUR_SRCPDU_CANIF_ICB_RZCUCANFD_100ms_FrP144_CONTROLLER_0_IAM_Rx
        PduRSrcPduUpTxConf = true
        PduRSrcPduRef = CANIF_ICB_RZCUCANFD_100ms_FrP144_CONTROLLER_0_IAM_Rx
      PduRDestPdu_ICB_RZCUCANFD_100ms_FrP144_CONTROLLER_0_IAM_Rx (PduRDestPdu):
        PduRDestPduDataProvision = PDUR_DIRECT
        PduRDestPduHandleId = PDUR_DESTPDU_COM_ICB_RZCUCANFD_100ms_FrP144_CONTROLLER_0_IAM_Rx
        PduRTransmissionConfirmation = true
        PduRDestPduRef = COM_ICB_RZCUCANFD_100ms_FrP144_CONTROLLER_0_IAM_Rx
      PDUR_ROUTING_SDM_CHCANFD_100ms_FrP03_CONTROLLER_0_IAM_Rx (PduRRoutingPath):
        PduRRouteType = IF
        PduRDestPduRRef = PduRDestPdu_SDM_CHCANFD_100ms_FrP03_CONTROLLER_0_IAM_Rx
        PduRSrcPduRRef = PduRSrcPdu_SDM_CHCANFD_100ms_FrP03_CONTROLLER_0_IAM_Rx
      PduRSrcPdu_SDM_CHCANFD_100ms_FrP03_CONTROLLER_0_IAM_Rx (PduRSrcPdu):
        PduRSourcePduHandleId = PDUR_SRCPDU_CANIF_SDM_CHCANFD_100ms_FrP03_CONTROLLER_0_IAM_Rx
        PduRSrcPduUpTxConf = true
        PduRSrcPduRef = CANIF_SDM_CHCANFD_100ms_FrP03_CONTROLLER_0_IAM_Rx
      PduRDestPdu_SDM_CHCANFD_100ms_FrP03_CONTROLLER_0_IAM_Rx (PduRDestPdu):
        PduRDestPduDataProvision = PDUR_DIRECT
        PduRDestPduHandleId = PDUR_DESTPDU_COM_SDM_CHCANFD_100ms_FrP03_CONTROLLER_0_IAM_Rx
        PduRTransmissionConfirmation = true
        PduRDestPduRef = COM_SDM_CHCANFD_100ms_FrP03_CONTROLLER_0_IAM_Rx
      PDUR_ROUTING_RZCU_IMCU_SFCANFD_100ms_FrP26_CONTROLLER_0_IAM_Rx (PduRRoutingPath):
        PduRRouteType = IF
        PduRDestPduRRef = PduRDestPdu_RZCU_IMCU_SFCANFD_100ms_FrP26_CONTROLLER_0_IAM_Rx
        PduRSrcPduRRef = PduRSrcPdu_RZCU_IMCU_SFCANFD_100ms_FrP26_CONTROLLER_0_IAM_Rx
      PduRSrcPdu_RZCU_IMCU_SFCANFD_100ms_FrP26_CONTROLLER_0_IAM_Rx (PduRSrcPdu):
        PduRSourcePduHandleId = PDUR_SRCPDU_CANIF_RZCU_IMCU_SFCANFD_100ms_FrP26_CONTROLLER_0_IAM_Rx
        PduRSrcPduUpTxConf = true
        PduRSrcPduRef = CANIF_RZCU_IMCU_SFCANFD_100ms_FrP26_CONTROLLER_0_IAM_Rx
      PduRDestPdu_RZCU_IMCU_SFCANFD_100ms_FrP26_CONTROLLER_0_IAM_Rx (PduRDestPdu):
        PduRDestPduDataProvision = PDUR_DIRECT
        PduRDestPduHandleId = PDUR_DESTPDU_COM_RZCU_IMCU_SFCANFD_100ms_FrP26_CONTROLLER_0_IAM_Rx
        PduRTransmissionConfirmation = true
        PduRDestPduRef = COM_RZCU_IMCU_SFCANFD_100ms_FrP26_CONTROLLER_0_IAM_Rx
      PDUR_ROUTING_ICBVC_CONNCANFD_200ms_FrP157_CONTROLLER_0_IAM_Rx (PduRRoutingPath):
        PduRRouteType = IF
        PduRDestPduRRef = PduRDestPdu_ICBVC_CONNCANFD_200ms_FrP157_CONTROLLER_0_IAM_Rx
        PduRSrcPduRRef = PduRSrcPdu_ICBVC_CONNCANFD_200ms_FrP157_CONTROLLER_0_IAM_Rx
      PduRSrcPdu_ICBVC_CONNCANFD_200ms_FrP157_CONTROLLER_0_IAM_Rx (PduRSrcPdu):
        PduRSourcePduHandleId = PDUR_SRCPDU_CANIF_ICBVC_CONNCANFD_200ms_FrP157_CONTROLLER_0_IAM_Rx
        PduRSrcPduUpTxConf = true
        PduRSrcPduRef = CANIF_ICBVC_CONNCANFD_200ms_FrP157_CONTROLLER_0_IAM_Rx
      PduRDestPdu_ICBVC_CONNCANFD_200ms_FrP157_CONTROLLER_0_IAM_Rx (PduRDestPdu):
        PduRDestPduDataProvision = PDUR_DIRECT
        PduRDestPduHandleId = PDUR_DESTPDU_COM_ICBVC_CONNCANFD_200ms_FrP157_CONTROLLER_0_IAM_Rx
        PduRTransmissionConfirmation = true
        PduRDestPduRef = COM_ICBVC_CONNCANFD_200ms_FrP157_CONTROLLER_0_IAM_Rx
      PDUR_ROUTING_ESS_PTCANFD_200ms_FrP42_CONTROLLER_0_IAM_Rx (PduRRoutingPath):
        PduRRouteType = IF
        PduRDestPduRRef = PduRDestPdu_ESS_PTCANFD_200ms_FrP42_CONTROLLER_0_IAM_Rx
        PduRSrcPduRRef = PduRSrcPdu_ESS_PTCANFD_200ms_FrP42_CONTROLLER_0_IAM_Rx
      PduRSrcPdu_ESS_PTCANFD_200ms_FrP42_CONTROLLER_0_IAM_Rx (PduRSrcPdu):
        PduRSourcePduHandleId = PDUR_SRCPDU_CANIF_ESS_PTCANFD_200ms_FrP42_CONTROLLER_0_IAM_Rx
        PduRSrcPduUpTxConf = true
        PduRSrcPduRef = CANIF_ESS_PTCANFD_200ms_FrP42_CONTROLLER_0_IAM_Rx
      PduRDestPdu_ESS_PTCANFD_200ms_FrP42_CONTROLLER_0_IAM_Rx (PduRDestPdu):
        PduRDestPduDataProvision = PDUR_DIRECT
        PduRDestPduHandleId = PDUR_DESTPDU_COM_ESS_PTCANFD_200ms_FrP42_CONTROLLER_0_IAM_Rx
        PduRTransmissionConfirmation = true
        PduRDestPduRef = COM_ESS_PTCANFD_200ms_FrP42_CONTROLLER_0_IAM_Rx
      PDUR_ROUTING_ESS_PTCANFD_200ms_FrP39_CONTROLLER_0_IAM_Rx (PduRRoutingPath):
        PduRRouteType = IF
        PduRDestPduRRef = PduRDestPdu_ESS_PTCANFD_200ms_FrP39_CONTROLLER_0_IAM_Rx
        PduRSrcPduRRef = PduRSrcPdu_ESS_PTCANFD_200ms_FrP39_CONTROLLER_0_IAM_Rx
      PduRSrcPdu_ESS_PTCANFD_200ms_FrP39_CONTROLLER_0_IAM_Rx (PduRSrcPdu):
        PduRSourcePduHandleId = PDUR_SRCPDU_CANIF_ESS_PTCANFD_200ms_FrP39_CONTROLLER_0_IAM_Rx
        PduRSrcPduUpTxConf = true
        PduRSrcPduRef = CANIF_ESS_PTCANFD_200ms_FrP39_CONTROLLER_0_IAM_Rx
      PduRDestPdu_ESS_PTCANFD_200ms_FrP39_CONTROLLER_0_IAM_Rx (PduRDestPdu):
        PduRDestPduDataProvision = PDUR_DIRECT
        PduRDestPduHandleId = PDUR_DESTPDU_COM_ESS_PTCANFD_200ms_FrP39_CONTROLLER_0_IAM_Rx
        PduRTransmissionConfirmation = true
        PduRDestPduRef = COM_ESS_PTCANFD_200ms_FrP39_CONTROLLER_0_IAM_Rx
      PDUR_ROUTING_ICBAD_BKPCANFD_100ms_FrP38_CONTROLLER_0_IAM_Rx (PduRRoutingPath):
        PduRRouteType = IF
        PduRDestPduRRef = PduRDestPdu_ICBAD_BKPCANFD_100ms_FrP38_CONTROLLER_0_IAM_Rx
        PduRSrcPduRRef = PduRSrcPdu_ICBAD_BKPCANFD_100ms_FrP38_CONTROLLER_0_IAM_Rx
      PduRSrcPdu_ICBAD_BKPCANFD_100ms_FrP38_CONTROLLER_0_IAM_Rx (PduRSrcPdu):
        PduRSourcePduHandleId = PDUR_SRCPDU_CANIF_ICBAD_BKPCANFD_100ms_FrP38_CONTROLLER_0_IAM_Rx
        PduRSrcPduUpTxConf = true
        PduRSrcPduRef = CANIF_ICBAD_BKPCANFD_100ms_FrP38_CONTROLLER_0_IAM_Rx
      PduRDestPdu_ICBAD_BKPCANFD_100ms_FrP38_CONTROLLER_0_IAM_Rx (PduRDestPdu):
        PduRDestPduDataProvision = PDUR_DIRECT
        PduRDestPduHandleId = PDUR_DESTPDU_COM_ICBAD_BKPCANFD_100ms_FrP38_CONTROLLER_0_IAM_Rx
        PduRTransmissionConfirmation = true
        PduRDestPduRef = COM_ICBAD_BKPCANFD_100ms_FrP38_CONTROLLER_0_IAM_Rx
      PDUR_ROUTING_CCU_PTEXTDCAN_100ms_FrP06_CONTROLLER_0_IAM_Rx (PduRRoutingPath):
        PduRRouteType = IF
        PduRDestPduRRef = PduRDestPdu_CCU_PTEXTDCAN_100ms_FrP06_CONTROLLER_0_IAM_Rx
        PduRSrcPduRRef = PduRSrcPdu_CCU_PTEXTDCAN_100ms_FrP06_CONTROLLER_0_IAM_Rx
      PduRSrcPdu_CCU_PTEXTDCAN_100ms_FrP06_CONTROLLER_0_IAM_Rx (PduRSrcPdu):
        PduRSourcePduHandleId = PDUR_SRCPDU_CANIF_CCU_PTEXTDCAN_100ms_FrP06_CONTROLLER_0_IAM_Rx
        PduRSrcPduUpTxConf = true
        PduRSrcPduRef = CANIF_CCU_PTEXTDCAN_100ms_FrP06_CONTROLLER_0_IAM_Rx
      PduRDestPdu_CCU_PTEXTDCAN_100ms_FrP06_CONTROLLER_0_IAM_Rx (PduRDestPdu):
        PduRDestPduDataProvision = PDUR_DIRECT
        PduRDestPduHandleId = PDUR_DESTPDU_COM_CCU_PTEXTDCAN_100ms_FrP06_CONTROLLER_0_IAM_Rx
        PduRTransmissionConfirmation = true
        PduRDestPduRef = COM_CCU_PTEXTDCAN_100ms_FrP06_CONTROLLER_0_IAM_Rx
      PDUR_ROUTING_RZCU_PTEXTDCAN_100ms_FrP21_CONTROLLER_0_IAM_Rx (PduRRoutingPath):
        PduRRouteType = IF
        PduRDestPduRRef = PduRDestPdu_RZCU_PTEXTDCAN_100ms_FrP21_CONTROLLER_0_IAM_Rx
        PduRSrcPduRRef = PduRSrcPdu_RZCU_PTEXTDCAN_100ms_FrP21_CONTROLLER_0_IAM_Rx
      PduRSrcPdu_RZCU_PTEXTDCAN_100ms_FrP21_CONTROLLER_0_IAM_Rx (PduRSrcPdu):
        PduRSourcePduHandleId = PDUR_SRCPDU_CANIF_RZCU_PTEXTDCAN_100ms_FrP21_CONTROLLER_0_IAM_Rx
        PduRSrcPduUpTxConf = true
        PduRSrcPduRef = CANIF_RZCU_PTEXTDCAN_100ms_FrP21_CONTROLLER_0_IAM_Rx
      PduRDestPdu_RZCU_PTEXTDCAN_100ms_FrP21_CONTROLLER_0_IAM_Rx (PduRDestPdu):
        PduRDestPduDataProvision = PDUR_DIRECT
        PduRDestPduHandleId = PDUR_DESTPDU_COM_RZCU_PTEXTDCAN_100ms_FrP21_CONTROLLER_0_IAM_Rx
        PduRTransmissionConfirmation = true
        PduRDestPduRef = COM_RZCU_PTEXTDCAN_100ms_FrP21_CONTROLLER_0_IAM_Rx
      PDUR_ROUTING_TC_PTCANFD_20ms_FrP08_CONTROLLER_0_IAM_Rx (PduRRoutingPath):
        PduRRouteType = IF
        PduRDestPduRRef = PduRDestPdu_TC_PTCANFD_20ms_FrP08_CONTROLLER_0_IAM_Rx
        PduRSrcPduRRef = PduRSrcPdu_TC_PTCANFD_20ms_FrP08_CONTROLLER_0_IAM_Rx
      PduRSrcPdu_TC_PTCANFD_20ms_FrP08_CONTROLLER_0_IAM_Rx (PduRSrcPdu):
        PduRSourcePduHandleId = PDUR_SRCPDU_CANIF_TC_PTCANFD_20ms_FrP08_CONTROLLER_0_IAM_Rx
        PduRSrcPduUpTxConf = true
        PduRSrcPduRef = CANIF_TC_PTCANFD_20ms_FrP08_CONTROLLER_0_IAM_Rx
      PduRDestPdu_TC_PTCANFD_20ms_FrP08_CONTROLLER_0_IAM_Rx (PduRDestPdu):
        PduRDestPduDataProvision = PDUR_DIRECT
        PduRDestPduHandleId = PDUR_DESTPDU_COM_TC_PTCANFD_20ms_FrP08_CONTROLLER_0_IAM_Rx
        PduRTransmissionConfirmation = true
        PduRDestPduRef = COM_TC_PTCANFD_20ms_FrP08_CONTROLLER_0_IAM_Rx
      PDUR_ROUTING_LHZCU_LHBKBCANFDF_400ms_FrP18_CONTROLLER_0_IAM_Rx (PduRRoutingPath):
        PduRRouteType = IF
        PduRDestPduRRef = PduRDestPdu_LHZCU_LHBKBCANFDF_400ms_FrP18_CONTROLLER_0_IAM_Rx
        PduRSrcPduRRef = PduRSrcPdu_LHZCU_LHBKBCANFDF_400ms_FrP18_CONTROLLER_0_IAM_Rx
      PduRSrcPdu_LHZCU_LHBKBCANFDF_400ms_FrP18_CONTROLLER_0_IAM_Rx (PduRSrcPdu):
        PduRSourcePduHandleId = PDUR_SRCPDU_CANIF_LHZCU_LHBKBCANFDF_400ms_FrP18_CONTROLLER_0_IAM_Rx
        PduRSrcPduUpTxConf = true
        PduRSrcPduRef = CANIF_LHZCU_LHBKBCANFDF_400ms_FrP18_CONTROLLER_0_IAM_Rx
      PduRDestPdu_LHZCU_LHBKBCANFDF_400ms_FrP18_CONTROLLER_0_IAM_Rx (PduRDestPdu):
        PduRDestPduDataProvision = PDUR_DIRECT
        PduRDestPduHandleId = PDUR_DESTPDU_COM_LHZCU_LHBKBCANFDF_400ms_FrP18_CONTROLLER_0_IAM_Rx
        PduRTransmissionConfirmation = true
        PduRDestPduRef = COM_LHZCU_LHBKBCANFDF_400ms_FrP18_CONTROLLER_0_IAM_Rx
      PDUR_ROUTING_ICBVC_RZCUCANFD_200ms_FrP79_CONTROLLER_0_IAM_Rx (PduRRoutingPath):
        PduRRouteType = IF
        PduRDestPduRRef = PduRDestPdu_ICBVC_RZCUCANFD_200ms_FrP79_CONTROLLER_0_IAM_Rx
        PduRSrcPduRRef = PduRSrcPdu_ICBVC_RZCUCANFD_200ms_FrP79_CONTROLLER_0_IAM_Rx
      PduRSrcPdu_ICBVC_RZCUCANFD_200ms_FrP79_CONTROLLER_0_IAM_Rx (PduRSrcPdu):
        PduRSourcePduHandleId = PDUR_SRCPDU_CANIF_ICBVC_RZCUCANFD_200ms_FrP79_CONTROLLER_0_IAM_Rx
        PduRSrcPduUpTxConf = true
        PduRSrcPduRef = CANIF_ICBVC_RZCUCANFD_200ms_FrP79_CONTROLLER_0_IAM_Rx
      PduRDestPdu_ICBVC_RZCUCANFD_200ms_FrP79_CONTROLLER_0_IAM_Rx (PduRDestPdu):
        PduRDestPduDataProvision = PDUR_DIRECT
        PduRDestPduHandleId = PDUR_DESTPDU_COM_ICBVC_RZCUCANFD_200ms_FrP79_CONTROLLER_0_IAM_Rx
        PduRTransmissionConfirmation = true
        PduRDestPduRef = COM_ICBVC_RZCUCANFD_200ms_FrP79_CONTROLLER_0_IAM_Rx
      PDUR_ROUTING_ICBVC_CONNCANFD_Event_FrS145_CONTROLLER_0_IAM_Rx (PduRRoutingPath):
        PduRRouteType = IF
        PduRDestPduRRef = PduRDestPdu_ICBVC_CONNCANFD_Event_FrS145_CONTROLLER_0_IAM_Rx
        PduRSrcPduRRef = PduRSrcPdu_ICBVC_CONNCANFD_Event_FrS145_CONTROLLER_0_IAM_Rx
      PduRSrcPdu_ICBVC_CONNCANFD_Event_FrS145_CONTROLLER_0_IAM_Rx (PduRSrcPdu):
        PduRSourcePduHandleId = PDUR_SRCPDU_CANIF_ICBVC_CONNCANFD_Event_FrS145_CONTROLLER_0_IAM_Rx
        PduRSrcPduUpTxConf = true
        PduRSrcPduRef = CANIF_ICBVC_CONNCANFD_Event_FrS145_CONTROLLER_0_IAM_Rx
      PduRDestPdu_ICBVC_CONNCANFD_Event_FrS145_CONTROLLER_0_IAM_Rx (PduRDestPdu):
        PduRDestPduDataProvision = PDUR_DIRECT
        PduRDestPduHandleId = PDUR_DESTPDU_COM_ICBVC_CONNCANFD_Event_FrS145_CONTROLLER_0_IAM_Rx
        PduRTransmissionConfirmation = true
        PduRDestPduRef = COM_ICBVC_CONNCANFD_Event_FrS145_CONTROLLER_0_IAM_Rx
      PDUR_ROUTING_LHZCU_LHBDCANFD_Event_FrS48_CONTROLLER_0_IAM_Rx (PduRRoutingPath):
        PduRRouteType = IF
        PduRDestPduRRef = PduRDestPdu_LHZCU_LHBDCANFD_Event_FrS48_CONTROLLER_0_IAM_Rx
        PduRSrcPduRRef = PduRSrcPdu_LHZCU_LHBDCANFD_Event_FrS48_CONTROLLER_0_IAM_Rx
      PduRSrcPdu_LHZCU_LHBDCANFD_Event_FrS48_CONTROLLER_0_IAM_Rx (PduRSrcPdu):
        PduRSourcePduHandleId = PDUR_SRCPDU_CANIF_LHZCU_LHBDCANFD_Event_FrS48_CONTROLLER_0_IAM_Rx
        PduRSrcPduUpTxConf = true
        PduRSrcPduRef = CANIF_LHZCU_LHBDCANFD_Event_FrS48_CONTROLLER_0_IAM_Rx
      PduRDestPdu_LHZCU_LHBDCANFD_Event_FrS48_CONTROLLER_0_IAM_Rx (PduRDestPdu):
        PduRDestPduDataProvision = PDUR_DIRECT
        PduRDestPduHandleId = PDUR_DESTPDU_COM_LHZCU_LHBDCANFD_Event_FrS48_CONTROLLER_0_IAM_Rx
        PduRTransmissionConfirmation = true
        PduRDestPduRef = COM_LHZCU_LHBDCANFD_Event_FrS48_CONTROLLER_0_IAM_Rx
      PDUR_ROUTING_LHZCU_LHBDCANFD_Event_FrS49_CONTROLLER_0_IAM_Rx (PduRRoutingPath):
        PduRRouteType = IF
        PduRDestPduRRef = PduRDestPdu_LHZCU_LHBDCANFD_Event_FrS49_CONTROLLER_0_IAM_Rx
        PduRSrcPduRRef = PduRSrcPdu_LHZCU_LHBDCANFD_Event_FrS49_CONTROLLER_0_IAM_Rx
      PduRSrcPdu_LHZCU_LHBDCANFD_Event_FrS49_CONTROLLER_0_IAM_Rx (PduRSrcPdu):
        PduRSourcePduHandleId = PDUR_SRCPDU_CANIF_LHZCU_LHBDCANFD_Event_FrS49_CONTROLLER_0_IAM_Rx
        PduRSrcPduUpTxConf = true
        PduRSrcPduRef = CANIF_LHZCU_LHBDCANFD_Event_FrS49_CONTROLLER_0_IAM_Rx
      PduRDestPdu_LHZCU_LHBDCANFD_Event_FrS49_CONTROLLER_0_IAM_Rx (PduRDestPdu):
        PduRDestPduDataProvision = PDUR_DIRECT
        PduRDestPduHandleId = PDUR_DESTPDU_COM_LHZCU_LHBDCANFD_Event_FrS49_CONTROLLER_0_IAM_Rx
        PduRTransmissionConfirmation = true
        PduRDestPduRef = COM_LHZCU_LHBDCANFD_Event_FrS49_CONTROLLER_0_IAM_Rx
      PDUR_ROUTING_ICBVC_RHBKBCANFD_500ms_FrP67_CONTROLLER_0_IAM_Rx (PduRRoutingPath):
        PduRRouteType = IF
        PduRDestPduRRef = PduRDestPdu_ICBVC_RHBKBCANFD_500ms_FrP67_CONTROLLER_0_IAM_Rx
        PduRSrcPduRRef = PduRSrcPdu_ICBVC_RHBKBCANFD_500ms_FrP67_CONTROLLER_0_IAM_Rx
      PduRSrcPdu_ICBVC_RHBKBCANFD_500ms_FrP67_CONTROLLER_0_IAM_Rx (PduRSrcPdu):
        PduRSourcePduHandleId = PDUR_SRCPDU_CANIF_ICBVC_RHBKBCANFD_500ms_FrP67_CONTROLLER_0_IAM_Rx
        PduRSrcPduUpTxConf = true
        PduRSrcPduRef = CANIF_ICBVC_RHBKBCANFD_500ms_FrP67_CONTROLLER_0_IAM_Rx
      PduRDestPdu_ICBVC_RHBKBCANFD_500ms_FrP67_CONTROLLER_0_IAM_Rx (PduRDestPdu):
        PduRDestPduDataProvision = PDUR_DIRECT
        PduRDestPduHandleId = PDUR_DESTPDU_COM_ICBVC_RHBKBCANFD_500ms_FrP67_CONTROLLER_0_IAM_Rx
        PduRTransmissionConfirmation = true
        PduRDestPduRef = COM_ICBVC_RHBKBCANFD_500ms_FrP67_CONTROLLER_0_IAM_Rx
      PDUR_ROUTING_ZXD_CONNCANFD_Event_FrS220_CONTROLLER_0_IAM_Rx (PduRRoutingPath):
        PduRRouteType = IF
        PduRDestPduRRef = PduRDestPdu_ZXD_CONNCANFD_Event_FrS220_CONTROLLER_0_IAM_Rx
        PduRSrcPduRRef = PduRSrcPdu_ZXD_CONNCANFD_Event_FrS220_CONTROLLER_0_IAM_Rx
      PduRSrcPdu_ZXD_CONNCANFD_Event_FrS220_CONTROLLER_0_IAM_Rx (PduRSrcPdu):
        PduRSourcePduHandleId = PDUR_SRCPDU_CANIF_ZXD_CONNCANFD_Event_FrS220_CONTROLLER_0_IAM_Rx
        PduRSrcPduUpTxConf = true
        PduRSrcPduRef = CANIF_ZXD_CONNCANFD_Event_FrS220_CONTROLLER_0_IAM_Rx
      PduRDestPdu_ZXD_CONNCANFD_Event_FrS220_CONTROLLER_0_IAM_Rx (PduRDestPdu):
        PduRDestPduDataProvision = PDUR_DIRECT
        PduRDestPduHandleId = PDUR_DESTPDU_COM_ZXD_CONNCANFD_Event_FrS220_CONTROLLER_0_IAM_Rx
        PduRTransmissionConfirmation = true
        PduRDestPduRef = COM_ZXD_CONNCANFD_Event_FrS220_CONTROLLER_0_IAM_Rx
      PDUR_ROUTING_ICBVC_RZCUCANFD_200ms_FrP50_CONTROLLER_0_IAM_Rx (PduRRoutingPath):
        PduRRouteType = IF
        PduRDestPduRRef = PduRDestPdu_ICBVC_RZCUCANFD_200ms_FrP50_CONTROLLER_0_IAM_Rx
        PduRSrcPduRRef = PduRSrcPdu_ICBVC_RZCUCANFD_200ms_FrP50_CONTROLLER_0_IAM_Rx
      PduRSrcPdu_ICBVC_RZCUCANFD_200ms_FrP50_CONTROLLER_0_IAM_Rx (PduRSrcPdu):
        PduRSourcePduHandleId = PDUR_SRCPDU_CANIF_ICBVC_RZCUCANFD_200ms_FrP50_CONTROLLER_0_IAM_Rx
        PduRSrcPduUpTxConf = true
        PduRSrcPduRef = CANIF_ICBVC_RZCUCANFD_200ms_FrP50_CONTROLLER_0_IAM_Rx
      PduRDestPdu_ICBVC_RZCUCANFD_200ms_FrP50_CONTROLLER_0_IAM_Rx (PduRDestPdu):
        PduRDestPduDataProvision = PDUR_DIRECT
        PduRDestPduHandleId = PDUR_DESTPDU_COM_ICBVC_RZCUCANFD_200ms_FrP50_CONTROLLER_0_IAM_Rx
        PduRTransmissionConfirmation = true
        PduRDestPduRef = COM_ICBVC_RZCUCANFD_200ms_FrP50_CONTROLLER_0_IAM_Rx
      PDUR_ROUTING_ICB_CONNCANFD_Event_FrS67_CONTROLLER_0_IAM_Rx (PduRRoutingPath):
        PduRRouteType = IF
        PduRDestPduRRef = PduRDestPdu_ICB_CONNCANFD_Event_FrS67_CONTROLLER_0_IAM_Rx
        PduRSrcPduRRef = PduRSrcPdu_ICB_CONNCANFD_Event_FrS67_CONTROLLER_0_IAM_Rx
      PduRSrcPdu_ICB_CONNCANFD_Event_FrS67_CONTROLLER_0_IAM_Rx (PduRSrcPdu):
        PduRSourcePduHandleId = PDUR_SRCPDU_CANIF_ICB_CONNCANFD_Event_FrS67_CONTROLLER_0_IAM_Rx
        PduRSrcPduUpTxConf = true
        PduRSrcPduRef = CANIF_ICB_CONNCANFD_Event_FrS67_CONTROLLER_0_IAM_Rx
      PduRDestPdu_ICB_CONNCANFD_Event_FrS67_CONTROLLER_0_IAM_Rx (PduRDestPdu):
        PduRDestPduDataProvision = PDUR_DIRECT
        PduRDestPduHandleId = PDUR_DESTPDU_COM_ICB_CONNCANFD_Event_FrS67_CONTROLLER_0_IAM_Rx
        PduRTransmissionConfirmation = true
        PduRDestPduRef = COM_ICB_CONNCANFD_Event_FrS67_CONTROLLER_0_IAM_Rx
      PduRSrcPdu_CanIf_CAN0_Rx_SecOC_SyncMsg_0x56F_SecOC_Secured (PduRSrcPdu):
        PduRSourcePduHandleId = PDUR_SRCPDU_CANIF_synthesized_ICBVC_SecOC_SyncMsg__CONTROLLER_0_IAM_Rx
        PduRSrcPduUpTxConf = true
        PduRSrcPduRef = CANIF_synthesized_ICBVC_SecOC_SyncMsg__CONTROLLER_0_IAM_Rx
      PsduRDestPdu_Com_CAN0_Rx_SecOC_SyncMsg_0x56F_SecOC_Authentic (PduRDestPdu):
        PduRDestPduDataProvision = PDUR_DIRECT
        PduRDestPduHandleId = PDUR_DESTPDU_COM_synthesized_ICBVC_SecOC_SyncMsg__CONTROLLER_0_IAM_Rx
        PduRTransmissionConfirmation = true
        PduRDestPduRef = COM_synthesized_ICBVC_SecOC_SyncMsg__CONTROLLER_0_IAM_Rx
      PDUR_ROUTING_RHZCU_BKBCANFD_Event_FrS37_CONTROLLER_0_IAM_Rx (PduRRoutingPath):
        PduRRouteType = IF
        PduRDestPduRRef = PduRDestPdu_RHZCU_BKBCANFD_Event_FrS37_CONTROLLER_0_IAM_Rx
        PduRSrcPduRRef = PduRSrcPdu_RHZCU_BKBCANFD_Event_FrS37_CONTROLLER_0_IAM_Rx
      PduRSrcPdu_RHZCU_BKBCANFD_Event_FrS37_CONTROLLER_0_IAM_Rx (PduRSrcPdu):
        PduRSourcePduHandleId = PDUR_SRCPDU_CANIF_RHZCU_BKBCANFD_Event_FrS37_CONTROLLER_0_IAM_Rx
        PduRSrcPduUpTxConf = true
        PduRSrcPduRef = CANIF_RHZCU_BKBCANFD_Event_FrS37_CONTROLLER_0_IAM_Rx
      PduRDestPdu_RHZCU_BKBCANFD_Event_FrS37_CONTROLLER_0_IAM_Rx (PduRDestPdu):
        PduRDestPduDataProvision = PDUR_DIRECT
        PduRDestPduHandleId = PDUR_DESTPDU_COM_RHZCU_BKBCANFD_Event_FrS37_CONTROLLER_0_IAM_Rx
        PduRTransmissionConfirmation = true
        PduRDestPduRef = COM_RHZCU_BKBCANFD_Event_FrS37_CONTROLLER_0_IAM_Rx
      PDUR_ROUTING_ESS_PTCANFD_Event_FrS452_CONTROLLER_0_IAM_Rx (PduRRoutingPath):
        PduRRouteType = IF
        PduRDestPduRRef = PduRDestPdu_ESS_PTCANFD_Event_FrS452_CONTROLLER_0_IAM_Rx
        PduRSrcPduRRef = PduRSrcPdu_ESS_PTCANFD_Event_FrS452_CONTROLLER_0_IAM_Rx
      PduRSrcPdu_ESS_PTCANFD_Event_FrS452_CONTROLLER_0_IAM_Rx (PduRSrcPdu):
        PduRSourcePduHandleId = PDUR_SRCPDU_CANIF_ESS_PTCANFD_Event_FrS452_CONTROLLER_0_IAM_Rx
        PduRSrcPduUpTxConf = true
        PduRSrcPduRef = CANIF_ESS_PTCANFD_Event_FrS452_CONTROLLER_0_IAM_Rx
      PduRDestPdu_ESS_PTCANFD_Event_FrS452_CONTROLLER_0_IAM_Rx (PduRDestPdu):
        PduRDestPduDataProvision = PDUR_DIRECT
        PduRDestPduHandleId = PDUR_DESTPDU_COM_ESS_PTCANFD_Event_FrS452_CONTROLLER_0_IAM_Rx
        PduRTransmissionConfirmation = true
        PduRDestPduRef = COM_ESS_PTCANFD_Event_FrS452_CONTROLLER_0_IAM_Rx
      PDUR_ROUTING_IPD_BKPCANFD_Event_FrS35_CONTROLLER_0_IAM_Rx (PduRRoutingPath):
        PduRRouteType = IF
        PduRDestPduRRef = PduRDestPdu_IPD_BKPCANFD_Event_FrS35_CONTROLLER_0_IAM_Rx
        PduRSrcPduRRef = PduRSrcPdu_IPD_BKPCANFD_Event_FrS35_CONTROLLER_0_IAM_Rx
      PduRSrcPdu_IPD_BKPCANFD_Event_FrS35_CONTROLLER_0_IAM_Rx (PduRSrcPdu):
        PduRSourcePduHandleId = PDUR_SRCPDU_CANIF_IPD_BKPCANFD_Event_FrS35_CONTROLLER_0_IAM_Rx
        PduRSrcPduUpTxConf = true
        PduRSrcPduRef = CANIF_IPD_BKPCANFD_Event_FrS35_CONTROLLER_0_IAM_Rx
      PduRDestPdu_IPD_BKPCANFD_Event_FrS35_CONTROLLER_0_IAM_Rx (PduRDestPdu):
        PduRDestPduDataProvision = PDUR_DIRECT
        PduRDestPduHandleId = PDUR_DESTPDU_COM_IPD_BKPCANFD_Event_FrS35_CONTROLLER_0_IAM_Rx
        PduRTransmissionConfirmation = true
        PduRDestPduRef = COM_IPD_BKPCANFD_Event_FrS35_CONTROLLER_0_IAM_Rx
      PDUR_ROUTING_CCU_PTCANFD_500ms_FrP13_CONTROLLER_0_IAM_Rx (PduRRoutingPath):
        PduRRouteType = IF
        PduRDestPduRRef = PduRDestPdu_CCU_PTCANFD_500ms_FrP13_CONTROLLER_0_IAM_Rx
        PduRSrcPduRRef = PduRSrcPdu_CCU_PTCANFD_500ms_FrP13_CONTROLLER_0_IAM_Rx
      PduRSrcPdu_CCU_PTCANFD_500ms_FrP13_CONTROLLER_0_IAM_Rx (PduRSrcPdu):
        PduRSourcePduHandleId = PDUR_SRCPDU_CANIF_CCU_PTCANFD_500ms_FrP13_CONTROLLER_0_IAM_Rx
        PduRSrcPduUpTxConf = true
        PduRSrcPduRef = CANIF_CCU_PTCANFD_500ms_FrP13_CONTROLLER_0_IAM_Rx
      PduRDestPdu_CCU_PTCANFD_500ms_FrP13_CONTROLLER_0_IAM_Rx (PduRDestPdu):
        PduRDestPduDataProvision = PDUR_DIRECT
        PduRDestPduHandleId = PDUR_DESTPDU_COM_CCU_PTCANFD_500ms_FrP13_CONTROLLER_0_IAM_Rx
        PduRTransmissionConfirmation = true
        PduRDestPduRef = COM_CCU_PTCANFD_500ms_FrP13_CONTROLLER_0_IAM_Rx
      PDUR_ROUTING_ESS_PTCANFD_500ms_FrP60_CONTROLLER_0_IAM_Rx (PduRRoutingPath):
        PduRRouteType = IF
        PduRDestPduRRef = PduRDestPdu_ESS_PTCANFD_500ms_FrP60_CONTROLLER_0_IAM_Rx
        PduRSrcPduRRef = PduRSrcPdu_ESS_PTCANFD_500ms_FrP60_CONTROLLER_0_IAM_Rx
      PduRSrcPdu_ESS_PTCANFD_500ms_FrP60_CONTROLLER_0_IAM_Rx (PduRSrcPdu):
        PduRSourcePduHandleId = PDUR_SRCPDU_CANIF_ESS_PTCANFD_500ms_FrP60_CONTROLLER_0_IAM_Rx
        PduRSrcPduUpTxConf = true
        PduRSrcPduRef = CANIF_ESS_PTCANFD_500ms_FrP60_CONTROLLER_0_IAM_Rx
      PduRDestPdu_ESS_PTCANFD_500ms_FrP60_CONTROLLER_0_IAM_Rx (PduRDestPdu):
        PduRDestPduDataProvision = PDUR_DIRECT
        PduRDestPduHandleId = PDUR_DESTPDU_COM_ESS_PTCANFD_500ms_FrP60_CONTROLLER_0_IAM_Rx
        PduRTransmissionConfirmation = true
        PduRDestPduRef = COM_ESS_PTCANFD_500ms_FrP60_CONTROLLER_0_IAM_Rx
      PDUR_ROUTING_ICBVC_CONNCANFD_Event_FrS139_CONTROLLER_0_IAM_Rx (PduRRoutingPath):
        PduRRouteType = IF
        PduRDestPduRRef = PduRDestPdu_ICBVC_CONNCANFD_Event_FrS139_CONTROLLER_0_IAM_Rx
        PduRSrcPduRRef = PduRSrcPdu_ICBVC_CONNCANFD_Event_FrS139_CONTROLLER_0_IAM_Rx
      PduRSrcPdu_ICBVC_CONNCANFD_Event_FrS139_CONTROLLER_0_IAM_Rx (PduRSrcPdu):
        PduRSourcePduHandleId = PDUR_SRCPDU_CANIF_ICBVC_CONNCANFD_Event_FrS139_CONTROLLER_0_IAM_Rx
        PduRSrcPduUpTxConf = true
        PduRSrcPduRef = CANIF_ICBVC_CONNCANFD_Event_FrS139_CONTROLLER_0_IAM_Rx
      PduRDestPdu_ICBVC_CONNCANFD_Event_FrS139_CONTROLLER_0_IAM_Rx (PduRDestPdu):
        PduRDestPduDataProvision = PDUR_DIRECT
        PduRDestPduHandleId = PDUR_DESTPDU_COM_ICBVC_CONNCANFD_Event_FrS139_CONTROLLER_0_IAM_Rx
        PduRTransmissionConfirmation = true
        PduRDestPduRef = COM_ICBVC_CONNCANFD_Event_FrS139_CONTROLLER_0_IAM_Rx
      PDUR_ROUTING_SDM_SFCANFD_Event_FrS13_CONTROLLER_0_IAM_Rx (PduRRoutingPath):
        PduRRouteType = IF
        PduRDestPduRRef = PduRDestPdu_SDM_SFCANFD_Event_FrS13_CONTROLLER_0_IAM_Rx
        PduRSrcPduRRef = PduRSrcPdu_SDM_SFCANFD_Event_FrS13_CONTROLLER_0_IAM_Rx
      PduRSrcPdu_SDM_SFCANFD_Event_FrS13_CONTROLLER_0_IAM_Rx (PduRSrcPdu):
        PduRSourcePduHandleId = PDUR_SRCPDU_CANIF_SDM_SFCANFD_Event_FrS13_CONTROLLER_0_IAM_Rx
        PduRSrcPduUpTxConf = true
        PduRSrcPduRef = CANIF_SDM_SFCANFD_Event_FrS13_CONTROLLER_0_IAM_Rx
      PduRDestPdu_SDM_SFCANFD_Event_FrS13_CONTROLLER_0_IAM_Rx (PduRDestPdu):
        PduRDestPduDataProvision = PDUR_DIRECT
        PduRDestPduHandleId = PDUR_DESTPDU_COM_SDM_SFCANFD_Event_FrS13_CONTROLLER_0_IAM_Rx
        PduRTransmissionConfirmation = true
        PduRDestPduRef = COM_SDM_SFCANFD_Event_FrS13_CONTROLLER_0_IAM_Rx
      PDUR_ROUTING_SDM_SFCANFD_Event_FrS12_CONTROLLER_0_IAM_Rx (PduRRoutingPath):
        PduRRouteType = IF
        PduRDestPduRRef = PduRDestPdu_SDM_SFCANFD_Event_FrS12_CONTROLLER_0_IAM_Rx
        PduRSrcPduRRef = PduRSrcPdu_SDM_SFCANFD_Event_FrS12_CONTROLLER_0_IAM_Rx
      PduRSrcPdu_SDM_SFCANFD_Event_FrS12_CONTROLLER_0_IAM_Rx (PduRSrcPdu):
        PduRSourcePduHandleId = PDUR_SRCPDU_CANIF_SDM_SFCANFD_Event_FrS12_CONTROLLER_0_IAM_Rx
        PduRSrcPduUpTxConf = true
        PduRSrcPduRef = CANIF_SDM_SFCANFD_Event_FrS12_CONTROLLER_0_IAM_Rx
      PduRDestPdu_SDM_SFCANFD_Event_FrS12_CONTROLLER_0_IAM_Rx (PduRDestPdu):
        PduRDestPduDataProvision = PDUR_DIRECT
        PduRDestPduHandleId = PDUR_DESTPDU_COM_SDM_SFCANFD_Event_FrS12_CONTROLLER_0_IAM_Rx
        PduRTransmissionConfirmation = true
        PduRDestPduRef = COM_SDM_SFCANFD_Event_FrS12_CONTROLLER_0_IAM_Rx
      PDUR_ROUTING_ICB_CONNCANFD_EvtInfo_CONTROLLER_0_IAM_Rx (PduRRoutingPath):
        PduRRouteType = IF
        PduRDestPduRRef = PduRDestPdu_ICB_CONNCANFD_EvtInfo_CONTROLLER_0_IAM_Rx
        PduRSrcPduRRef = PduRSrcPdu_ICB_CONNCANFD_EvtInfo_CONTROLLER_0_IAM_Rx
      PduRSrcPdu_ICB_CONNCANFD_EvtInfo_CONTROLLER_0_IAM_Rx (PduRSrcPdu):
        PduRSourcePduHandleId = PDUR_SRCPDU_CANIF_ICB_CONNCANFD_EvtInfo_CONTROLLER_0_IAM_Rx
        PduRSrcPduUpTxConf = true
        PduRSrcPduRef = CANIF_ICB_CONNCANFD_EvtInfo_CONTROLLER_0_IAM_Rx
      PduRDestPdu_ICB_CONNCANFD_EvtInfo_CONTROLLER_0_IAM_Rx (PduRDestPdu):
        PduRDestPduDataProvision = PDUR_DIRECT
        PduRDestPduHandleId = PDUR_DESTPDU_COM_ICB_CONNCANFD_EvtInfo_CONTROLLER_0_IAM_Rx
        PduRTransmissionConfirmation = true
        PduRDestPduRef = COM_ICB_CONNCANFD_EvtInfo_CONTROLLER_0_IAM_Rx
      PDUR_ROUTING_ESS_PTCANFD_EvtInfo_CONTROLLER_0_IAM_Rx (PduRRoutingPath):
        PduRRouteType = IF
        PduRDestPduRRef = PduRDestPdu_ESS_PTCANFD_EvtInfo_CONTROLLER_0_IAM_Rx
        PduRSrcPduRRef = PduRSrcPdu_ESS_PTCANFD_EvtInfo_CONTROLLER_0_IAM_Rx
      PduRSrcPdu_ESS_PTCANFD_EvtInfo_CONTROLLER_0_IAM_Rx (PduRSrcPdu):
        PduRSourcePduHandleId = PDUR_SRCPDU_CANIF_ESS_PTCANFD_EvtInfo_CONTROLLER_0_IAM_Rx
        PduRSrcPduUpTxConf = true
        PduRSrcPduRef = CANIF_ESS_PTCANFD_EvtInfo_CONTROLLER_0_IAM_Rx
      PduRDestPdu_ESS_PTCANFD_EvtInfo_CONTROLLER_0_IAM_Rx (PduRDestPdu):
        PduRDestPduDataProvision = PDUR_DIRECT
        PduRDestPduHandleId = PDUR_DESTPDU_COM_ESS_PTCANFD_EvtInfo_CONTROLLER_0_IAM_Rx
        PduRTransmissionConfirmation = true
        PduRDestPduRef = COM_ESS_PTCANFD_EvtInfo_CONTROLLER_0_IAM_Rx
      PDUR_ROUTING_DIAG_DTCInfo_ECM_CONTROLLER_0_IAM_Rx (PduRRoutingPath):
        PduRRouteType = IF
        PduRDestPduRRef = PduRDestPdu_DIAG_DTCInfo_ECM_CONTROLLER_0_IAM_Rx
        PduRSrcPduRRef = PduRSrcPdu_DIAG_DTCInfo_ECM_CONTROLLER_0_IAM_Rx
      PduRSrcPdu_DIAG_DTCInfo_ECM_CONTROLLER_0_IAM_Rx (PduRSrcPdu):
        PduRSourcePduHandleId = PDUR_SRCPDU_CANIF_DIAG_DTCInfo_ECM_CONTROLLER_0_IAM_Rx
        PduRSrcPduUpTxConf = true
        PduRSrcPduRef = CANIF_DIAG_DTCInfo_ECM_CONTROLLER_0_IAM_Rx
      PduRDestPdu_DIAG_DTCInfo_ECM_CONTROLLER_0_IAM_Rx (PduRDestPdu):
        PduRDestPduDataProvision = PDUR_DIRECT
        PduRDestPduHandleId = PDUR_DESTPDU_COM_DIAG_DTCInfo_ECM_CONTROLLER_0_IAM_Rx
        PduRTransmissionConfirmation = true
        PduRDestPduRef = COM_DIAG_DTCInfo_ECM_CONTROLLER_0_IAM_Rx
      PDUR_ROUTING_DIAG_DTCInfo_PEU_CONTROLLER_0_IAM_Rx (PduRRoutingPath):
        PduRRouteType = IF
        PduRDestPduRRef = PduRDestPdu_DIAG_DTCInfo_PEU_CONTROLLER_0_IAM_Rx
        PduRSrcPduRRef = PduRSrcPdu_DIAG_DTCInfo_PEU_CONTROLLER_0_IAM_Rx
      PduRSrcPdu_DIAG_DTCInfo_PEU_CONTROLLER_0_IAM_Rx (PduRSrcPdu):
        PduRSourcePduHandleId = PDUR_SRCPDU_CANIF_DIAG_DTCInfo_PEU_CONTROLLER_0_IAM_Rx
        PduRSrcPduUpTxConf = true
        PduRSrcPduRef = CANIF_DIAG_DTCInfo_PEU_CONTROLLER_0_IAM_Rx
      PduRDestPdu_DIAG_DTCInfo_PEU_CONTROLLER_0_IAM_Rx (PduRDestPdu):
        PduRDestPduDataProvision = PDUR_DIRECT
        PduRDestPduHandleId = PDUR_DESTPDU_COM_DIAG_DTCInfo_PEU_CONTROLLER_0_IAM_Rx
        PduRTransmissionConfirmation = true
        PduRDestPduRef = COM_DIAG_DTCInfo_PEU_CONTROLLER_0_IAM_Rx
      PDUR_ROUTING_DIAG_DTCInfo_ESS_CONTROLLER_0_IAM_Rx (PduRRoutingPath):
        PduRRouteType = IF
        PduRDestPduRRef = PduRDestPdu_DIAG_DTCInfo_ESS_CONTROLLER_0_IAM_Rx
        PduRSrcPduRRef = PduRSrcPdu_DIAG_DTCInfo_ESS_CONTROLLER_0_IAM_Rx
      PduRSrcPdu_DIAG_DTCInfo_ESS_CONTROLLER_0_IAM_Rx (PduRSrcPdu):
        PduRSourcePduHandleId = PDUR_SRCPDU_CANIF_DIAG_DTCInfo_ESS_CONTROLLER_0_IAM_Rx
        PduRSrcPduUpTxConf = true
        PduRSrcPduRef = CANIF_DIAG_DTCInfo_ESS_CONTROLLER_0_IAM_Rx
      PduRDestPdu_DIAG_DTCInfo_ESS_CONTROLLER_0_IAM_Rx (PduRDestPdu):
        PduRDestPduDataProvision = PDUR_DIRECT
        PduRDestPduHandleId = PDUR_DESTPDU_COM_DIAG_DTCInfo_ESS_CONTROLLER_0_IAM_Rx
        PduRTransmissionConfirmation = true
        PduRDestPduRef = COM_DIAG_DTCInfo_ESS_CONTROLLER_0_IAM_Rx
      PDUR_ROUTING_DIAG_DTCInfo_TC_CONTROLLER_0_IAM_Rx (PduRRoutingPath): PduRRouteType=IF, PduRDestPduRRef=PduRDestPdu_DIAG_DTCInfo_TC_CONTROLLER_0_IAM_Rx, PduRSrcPduRRef=PduRSrcPdu_DIAG_DTCInfo_TC_CONTROLLER_0_IAM_Rx
      PduRSrcPdu_DIAG_DTCInfo_TC_CONTROLLER_0_IAM_Rx (PduRSrcPdu):
        PduRSourcePduHandleId = PDUR_SRCPDU_CANIF_DIAG_DTCInfo_TC_CONTROLLER_0_IAM_Rx
        PduRSrcPduUpTxConf = true
        PduRSrcPduRef = CANIF_DIAG_DTCInfo_TC_CONTROLLER_0_IAM_Rx
      PduRDestPdu_DIAG_DTCInfo_TC_CONTROLLER_0_IAM_Rx (PduRDestPdu):
        PduRDestPduDataProvision = PDUR_DIRECT
        PduRDestPduHandleId = PDUR_DESTPDU_COM_DIAG_DTCInfo_TC_CONTROLLER_0_IAM_Rx
        PduRTransmissionConfirmation = true
        PduRDestPduRef = COM_DIAG_DTCInfo_TC_CONTROLLER_0_IAM_Rx
      PDUR_ROUTING_Diag_CONNCANFD_PhyReq_IAM_CONTROLLER_0_IAM_Rx (PduRRoutingPath):
        PduRRouteType = TP
        PduRDestPduRRef = PduRDestPdu_Diag_CONNCANFD_PhyReq_IAM_CONTROLLER_0_IAM_Rx
        PduRSrcPduRRef = PduRSrcPdu_Diag_CONNCANFD_PhyReq_IAM_CONTROLLER_0_IAM_Rx
      PduRSrcPdu_Diag_CONNCANFD_PhyReq_IAM_CONTROLLER_0_IAM_Rx (PduRSrcPdu): PduRSourcePduHandleId=PDUR_SRCPDU_CanTp_phy_rx_0x711, PduRSrcPduUpTxConf=true, PduRSrcPduRef=CanTp_phy_rx_0x711
      PduRDestPdu_Diag_CONNCANFD_PhyReq_IAM_CONTROLLER_0_IAM_Rx (PduRDestPdu):
        PduRDestPduDataProvision = PDUR_DIRECT
        PduRDestPduHandleId = PDUR_DESTPDU_Dcm_phy_rx_0x711
        PduRTransmissionConfirmation = true
        PduRDestPduRef = Dcm_phy_rx_0x711
      PDUR_ROUTING_Diag_CONNCANFD_FuncReq_CONTROLLER_0_IAM_Rx (PduRRoutingPath):
        PduRRouteType = TP
        PduRDestPduRRef = PduRDestPdu_Diag_CONNCANFD_FuncReq_CONTROLLER_0_IAM_Rx
        PduRSrcPduRRef = PduRSrcPdu_Diag_CONNCANFD_FuncReq_CONTROLLER_0_IAM_Rx
      PduRSrcPdu_Diag_CONNCANFD_FuncReq_CONTROLLER_0_IAM_Rx (PduRSrcPdu): PduRSourcePduHandleId=PDUR_SRCPDU_CanTp_fun_rx_0x7df, PduRSrcPduUpTxConf=true, PduRSrcPduRef=CanTp_fun_rx_0x7df
      PduRDestPdu_Diag_CONNCANFD_FuncReq_CONTROLLER_0_IAM_Rx (PduRDestPdu):
        PduRDestPduDataProvision = PDUR_DIRECT
        PduRDestPduHandleId = PDUR_DESTPDU_Dcm_fun_rx_0x7df
        PduRTransmissionConfirmation = true
        PduRDestPduRef = Dcm_fun_rx_0x7df
      PDUR_ROUTING_NMUSERDATA_IAM (PduRRoutingPath): PduRRouteType=IF, PduRDestPduRRef=PduRDestPdu_CanNm_UserDataPdu_IAM, PduRSrcPduRRef=PduRSrcPdu_Com_NmUserDataPdu_IAM
      PduRSrcPdu_Com_NmUserDataPdu_IAM (PduRSrcPdu): PduRSourcePduHandleId=PDUR_SRCPDU_Com_NmUserDataPdu_IAM, PduRSrcPduUpTxConf=true, PduRSrcPduRef=Com_NmUserDataPdu_IAM
      PduRDestPdu_CanNm_UserDataPdu_IAM (PduRDestPdu):
        PduRDestPduDataProvision = PDUR_DIRECT
        PduRDestPduHandleId = PDUR_DESTPDU_CanNm_UserDataPdu_IAM
        PduRTransmissionConfirmation = true
        PduRDestPduRef = CanNm_UserDataPdu_IAM
      PduRDestPdu_CanIf_Contained_Tx_Pdu_0x377 (PduRDestPdu):
        PduRDestPduDataProvision = PDUR_DIRECT
        PduRDestPduHandleId = PDUR_DESTPDU_CanIf_Contained_Tx_Pdu_0x377
        PduRTransmissionConfirmation = true
        PduRDestPduRef = CanIf_Contained_Tx_Pdu_0x377
      PduRSrcPdu_IpduM_Contained_Tx_Pdu_0x377 (PduRSrcPdu): PduRSourcePduHandleId=PDUR_SRCPDU_IpduM_Contained_Tx_Pdu_0x377, PduRSrcPduUpTxConf=true, PduRSrcPduRef=IpduM_Contained_Tx_Pdu_0x377
      PduRDestPdu_IpduM_Contained_Tx_0x377_Pdu06 (PduRDestPdu):
        PduRDestPduDataProvision = PDUR_DIRECT
        PduRDestPduHandleId = PDUR_DESTPDU_IpduM_Contained_Tx_0x377_Pdu06
        PduRTransmissionConfirmation = true
        PduRDestPduRef = IpduM_Contained_Tx_0x377_Pdu06
      PduRSrcPdu_Com_Contained_Tx_0x377_Pdu06 (PduRSrcPdu): PduRSourcePduHandleId=PDUR_SRCPDU_Com_Contained_Tx_0x377_Pdu06, PduRSrcPduUpTxConf=true, PduRSrcPduRef=Com_Contained_Tx_0x377_Pdu06
      PduRDestPdu_IpduM_Contained_Tx_0x377_Pdu07 (PduRDestPdu):
        PduRDestPduDataProvision = PDUR_DIRECT
        PduRDestPduHandleId = PDUR_DESTPDU_IpduM_Contained_Tx_0x377_Pdu07
        PduRTransmissionConfirmation = true
        PduRDestPduRef = IpduM_Contained_Tx_0x377_Pdu07
      PduRRoutingPath_Contained_Tx_Pdu_0x377 (PduRRoutingPath): PduRRouteType=IF, PduRDestPduRRef=PduRDestPdu_CanIf_Contained_Tx_Pdu_0x377, PduRSrcPduRRef=PduRSrcPdu_IpduM_Contained_Tx_Pdu_0x377
      PduRSrcPdu_Com_Contained_Tx_0x377_Pdu07 (PduRSrcPdu): PduRSourcePduHandleId=PDUR_SRCPDU_Com_Contained_Tx_0x377_Pdu07, PduRSrcPduUpTxConf=true, PduRSrcPduRef=Com_Contained_Tx_0x377_Pdu07
      PduRDestPdu_IpduM_Contained_Tx_0x377_Pdu08 (PduRDestPdu):
        PduRDestPduDataProvision = PDUR_DIRECT
        PduRDestPduHandleId = PDUR_DESTPDU_IpduM_Contained_Tx_0x377_Pdu08
        PduRTransmissionConfirmation = true
        PduRDestPduRef = IpduM_Contained_Tx_0x377_Pdu08
      PduRSrcPdu_Com_Contained_Tx_0x377_Pdu08 (PduRSrcPdu): PduRSourcePduHandleId=PDUR_SRCPDU_Com_Contained_Tx_0x377_Pdu08, PduRSrcPduUpTxConf=true, PduRSrcPduRef=Com_Contained_Tx_0x377_Pdu08
      9 x PduRRoutingPath, all with PduRRouteType=IF:
        PduRRoutingPath_Contained_Tx_0x377_Pdu{06..08}: PduRDestPduRRef=PduRDestPdu_IpduM_Contained_Tx_0x377_Pdu{06..08}, PduRSrcPduRRef=PduRSrcPdu_Com_Contained_Tx_0x377_Pdu{06..08}
        PduRRoutingPath_Contained_Tx_Pdu_0x36A: PduRDestPduRRef=PduRDestPdu_CanIf_Contained_Tx_Pdu_0x36A, PduRSrcPduRRef=PduRSrcPdu_IpduM_Contained_Tx_Pdu_0x36A
        PduRRoutingPath_Contained_Tx_0x36A_Pdu13: PduRDestPduRRef=PduRDestPdu_IpduM_Contained_Tx_0x36A_Pdu13, PduRSrcPduRRef=PduRSrcPdu_Com_Contained_Tx_0x36A_Pdu13
        PduRRoutingPath_Contained_Tx_0x36A_Pdu34: PduRDestPduRRef=PduRDestPdu_IpduM_Contained_Tx_0x36A_Pdu34, PduRSrcPduRRef=PduRSrcPdu_Com_Contained_Tx_0x36A_Pdu34
        PduRRoutingPath_Contained_Tx_0x36A_Pdu35: PduRDestPduRRef=PduRDestPdu_IpduM_Contained_Tx_0x36A_Pdu35, PduRSrcPduRRef=PduRSrcPdu_Com_Contained_Tx_0x36A_Pdu35
        PduRRoutingPath_Contained_Tx_0x36A_Pdu39: PduRDestPduRRef=PduRDestPdu_IpduM_Contained_Tx_0x36A_Pdu39, PduRSrcPduRRef=PduRSrcPdu_Com_Contained_Tx_0x36A_Pdu39
        PduRRoutingPath_Contained_Tx_0x36A_Pdu40: PduRDestPduRRef=PduRDestPdu_IpduM_Contained_Tx_0x36A_Pdu40, PduRSrcPduRRef=PduRSrcPdu_Com_Contained_Tx_0x36A_Pdu40
      6 x PduRDestPdu, all with PduRDestPduDataProvision=PDUR_DIRECT, PduRTransmissionConfirmation=true:
        PduRDestPdu_CanIf_Contained_Tx_Pdu_0x36A: PduRDestPduHandleId=PDUR_DESTPDU_CanIf_Contained_Tx_Pdu_0x36A, PduRDestPduRef=CanIf_Contained_Tx_Pdu_0x36A
        PduRDestPdu_IpduM_Contained_Tx_0x36A_Pdu13: PduRDestPduHandleId=PDUR_DESTPDU_IpduM_Contained_Tx_0x36A_Pdu13, PduRDestPduRef=IpduM_Contained_Tx_0x36A_Pdu13
        PduRDestPdu_IpduM_Contained_Tx_0x36A_Pdu34: PduRDestPduHandleId=PDUR_DESTPDU_IpduM_Contained_Tx_0x36A_Pdu34, PduRDestPduRef=IpduM_Contained_Tx_0x36A_Pdu34
        PduRDestPdu_IpduM_Contained_Tx_0x36A_Pdu35: PduRDestPduHandleId=PDUR_DESTPDU_IpduM_Contained_Tx_0x36A_Pdu35, PduRDestPduRef=IpduM_Contained_Tx_0x36A_Pdu35
        PduRDestPdu_IpduM_Contained_Tx_0x36A_Pdu39: PduRDestPduHandleId=PDUR_DESTPDU_IpduM_Contained_Tx_0x36A_Pdu39, PduRDestPduRef=IpduM_Contained_Tx_0x36A_Pdu39
        PduRDestPdu_IpduM_Contained_Tx_0x36A_Pdu40: PduRDestPduHandleId=PDUR_DESTPDU_IpduM_Contained_Tx_0x36A_Pdu40, PduRDestPduRef=IpduM_Contained_Tx_0x36A_Pdu40
      6 x PduRSrcPdu, all with PduRSrcPduUpTxConf=true:
        PduRSrcPdu_IpduM_Contained_Tx_Pdu_0x36A: PduRSourcePduHandleId=PDUR_SRCPDU_IpduM_Contained_Tx_Pdu_0x36A, PduRSrcPduRef=IpduM_Contained_Tx_Pdu_0x36A
        PduRSrcPdu_Com_Contained_Tx_0x36A_Pdu13: PduRSourcePduHandleId=PDUR_SRCPDU_Com_Contained_Tx_0x36A_Pdu13, PduRSrcPduRef=Com_Contained_Tx_0x36A_Pdu13
        PduRSrcPdu_Com_Contained_Tx_0x36A_Pdu34: PduRSourcePduHandleId=PDUR_SRCPDU_Com_Contained_Tx_0x36A_Pdu34, PduRSrcPduRef=Com_Contained_Tx_0x36A_Pdu34
        PduRSrcPdu_Com_Contained_Tx_0x36A_Pdu35: PduRSourcePduHandleId=PDUR_SRCPDU_Com_Contained_Tx_0x36A_Pdu35, PduRSrcPduRef=Com_Contained_Tx_0x36A_Pdu35
        PduRSrcPdu_Com_Contained_Tx_0x36A_Pdu39: PduRSourcePduHandleId=PDUR_SRCPDU_Com_Contained_Tx_0x36A_Pdu39, PduRSrcPduRef=Com_Contained_Tx_0x36A_Pdu39
        PduRSrcPdu_Com_Contained_Tx_0x36A_Pdu40: PduRSourcePduHandleId=PDUR_SRCPDU_Com_Contained_Tx_0x36A_Pdu40, PduRSrcPduRef=Com_Contained_Tx_0x36A_Pdu40
      5 x PduRRoutingPath, all with PduRRouteType=IF:
        PduRRoutingPath_Contained_Tx_Pdu_0x3A2: PduRDestPduRRef=PduRDestPdu_CanIf_Contained_Tx_Pdu_0x3A2, PduRSrcPduRRef=PduRSrcPdu_IpduM_Contained_Tx_Pdu_0x3A2
        PduRRoutingPath_Contained_Tx_0x3A2_Pdu03: PduRDestPduRRef=PduRDestPdu_IpduM_Contained_Tx_0x3A2_Pdu03, PduRSrcPduRRef=PduRSrcPdu_Com_Contained_Tx_0x3A2_Pdu03
        PduRRoutingPath_Contained_Tx_0x3A2_Pdu04: PduRDestPduRRef=PduRDestPdu_IpduM_Contained_Tx_0x3A2_Pdu04, PduRSrcPduRRef=PduRSrcPdu_Com_Contained_Tx_0x3A2_Pdu04
        PduRRoutingPath_Contained_Tx_0x3A2_Pdu41: PduRDestPduRRef=PduRDestPdu_IpduM_Contained_Tx_0x3A2_Pdu41, PduRSrcPduRRef=PduRSrcPdu_Com_Contained_Tx_0x3A2_Pdu41
        PduRRoutingPath_Contained_Tx_0x3A2_Pdu57: PduRDestPduRRef=PduRDestPdu_IpduM_Contained_Tx_0x3A2_Pdu57, PduRSrcPduRRef=PduRSrcPdu_Com_Contained_Tx_0x3A2_Pdu57
      5 x PduRDestPdu, all with PduRDestPduDataProvision=PDUR_DIRECT, PduRTransmissionConfirmation=true:
        PduRDestPdu_CanIf_Contained_Tx_Pdu_0x3A2: PduRDestPduHandleId=PDUR_DESTPDU_CanIf_Contained_Tx_Pdu_0x3A2, PduRDestPduRef=CanIf_Contained_Tx_Pdu_0x3A2
        PduRDestPdu_IpduM_Contained_Tx_0x3A2_Pdu03: PduRDestPduHandleId=PDUR_DESTPDU_IpduM_Contained_Tx_0x3A2_Pdu03, PduRDestPduRef=IpduM_Contained_Tx_0x3A2_Pdu03
        PduRDestPdu_IpduM_Contained_Tx_0x3A2_Pdu04: PduRDestPduHandleId=PDUR_DESTPDU_IpduM_Contained_Tx_0x3A2_Pdu04, PduRDestPduRef=IpduM_Contained_Tx_0x3A2_Pdu04
        PduRDestPdu_IpduM_Contained_Tx_0x3A2_Pdu41: PduRDestPduHandleId=PDUR_DESTPDU_IpduM_Contained_Tx_0x3A2_Pdu41, PduRDestPduRef=IpduM_Contained_Tx_0x3A2_Pdu41
        PduRDestPdu_IpduM_Contained_Tx_0x3A2_Pdu57: PduRDestPduHandleId=PDUR_DESTPDU_IpduM_Contained_Tx_0x3A2_Pdu57, PduRDestPduRef=IpduM_Contained_Tx_0x3A2_Pdu57
      5 x PduRSrcPdu, all with PduRSrcPduUpTxConf=true:
        PduRSrcPdu_IpduM_Contained_Tx_Pdu_0x3A2: PduRSourcePduHandleId=PDUR_SRCPDU_IpduM_Contained_Tx_Pdu_0x3A2, PduRSrcPduRef=IpduM_Contained_Tx_Pdu_0x3A2
        PduRSrcPdu_Com_Contained_Tx_0x3A2_Pdu03: PduRSourcePduHandleId=PDUR_SRCPDU_Com_Contained_Tx_0x3A2_Pdu03, PduRSrcPduRef=Com_Contained_Tx_0x3A2_Pdu03
        PduRSrcPdu_Com_Contained_Tx_0x3A2_Pdu04: PduRSourcePduHandleId=PDUR_SRCPDU_Com_Contained_Tx_0x3A2_Pdu04, PduRSrcPduRef=Com_Contained_Tx_0x3A2_Pdu04
        PduRSrcPdu_Com_Contained_Tx_0x3A2_Pdu41: PduRSourcePduHandleId=PDUR_SRCPDU_Com_Contained_Tx_0x3A2_Pdu41, PduRSrcPduRef=Com_Contained_Tx_0x3A2_Pdu41
        PduRSrcPdu_Com_Contained_Tx_0x3A2_Pdu57: PduRSourcePduHandleId=PDUR_SRCPDU_Com_Contained_Tx_0x3A2_Pdu57, PduRSrcPduRef=Com_Contained_Tx_0x3A2_Pdu57
      PDUR_ROUTING_synthesized_IAM_ComKeyResp_0x98_CONTROLLER_0_IAM (PduRRoutingPath):
        PduRRouteType = IF
        PduRDestPduRRef = PsduRDestPdu_CANIF_0x98_synthesized_IAM_ComKeyResp_CONTROLLER_0_IAM_Tx
        PduRSrcPduRRef = PduRSrcPdu_COM_0x98_synthesized_IAM_ComKeyResp_CONTROLLER_0_IAM_Tx
      PduRSrcPdu_Sec_CAN0_Rx_SecOC_SyncMsg_0x56F_SecOC_Authentic (PduRSrcPdu):
        PduRSourcePduHandleId = PDUR_SRCPDU_CAN0_Rx_SecOC_SyncMsg_0x56F_SecOC_Authentic
        PduRSrcPduUpTxConf = true
        PduRSrcPduRef = CAN0_Rx_SecOC_SyncMsg_0x56F_SecOC_Authentic
      PduRDestPdu_Sec_CAN0_Rx_SecOC_SyncMsg_0x56F_SecOC_Secured (PduRDestPdu):
        PduRDestPduDataProvision = PDUR_DIRECT
        PduRDestPduHandleId = PDUR_DESTPDU_CAN0_Rx_SecOC_SyncMsg_0x56F_SecOC_Secured
        PduRTransmissionConfirmation = true
        PduRDestPduRef = CAN0_Rx_SecOC_SyncMsg_0x56F_SecOC_Secured
      PDUR_ROUTING_CanIf2Sec_CAN0_Rx_SecOC_SyncMsg_0x56F_SecOC_Secured (PduRRoutingPath):
        PduRRouteType = IF
        PduRDestPduRRef = PduRDestPdu_Sec_CAN0_Rx_SecOC_SyncMsg_0x56F_SecOC_Secured
        PduRSrcPduRRef = PduRSrcPdu_CanIf_CAN0_Rx_SecOC_SyncMsg_0x56F_SecOC_Secured
      PDUR_ROUTING_Sec2Com_CAN0_Rx_SecOC_SyncMsg_0x56F_SecOC_Authentic (PduRRoutingPath):
        PduRRouteType = IF
        PduRDestPduRRef = PsduRDestPdu_Com_CAN0_Rx_SecOC_SyncMsg_0x56F_SecOC_Authentic
        PduRSrcPduRRef = PduRSrcPdu_Sec_CAN0_Rx_SecOC_SyncMsg_0x56F_SecOC_Authentic
      PduRSrcPdu_SecOC_0x12A_synthesized_IAM_BKPCANFD_20ms_Fr_CONTROLLER_0_IAM_TxSecured (PduRSrcPdu):
        PduRSourcePduHandleId = PDUR_SRCPDU_SecOC_synthesized_IAM_BKPCANFD_20ms_Fr_CONTROLLER_0_IAM_TxSecured
        PduRSrcPduUpTxConf = true
        PduRSrcPduRef = SecOC_synthesized_IAM_BKPCANFD_20ms_Fr_CONTROLLER_0_IAM_TxSecured
      PsduRDestPdu_SecOC_0x12A_synthesized_IAM_BKPCANFD_20ms_Fr_CONTROLLER_0_IAM_TxAuthentic (PduRDestPdu):
        PduRDestPduDataProvision = PDUR_DIRECT
        PduRDestPduHandleId = PDUR_DESTPDU_SecOC_synthesized_IAM_BKPCANFD_20ms_Fr_CONTROLLER_0_IAM_TxAuthentic
        PduRTransmissionConfirmation = true
        PduRDestPduRef = SecOC_synthesized_IAM_BKPCANFD_20ms_Fr_CONTROLLER_0_IAM_TxAuthentic
      PDUR_ROUTING_Sec2CanIf_synthesized_IAM_BKPCANFD_20ms_Fr_0x12A_CONTROLLER_0_IAM_Tx_Secured (PduRRoutingPath):
        PduRRouteType = IF
        PduRDestPduRRef = PsduRDestPdu_CANIF_0x12A_synthesized_IAM_BKPCANFD_20ms_Fr_CONTROLLER_0_IAM_Tx
        PduRSrcPduRRef = PduRSrcPdu_SecOC_0x12A_synthesized_IAM_BKPCANFD_20ms_Fr_CONTROLLER_0_IAM_TxSecured
      PDUR_ROUTING_Sec2CanIf_synthesized_IAM_ZONE_CONNCA_0001_0xB3_CONTROLLER_0_IAM_Tx_Secured (PduRRoutingPath):
        PduRRouteType = IF
        PduRDestPduRRef = PsduRDestPdu_CANIF_0xB3_synthesized_IAM_ZONE_CONNCA_0001_CONTROLLER_0_IAM_Tx
        PduRSrcPduRRef = PduRSrcPdu_SecOC_0xB3_synthesized_IAM_ZONE_CONNCA_0001_CONTROLLER_0_IAM_TxSecured
      PsduRDestPdu_SecOC_0xB3_synthesized_IAM_ZONE_CONNCA_0001_CONTROLLER_0_IAM_TxAuthentic (PduRDestPdu):
        PduRDestPduDataProvision = PDUR_DIRECT
        PduRDestPduHandleId = PDUR_DESTPDU_SecOC_synthesized_IAM_ZONE_CONNCA_0001_CONTROLLER_0_IAM_TxAuthentic
        PduRTransmissionConfirmation = true
        PduRDestPduRef = SecOC_synthesized_IAM_ZONE_CONNCA_0001_CONTROLLER_0_IAM_TxAuthentic
      PduRSrcPdu_SecOC_0xB3_synthesized_IAM_ZONE_CONNCA_0001_CONTROLLER_0_IAM_TxSecured (PduRSrcPdu):
        PduRSourcePduHandleId = PDUR_SRCPDU_SecOC_synthesized_IAM_ZONE_CONNCA_0001_CONTROLLER_0_IAM_TxSecured
        PduRSrcPduUpTxConf = true
        PduRSrcPduRef = SecOC_synthesized_IAM_ZONE_CONNCA_0001_CONTROLLER_0_IAM_TxSecured
      PDUR_ROUTING_Sec2CanIf_synthesized_IAM_ZONE_CONNCA_0000_0x9F_CONTROLLER_0_IAM_Tx_Secured (PduRRoutingPath):
        PduRRouteType = IF
        PduRDestPduRRef = PsduRDestPdu_CANIF_0x9F_synthesized_IAM_ZONE_CONNCA_0000_CONTROLLER_0_IAM_Tx
        PduRSrcPduRRef = PduRSrcPdu_SecOC_0x9F_synthesized_IAM_ZONE_CONNCA_0000_CONTROLLER_0_IAM_TxSecured
      PsduRDestPdu_SecOC_0x9F_synthesized_IAM_ZONE_CONNCA_0000_CONTROLLER_0_IAM_TxAuthentic (PduRDestPdu):
        PduRDestPduDataProvision = PDUR_DIRECT
        PduRDestPduHandleId = PDUR_DESTPDU_SecOC_synthesized_IAM_ZONE_CONNCA_0000_CONTROLLER_0_IAM_TxAuthentic
        PduRTransmissionConfirmation = true
        PduRDestPduRef = SecOC_synthesized_IAM_ZONE_CONNCA_0000_CONTROLLER_0_IAM_TxAuthentic
      PduRSrcPdu_SecOC_0x9F_synthesized_IAM_ZONE_CONNCA_0000_CONTROLLER_0_IAM_TxSecured (PduRSrcPdu):
        PduRSourcePduHandleId = PDUR_SRCPDU_SecOC_synthesized_IAM_ZONE_CONNCA_0000_CONTROLLER_0_IAM_TxSecured
        PduRSrcPduUpTxConf = true
        PduRSrcPduRef = SecOC_synthesized_IAM_ZONE_CONNCA_0000_CONTROLLER_0_IAM_TxSecured
      PDUR_ROUTING_Sec2CanIf_synthesized_IAM_ZONE_CONNCANFD_E_0x7D_CONTROLLER_0_IAM_Tx_Secured (PduRRoutingPath):
        PduRRouteType = IF
        PduRDestPduRRef = PsduRDestPdu_CANIF_0x7D_synthesized_IAM_ZONE_CONNCANFD_E_CONTROLLER_0_IAM_Tx
        PduRSrcPduRRef = PduRSrcPdu_SecOC_0x7D_synthesized_IAM_ZONE_CONNCANFD_E_CONTROLLER_0_IAM_TxSecured
      PsduRDestPdu_SecOC_0x7D_synthesized_IAM_ZONE_CONNCANFD_E_CONTROLLER_0_IAM_TxAuthentic (PduRDestPdu):
        PduRDestPduDataProvision = PDUR_DIRECT
        PduRDestPduHandleId = PDUR_DESTPDU_SecOC_synthesized_IAM_ZONE_CONNCANFD_E_CONTROLLER_0_IAM_TxAuthentic
        PduRTransmissionConfirmation = true
        PduRDestPduRef = SecOC_synthesized_IAM_ZONE_CONNCANFD_E_CONTROLLER_0_IAM_TxAuthentic
      PduRSrcPdu_SecOC_0x7D_synthesized_IAM_ZONE_CONNCANFD_E_CONTROLLER_0_IAM_TxSecured (PduRSrcPdu):
        PduRSourcePduHandleId = PDUR_SRCPDU_SecOC_synthesized_IAM_ZONE_CONNCANFD_E_CONTROLLER_0_IAM_TxSecured
        PduRSrcPduUpTxConf = true
        PduRSrcPduRef = SecOC_synthesized_IAM_ZONE_CONNCANFD_E_CONTROLLER_0_IAM_TxSecured
    7 x PduRBswModules, all with PduRRetransmission=false, PduRUseTag=true:
      PduRBswModules_COM: PduRCancelReceive=true, PduRCancelTransmit=true, PduRCommunicationInterface=true, PduRCopyRxData=true, PduRCopyTxData=true, PduRLowerModule=false, PduRRxIndication=true, PduRStartOfReception=true, PduRTpRxIndication=true, PduRTpTransmit=false, PduRTpTxConfirmation=true, PduRTransmit=true, PduRTransportProtocol=true, PduRTriggertransmit=true, PduRTxConfirmation=true, PduRUpperModule=false, PduRBswModuleRef=Com
      PduRBswModules_CANIF: PduRCancelReceive=false, PduRCancelTransmit=false, PduRCommunicationInterface=true, PduRCopyRxData=false, PduRCopyTxData=false, PduRLowerModule=true, PduRRxIndication=true, PduRStartOfReception=false, PduRTpRxIndication=false, PduRTpTransmit=false, PduRTpTxConfirmation=false, PduRTransmit=true, PduRTransportProtocol=false, PduRTriggertransmit=true, PduRTxConfirmation=true, PduRUpperModule=false, PduRBswModuleRef=CanIf
      PduRBswModules_CanNm: PduRCancelReceive=false, PduRCancelTransmit=false, PduRCommunicationInterface=true, PduRCopyRxData=false, PduRCopyTxData=false, PduRLowerModule=true, PduRRxIndication=true, PduRStartOfReception=false, PduRTpRxIndication=false, PduRTpTransmit=false, PduRTpTxConfirmation=false, PduRTransmit=true, PduRTransportProtocol=false, PduRTriggertransmit=true, PduRTxConfirmation=true, PduRUpperModule=false, PduRBswModuleRef=CanNm
      PduRBswModules_CANTP: PduRCancelReceive=false, PduRCancelTransmit=false, PduRCommunicationInterface=false, PduRCopyRxData=true, PduRCopyTxData=true, PduRLowerModule=true, PduRRxIndication=false, PduRStartOfReception=true, PduRTpRxIndication=true, PduRTpTransmit=true, PduRTpTxConfirmation=true, PduRTransmit=false, PduRTransportProtocol=true, PduRTriggertransmit=false, PduRTxConfirmation=false, PduRUpperModule=false, PduRBswModuleRef=CanTp
      PduRBswModules_DCM: PduRCancelReceive=true, PduRCancelTransmit=true, PduRCommunicationInterface=true, PduRCopyRxData=true, PduRCopyTxData=true, PduRLowerModule=false, PduRRxIndication=false, PduRStartOfReception=true, PduRTpRxIndication=true, PduRTpTransmit=false, PduRTpTxConfirmation=true, PduRTransmit=true, PduRTransportProtocol=true, PduRTriggertransmit=false, PduRTxConfirmation=true, PduRUpperModule=false, PduRBswModuleRef=Dcm
      PduRBswModules_IpduM: PduRCancelReceive=false, PduRCancelTransmit=false, PduRCommunicationInterface=true, PduRCopyRxData=false, PduRCopyTxData=false, PduRLowerModule=true, PduRRxIndication=true, PduRStartOfReception=false, PduRTpRxIndication=false, PduRTpTransmit=false, PduRTpTxConfirmation=false, PduRTransmit=true, PduRTransportProtocol=false, PduRTriggertransmit=true, PduRTxConfirmation=true, PduRUpperModule=false, PduRBswModuleRef=IpduM
      PduRBswModules_SecOC: PduRCancelReceive=true, PduRCancelTransmit=true, PduRCommunicationInterface=true, PduRCopyRxData=true, PduRCopyTxData=true, PduRLowerModule=true, PduRRxIndication=true, PduRStartOfReception=true, PduRTpRxIndication=true, PduRTpTransmit=true, PduRTpTxConfirmation=true, PduRTransmit=true, PduRTransportProtocol=true, PduRTriggertransmit=true, PduRTxConfirmation=true, PduRUpperModule=true, PduRBswModuleRef=SecOC
