AUTOSAR XML (schema 00048)
package /R7F7015833
  module config Nm
    NmChannelConfig_0 (NmChannelConfig):
      NmChannelSleepMaster = false
      NmPassiveModeEnabled = false
      NmStateReportEnabled = true
      NmSynchronizingNetwork = false
      NmComUserDataSupport = true
      NmComMChannelRef = ComMChannel_0
      NmStateReportSignalRef = IIAM_NM_CANNM_State_CONNCANFD_IAM_CONNCANFD_NM_CONTROLLER_0_IAM_Tx
      NmBusType
        NmStandardBusNmConfig: NmStandardBusType=NM_BUSNM_CANNM
    NmGlobalConfig
      NmGlobalConstants: NmNumberOfChannels=1
      NmGlobalFeatures:
        NmBusSynchronizationEnabled = false
        NmCarWakeUpRxEnabled = false
        NmComControlEnabled = true
        NmCoordinatorSupportEnabled = false
        NmCoordinatorSyncSupport = false
        NmPduRxIndicationEnabled = true
        NmRemoteSleepIndEnabled = false
        NmStateChangeIndEnabled = true
        NmUserDataEnabled = false
      NmGlobalProperties: NmDevErrorDetect=false, NmVersionInfoApi=false
