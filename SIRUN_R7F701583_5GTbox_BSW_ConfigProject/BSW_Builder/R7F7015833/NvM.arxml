AUTOSAR XML (schema 00048)
package /R7F7015833
  module config NvM
    NvMCommon:
      NvMApiConfigClass = NVM_API_CONFIG_CLASS_3
      NvMBswMMultiBlockJobStatusInformation = false
      NvMCompiledConfigId = 43707
      NvMCrcNumOfBytes = 128
      NvMDatasetSelectionBits = 8
      NvMDevErrorDetect = false
      NvMDrvModeSwitch = false
      NvMDynamicConfiguration = false
      NvMJobPrioritization = false
      NvMMainFunctionPeriod = 0.01
      NvMPollingMode = true
      NvMRepeatMirrorOperations = 5
      NvMSetRamBlockStatusApi = false
      NvMSizeStandardJobQueue = 10
      NvMVersionInfoApi = false
    52 x NvMBlockDescriptor, all with NvMBlockJobPriority=1, NvMBlockUseAutoValidation=false, NvMBlockUseCompression=false, NvMBlockUseCrc=true, NvMBlockUsePort=false, NvMBlockUseSetRamBlockStatus=false, NvMBlockUseSyncMechanism=false, NvMBlockWriteProt=false, NvMBswMBlockStatusInformation=false, NvMMaxNumOfReadRetries=3, NvMMaxNumOfWriteRetries=3, NvMNvramDeviceId=0, NvMResistantToChangedSw=true, NvMSelectBlockForFirstInitAll=false, NvMSelectBlockForReadAll=true, NvMSelectBlockForWriteAll=true, NvMStaticBlockIDCheck=false, NvMWriteBlockOnce=false, NvMWriteVerification=false, NvMWriteVerificationDataSize=0, NvMBlockCrcType=NVM_CRC16:
      NvMBlock_ConfigID: NvMBlockManagementType=NVM_BLOCK_REDUNDANT, NvMBlockUseCRCCompMechanism=false, NvMCalcRamBlockCrc=true, NvMNvBlockBaseNumber=1, NvMNvBlockLength=2, NvMNvBlockNum=2, NvMNvramBlockIdentifier=NvMBlock_ConfigID, NvMRamBlockDataBufferAutoFill=true, NvMRomBlockNum=0, NvMRamBlockDataAddress=NvMBlockRamBuffer1
        NvMTargetBlockReference
          NvMFeeRef: NvMNameOfFeeBlock=FeeBlockConfiguration_0
      NvMBlock_DIDF1A9: NvMBlockManagementType=NVM_BLOCK_NATIVE, NvMBlockUseCRCCompMechanism=true, NvMCalcRamBlockCrc=true, NvMNvBlockBaseNumber=2, NvMNvBlockLength=5, NvMNvBlockNum=1, NvMNvramBlockIdentifier=NvMBlock_DIDF1A9, NvMRamBlockDataBufferAutoFill=true, NvMRomBlockNum=1, NvMRamBlockDataAddress=NvMBlockRamBuffer2, NvMRomBlockDataAddress=NvMBlock_DIDF1A9_RomAddress
        NvMTargetBlockReference
          NvMFeeRef: NvMNameOfFeeBlock=FeeBlockConfiguration_DIDF1A9
      NvMBlock_All_EventEntry: NvMBlockManagementType=NVM_BLOCK_NATIVE, NvMBlockUseCRCCompMechanism=false, NvMCalcRamBlockCrc=false, NvMNvBlockBaseNumber=3, NvMNvBlockLength=3132, NvMNvBlockNum=1, NvMNvramBlockIdentifier=NvMBlock_All_EventEntry, NvMRamBlockDataBufferAutoFill=false, NvMRomBlockNum=0, NvMRamBlockDataAddress=DemEventMemoryEntryStorage
        NvMTargetBlockReference
          NvMFeeRef: NvMNameOfFeeBlock=FeeBlockConfiguration_All_EventEntry
      NvMBlock_UDS_InternalData: NvMBlockManagementType=NVM_BLOCK_NATIVE, NvMBlockUseCRCCompMechanism=false, NvMCalcRamBlockCrc=false, NvMNvBlockBaseNumber=4, NvMNvBlockLength=182, NvMNvBlockNum=1, NvMNvramBlockIdentifier=NvMBlock_UDS_InternalData, NvMRamBlockDataBufferAutoFill=false, NvMRomBlockNum=0, NvMRamBlockDataAddress=DemEventRelateInformationStorage
        NvMTargetBlockReference
          NvMFeeRef: NvMNameOfFeeBlock=FeeBlockConfiguration_UDS_InternalData
      NvMBlock_DIDF18B: NvMBlockManagementType=NVM_BLOCK_NATIVE, NvMBlockUseCRCCompMechanism=true, NvMCalcRamBlockCrc=true, NvMNvBlockBaseNumber=5, NvMNvBlockLength=3, NvMNvBlockNum=1, NvMNvramBlockIdentifier=NvMBlock_DIDF18B, NvMRamBlockDataBufferAutoFill=true, NvMRomBlockNum=1, NvMRamBlockDataAddress=NvMBlockRamBuffer5, NvMRomBlockDataAddress=NvMBlock_DIDF18B_RomAddress
        NvMTargetBlockReference
          NvMFeeRef: NvMNameOfFeeBlock=FeeBlockConfiguration_DIDF18B
      NvMBlock_DIDF18C: NvMBlockManagementType=NVM_BLOCK_NATIVE, NvMBlockUseCRCCompMechanism=true, NvMCalcRamBlockCrc=true, NvMNvBlockBaseNumber=6, NvMNvBlockLength=16, NvMNvBlockNum=1, NvMNvramBlockIdentifier=NvMBlock_DIDF18C, NvMRamBlockDataBufferAutoFill=true, NvMRomBlockNum=1, NvMRamBlockDataAddress=NvMBlockRamBuffer6, NvMRomBlockDataAddress=NvMBlock_DIDF18C_RomAddress
        NvMTargetBlockReference
          NvMFeeRef: NvMNameOfFeeBlock=FeeBlockConfiguration_DIDF18C
      NvMBlock_DIDF190: NvMBlockManagementType=NVM_BLOCK_NATIVE, NvMBlockUseCRCCompMechanism=true, NvMCalcRamBlockCrc=true, NvMNvBlockBaseNumber=7, NvMNvBlockLength=17, NvMNvBlockNum=1, NvMNvramBlockIdentifier=NvMBlock_DIDF190, NvMRamBlockDataBufferAutoFill=true, NvMRomBlockNum=1, NvMRamBlockDataAddress=NvMBlockRamBuffer7, NvMRomBlockDataAddress=NvMBlock_DIDF190_RomAddress
        NvMTargetBlockReference
          NvMFeeRef: NvMNameOfFeeBlock=FeeBlockConfiguration_DIDF190
      NvMBlock_DIDF198: NvMBlockManagementType=NVM_BLOCK_NATIVE, NvMBlockUseCRCCompMechanism=true, NvMCalcRamBlockCrc=true, NvMNvBlockBaseNumber=8, NvMNvBlockLength=11, NvMNvBlockNum=1, NvMNvramBlockIdentifier=NvMBlock_DIDF198, NvMRamBlockDataBufferAutoFill=true, NvMRomBlockNum=1, NvMRamBlockDataAddress=NvMBlockRamBuffer8, NvMRomBlockDataAddress=NvMBlock_DIDF198_RomAddress
        NvMTargetBlockReference
          NvMFeeRef: NvMNameOfFeeBlock=FeeBlockConfiguration_DIDF198
      NvMBlock_DIDF1A8: NvMBlockManagementType=NVM_BLOCK_NATIVE, NvMBlockUseCRCCompMechanism=true, NvMCalcRamBlockCrc=true, NvMNvBlockBaseNumber=9, NvMNvBlockLength=20, NvMNvBlockNum=1, NvMNvramBlockIdentifier=NvMBlock_DIDF1A8, NvMRamBlockDataBufferAutoFill=true, NvMRomBlockNum=1, NvMRamBlockDataAddress=NvMBlockRamBuffer9, NvMRomBlockDataAddress=NvMBlock_DIDF1A8_RomAddress
        NvMTargetBlockReference
          NvMFeeRef: NvMNameOfFeeBlock=FeeBlockConfiguration_DIDF1A8
      NvMBlock_DIDF130: NvMBlockManagementType=NVM_BLOCK_NATIVE, NvMBlockUseCRCCompMechanism=true, NvMCalcRamBlockCrc=true, NvMNvBlockBaseNumber=10, NvMNvBlockLength=32, NvMNvBlockNum=1, NvMNvramBlockIdentifier=NvMBlock_DIDF130, NvMRamBlockDataBufferAutoFill=true, NvMRomBlockNum=1, NvMRamBlockDataAddress=NvMBlockRamBuffer10, NvMRomBlockDataAddress=NvMBlock_DIDF130_RomAddress
        NvMTargetBlockReference
          NvMFeeRef: NvMNameOfFeeBlock=FeeBlockConfiguration_DIDF130
      NvMBlock_DIDC001: NvMBlockManagementType=NVM_BLOCK_NATIVE, NvMBlockUseCRCCompMechanism=true, NvMCalcRamBlockCrc=true, NvMNvBlockBaseNumber=11, NvMNvBlockLength=64, NvMNvBlockNum=1, NvMNvramBlockIdentifier=NvMBlock_DIDC001, NvMRamBlockDataBufferAutoFill=true, NvMRomBlockNum=1, NvMRamBlockDataAddress=NvMBlockRamBuffer11, NvMRomBlockDataAddress=NvMBlock_DIDC001_RomAddress
        NvMTargetBlockReference
          NvMFeeRef: NvMNameOfFeeBlock=FeeBlockConfiguration_DIDC001
      NvMBlock_DIDC002: NvMBlockManagementType=NVM_BLOCK_NATIVE, NvMBlockUseCRCCompMechanism=true, NvMCalcRamBlockCrc=true, NvMNvBlockBaseNumber=12, NvMNvBlockLength=32, NvMNvBlockNum=1, NvMNvramBlockIdentifier=NvMBlock_DIDC002, NvMRamBlockDataBufferAutoFill=true, NvMRomBlockNum=1, NvMRamBlockDataAddress=NvMBlockRamBuffer12, NvMRomBlockDataAddress=NvMBlock_DIDC002_RomAddress
        NvMTargetBlockReference
          NvMFeeRef: NvMNameOfFeeBlock=FeeBlockConfiguration_DIDC002
      NvMBlock_DIDC003: NvMBlockManagementType=NVM_BLOCK_NATIVE, NvMBlockUseCRCCompMechanism=true, NvMCalcRamBlockCrc=true, NvMNvBlockBaseNumber=13, NvMNvBlockLength=32, NvMNvBlockNum=1, NvMNvramBlockIdentifier=NvMBlock_DIDC003, NvMRamBlockDataBufferAutoFill=true, NvMRomBlockNum=1, NvMRamBlockDataAddress=NvMBlockRamBuffer13, NvMRomBlockDataAddress=NvMBlock_DIDC003_RomAddress
        NvMTargetBlockReference
          NvMFeeRef: NvMNameOfFeeBlock=FeeBlockConfiguration_DIDC003
      NvMBlock_DIDC004: NvMBlockManagementType=NVM_BLOCK_NATIVE, NvMBlockUseCRCCompMechanism=true, NvMCalcRamBlockCrc=true, NvMNvBlockBaseNumber=14, NvMNvBlockLength=64, NvMNvBlockNum=1, NvMNvramBlockIdentifier=NvMBlock_DIDC004, NvMRamBlockDataBufferAutoFill=true, NvMRomBlockNum=1, NvMRamBlockDataAddress=NvMBlockRamBuffer14, NvMRomBlockDataAddress=NvMBlock_DIDC004_RomAddress
        NvMTargetBlockReference
          NvMFeeRef: NvMNameOfFeeBlock=FeeBlockConfiguration_DIDC004
      NvMBlock_DIDC005: NvMBlockManagementType=NVM_BLOCK_NATIVE, NvMBlockUseCRCCompMechanism=true, NvMCalcRamBlockCrc=true, NvMNvBlockBaseNumber=15, NvMNvBlockLength=32, NvMNvBlockNum=1, NvMNvramBlockIdentifier=NvMBlock_DIDC005, NvMRamBlockDataBufferAutoFill=true, NvMRomBlockNum=1, NvMRamBlockDataAddress=NvMBlockRamBuffer15, NvMRomBlockDataAddress=NvMBlock_DIDC005_RomAddress
        NvMTargetBlockReference
          NvMFeeRef: NvMNameOfFeeBlock=FeeBlockConfiguration_DIDC005
      NvMBlock_DIDC006: NvMBlockManagementType=NVM_BLOCK_NATIVE, NvMBlockUseCRCCompMechanism=true, NvMCalcRamBlockCrc=true, NvMNvBlockBaseNumber=16, NvMNvBlockLength=32, NvMNvBlockNum=1, NvMNvramBlockIdentifier=NvMBlock_DIDC006, NvMRamBlockDataBufferAutoFill=true, NvMRomBlockNum=1, NvMRamBlockDataAddress=NvMBlockRamBuffer16, NvMRomBlockDataAddress=NvMBlock_DIDC006_RomAddress
        NvMTargetBlockReference
          NvMFeeRef: NvMNameOfFeeBlock=FeeBlockConfiguration_DIDC006
      NvMBlock_DIDC007: NvMBlockManagementType=NVM_BLOCK_NATIVE, NvMBlockUseCRCCompMechanism=true, NvMCalcRamBlockCrc=true, NvMNvBlockBaseNumber=17, NvMNvBlockLength=32, NvMNvBlockNum=1, NvMNvramBlockIdentifier=NvMBlock_DIDC007, NvMRamBlockDataBufferAutoFill=true, NvMRomBlockNum=1, NvMRamBlockDataAddress=NvMBlockRamBuffer17, NvMRomBlockDataAddress=NvMBlock_DIDC007_RomAddress
        NvMTargetBlockReference
          NvMFeeRef: NvMNameOfFeeBlock=FeeBlockConfiguration_DIDC007
      NvMBlock_DIDC008: NvMBlockManagementType=NVM_BLOCK_NATIVE, NvMBlockUseCRCCompMechanism=true, NvMCalcRamBlockCrc=true, NvMNvBlockBaseNumber=18, NvMNvBlockLength=32, NvMNvBlockNum=1, NvMNvramBlockIdentifier=NvMBlock_DIDC008, NvMRamBlockDataBufferAutoFill=true, NvMRomBlockNum=1, NvMRamBlockDataAddress=NvMBlockRamBuffer18, NvMRomBlockDataAddress=NvMBlock_DIDC008_RomAddress
        NvMTargetBlockReference
          NvMFeeRef: NvMNameOfFeeBlock=FeeBlockConfiguration_DIDC008
      NvMBlock_DIDC009: NvMBlockManagementType=NVM_BLOCK_NATIVE, NvMBlockUseCRCCompMechanism=true, NvMCalcRamBlockCrc=true, NvMNvBlockBaseNumber=19, NvMNvBlockLength=6, NvMNvBlockNum=1, NvMNvramBlockIdentifier=NvMBlock_DIDC009, NvMRamBlockDataBufferAutoFill=true, NvMRomBlockNum=1, NvMRamBlockDataAddress=NvMBlockRamBuffer19, NvMRomBlockDataAddress=NvMBlock_DIDC009_RomAddress
        NvMTargetBlockReference
          NvMFeeRef: NvMNameOfFeeBlock=FeeBlockConfiguration_DIDC009
      NvMBlock_DIDC00A: NvMBlockManagementType=NVM_BLOCK_NATIVE, NvMBlockUseCRCCompMechanism=true, NvMCalcRamBlockCrc=true, NvMNvBlockBaseNumber=20, NvMNvBlockLength=32, NvMNvBlockNum=1, NvMNvramBlockIdentifier=NvMBlock_DIDC00A, NvMRamBlockDataBufferAutoFill=true, NvMRomBlockNum=1, NvMRamBlockDataAddress=NvMBlockRamBuffer20, NvMRomBlockDataAddress=NvMBlock_DIDC00A_RomAddress
        NvMTargetBlockReference
          NvMFeeRef: NvMNameOfFeeBlock=FeeBlockConfiguration_DIDC00A
      NvMBlock_DIDC00B: NvMBlockManagementType=NVM_BLOCK_NATIVE, NvMBlockUseCRCCompMechanism=true, NvMCalcRamBlockCrc=true, NvMNvBlockBaseNumber=21, NvMNvBlockLength=6, NvMNvBlockNum=1, NvMNvramBlockIdentifier=NvMBlock_DIDC00B, NvMRamBlockDataBufferAutoFill=true, NvMRomBlockNum=1, NvMRamBlockDataAddress=NvMBlockRamBuffer21, NvMRomBlockDataAddress=NvMBlock_DIDC00B_RomAddress
        NvMTargetBlockReference
          NvMFeeRef: NvMNameOfFeeBlock=FeeBlockConfiguration_DIDC00B
      NvMBlock_DIDC00C: NvMBlockManagementType=NVM_BLOCK_NATIVE, NvMBlockUseCRCCompMechanism=true, NvMCalcRamBlockCrc=true, NvMNvBlockBaseNumber=22, NvMNvBlockLength=4, NvMNvBlockNum=1, NvMNvramBlockIdentifier=NvMBlock_DIDC00C, NvMRamBlockDataBufferAutoFill=true, NvMRomBlockNum=1, NvMRamBlockDataAddress=NvMBlockRamBuffer22, NvMRomBlockDataAddress=NvMBlock_DIDC00C_RomAddress
        NvMTargetBlockReference
          NvMFeeRef: NvMNameOfFeeBlock=FeeBlockConfiguration_DIDC00C
      NvMBlock_DIDC00D: NvMBlockManagementType=NVM_BLOCK_NATIVE, NvMBlockUseCRCCompMechanism=true, NvMCalcRamBlockCrc=true, NvMNvBlockBaseNumber=23, NvMNvBlockLength=2, NvMNvBlockNum=1, NvMNvramBlockIdentifier=NvMBlock_DIDC00D, NvMRamBlockDataBufferAutoFill=true, NvMRomBlockNum=1, NvMRamBlockDataAddress=NvMBlockRamBuffer23, NvMRomBlockDataAddress=NvMBlock_DIDC00D_RomAddress
        NvMTargetBlockReference
          NvMFeeRef: NvMNameOfFeeBlock=FeeBlockConfiguration_DIDC00D
      NvMBlock_DIDC011: NvMBlockManagementType=NVM_BLOCK_NATIVE, NvMBlockUseCRCCompMechanism=true, NvMCalcRamBlockCrc=true, NvMNvBlockBaseNumber=24, NvMNvBlockLength=64, NvMNvBlockNum=1, NvMNvramBlockIdentifier=NvMBlock_DIDC011, NvMRamBlockDataBufferAutoFill=true, NvMRomBlockNum=1, NvMRamBlockDataAddress=NvMBlockRamBuffer24, NvMRomBlockDataAddress=NvMBlock_DIDC011_RomAddress
        NvMTargetBlockReference
          NvMFeeRef: NvMNameOfFeeBlock=FeeBlockConfiguration_DIDC011
      NvMBlock_DIDC012: NvMBlockManagementType=NVM_BLOCK_NATIVE, NvMBlockUseCRCCompMechanism=true, NvMCalcRamBlockCrc=true, NvMNvBlockBaseNumber=25, NvMNvBlockLength=32, NvMNvBlockNum=1, NvMNvramBlockIdentifier=NvMBlock_DIDC012, NvMRamBlockDataBufferAutoFill=true, NvMRomBlockNum=1, NvMRamBlockDataAddress=NvMBlockRamBuffer25, NvMRomBlockDataAddress=NvMBlock_DIDC012_RomAddress
        NvMTargetBlockReference
          NvMFeeRef: NvMNameOfFeeBlock=FeeBlockConfiguration_DIDC012
      NvMBlock_DIDC013: NvMBlockManagementType=NVM_BLOCK_NATIVE, NvMBlockUseCRCCompMechanism=true, NvMCalcRamBlockCrc=true, NvMNvBlockBaseNumber=26, NvMNvBlockLength=32, NvMNvBlockNum=1, NvMNvramBlockIdentifier=NvMBlock_DIDC013, NvMRamBlockDataBufferAutoFill=true, NvMRomBlockNum=1, NvMRamBlockDataAddress=NvMBlockRamBuffer26, NvMRomBlockDataAddress=NvMBlock_DIDC013_RomAddress
        NvMTargetBlockReference
          NvMFeeRef: NvMNameOfFeeBlock=FeeBlockConfiguration_DIDC013
      NvMBlock_DIDC014: NvMBlockManagementType=NVM_BLOCK_NATIVE, NvMBlockUseCRCCompMechanism=true, NvMCalcRamBlockCrc=true, NvMNvBlockBaseNumber=27, NvMNvBlockLength=64, NvMNvBlockNum=1, NvMNvramBlockIdentifier=NvMBlock_DIDC014, NvMRamBlockDataBufferAutoFill=true, NvMRomBlockNum=1, NvMRamBlockDataAddress=NvMBlockRamBuffer27, NvMRomBlockDataAddress=NvMBlock_DIDC014_RomAddress
        NvMTargetBlockReference
          NvMFeeRef: NvMNameOfFeeBlock=FeeBlockConfiguration_DIDC014
      NvMBlock_DIDC015: NvMBlockManagementType=NVM_BLOCK_NATIVE, NvMBlockUseCRCCompMechanism=true, NvMCalcRamBlockCrc=true, NvMNvBlockBaseNumber=28, NvMNvBlockLength=32, NvMNvBlockNum=1, NvMNvramBlockIdentifier=NvMBlock_DIDC015, NvMRamBlockDataBufferAutoFill=true, NvMRomBlockNum=1, NvMRamBlockDataAddress=NvMBlockRamBuffer28, NvMRomBlockDataAddress=NvMBlock_DIDC015_RomAddress
        NvMTargetBlockReference
          NvMFeeRef: NvMNameOfFeeBlock=FeeBlockConfiguration_DIDC015
      NvMBlock_DIDC016: NvMBlockManagementType=NVM_BLOCK_NATIVE, NvMBlockUseCRCCompMechanism=true, NvMCalcRamBlockCrc=true, NvMNvBlockBaseNumber=29, NvMNvBlockLength=32, NvMNvBlockNum=1, NvMNvramBlockIdentifier=NvMBlock_DIDC016, NvMRamBlockDataBufferAutoFill=true, NvMRomBlockNum=1, NvMRamBlockDataAddress=NvMBlockRamBuffer29, NvMRomBlockDataAddress=NvMBlock_DIDC016_RomAddress
        NvMTargetBlockReference
          NvMFeeRef: NvMNameOfFeeBlock=FeeBlockConfiguration_DIDC016
      NvMBlock_DIDC102: NvMBlockManagementType=NVM_BLOCK_NATIVE, NvMBlockUseCRCCompMechanism=true, NvMCalcRamBlockCrc=true, NvMNvBlockBaseNumber=30, NvMNvBlockLength=2, NvMNvBlockNum=1, NvMNvramBlockIdentifier=NvMBlock_DIDC102, NvMRamBlockDataBufferAutoFill=true, NvMRomBlockNum=1, NvMRamBlockDataAddress=NvMBlockRamBuffer30, NvMRomBlockDataAddress=NvMBlock_DIDC102_RomAddress
        NvMTargetBlockReference
          NvMFeeRef: NvMNameOfFeeBlock=FeeBlockConfiguration_DIDC102
      NvMBlock_DIDC106: NvMBlockManagementType=NVM_BLOCK_NATIVE, NvMBlockUseCRCCompMechanism=true, NvMCalcRamBlockCrc=true, NvMNvBlockBaseNumber=31, NvMNvBlockLength=8, NvMNvBlockNum=1, NvMNvramBlockIdentifier=NvMBlock_DIDC106, NvMRamBlockDataBufferAutoFill=true, NvMRomBlockNum=1, NvMRamBlockDataAddress=NvMBlockRamBuffer31, NvMRomBlockDataAddress=NvMBlock_DIDC106_RomAddress
        NvMTargetBlockReference
          NvMFeeRef: NvMNameOfFeeBlock=FeeBlockConfiguration_DIDC106
      NvMBlock_DIDC109: NvMBlockManagementType=NVM_BLOCK_NATIVE, NvMBlockUseCRCCompMechanism=true, NvMCalcRamBlockCrc=true, NvMNvBlockBaseNumber=32, NvMNvBlockLength=14, NvMNvBlockNum=1, NvMNvramBlockIdentifier=NvMBlock_DIDC109, NvMRamBlockDataBufferAutoFill=true, NvMRomBlockNum=1, NvMRamBlockDataAddress=NvMBlockRamBuffer32, NvMRomBlockDataAddress=NvMBlock_DIDC109_RomAddress
        NvMTargetBlockReference
          NvMFeeRef: NvMNameOfFeeBlock=FeeBlockConfiguration_DIDC109
      NvMBlock_DIDCA02: NvMBlockManagementType=NVM_BLOCK_NATIVE, NvMBlockUseCRCCompMechanism=true, NvMCalcRamBlockCrc=true, NvMNvBlockBaseNumber=33, NvMNvBlockLength=37, NvMNvBlockNum=1, NvMNvramBlockIdentifier=NvMBlock_DIDCA02, NvMRamBlockDataBufferAutoFill=true, NvMRomBlockNum=1, NvMRamBlockDataAddress=NvMBlockRamBuffer33, NvMRomBlockDataAddress=NvMBlock_DIDCA02_RomAddress
        NvMTargetBlockReference
          NvMFeeRef: NvMNameOfFeeBlock=FeeBlockConfiguration_DIDCA02
      NvMBlock_DIDCA21: NvMBlockManagementType=NVM_BLOCK_NATIVE, NvMBlockUseCRCCompMechanism=true, NvMCalcRamBlockCrc=true, NvMNvBlockBaseNumber=34, NvMNvBlockLength=1, NvMNvBlockNum=1, NvMNvramBlockIdentifier=NvMBlock_DIDCA21, NvMRamBlockDataBufferAutoFill=true, NvMRomBlockNum=1, NvMRamBlockDataAddress=NvMBlockRamBuffer34, NvMRomBlockDataAddress=NvMBlock_DIDCA21_RomAddress
        NvMTargetBlockReference
          NvMFeeRef: NvMNameOfFeeBlock=FeeBlockConfiguration_DIDCA21
      NvMBlock_DIDC305: NvMBlockManagementType=NVM_BLOCK_NATIVE, NvMBlockUseCRCCompMechanism=true, NvMCalcRamBlockCrc=true, NvMNvBlockBaseNumber=35, NvMNvBlockLength=2, NvMNvBlockNum=1, NvMNvramBlockIdentifier=NvMBlock_DIDC305, NvMRamBlockDataBufferAutoFill=true, NvMRomBlockNum=1, NvMRamBlockDataAddress=NvMBlockRamBuffer35, NvMRomBlockDataAddress=NvMBlock_DIDC305_RomAddress
        NvMTargetBlockReference
          NvMFeeRef: NvMNameOfFeeBlock=FeeBlockConfiguration_DIDC305
      NvMBlock_DIDC306: NvMBlockManagementType=NVM_BLOCK_NATIVE, NvMBlockUseCRCCompMechanism=true, NvMCalcRamBlockCrc=true, NvMNvBlockBaseNumber=36, NvMNvBlockLength=1, NvMNvBlockNum=1, NvMNvramBlockIdentifier=NvMBlock_DIDC306, NvMRamBlockDataBufferAutoFill=true, NvMRomBlockNum=1, NvMRamBlockDataAddress=NvMBlockRamBuffer36, NvMRomBlockDataAddress=NvMBlock_DIDC306_RomAddress
        NvMTargetBlockReference
          NvMFeeRef: NvMNameOfFeeBlock=FeeBlockConfiguration_DIDC306
      NvMBlock_DIDC307: NvMBlockManagementType=NVM_BLOCK_NATIVE, NvMBlockUseCRCCompMechanism=true, NvMCalcRamBlockCrc=true, NvMNvBlockBaseNumber=37, NvMNvBlockLength=2, NvMNvBlockNum=1, NvMNvramBlockIdentifier=NvMBlock_DIDC307, NvMRamBlockDataBufferAutoFill=true, NvMRomBlockNum=1, NvMRamBlockDataAddress=NvMBlockRamBuffer37, NvMRomBlockDataAddress=NvMBlock_DIDC307_RomAddress
        NvMTargetBlockReference
          NvMFeeRef: NvMNameOfFeeBlock=FeeBlockConfiguration_DIDC307
      NvMBlock_DIDC308: NvMBlockManagementType=NVM_BLOCK_NATIVE, NvMBlockUseCRCCompMechanism=true, NvMCalcRamBlockCrc=true, NvMNvBlockBaseNumber=38, NvMNvBlockLength=8, NvMNvBlockNum=1, NvMNvramBlockIdentifier=NvMBlock_DIDC308, NvMRamBlockDataBufferAutoFill=true, NvMRomBlockNum=1, NvMRamBlockDataAddress=NvMBlockRamBuffer38, NvMRomBlockDataAddress=NvMBlock_DIDC308_RomAddress
        NvMTargetBlockReference
          NvMFeeRef: NvMNameOfFeeBlock=FeeBlockConfiguration_DIDC308
      NvMBlock_DIDC309: NvMBlockManagementType=NVM_BLOCK_NATIVE, NvMBlockUseCRCCompMechanism=true, NvMCalcRamBlockCrc=true, NvMNvBlockBaseNumber=39, NvMNvBlockLength=8, NvMNvBlockNum=1, NvMNvramBlockIdentifier=NvMBlock_DIDC309, NvMRamBlockDataBufferAutoFill=true, NvMRomBlockNum=1, NvMRamBlockDataAddress=NvMBlockRamBuffer39, NvMRomBlockDataAddress=NvMBlock_DIDC309_RomAddress
        NvMTargetBlockReference
          NvMFeeRef: NvMNameOfFeeBlock=FeeBlockConfiguration_DIDC309
      NvMBlock_DIDC30A: NvMBlockManagementType=NVM_BLOCK_NATIVE, NvMBlockUseCRCCompMechanism=true, NvMCalcRamBlockCrc=true, NvMNvBlockBaseNumber=40, NvMNvBlockLength=2, NvMNvBlockNum=1, NvMNvramBlockIdentifier=NvMBlock_DIDC30A, NvMRamBlockDataBufferAutoFill=true, NvMRomBlockNum=1, NvMRamBlockDataAddress=NvMBlockRamBuffer40, NvMRomBlockDataAddress=NvMBlock_DIDC30A_RomAddress
        NvMTargetBlockReference
          NvMFeeRef: NvMNameOfFeeBlock=FeeBlockConfiguration_DIDC30A
      NvMBlock_DIDC30C: NvMBlockManagementType=NVM_BLOCK_NATIVE, NvMBlockUseCRCCompMechanism=true, NvMCalcRamBlockCrc=true, NvMNvBlockBaseNumber=41, NvMNvBlockLength=8, NvMNvBlockNum=1, NvMNvramBlockIdentifier=NvMBlock_DIDC30C, NvMRamBlockDataBufferAutoFill=true, NvMRomBlockNum=1, NvMRamBlockDataAddress=NvMBlockRamBuffer41, NvMRomBlockDataAddress=NvMBlock_DIDC30C_RomAddress
        NvMTargetBlockReference
          NvMFeeRef: NvMNameOfFeeBlock=FeeBlockConfiguration_DIDC30C
      NvMBlock_DIDCE01: NvMBlockManagementType=NVM_BLOCK_NATIVE, NvMBlockUseCRCCompMechanism=true, NvMCalcRamBlockCrc=true, NvMNvBlockBaseNumber=42, NvMNvBlockLength=2, NvMNvBlockNum=1, NvMNvramBlockIdentifier=NvMBlock_DIDCE01, NvMRamBlockDataBufferAutoFill=true, NvMRomBlockNum=1, NvMRamBlockDataAddress=NvMBlockRamBuffer42, NvMRomBlockDataAddress=NvMBlock_DIDCE01_RomAddress
        NvMTargetBlockReference
          NvMFeeRef: NvMNameOfFeeBlock=FeeBlockConfiguration_DIDCE01
      NvMBlock_DIDCE05: NvMBlockManagementType=NVM_BLOCK_NATIVE, NvMBlockUseCRCCompMechanism=true, NvMCalcRamBlockCrc=true, NvMNvBlockBaseNumber=43, NvMNvBlockLength=1, NvMNvBlockNum=1, NvMNvramBlockIdentifier=NvMBlock_DIDCE05, NvMRamBlockDataBufferAutoFill=true, NvMRomBlockNum=1, NvMRamBlockDataAddress=NvMBlockRamBuffer43, NvMRomBlockDataAddress=NvMBlock_DIDCE05_RomAddress
        NvMTargetBlockReference
          NvMFeeRef: NvMNameOfFeeBlock=FeeBlockConfiguration_DIDCE05
      NvMBlock_DIDCE06: NvMBlockManagementType=NVM_BLOCK_NATIVE, NvMBlockUseCRCCompMechanism=true, NvMCalcRamBlockCrc=true, NvMNvBlockBaseNumber=44, NvMNvBlockLength=1, NvMNvBlockNum=1, NvMNvramBlockIdentifier=NvMBlock_DIDCE06, NvMRamBlockDataBufferAutoFill=true, NvMRomBlockNum=1, NvMRomBlockDataAddress=NvMBlock_DIDCE06_RomAddress, NvMRamBlockDataAddress=NvMBlockRamBuffer44
        NvMTargetBlockReference
          NvMFeeRef: NvMNameOfFeeBlock=FeeBlockConfiguration_DIDCE06
      NvMBlock_DIDCF00: NvMBlockManagementType=NVM_BLOCK_NATIVE, NvMBlockUseCRCCompMechanism=true, NvMCalcRamBlockCrc=true, NvMNvBlockBaseNumber=45, NvMNvBlockLength=24, NvMNvBlockNum=1, NvMNvramBlockIdentifier=NvMBlock_DIDCF00, NvMRamBlockDataBufferAutoFill=true, NvMRomBlockNum=1, NvMRamBlockDataAddress=NvMBlockRamBuffer45, NvMRomBlockDataAddress=NvMBlock_DIDCF00_RomAddress
        NvMTargetBlockReference
          NvMFeeRef: NvMNameOfFeeBlock=FeeBlockConfiguration_DIDCF00
      NvMBlock_DIDC30D: NvMBlockManagementType=NVM_BLOCK_NATIVE, NvMBlockUseCRCCompMechanism=true, NvMCalcRamBlockCrc=true, NvMNvBlockBaseNumber=46, NvMNvBlockLength=2, NvMNvBlockNum=1, NvMNvramBlockIdentifier=NvMBlock_DIDC30D, NvMRamBlockDataBufferAutoFill=true, NvMRomBlockNum=1, NvMRamBlockDataAddress=NvMBlockRamBuffer46, NvMRomBlockDataAddress=NvMBlock_DIDC30D_RomAddress
        NvMTargetBlockReference
          NvMFeeRef: NvMNameOfFeeBlock=FeeBlockConfiguration_DIDC30D
      NvMBlock_Reserved_block0: NvMBlockManagementType=NVM_BLOCK_NATIVE, NvMBlockUseCRCCompMechanism=true, NvMCalcRamBlockCrc=true, NvMNvBlockBaseNumber=47, NvMNvBlockLength=254, NvMNvBlockNum=1, NvMNvramBlockIdentifier=NvMBlock_Reserved_block0, NvMRamBlockDataBufferAutoFill=true, NvMRomBlockNum=1, NvMRamBlockDataAddress=NvMBlockRamBuffer47, NvMRomBlockDataAddress=NvMBlock_Reserved_block0_RomAddress
        NvMTargetBlockReference
          NvMFeeRef: NvMNameOfFeeBlock=FeeBlockConfiguration_Reserved_block0
      NvMBlock_Reserved_block1: NvMBlockManagementType=NVM_BLOCK_NATIVE, NvMBlockUseCRCCompMechanism=true, NvMCalcRamBlockCrc=true, NvMNvBlockBaseNumber=48, NvMNvBlockLength=254, NvMNvBlockNum=1, NvMNvramBlockIdentifier=NvMBlock_Reserved_block1, NvMRamBlockDataBufferAutoFill=true, NvMRomBlockNum=1, NvMRomBlockDataAddress=NvMBlock_Reserved_block1_RomAddress, NvMRamBlockDataAddress=NvMBlockRamBuffer48
        NvMTargetBlockReference
          NvMFeeRef: NvMNameOfFeeBlock=FeeBlockConfiguration_Reserved_block1
      NvMBlock_Reserved_block2: NvMBlockManagementType=NVM_BLOCK_NATIVE, NvMBlockUseCRCCompMechanism=true, NvMCalcRamBlockCrc=true, NvMNvBlockBaseNumber=49, NvMNvBlockLength=254, NvMNvBlockNum=1, NvMNvramBlockIdentifier=NvMBlock_Reserved_block2, NvMRamBlockDataBufferAutoFill=true, NvMRomBlockNum=1, NvMRamBlockDataAddress=NvMBlockRamBuffer49, NvMRomBlockDataAddress=NvMBlock_Reserved_block2_RomAddress
        NvMTargetBlockReference
          NvMFeeRef: NvMNameOfFeeBlock=FeeBlockConfiguration_Reserved_block2
      NvMBlock_27Key_error_count: NvMBlockManagementType=NVM_BLOCK_NATIVE, NvMBlockUseCRCCompMechanism=true, NvMCalcRamBlockCrc=true, NvMNvBlockBaseNumber=50, NvMNvBlockLength=1, NvMNvBlockNum=1, NvMNvramBlockIdentifier=NvMBlock_27Key_error_count, NvMRamBlockDataBufferAutoFill=true, NvMRomBlockNum=1, NvMRamBlockDataAddress=NvMBlockRamBuffer50, NvMRomBlockDataAddress=NvMBlock_27Key_error_count_RomAddress
        NvMTargetBlockReference
          NvMFeeRef: NvMNameOfFeeBlock=FeeBlockConfiguration_27Key_error_count
      NvMBlock_SecOc_count: NvMBlockManagementType=NVM_BLOCK_NATIVE, NvMBlockUseCRCCompMechanism=true, NvMCalcRamBlockCrc=true, NvMNvBlockBaseNumber=51, NvMNvBlockLength=4, NvMNvBlockNum=1, NvMNvramBlockIdentifier=NvMBlock_SecOc_count, NvMRamBlockDataBufferAutoFill=true, NvMRomBlockNum=1, NvMRamBlockDataAddress=NvMBlockRamBuffer51, NvMRomBlockDataAddress=NvMBlock_SecOc_count_RomAddress
        NvMTargetBlockReference
          NvMFeeRef: NvMNameOfFeeBlock=FeeBlockConfiguration_SecOc_count
      NvMBlock_SecOc_Key: NvMBlockManagementType=NVM_BLOCK_NATIVE, NvMBlockUseCRCCompMechanism=true, NvMCalcRamBlockCrc=true, NvMNvBlockBaseNumber=52, NvMNvBlockLength=16, NvMNvBlockNum=1, NvMNvramBlockIdentifier=NvMBlock_SecOc_Key, NvMRamBlockDataBufferAutoFill=true, NvMRomBlockNum=1, NvMRamBlockDataAddress=NvMBlockRamBuffer52, NvMRomBlockDataAddress=NvMBlock_SecOc_Key_RomAddress
        NvMTargetBlockReference
          NvMFeeRef: NvMNameOfFeeBlock=FeeBlockConfiguration_SecOc_Key
