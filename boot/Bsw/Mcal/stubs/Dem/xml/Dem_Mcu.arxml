AUTOSAR XML (schema 4-2-2)
package /AUTOSAR/EcucDefs
  ecuc value collection ECUConfiguration: ecuc-values=Dem0
  module config Dem0: definition=Dem, implementation-config-variant=VARIANT-PRE-COMPILE
    DemConfigSet0 (DemConfigSet)
      6 x DemEventParameter, all with DemEventKind=, DemMaxNumberFreezeFrameRecords=, DemDTCClassRef=, DemExtendedDataClassRef=, DemFreezeFrameClassRef=, DemFreezeFrameRecNumClassRef=:
        DemEventParameter0: DemEventId=1
        DemEventParameter1: DemEventId=2
        DemEventParameter2: DemEventId=3
        DemEventParameter3: DemEventId=4
        DemEventParameter4: DemEventId=5
        DemEventParameter5: DemEventId=6
    DemGeneral0 (DemGeneral):
      DemAgingCycleCounterProcessing = 
      DemBswErrorBufferSize = 
      DemClearDTCBehavior = 
      DemDTCSuppressionSupport = 0
      DemDebounceCounterBasedSupport = 0
      DemDebounceTimeBasedSupport = 0
      DemDevErrorDetect = 0
      DemDtcStatusAvailabilityMask = 
      DemEnableConditionSupport = 0
      DemEventCombinationSupport = 
      DemEventDisplacementSupport = 0
      DemExtendedDataCapture = 
      DemFreezeFrameCapture = 
      DemHeaderFileInclusion = 
      DemImmediateNvStorageLimit = 
      DemMaxNumberEventEntryMirror = 
      DemMaxNumberEventEntryPermanent = 
      DemMaxNumberEventEntryPrimary = 
      DemMaxNumberEventEntrySecondary = 
      DemMaxNumberPrestoredFF = 
      DemOBDSupport = 0
      DemOccurrenceCounterProcessing = 
      DemOperationCycleStatusStorage = 0
      DemPTOSupport = 0
      DemStatusBitStorageTestFailed = 0
      DemStorageConditionSupport = 0
      DemTaskTime = 
      DemTriggerDcmReports = 0
      DemTriggerDltReports = 0
      DemTriggerFiMReports = 0
      DemTriggerMonitorInitBeforeClearOk = 0
      DemTypeOfDTCSupported = 
      DemTypeOfFreezeFrameRecordNumeration = 
      DemVersionInfoApi = 0
      DemMILIndicatorRef = 
