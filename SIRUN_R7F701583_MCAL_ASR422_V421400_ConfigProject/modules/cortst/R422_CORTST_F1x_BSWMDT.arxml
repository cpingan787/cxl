AUTOSAR XML (schema 4-2-2)
# COPYRIGHT
# Copyright(c) 2016-2021 Renesas Electronics Corporation
package /Renesas/ModuleDescription_CorTst
  bsw implementation CorTst_Impl: programming-language=C, sw-version=1.1.5, vendor-id=59, ar-release-version=4.2.2, behavior=BswInternalBehavior_0, vendor-specific-module-def=CorTst
    code-descriptors:
      code CorTst_Code: artifact-descriptors=[{short-label=CorTst.c, category=SWSRC}, {short-label=CorTst.h, category=SWHDR}]
    resource consumption ResourceConsumption
      9 x memory section:
        VAR_INIT_8: sw-addrmethod=VAR
        VAR_NO_INIT_UNSPECIFIED: sw-addrmethod=VAR
        CONST_UNSPECIFIED: sw-addrmethod=CONST
        CONFIG_DATA_UNSPECIFIED: sw-addrmethod=CONFIG_DATA
        PUBLIC_CODE: sw-addrmethod=CODE
        PRIVATE_CODE: sw-addrmethod=CODE
        APPL_CODE: sw-addrmethod=CODE
        BUFFER_CODE: sw-addrmethod=CODE
        CODE_FAST: sw-addrmethod=CODE
  bsw module description CorTst: module-id=103
    provided-entrys:
      CorTst_Init
      CorTst_DeInit
      CorTst_Abort
      CorTst_GetState
      CorTst_GetCurrentStatus
      CorTst_GetSignature
      CorTst_GetFgndSignature
      CorTst_Start
      CorTst_MainFunction
      CorTst_GetVersionInfo
      CORTST_G3KH_EITRAP0_ISR
      CORTST_G3KH_EITRAP0_CAT2_ISR
      CORTST_G3KH_EITRAP1_ISR
      CORTST_G3KH_EITRAP1_CAT2_ISR
      CORTST_G3KH_FETRAP_ISR
      CORTST_G3KH_FETRAP_CAT2_ISR
      CORTST_G3KH_MAE_ISR
      CORTST_G3KH_MAE_CAT2_ISR
    bsw internal behavior BswInternalBehavior_0
      exclusive area CORTST_TESTMODULE_DATA_PROTECTION
      8 x bsw interrupt entity:
        BswInterruptEntity_0: implemented-entry=CORTST_G3KH_EITRAP0_ISR, interrupt-category=CAT-1, interrupt-source=EITRAP0
        BswInterruptEntity_1: implemented-entry=CORTST_G3KH_EITRAP0_CAT2_ISR, interrupt-category=CAT-2, interrupt-source=EITRAP0
        BswInterruptEntity_2: implemented-entry=CORTST_G3KH_EITRAP1_ISR, interrupt-category=CAT-1, interrupt-source=EITRAP1
        BswInterruptEntity_3: implemented-entry=CORTST_G3KH_EITRAP1_CAT2_ISR, interrupt-category=CAT-2, interrupt-source=EITRAP1
        BswInterruptEntity_4: implemented-entry=CORTST_G3KH_FETRAP_ISR, interrupt-category=CAT-1, interrupt-source=FETRAP
        BswInterruptEntity_5: implemented-entry=CORTST_G3KH_FETRAP_CAT2_ISR, interrupt-category=CAT-2, interrupt-source=FETRAP
        BswInterruptEntity_6: implemented-entry=CORTST_G3KH_MAE_ISR, interrupt-category=CAT-1, interrupt-source=MAE
        BswInterruptEntity_7: implemented-entry=CORTST_G3KH_MAE_CAT2_ISR, interrupt-category=CAT-2, interrupt-source=MAE
      9 x bsw called entity:
        BswCalledEntity_0: implemented-entry=CorTst_Init
        BswCalledEntity_1: implemented-entry=CorTst_DeInit
        BswCalledEntity_2: implemented-entry=CorTst_Abort
        BswCalledEntity_3: implemented-entry=CorTst_GetState
        BswCalledEntity_4: implemented-entry=CorTst_GetCurrentStatus
        BswCalledEntity_5: implemented-entry=CorTst_GetSignature
        BswCalledEntity_6: implemented-entry=CorTst_GetFgndSignature
        BswCalledEntity_7: can-enter-exclusive-area=CORTST_TESTMODULE_DATA_PROTECTION, implemented-entry=CorTst_Start
        BswCalledEntity_8: implemented-entry=CorTst_GetVersionInfo
      bsw schedulable entity BSE_CorTst_MainFunction: can-enter-exclusive-area=CORTST_TESTMODULE_DATA_PROTECTION, minimum-start-interval=0.00000085, implemented-entry=CorTst_MainFunction
      bsw timing event Evt_CorTst_MainFunction: starts-on-event=BSE_CorTst_MainFunction, period=0.001
  18 x bsw module entry, all with is-synchronous=true, sw-service-impl-policy=STANDARD:
    CORTST_G3KH_EITRAP0_ISR: is-reentrant=false, call-type=INTERRUPT, execution-context=INTERRUPT-CAT-1
    CORTST_G3KH_EITRAP0_CAT2_ISR: is-reentrant=false, call-type=INTERRUPT, execution-context=INTERRUPT-CAT-2
    CORTST_G3KH_EITRAP1_ISR: is-reentrant=false, call-type=INTERRUPT, execution-context=INTERRUPT-CAT-1
    CORTST_G3KH_EITRAP1_CAT2_ISR: is-reentrant=false, call-type=INTERRUPT, execution-context=INTERRUPT-CAT-2
    CORTST_G3KH_FETRAP_ISR: is-reentrant=false, call-type=INTERRUPT, execution-context=INTERRUPT-CAT-1
    CORTST_G3KH_FETRAP_CAT2_ISR: is-reentrant=false, call-type=INTERRUPT, execution-context=INTERRUPT-CAT-2
    CORTST_G3KH_MAE_ISR: is-reentrant=false, call-type=INTERRUPT, execution-context=INTERRUPT-CAT-1
    CORTST_G3KH_MAE_CAT2_ISR: is-reentrant=false, call-type=INTERRUPT, execution-context=INTERRUPT-CAT-2
    CorTst_MainFunction: service-id=0x0b, is-reentrant=false, call-type=SCHEDULED, execution-context=TASK  # Cyclically called by scheduler to perform processing of Core Test.
    CorTst_Init: service-id=0, is-reentrant=false, call-type=REGULAR, execution-context=TASK  # Service for initialization and change of state of the Core Test
    CorTst_DeInit: service-id=1, is-reentrant=false, call-type=REGULAR, execution-context=TASK  # Service to change from CORTST_ABORT or CORTST_INIT to CORTST_UNINIT state
    CorTst_Abort: service-id=2, is-reentrant=false, call-type=REGULAR, execution-context=TASK  # Service to change from CORTST_INIT to CORTST_ABORT state
    CorTst_GetState: service-id=3, is-reentrant=false, call-type=REGULAR, execution-context=TASK  # Service for Core Test to immediately return status on currently executed Core Test.
    CorTst_GetCurrentStatus: service-id=4, is-reentrant=false, call-type=REGULAR, execution-context=TASK  # Service for Core Test to get indicator of the last executed Core Test result
    CorTst_GetSignature: service-id=5, is-reentrant=false, call-type=REGULAR, execution-context=TASK  # Service to get signature of the last executed Core Test in background mode.
    CorTst_GetFgndSignature: service-id=6, is-reentrant=false, call-type=REGULAR, execution-context=TASK  # Service to get signature of the last executed Core Test in foreground mode.
    CorTst_Start: service-id=7, is-reentrant=false, call-type=REGULAR, execution-context=TASK  # Service for executing foreground Core Test.
    CorTst_GetVersionInfo: service-id=8, is-reentrant=true, call-type=REGULAR, execution-context=TASK  # Service returns the version information of this module.
