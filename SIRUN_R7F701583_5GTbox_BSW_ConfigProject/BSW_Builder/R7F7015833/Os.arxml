AUTOSAR XML (schema 00048)
package /R7F7015833
  module config Os
    OsOS:
      OsMaxNumberOfCores = 1
      OsPhyIdOfCores = 0
      OsNumberOfCores = 1
      OsScalabilityClass = SC1
      Compiler = csplus_rh850_ccrh
      OsSystemStackSize = 1024
      OsStatus = EXTENDED
      OsStackMonitoring = true
      OsISRStackSharing = false
      OsUseResScheduler = true
      OsUseGetServiceId = false
      OsUseParameterAccess = false
      OsUseArti = false
      OsUseOrti = false
      FloatingPointContextSave = false
      OsHooks: OsErrorHook=false, OsPostTaskHook=false, OsPreTaskHook=false, OsShutdownHook=true, OsStartupHook=false
      OsTrace: Os_Trace=false
    OSDEFAULTAPPMODE (OsAppMode)
    OsSystemConfig
      SystemTimer_Core_0 (SystemTimer): OsCounterMaxAllowedValue=2147483647, OsCounterMinCycle=1, OsCounterType=HARDWARE, OsSecondsPerTick=0.001, OsCounterTicksPerBase=10000
      SystemIsr
        OsIsrSystemTimerCore_0 (OsIsrSystemTimerCore): OsIsrCategory=CATEGORY_2, OsSystemIsrStackSize=128, OsIsrSystemTimerSource=TAUB0I0_IRQ, OsIsrSystemTimerLevel=10, OsSystemIsrNestedEnable=false
        OsIsrRemoteCallCore_0 (OsIsrRemoteCallCore): OsIsrCategory=CATEGORY_2, OsSystemIsrStackSize=128, OsIsrRemoteCallSource=NONE, OsIsrRemoteCallLevel=1, OsSystemIsrNestedEnable=false
        OsIsrTimingProtCore_0 (OsIsrTimingProtCore): OsIsrCategory=CATEGORY_2, OsSystemIsrStackSize=128, OsIsrTimingProtSource=OSTM0_IRQ, OsIsrTimingProtLevel=11, OsSystemIsrNestedEnable=false
    ArchInfo
      ArchSystemTimer: ArchSystemTimerFrequency=10.0
      ArchTimingProt: ArchTimingProtSecondsTick=0.001, ArchTimingProtFrequency=60.0
    OsDebug
      OsMonitor
        OsInterruptMonitor: OsInterMonitorEnable=false
        OsTaskMonitor: OsTaskResponseTime=false
        OsLoadMonitor: OsLoadRatio=false
        OsStackMonitor: OsStackUsageMeasurement=false
        OsScheduleMonitor: OsScheduleCountMonitor=false
        OsEventMonitor
      OsFaultManagers: OsFaultManager=false
    OsMemoryProtection: UseConfigurationRegion=false
    RES_SCHEDULER_CORE0 (OsResource): OsResourceProperty=STANDARD
    OsTask_Init (OsTask): OsTaskActivation=1, OsTaskPriority=1, OsTaskSchedule=NON, OsTaskStackSize=256, OsTaskStackSharing=false
      OsTaskAutostart: OsTaskAppModeRef=OSDEFAULTAPPMODE
    OsAlarm_1ms (OsAlarm): OsAlarmCounterRef=SystemTimer_Core_0
      OsAlarmAction
        OsAlarmActivateTask: OsAlarmActivateTaskRef=OsTask_1ms
    RCAN1ERR_IRQ (OsIsr): OsIsrCategory=CATEGORY_2
      OsIsrSettings: OsIsrStackSize=256, OsInterruptSource=RCAN1ERR_IRQ, OsInterruptSourceId=113, OsInterruptLevel=3, OsIsrNestedEnable=true, DMAChannelID=
    RCAN1TRX_IRQ (OsIsr): OsIsrCategory=CATEGORY_2
      OsIsrSettings: OsIsrStackSize=512, OsInterruptSource=RCAN1TRX_IRQ, OsInterruptSourceId=115, OsInterruptLevel=3, OsIsrNestedEnable=true, DMAChannelID=
    OsTask_1ms (OsTask): OsTaskActivation=1, OsTaskPriority=6, OsTaskSchedule=FULL, OsTaskStackSize=256, OsTaskStackSharing=false
    OsTask_5ms (OsTask): OsTaskActivation=1, OsTaskPriority=5, OsTaskSchedule=FULL, OsTaskStackSize=1024, OsTaskStackSharing=false
    OsIoc
    RCANGRECC0_IRQ (OsIsr): OsIsrCategory=CATEGORY_2
      OsIsrSettings: OsIsrStackSize=512, OsInterruptSource=RCANGRECC0_IRQ, OsInterruptSourceId=23, OsInterruptLevel=3, OsIsrNestedEnable=true, DMAChannelID=
    ADCA0I1_IRQ (OsIsr): OsIsrCategory=CATEGORY_2
      OsIsrSettings: OsIsrStackSize=256, OsInterruptSource=ADCA0I1_IRQ, OsInterruptSourceId=19, OsInterruptLevel=3, OsIsrNestedEnable=true, DMAChannelID=
    3 x OsTask, all with OsTaskActivation=1, OsTaskSchedule=FULL, OsTaskStackSharing=false:
      OsTask_10ms: OsTaskPriority=4, OsTaskStackSize=1024
      OsTask_50ms: OsTaskPriority=3, OsTaskStackSize=256
      OsTask_100ms: OsTaskPriority=2, OsTaskStackSize=256
    4 x OsAlarm, all with OsAlarmCounterRef=SystemTimer_Core_0:
      OsAlarm_5ms
        OsAlarmAction
          OsAlarmActivateTask: OsAlarmActivateTaskRef=OsTask_5ms
      OsAlarm_10ms
        OsAlarmAction
          OsAlarmActivateTask: OsAlarmActivateTaskRef=OsTask_10ms
      OsAlarm_50ms
        OsAlarmAction
          OsAlarmActivateTask: OsAlarmActivateTaskRef=OsTask_50ms
      OsAlarm_100ms
        OsAlarmAction
          OsAlarmActivateTask: OsAlarmActivateTaskRef=OsTask_100ms
    4 x OsIsr, all with OsIsrCategory=CATEGORY_2:
      ADCA1I1_IRQ
        OsIsrSettings: OsIsrStackSize=256, OsInterruptSource=ADCA1I1_IRQ, OsInterruptSourceId=214, OsInterruptLevel=3, OsIsrNestedEnable=true, DMAChannelID=
      TAUJ0I0_IRQ
        OsIsrSettings: OsIsrStackSize=128, OsInterruptSource=TAUJ0I0_IRQ, OsInterruptSourceId=80, OsInterruptLevel=4, OsIsrNestedEnable=true, DMAChannelID=
      TAUD0I9_IRQ
        OsIsrSettings: OsIsrStackSize=128, OsInterruptSource=TAUD0I9_IRQ, OsInterruptSourceId=52, OsInterruptLevel=4, OsIsrNestedEnable=true, DMAChannelID=
      TAUB0I12_IRQ
        OsIsrSettings: OsIsrStackSize=128, OsInterruptSource=TAUB0I12_IRQ, OsInterruptSourceId=154, OsInterruptLevel=4, OsIsrNestedEnable=true, DMAChannelID=
