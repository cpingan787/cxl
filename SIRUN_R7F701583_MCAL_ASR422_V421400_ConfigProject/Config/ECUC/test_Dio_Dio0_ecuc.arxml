AUTOSAR XML (schema 00049)
package /Renesas/EcucDefs_Dio
  module config Dio0: definition=Dio, implementation-config-variant=VARIANT-LINK-TIME, module-description=Dio_Impl
    DioConfig0 (DioConfig)
      8 x DioPort:
        PortGroup9_Bits0_6: DioPortId=0, DioPortName=PORTGROUP_9_BITS_0_TO_6
          UserConfigCh1 (DioChannel): DioChannelId=0, DioChannelBitPosition=0
          UserConfigCh2 (DioChannel): DioChannelId=1, DioChannelBitPosition=4
          UserConfigChGrp1 (DioChannelGroup): DioChannelGroupIdentification=NULL, DioPortMask=15, DioPortOffset=0
          UserConfigChGrp2 (DioChannelGroup): DioChannelGroupIdentification=NULL, DioPortMask=6, DioPortOffset=1
          DIO_Channel_ECALL_BUTTON_DET_Pin9_5 (DioChannel): DioChannelId=2, DioChannelBitPosition=5
        PortGroup11_Bits0_15: DioPortId=1, DioPortName=PORTGROUP_11_BITS_0_TO_15
          UserConfigCh3 (DioChannel): DioChannelId=0, DioChannelBitPosition=0
          UserConfigCh4 (DioChannel): DioChannelId=1, DioChannelBitPosition=4
          UserConfigChGrp3 (DioChannelGroup): DioChannelGroupIdentification=NULL, DioPortMask=15, DioPortOffset=0
          UserConfigChGrp4 (DioChannelGroup): DioChannelGroupIdentification=NULL, DioPortMask=6, DioPortOffset=1
          DIO_Channel_LEVEL_SHIFT_EN_Pin11_15 (DioChannel): DioChannelId=2, DioChannelBitPosition=15
        PortGroup8_Bits0_12: DioPortId=2, DioPortName=PORTGROUP_8_BITS_0_TO_12
          5 x DioChannel:
            DIO_Channel_CAN_STB_Pin8_6: DioChannelId=0, DioChannelBitPosition=6
            DIO_Channel_ACC_INT_Pin8_5: DioChannelId=1, DioChannelBitPosition=5
            DIO_Channel_IMU_INT1_Pin8_1: DioChannelId=2, DioChannelBitPosition=1
            DIO_Channel_IMU_INT2_Pin8_3: DioChannelId=3, DioChannelBitPosition=3
            DIO_Channel_NAD_WAKEUP_MCU_Pin8_2: DioChannelId=4, DioChannelBitPosition=2
        PortGroup0_Bits0_14: DioPortId=3, DioPortName=PORTGROUP_0_BITS_0_TO_14
          6 x DioChannel:
            DIO_Channel_KL30_Voltage_DET_EN_Pin0_12: DioChannelId=0, DioChannelBitPosition=12
            DIO_Channel_KL30_Voltage_DET_INT_Pin0_9: DioChannelId=1, DioChannelBitPosition=9
            DIO_Channel_CanRx_DET_INT_Pin0_2: DioChannelId=2, DioChannelBitPosition=2
            DIO_Channel_NAD_SLEEP_IND_Pin0_4: DioChannelId=3, DioChannelBitPosition=4
            DIO_Channel_CDS_STATE_Pin0_11: DioChannelId=4, DioChannelBitPosition=11
            DIO_Channel_RTC_INT_Pin0_6: DioChannelId=5, DioChannelBitPosition=6
        PortGroup_1_Bits0_11: DioPortId=4, DioPortName=PORTGROUP_1_BITS_0_TO_11
          4 x DioChannel:
            DIO_Channel_KL30_DOWEN_DET_EN_Pin1_6: DioChannelId=0, DioChannelBitPosition=6
            DIO_Channel_IG1_INT_Pin1_8: DioChannelId=1, DioChannelBitPosition=8
            DIO_Channel_NAD_V2X_5V0__EN_Pin1_7: DioChannelId=2, DioChannelBitPosition=7
            DIO_Channel_CALL_BUTTON_PWR_EN_Pin1_0: DioChannelId=3, DioChannelBitPosition=0
        PortGroup18_Bits0_3: DioPortId=5, DioPortName=PORTGROUP_18_BITS_0_TO_3
          3 x DioChannel:
            DIO_Channel_NAD_V2X_3V8_EN_Pin18_3: DioChannelId=2, DioChannelBitPosition=3
            DIO_Channel_AG591_POWERKEY_EN_Pin18_1: DioChannelId=1, DioChannelBitPosition=1
            DIO_Channel_AG591_RST_EN_Pin18_0: DioChannelId=0, DioChannelBitPosition=0
        PortGroup10_Bits0_15: DioPortId=6, DioPortName=PORTGROUP_10_BITS_0_TO_15
          DIO_Channel_NAD_TO_MCU_Pin10_13 (DioChannel): DioChannelId=0, DioChannelBitPosition=13
          DIO_Channel_MCU_TO_NAD_EN_Pin10_14 (DioChannel): DioChannelId=1, DioChannelBitPosition=14
        PortGroup12_Bits0_2: DioPortId=7, DioPortName=PORTGROUP_12_BITS_0_TO_2
          DIO_Channel_MCU_WAKEUP_NAD_Pin12_0 (DioChannel): DioChannelId=0, DioChannelBitPosition=0
    DioGeneral0 (DioGeneral):
      DioDevErrorDetect = false
      DioFlipChannelApi = true
      DioVersionInfoApi = true
      DioVersionCheckExternalModules = true
      DioCriticalSectionProtection = true
      DioDeviceName = R7F701583
      DioWriteVerify = WV_DISABLE
      DioUseWriteVerifyErrorInterface = false
      DioWriteVerifyErrorInterface = DioErrorReportInterface
      DioMaskedWritePortApi = true
      DioReadChannelGroupOutputValueApi = true
      DioReadChannelOutputValueApi = true
      DioRAMMirror = ENABLE
    DioDemEventParameterRefs0 (DioDemEventParameterRefs): DIO_E_REG_WRITE_VERIFY=DemEventParameter0
