AUTOSAR XML (schema 4-2-2)
# COPYRIGHT
# Copyright(c) 2016-2021 Renesas Electronics Corporation
package /Renesas/ModuleDescription_Adc
  bsw implementation Adc_Impl: programming-language=C, sw-version=1.1.6, vendor-id=59, ar-release-version=4.2.2, behavior=BswInternalBehavior_0, vendor-specific-module-def=Adc
    code-descriptors:
      code Adc_Code: artifact-descriptors=[{short-label=Adc.c, category=SWSRC}, {short-label=Adc.h, category=SWHDR}]
    resource consumption ResourceConsumption
      15 x memory section:
        VAR_DMA_NO_INIT_16: sw-addrmethod=VAR
        VAR_DMA_NO_INIT_32: sw-addrmethod=VAR
        VAR_DMA_DB_NO_INIT_32: sw-addrmethod=VAR
        CONST_32: sw-addrmethod=CONST
        CONST_UNSPECIFIED: sw-addrmethod=CONST
        VAR_INIT_BOOLEAN: sw-addrmethod=VAR
        VAR_NO_INIT_8: sw-addrmethod=VAR
        VAR_NO_INIT_UNSPECIFIED: sw-addrmethod=VAR
        CONFIG_DATA_UNSPECIFIED: sw-addrmethod=CONFIG_DATA
        CONFIG_DATA_8: sw-addrmethod=CONFIG_DATA_8
        CONFIG_DATA_16: sw-addrmethod=CONFIG_DATA_16
        CONFIG_DATA_32: sw-addrmethod=CONFIG_DATA_32
        CODE: sw-addrmethod=CODE
        CALLOUT_CODE: sw-addrmethod=CODE
        CODE_FAST: sw-addrmethod=CODE
  bsw module description Adc: module-id=123
    provided-entrys:
      Adc_Init
      Adc_SetupResultBuffer
      Adc_DeInit
      Adc_StartGroupConversion
      Adc_StopGroupConversion
      Adc_ReadGroup
      Adc_EnableHardwareTrigger
      Adc_DisableHardwareTrigger
      Adc_EnableGroupNotification
      Adc_DisableGroupNotification
      Adc_GetGroupStatus
      Adc_GetStreamLastPointer
      Adc_EnableHwTrigger
      Adc_PrepareEnableHwTrigger
      Adc_DisableHwTrigger
      Adc_HwResultReadGroup
      Adc_DisableChannel
      Adc_EnableChannel
      Adc_SetThreshold
      Adc_SelectChannelThreshold
      Adc_CusGetADCAnDRmAddr
      Adc_EnableIntAdcErr
      Adc_DisableIntAdcErr
      Adc_CusSetSamplingClock
      Adc_CusGetPWSAnPVCRx_y_32bit
      Adc_CusGetPWSAnPVCRx_y_16bit
      Adc_GetVersionInfo
      Adc_CheckHWConsistency
      ADC0_SG1_ISR
      ADC0_SG1_CAT2_ISR
      ADC0_SG2_ISR
      ADC0_SG2_CAT2_ISR
      ADC0_SG3_ISR
      ADC0_SG3_CAT2_ISR
      ADC0_ERR_ISR
      ADC0_ERR_CAT2_ISR
      ADC1_SG1_ISR
      ADC1_SG1_CAT2_ISR
      ADC1_SG2_ISR
      ADC1_SG2_CAT2_ISR
      ADC1_SG3_ISR
      ADC1_SG3_CAT2_ISR
      ADC1_ERR_ISR
      ADC1_ERR_CAT2_ISR
      PWSA_QUE_ISR
      PWSA_QUE_CAT2_ISR
      ADC_DMA_CH00_ISR
      ADC_DMA_CH00_CAT2_ISR
      ADC_DMA_CH01_ISR
      ADC_DMA_CH01_CAT2_ISR
      ADC_DMA_CH02_ISR
      ADC_DMA_CH02_CAT2_ISR
      ADC_DMA_CH03_ISR
      ADC_DMA_CH03_CAT2_ISR
      ADC_DMA_CH04_ISR
      ADC_DMA_CH04_CAT2_ISR
      ADC_DMA_CH05_ISR
      ADC_DMA_CH05_CAT2_ISR
      ADC_DMA_CH06_ISR
      ADC_DMA_CH06_CAT2_ISR
      ADC_DMA_CH07_ISR
      ADC_DMA_CH07_CAT2_ISR
      ADC_DMA_CH08_ISR
      ADC_DMA_CH08_CAT2_ISR
      ADC_DMA_CH09_ISR
      ADC_DMA_CH09_CAT2_ISR
      ADC_DMA_CH10_ISR
      ADC_DMA_CH10_CAT2_ISR
      ADC_DMA_CH11_ISR
      ADC_DMA_CH11_CAT2_ISR
      ADC_DMA_CH12_ISR
      ADC_DMA_CH12_CAT2_ISR
      ADC_DMA_CH13_ISR
      ADC_DMA_CH13_CAT2_ISR
      ADC_DMA_CH14_ISR
      ADC_DMA_CH14_CAT2_ISR
      ADC_DMA_CH15_ISR
      ADC_DMA_CH15_CAT2_ISR
      ADC_DMA_CH16_ISR
      ADC_DMA_CH16_CAT2_ISR
      ADC_DMA_CH17_ISR
      ADC_DMA_CH17_CAT2_ISR
      ADC_DMA_CH18_ISR
      ADC_DMA_CH18_CAT2_ISR
      ADC_DMA_CH19_ISR
      ADC_DMA_CH19_CAT2_ISR
      ADC_DMA_CH20_ISR
      ADC_DMA_CH20_CAT2_ISR
      ADC_DMA_CH21_ISR
      ADC_DMA_CH21_CAT2_ISR
      ADC_DMA_CH22_ISR
      ADC_DMA_CH22_CAT2_ISR
      ADC_DMA_CH23_ISR
      ADC_DMA_CH23_CAT2_ISR
      ADC_DMA_CH24_ISR
      ADC_DMA_CH24_CAT2_ISR
      ADC_DMA_CH25_ISR
      ADC_DMA_CH25_CAT2_ISR
      ADC_DMA_CH26_ISR
      ADC_DMA_CH26_CAT2_ISR
      ADC_DMA_CH27_ISR
      ADC_DMA_CH27_CAT2_ISR
      ADC_DMA_CH28_ISR
      ADC_DMA_CH28_CAT2_ISR
      ADC_DMA_CH29_ISR
      ADC_DMA_CH29_CAT2_ISR
      ADC_DMA_CH30_ISR
      ADC_DMA_CH30_CAT2_ISR
      ADC_DMA_CH31_ISR
      ADC_DMA_CH31_CAT2_ISR
      ADC_DMA_CH32_ISR
      ADC_DMA_CH32_CAT2_ISR
      ADC_DMA_CH33_ISR
      ADC_DMA_CH33_CAT2_ISR
      ADC_DMA_CH34_ISR
      ADC_DMA_CH34_CAT2_ISR
      ADC_DMA_CH35_ISR
      ADC_DMA_CH35_CAT2_ISR
      ADC_DMA_CH36_ISR
      ADC_DMA_CH36_CAT2_ISR
      ADC_DMA_CH37_ISR
      ADC_DMA_CH37_CAT2_ISR
      ADC_DMA_CH38_ISR
      ADC_DMA_CH38_CAT2_ISR
      ADC_DMA_CH39_ISR
      ADC_DMA_CH39_CAT2_ISR
      ADC_DMA_CH40_ISR
      ADC_DMA_CH40_CAT2_ISR
      ADC_DMA_CH41_ISR
      ADC_DMA_CH41_CAT2_ISR
      ADC_DMA_CH42_ISR
      ADC_DMA_CH42_CAT2_ISR
      ADC_DMA_CH43_ISR
      ADC_DMA_CH43_CAT2_ISR
      ADC_DMA_CH44_ISR
      ADC_DMA_CH44_CAT2_ISR
      ADC_DMA_CH45_ISR
      ADC_DMA_CH45_CAT2_ISR
      ADC_DMA_CH46_ISR
      ADC_DMA_CH46_CAT2_ISR
      ADC_DMA_CH47_ISR
      ADC_DMA_CH47_CAT2_ISR
      ADC_DMA_CH48_ISR
      ADC_DMA_CH48_CAT2_ISR
      ADC_DMA_CH49_ISR
      ADC_DMA_CH49_CAT2_ISR
      ADC_DMA_CH50_ISR
      ADC_DMA_CH50_CAT2_ISR
      ADC_DMA_CH51_ISR
      ADC_DMA_CH51_CAT2_ISR
      ADC_DMA_CH52_ISR
      ADC_DMA_CH52_CAT2_ISR
      ADC_DMA_CH53_ISR
      ADC_DMA_CH53_CAT2_ISR
      ADC_DMA_CH54_ISR
      ADC_DMA_CH54_CAT2_ISR
      ADC_DMA_CH55_ISR
      ADC_DMA_CH55_CAT2_ISR
      ADC_DMA_CH56_ISR
      ADC_DMA_CH56_CAT2_ISR
      ADC_DMA_CH57_ISR
      ADC_DMA_CH57_CAT2_ISR
      ADC_DMA_CH58_ISR
      ADC_DMA_CH58_CAT2_ISR
      ADC_DMA_CH59_ISR
      ADC_DMA_CH59_CAT2_ISR
      ADC_DMA_CH60_ISR
      ADC_DMA_CH60_CAT2_ISR
      ADC_DMA_CH61_ISR
      ADC_DMA_CH61_CAT2_ISR
      ADC_DMA_CH62_ISR
      ADC_DMA_CH62_CAT2_ISR
      ADC_DMA_CH63_ISR
      ADC_DMA_CH63_CAT2_ISR
    bsw internal behavior BswInternalBehavior_0
      exclusive area ADC_RAMDATA_PROTECTION
      146 x bsw interrupt entity:
        BswInterruptEntity_0: implemented-entry=ADC0_SG1_ISR, interrupt-category=CAT-1, interrupt-source=INTADCA0I0
        BswInterruptEntity_1: implemented-entry=ADC0_SG1_CAT2_ISR, interrupt-category=CAT-2, interrupt-source=INTADCA0I0
        BswInterruptEntity_2: implemented-entry=ADC0_SG2_ISR, interrupt-category=CAT-1, interrupt-source=INTADCA0I1
        BswInterruptEntity_3: implemented-entry=ADC0_SG2_CAT2_ISR, interrupt-category=CAT-2, interrupt-source=INTADCA0I1
        BswInterruptEntity_4: implemented-entry=ADC0_SG3_ISR, interrupt-category=CAT-1, interrupt-source=INTADCA0I2
        BswInterruptEntity_5: implemented-entry=ADC0_SG3_CAT2_ISR, interrupt-category=CAT-2, interrupt-source=INTADCA0I2
        BswInterruptEntity_6: implemented-entry=ADC0_ERR_ISR, interrupt-category=CAT-1, interrupt-source=INTADCA0ERR
        BswInterruptEntity_7: implemented-entry=ADC0_ERR_CAT2_ISR, interrupt-category=CAT-2, interrupt-source=INTADCA0ERR
        BswInterruptEntity_8: implemented-entry=ADC1_SG1_ISR, interrupt-category=CAT-1, interrupt-source=INTADCA1I0
        BswInterruptEntity_9: implemented-entry=ADC1_SG1_CAT2_ISR, interrupt-category=CAT-2, interrupt-source=INTADCA1I0
        BswInterruptEntity_10: implemented-entry=ADC1_SG2_ISR, interrupt-category=CAT-1, interrupt-source=INTADCA1I1
        BswInterruptEntity_11: implemented-entry=ADC1_SG2_CAT2_ISR, interrupt-category=CAT-2, interrupt-source=INTADCA1I1
        BswInterruptEntity_12: implemented-entry=ADC1_SG3_ISR, interrupt-category=CAT-1, interrupt-source=INTADCA1I2
        BswInterruptEntity_13: implemented-entry=ADC1_SG3_CAT2_ISR, interrupt-category=CAT-2, interrupt-source=INTADCA1I2
        BswInterruptEntity_14: implemented-entry=ADC1_ERR_ISR, interrupt-category=CAT-1, interrupt-source=INTADCA1ERR
        BswInterruptEntity_15: implemented-entry=ADC1_ERR_CAT2_ISR, interrupt-category=CAT-2, interrupt-source=INTADCA1ERR
        BswInterruptEntity_16: implemented-entry=PWSA_QUE_ISR, interrupt-category=CAT-1, interrupt-source=INTQFULL
        BswInterruptEntity_17: implemented-entry=PWSA_QUE_CAT2_ISR, interrupt-category=CAT-2, interrupt-source=INTQFULL
        BswInterruptEntity_18: implemented-entry=ADC_DMA_CH00_ISR, interrupt-category=CAT-1, interrupt-source=INTDMA0
        BswInterruptEntity_19: implemented-entry=ADC_DMA_CH00_CAT2_ISR, interrupt-category=CAT-2, interrupt-source=INTDMA0
        BswInterruptEntity_20: implemented-entry=ADC_DMA_CH01_ISR, interrupt-category=CAT-1, interrupt-source=INTDMA1
        BswInterruptEntity_21: implemented-entry=ADC_DMA_CH01_CAT2_ISR, interrupt-category=CAT-2, interrupt-source=INTDMA1
        BswInterruptEntity_22: implemented-entry=ADC_DMA_CH02_ISR, interrupt-category=CAT-1, interrupt-source=INTDMA2
        BswInterruptEntity_23: implemented-entry=ADC_DMA_CH02_CAT2_ISR, interrupt-category=CAT-2, interrupt-source=INTDMA2
        BswInterruptEntity_24: implemented-entry=ADC_DMA_CH03_ISR, interrupt-category=CAT-1, interrupt-source=INTDMA3
        BswInterruptEntity_25: implemented-entry=ADC_DMA_CH03_CAT2_ISR, interrupt-category=CAT-2, interrupt-source=INTDMA3
        BswInterruptEntity_26: implemented-entry=ADC_DMA_CH04_ISR, interrupt-category=CAT-1, interrupt-source=INTDMA4
        BswInterruptEntity_27: implemented-entry=ADC_DMA_CH04_CAT2_ISR, interrupt-category=CAT-2, interrupt-source=INTDMA4
        BswInterruptEntity_28: implemented-entry=ADC_DMA_CH05_ISR, interrupt-category=CAT-1, interrupt-source=INTDMA5
        BswInterruptEntity_29: implemented-entry=ADC_DMA_CH05_CAT2_ISR, interrupt-category=CAT-2, interrupt-source=INTDMA5
        BswInterruptEntity_30: implemented-entry=ADC_DMA_CH06_ISR, interrupt-category=CAT-1, interrupt-source=INTDMA6
        BswInterruptEntity_31: implemented-entry=ADC_DMA_CH06_CAT2_ISR, interrupt-category=CAT-2, interrupt-source=INTDMA6
        BswInterruptEntity_32: implemented-entry=ADC_DMA_CH07_ISR, interrupt-category=CAT-1, interrupt-source=INTDMA7
        BswInterruptEntity_33: implemented-entry=ADC_DMA_CH07_CAT2_ISR, interrupt-category=CAT-2, interrupt-source=INTDMA7
        BswInterruptEntity_34: implemented-entry=ADC_DMA_CH08_ISR, interrupt-category=CAT-1, interrupt-source=INTDMA8
        BswInterruptEntity_35: implemented-entry=ADC_DMA_CH08_CAT2_ISR, interrupt-category=CAT-2, interrupt-source=INTDMA8
        BswInterruptEntity_36: implemented-entry=ADC_DMA_CH09_ISR, interrupt-category=CAT-1, interrupt-source=INTDMA9
        BswInterruptEntity_37: implemented-entry=ADC_DMA_CH09_CAT2_ISR, interrupt-category=CAT-2, interrupt-source=INTDMA9
        BswInterruptEntity_38: implemented-entry=ADC_DMA_CH10_ISR, interrupt-category=CAT-1, interrupt-source=INTDMA10
        BswInterruptEntity_39: implemented-entry=ADC_DMA_CH10_CAT2_ISR, interrupt-category=CAT-2, interrupt-source=INTDMA10
        BswInterruptEntity_40: implemented-entry=ADC_DMA_CH11_ISR, interrupt-category=CAT-1, interrupt-source=INTDMA11
        BswInterruptEntity_41: implemented-entry=ADC_DMA_CH11_CAT2_ISR, interrupt-category=CAT-2, interrupt-source=INTDMA11
        BswInterruptEntity_42: implemented-entry=ADC_DMA_CH12_ISR, interrupt-category=CAT-1, interrupt-source=INTDMA12
        BswInterruptEntity_43: implemented-entry=ADC_DMA_CH12_CAT2_ISR, interrupt-category=CAT-2, interrupt-source=INTDMA12
        BswInterruptEntity_44: implemented-entry=ADC_DMA_CH13_ISR, interrupt-category=CAT-1, interrupt-source=INTDMA13
        BswInterruptEntity_45: implemented-entry=ADC_DMA_CH13_CAT2_ISR, interrupt-category=CAT-2, interrupt-source=INTDMA13
        BswInterruptEntity_46: implemented-entry=ADC_DMA_CH14_ISR, interrupt-category=CAT-1, interrupt-source=INTDMA14
        BswInterruptEntity_47: implemented-entry=ADC_DMA_CH14_CAT2_ISR, interrupt-category=CAT-2, interrupt-source=INTDMA14
        BswInterruptEntity_48: implemented-entry=ADC_DMA_CH15_ISR, interrupt-category=CAT-1, interrupt-source=INTDMA15
        BswInterruptEntity_49: implemented-entry=ADC_DMA_CH15_CAT2_ISR, interrupt-category=CAT-2, interrupt-source=INTDMA15
        BswInterruptEntity_50: implemented-entry=ADC_DMA_CH16_ISR, interrupt-category=CAT-1, interrupt-source=INTDMA16
        BswInterruptEntity_51: implemented-entry=ADC_DMA_CH16_CAT2_ISR, interrupt-category=CAT-2, interrupt-source=INTDMA16
        BswInterruptEntity_52: implemented-entry=ADC_DMA_CH17_ISR, interrupt-category=CAT-1, interrupt-source=INTDMA17
        BswInterruptEntity_53: implemented-entry=ADC_DMA_CH17_CAT2_ISR, interrupt-category=CAT-2, interrupt-source=INTDMA17
        BswInterruptEntity_54: implemented-entry=ADC_DMA_CH18_ISR, interrupt-category=CAT-1, interrupt-source=INTDMA18
        BswInterruptEntity_55: implemented-entry=ADC_DMA_CH18_CAT2_ISR, interrupt-category=CAT-2, interrupt-source=INTDMA18
        BswInterruptEntity_56: implemented-entry=ADC_DMA_CH19_ISR, interrupt-category=CAT-1, interrupt-source=INTDMA19
        BswInterruptEntity_57: implemented-entry=ADC_DMA_CH19_CAT2_ISR, interrupt-category=CAT-2, interrupt-source=INTDMA19
        BswInterruptEntity_58: implemented-entry=ADC_DMA_CH20_ISR, interrupt-category=CAT-1, interrupt-source=INTDMA20
        BswInterruptEntity_59: implemented-entry=ADC_DMA_CH20_CAT2_ISR, interrupt-category=CAT-2, interrupt-source=INTDMA20
        BswInterruptEntity_60: implemented-entry=ADC_DMA_CH21_ISR, interrupt-category=CAT-1, interrupt-source=INTDMA21
        BswInterruptEntity_61: implemented-entry=ADC_DMA_CH21_CAT2_ISR, interrupt-category=CAT-2, interrupt-source=INTDMA21
        BswInterruptEntity_62: implemented-entry=ADC_DMA_CH22_ISR, interrupt-category=CAT-1, interrupt-source=INTDMA22
        BswInterruptEntity_63: implemented-entry=ADC_DMA_CH22_CAT2_ISR, interrupt-category=CAT-2, interrupt-source=INTDMA22
        BswInterruptEntity_64: implemented-entry=ADC_DMA_CH23_ISR, interrupt-category=CAT-1, interrupt-source=INTDMA23
        BswInterruptEntity_65: implemented-entry=ADC_DMA_CH23_CAT2_ISR, interrupt-category=CAT-2, interrupt-source=INTDMA23
        BswInterruptEntity_66: implemented-entry=ADC_DMA_CH24_ISR, interrupt-category=CAT-1, interrupt-source=INTDMA24
        BswInterruptEntity_67: implemented-entry=ADC_DMA_CH24_CAT2_ISR, interrupt-category=CAT-2, interrupt-source=INTDMA24
        BswInterruptEntity_68: implemented-entry=ADC_DMA_CH25_ISR, interrupt-category=CAT-1, interrupt-source=INTDMA25
        BswInterruptEntity_69: implemented-entry=ADC_DMA_CH25_CAT2_ISR, interrupt-category=CAT-2, interrupt-source=INTDMA25
        BswInterruptEntity_70: implemented-entry=ADC_DMA_CH26_ISR, interrupt-category=CAT-1, interrupt-source=INTDMA26
        BswInterruptEntity_71: implemented-entry=ADC_DMA_CH26_CAT2_ISR, interrupt-category=CAT-2, interrupt-source=INTDMA26
        BswInterruptEntity_72: implemented-entry=ADC_DMA_CH27_ISR, interrupt-category=CAT-1, interrupt-source=INTDMA27
        BswInterruptEntity_73: implemented-entry=ADC_DMA_CH27_CAT2_ISR, interrupt-category=CAT-2, interrupt-source=INTDMA27
        BswInterruptEntity_74: implemented-entry=ADC_DMA_CH28_ISR, interrupt-category=CAT-1, interrupt-source=INTDMA28
        BswInterruptEntity_75: implemented-entry=ADC_DMA_CH28_CAT2_ISR, interrupt-category=CAT-2, interrupt-source=INTDMA28
        BswInterruptEntity_76: implemented-entry=ADC_DMA_CH29_ISR, interrupt-category=CAT-1, interrupt-source=INTDMA29
        BswInterruptEntity_77: implemented-entry=ADC_DMA_CH29_CAT2_ISR, interrupt-category=CAT-2, interrupt-source=INTDMA29
        BswInterruptEntity_78: implemented-entry=ADC_DMA_CH30_ISR, interrupt-category=CAT-1, interrupt-source=INTDMA30
        BswInterruptEntity_79: implemented-entry=ADC_DMA_CH30_CAT2_ISR, interrupt-category=CAT-2, interrupt-source=INTDMA30
        BswInterruptEntity_80: implemented-entry=ADC_DMA_CH31_ISR, interrupt-category=CAT-1, interrupt-source=INTDMA31
        BswInterruptEntity_81: implemented-entry=ADC_DMA_CH31_CAT2_ISR, interrupt-category=CAT-2, interrupt-source=INTDMA31
        BswInterruptEntity_82: implemented-entry=ADC_DMA_CH32_ISR, interrupt-category=CAT-1, interrupt-source=INTDMA32
        BswInterruptEntity_83: implemented-entry=ADC_DMA_CH32_CAT2_ISR, interrupt-category=CAT-2, interrupt-source=INTDMA32
        BswInterruptEntity_84: implemented-entry=ADC_DMA_CH33_ISR, interrupt-category=CAT-1, interrupt-source=INTDMA33
        BswInterruptEntity_85: implemented-entry=ADC_DMA_CH33_CAT2_ISR, interrupt-category=CAT-2, interrupt-source=INTDMA33
        BswInterruptEntity_86: implemented-entry=ADC_DMA_CH34_ISR, interrupt-category=CAT-1, interrupt-source=INTDMA34
        BswInterruptEntity_87: implemented-entry=ADC_DMA_CH34_CAT2_ISR, interrupt-category=CAT-2, interrupt-source=INTDMA34
        BswInterruptEntity_88: implemented-entry=ADC_DMA_CH35_ISR, interrupt-category=CAT-1, interrupt-source=INTDMA35
        BswInterruptEntity_89: implemented-entry=ADC_DMA_CH35_CAT2_ISR, interrupt-category=CAT-2, interrupt-source=INTDMA35
        BswInterruptEntity_90: implemented-entry=ADC_DMA_CH36_ISR, interrupt-category=CAT-1, interrupt-source=INTDMA36
        BswInterruptEntity_91: implemented-entry=ADC_DMA_CH36_CAT2_ISR, interrupt-category=CAT-2, interrupt-source=INTDMA36
        BswInterruptEntity_92: implemented-entry=ADC_DMA_CH37_ISR, interrupt-category=CAT-1, interrupt-source=INTDMA37
        BswInterruptEntity_93: implemented-entry=ADC_DMA_CH37_CAT2_ISR, interrupt-category=CAT-2, interrupt-source=INTDMA37
        BswInterruptEntity_94: implemented-entry=ADC_DMA_CH38_ISR, interrupt-category=CAT-1, interrupt-source=INTDMA38
        BswInterruptEntity_95: implemented-entry=ADC_DMA_CH38_CAT2_ISR, interrupt-category=CAT-2, interrupt-source=INTDMA38
        BswInterruptEntity_96: implemented-entry=ADC_DMA_CH39_ISR, interrupt-category=CAT-1, interrupt-source=INTDMA39
        BswInterruptEntity_97: implemented-entry=ADC_DMA_CH39_CAT2_ISR, interrupt-category=CAT-2, interrupt-source=INTDMA39
        BswInterruptEntity_98: implemented-entry=ADC_DMA_CH40_ISR, interrupt-category=CAT-1, interrupt-source=INTDMA40
        BswInterruptEntity_99: implemented-entry=ADC_DMA_CH40_CAT2_ISR, interrupt-category=CAT-2, interrupt-source=INTDMA40
        BswInterruptEntity_100: implemented-entry=ADC_DMA_CH41_ISR, interrupt-category=CAT-1, interrupt-source=INTDMA41
        BswInterruptEntity_101: implemented-entry=ADC_DMA_CH41_CAT2_ISR, interrupt-category=CAT-2, interrupt-source=INTDMA41
        BswInterruptEntity_102: implemented-entry=ADC_DMA_CH42_ISR, interrupt-category=CAT-1, interrupt-source=INTDMA42
        BswInterruptEntity_103: implemented-entry=ADC_DMA_CH42_CAT2_ISR, interrupt-category=CAT-2, interrupt-source=INTDMA42
        BswInterruptEntity_104: implemented-entry=ADC_DMA_CH43_ISR, interrupt-category=CAT-1, interrupt-source=INTDMA43
        BswInterruptEntity_105: implemented-entry=ADC_DMA_CH43_CAT2_ISR, interrupt-category=CAT-2, interrupt-source=INTDMA43
        BswInterruptEntity_106: implemented-entry=ADC_DMA_CH44_ISR, interrupt-category=CAT-1, interrupt-source=INTDMA44
        BswInterruptEntity_107: implemented-entry=ADC_DMA_CH44_CAT2_ISR, interrupt-category=CAT-2, interrupt-source=INTDMA44
        BswInterruptEntity_108: implemented-entry=ADC_DMA_CH45_ISR, interrupt-category=CAT-1, interrupt-source=INTDMA45
        BswInterruptEntity_109: implemented-entry=ADC_DMA_CH45_CAT2_ISR, interrupt-category=CAT-2, interrupt-source=INTDMA45
        BswInterruptEntity_110: implemented-entry=ADC_DMA_CH46_ISR, interrupt-category=CAT-1, interrupt-source=INTDMA46
        BswInterruptEntity_111: implemented-entry=ADC_DMA_CH46_CAT2_ISR, interrupt-category=CAT-2, interrupt-source=INTDMA46
        BswInterruptEntity_112: implemented-entry=ADC_DMA_CH47_ISR, interrupt-category=CAT-1, interrupt-source=INTDMA47
        BswInterruptEntity_113: implemented-entry=ADC_DMA_CH47_CAT2_ISR, interrupt-category=CAT-2, interrupt-source=INTDMA47
        BswInterruptEntity_114: implemented-entry=ADC_DMA_CH48_ISR, interrupt-category=CAT-1, interrupt-source=INTDMA48
        BswInterruptEntity_115: implemented-entry=ADC_DMA_CH48_CAT2_ISR, interrupt-category=CAT-2, interrupt-source=INTDMA48
        BswInterruptEntity_116: implemented-entry=ADC_DMA_CH49_ISR, interrupt-category=CAT-1, interrupt-source=INTDMA49
        BswInterruptEntity_117: implemented-entry=ADC_DMA_CH49_CAT2_ISR, interrupt-category=CAT-2, interrupt-source=INTDMA49
        BswInterruptEntity_118: implemented-entry=ADC_DMA_CH50_ISR, interrupt-category=CAT-1, interrupt-source=INTDMA50
        BswInterruptEntity_119: implemented-entry=ADC_DMA_CH50_CAT2_ISR, interrupt-category=CAT-2, interrupt-source=INTDMA50
        BswInterruptEntity_120: implemented-entry=ADC_DMA_CH51_ISR, interrupt-category=CAT-1, interrupt-source=INTDMA51
        BswInterruptEntity_121: implemented-entry=ADC_DMA_CH51_CAT2_ISR, interrupt-category=CAT-2, interrupt-source=INTDMA51
        BswInterruptEntity_122: implemented-entry=ADC_DMA_CH52_ISR, interrupt-category=CAT-1, interrupt-source=INTDMA52
        BswInterruptEntity_123: implemented-entry=ADC_DMA_CH52_CAT2_ISR, interrupt-category=CAT-2, interrupt-source=INTDMA52
        BswInterruptEntity_124: implemented-entry=ADC_DMA_CH53_ISR, interrupt-category=CAT-1, interrupt-source=INTDMA53
        BswInterruptEntity_125: implemented-entry=ADC_DMA_CH53_CAT2_ISR, interrupt-category=CAT-2, interrupt-source=INTDMA53
        BswInterruptEntity_126: implemented-entry=ADC_DMA_CH54_ISR, interrupt-category=CAT-1, interrupt-source=INTDMA54
        BswInterruptEntity_127: implemented-entry=ADC_DMA_CH54_CAT2_ISR, interrupt-category=CAT-2, interrupt-source=INTDMA54
        BswInterruptEntity_128: implemented-entry=ADC_DMA_CH55_ISR, interrupt-category=CAT-1, interrupt-source=INTDMA55
        BswInterruptEntity_129: implemented-entry=ADC_DMA_CH55_CAT2_ISR, interrupt-category=CAT-2, interrupt-source=INTDMA55
        BswInterruptEntity_130: implemented-entry=ADC_DMA_CH56_ISR, interrupt-category=CAT-1, interrupt-source=INTDMA56
        BswInterruptEntity_131: implemented-entry=ADC_DMA_CH56_CAT2_ISR, interrupt-category=CAT-2, interrupt-source=INTDMA56
        BswInterruptEntity_132: implemented-entry=ADC_DMA_CH57_ISR, interrupt-category=CAT-1, interrupt-source=INTDMA57
        BswInterruptEntity_133: implemented-entry=ADC_DMA_CH57_CAT2_ISR, interrupt-category=CAT-2, interrupt-source=INTDMA57
        BswInterruptEntity_134: implemented-entry=ADC_DMA_CH58_ISR, interrupt-category=CAT-1, interrupt-source=INTDMA58
        BswInterruptEntity_135: implemented-entry=ADC_DMA_CH58_CAT2_ISR, interrupt-category=CAT-2, interrupt-source=INTDMA58
        BswInterruptEntity_136: implemented-entry=ADC_DMA_CH59_ISR, interrupt-category=CAT-1, interrupt-source=INTDMA59
        BswInterruptEntity_137: implemented-entry=ADC_DMA_CH59_CAT2_ISR, interrupt-category=CAT-2, interrupt-source=INTDMA59
        BswInterruptEntity_138: implemented-entry=ADC_DMA_CH60_ISR, interrupt-category=CAT-1, interrupt-source=INTDMA60
        BswInterruptEntity_139: implemented-entry=ADC_DMA_CH60_CAT2_ISR, interrupt-category=CAT-2, interrupt-source=INTDMA60
        BswInterruptEntity_140: implemented-entry=ADC_DMA_CH61_ISR, interrupt-category=CAT-1, interrupt-source=INTDMA61
        BswInterruptEntity_141: implemented-entry=ADC_DMA_CH61_CAT2_ISR, interrupt-category=CAT-2, interrupt-source=INTDMA61
        BswInterruptEntity_142: implemented-entry=ADC_DMA_CH62_ISR, interrupt-category=CAT-1, interrupt-source=INTDMA62
        BswInterruptEntity_143: implemented-entry=ADC_DMA_CH62_CAT2_ISR, interrupt-category=CAT-2, interrupt-source=INTDMA62
        BswInterruptEntity_144: implemented-entry=ADC_DMA_CH63_ISR, interrupt-category=CAT-1, interrupt-source=INTDMA63
        BswInterruptEntity_145: implemented-entry=ADC_DMA_CH63_CAT2_ISR, interrupt-category=CAT-2, interrupt-source=INTDMA63
      28 x bsw called entity:
        BswCalledEntity_0: implemented-entry=Adc_Init
        BswCalledEntity_1: implemented-entry=Adc_DeInit
        BswCalledEntity_2: can-enter-exclusive-area=ADC_RAMDATA_PROTECTION, implemented-entry=Adc_StartGroupConversion
        BswCalledEntity_3: can-enter-exclusive-area=ADC_RAMDATA_PROTECTION, implemented-entry=Adc_StopGroupConversion
        BswCalledEntity_4: can-enter-exclusive-area=ADC_RAMDATA_PROTECTION, implemented-entry=Adc_ReadGroup
        BswCalledEntity_5: can-enter-exclusive-area=ADC_RAMDATA_PROTECTION, implemented-entry=Adc_EnableHardwareTrigger
        BswCalledEntity_6: can-enter-exclusive-area=ADC_RAMDATA_PROTECTION, implemented-entry=Adc_DisableHardwareTrigger
        BswCalledEntity_7: implemented-entry=Adc_EnableGroupNotification
        BswCalledEntity_8: implemented-entry=Adc_DisableGroupNotification
        BswCalledEntity_9: can-enter-exclusive-area=ADC_RAMDATA_PROTECTION, implemented-entry=Adc_GetGroupStatus
        BswCalledEntity_10: can-enter-exclusive-area=ADC_RAMDATA_PROTECTION, implemented-entry=Adc_GetStreamLastPointer
        BswCalledEntity_11: implemented-entry=Adc_CusGetADCAnDRmAddr
        BswCalledEntity_12: implemented-entry=Adc_EnableHwTrigger
        BswCalledEntity_13: can-enter-exclusive-area=ADC_RAMDATA_PROTECTION, implemented-entry=Adc_DisableHwTrigger
        BswCalledEntity_14: implemented-entry=Adc_HwResultReadGroup
        BswCalledEntity_15: implemented-entry=Adc_DisableChannel
        BswCalledEntity_16: implemented-entry=Adc_EnableChannel
        BswCalledEntity_17: implemented-entry=Adc_SetThreshold
        BswCalledEntity_18: implemented-entry=Adc_SelectChannelThreshold
        BswCalledEntity_19: implemented-entry=Adc_EnableIntAdcErr
        BswCalledEntity_20: implemented-entry=Adc_DisableIntAdcErr
        BswCalledEntity_21: implemented-entry=Adc_SetupResultBuffer
        BswCalledEntity_22: implemented-entry=Adc_GetVersionInfo
        BswCalledEntity_23: implemented-entry=Adc_CusSetSamplingClock
        BswCalledEntity_24: implemented-entry=Adc_CusGetPWSAnPVCRx_y_16bit
        BswCalledEntity_25: implemented-entry=Adc_CusGetPWSAnPVCRx_y_32bit
        BswCalledEntity_26: implemented-entry=Adc_CheckHWConsistency
        BswCalledEntity_27: can-enter-exclusive-area=ADC_RAMDATA_PROTECTION, implemented-entry=Adc_PrepareEnableHwTrigger
  174 x bsw module entry, all with sw-service-impl-policy=STANDARD:
    ADC0_SG1_ISR: is-reentrant=false, is-synchronous=true, call-type=INTERRUPT, execution-context=INTERRUPT-CAT-1
    ADC0_SG1_CAT2_ISR: is-reentrant=false, is-synchronous=true, call-type=INTERRUPT, execution-context=INTERRUPT-CAT-2
    ADC0_SG2_ISR: is-reentrant=false, is-synchronous=true, call-type=INTERRUPT, execution-context=INTERRUPT-CAT-1
    ADC0_SG2_CAT2_ISR: is-reentrant=false, is-synchronous=true, call-type=INTERRUPT, execution-context=INTERRUPT-CAT-2
    ADC0_SG3_ISR: is-reentrant=false, is-synchronous=true, call-type=INTERRUPT, execution-context=INTERRUPT-CAT-1
    ADC0_SG3_CAT2_ISR: is-reentrant=false, is-synchronous=true, call-type=INTERRUPT, execution-context=INTERRUPT-CAT-2
    ADC0_ERR_ISR: is-reentrant=false, is-synchronous=true, call-type=INTERRUPT, execution-context=INTERRUPT-CAT-1
    ADC0_ERR_CAT2_ISR: is-reentrant=false, is-synchronous=true, call-type=INTERRUPT, execution-context=INTERRUPT-CAT-2
    ADC1_SG1_ISR: is-reentrant=false, is-synchronous=true, call-type=INTERRUPT, execution-context=INTERRUPT-CAT-1
    ADC1_SG1_CAT2_ISR: is-reentrant=false, is-synchronous=true, call-type=INTERRUPT, execution-context=INTERRUPT-CAT-2
    ADC1_SG2_ISR: is-reentrant=false, is-synchronous=true, call-type=INTERRUPT, execution-context=INTERRUPT-CAT-1
    ADC1_SG2_CAT2_ISR: is-reentrant=false, is-synchronous=true, call-type=INTERRUPT, execution-context=INTERRUPT-CAT-2
    ADC1_SG3_ISR: is-reentrant=false, is-synchronous=true, call-type=INTERRUPT, execution-context=INTERRUPT-CAT-1
    ADC1_SG3_CAT2_ISR: is-reentrant=false, is-synchronous=true, call-type=INTERRUPT, execution-context=INTERRUPT-CAT-2
    ADC1_ERR_ISR: is-reentrant=false, is-synchronous=true, call-type=INTERRUPT, execution-context=INTERRUPT-CAT-1
    ADC1_ERR_CAT2_ISR: is-reentrant=false, is-synchronous=true, call-type=INTERRUPT, execution-context=INTERRUPT-CAT-2
    PWSA_QUE_ISR: is-reentrant=false, is-synchronous=true, call-type=INTERRUPT, execution-context=INTERRUPT-CAT-1
    PWSA_QUE_CAT2_ISR: is-reentrant=false, is-synchronous=true, call-type=INTERRUPT, execution-context=INTERRUPT-CAT-2
    ADC_DMA_CH00_ISR: is-reentrant=false, is-synchronous=true, call-type=INTERRUPT, execution-context=INTERRUPT-CAT-1
    ADC_DMA_CH00_CAT2_ISR: is-reentrant=false, is-synchronous=true, call-type=INTERRUPT, execution-context=INTERRUPT-CAT-2
    ADC_DMA_CH01_ISR: is-reentrant=false, is-synchronous=true, call-type=INTERRUPT, execution-context=INTERRUPT-CAT-1
    ADC_DMA_CH01_CAT2_ISR: is-reentrant=false, is-synchronous=true, call-type=INTERRUPT, execution-context=INTERRUPT-CAT-2
    ADC_DMA_CH02_ISR: is-reentrant=false, is-synchronous=true, call-type=INTERRUPT, execution-context=INTERRUPT-CAT-1
    ADC_DMA_CH02_CAT2_ISR: is-reentrant=false, is-synchronous=true, call-type=INTERRUPT, execution-context=INTERRUPT-CAT-2
    ADC_DMA_CH03_ISR: is-reentrant=false, is-synchronous=true, call-type=INTERRUPT, execution-context=INTERRUPT-CAT-1
    ADC_DMA_CH03_CAT2_ISR: is-reentrant=false, is-synchronous=true, call-type=INTERRUPT, execution-context=INTERRUPT-CAT-2
    ADC_DMA_CH04_ISR: is-reentrant=false, is-synchronous=true, call-type=INTERRUPT, execution-context=INTERRUPT-CAT-1
    ADC_DMA_CH04_CAT2_ISR: is-reentrant=false, is-synchronous=true, call-type=INTERRUPT, execution-context=INTERRUPT-CAT-2
    ADC_DMA_CH05_ISR: is-reentrant=false, is-synchronous=true, call-type=INTERRUPT, execution-context=INTERRUPT-CAT-1
    ADC_DMA_CH05_CAT2_ISR: is-reentrant=false, is-synchronous=true, call-type=INTERRUPT, execution-context=INTERRUPT-CAT-2
    ADC_DMA_CH06_ISR: is-reentrant=false, is-synchronous=true, call-type=INTERRUPT, execution-context=INTERRUPT-CAT-1
    ADC_DMA_CH06_CAT2_ISR: is-reentrant=false, is-synchronous=true, call-type=INTERRUPT, execution-context=INTERRUPT-CAT-2
    ADC_DMA_CH07_ISR: is-reentrant=false, is-synchronous=true, call-type=INTERRUPT, execution-context=INTERRUPT-CAT-1
    ADC_DMA_CH07_CAT2_ISR: is-reentrant=false, is-synchronous=true, call-type=INTERRUPT, execution-context=INTERRUPT-CAT-2
    ADC_DMA_CH08_ISR: is-reentrant=false, is-synchronous=true, call-type=INTERRUPT, execution-context=INTERRUPT-CAT-1
    ADC_DMA_CH08_CAT2_ISR: is-reentrant=false, is-synchronous=true, call-type=INTERRUPT, execution-context=INTERRUPT-CAT-2
    ADC_DMA_CH09_ISR: is-reentrant=false, is-synchronous=true, call-type=INTERRUPT, execution-context=INTERRUPT-CAT-1
    ADC_DMA_CH09_CAT2_ISR: is-reentrant=false, is-synchronous=true, call-type=INTERRUPT, execution-context=INTERRUPT-CAT-2
    ADC_DMA_CH10_ISR: is-reentrant=false, is-synchronous=true, call-type=INTERRUPT, execution-context=INTERRUPT-CAT-1
    ADC_DMA_CH10_CAT2_ISR: is-reentrant=false, is-synchronous=true, call-type=INTERRUPT, execution-context=INTERRUPT-CAT-2
    ADC_DMA_CH11_ISR: is-reentrant=false, is-synchronous=true, call-type=INTERRUPT, execution-context=INTERRUPT-CAT-1
    ADC_DMA_CH11_CAT2_ISR: is-reentrant=false, is-synchronous=true, call-type=INTERRUPT, execution-context=INTERRUPT-CAT-2
    ADC_DMA_CH12_ISR: is-reentrant=false, is-synchronous=true, call-type=INTERRUPT, execution-context=INTERRUPT-CAT-1
    ADC_DMA_CH12_CAT2_ISR: is-reentrant=false, is-synchronous=true, call-type=INTERRUPT, execution-context=INTERRUPT-CAT-2
    ADC_DMA_CH13_ISR: is-reentrant=false, is-synchronous=true, call-type=INTERRUPT, execution-context=INTERRUPT-CAT-1
    ADC_DMA_CH13_CAT2_ISR: is-reentrant=false, is-synchronous=true, call-type=INTERRUPT, execution-context=INTERRUPT-CAT-2
    ADC_DMA_CH14_ISR: is-reentrant=false, is-synchronous=true, call-type=INTERRUPT, execution-context=INTERRUPT-CAT-1
    ADC_DMA_CH14_CAT2_ISR: is-reentrant=false, is-synchronous=true, call-type=INTERRUPT, execution-context=INTERRUPT-CAT-2
    ADC_DMA_CH15_ISR: is-reentrant=false, is-synchronous=true, call-type=INTERRUPT, execution-context=INTERRUPT-CAT-1
    ADC_DMA_CH15_CAT2_ISR: is-reentrant=false, is-synchronous=true, call-type=INTERRUPT, execution-context=INTERRUPT-CAT-2
    ADC_DMA_CH16_ISR: is-reentrant=false, is-synchronous=true, call-type=INTERRUPT, execution-context=INTERRUPT-CAT-1
    ADC_DMA_CH16_CAT2_ISR: is-reentrant=false, is-synchronous=true, call-type=INTERRUPT, execution-context=INTERRUPT-CAT-2
    ADC_DMA_CH17_ISR: is-reentrant=false, is-synchronous=true, call-type=INTERRUPT, execution-context=INTERRUPT-CAT-1
    ADC_DMA_CH17_CAT2_ISR: is-reentrant=false, is-synchronous=true, call-type=INTERRUPT, execution-context=INTERRUPT-CAT-2
    ADC_DMA_CH18_ISR: is-reentrant=false, is-synchronous=true, call-type=INTERRUPT, execution-context=INTERRUPT-CAT-1
    ADC_DMA_CH18_CAT2_ISR: is-reentrant=false, is-synchronous=true, call-type=INTERRUPT, execution-context=INTERRUPT-CAT-2
    ADC_DMA_CH19_ISR: is-reentrant=false, is-synchronous=true, call-type=INTERRUPT, execution-context=INTERRUPT-CAT-1
    ADC_DMA_CH19_CAT2_ISR: is-reentrant=false, is-synchronous=true, call-type=INTERRUPT, execution-context=INTERRUPT-CAT-2
    ADC_DMA_CH20_ISR: is-reentrant=false, is-synchronous=true, call-type=INTERRUPT, execution-context=INTERRUPT-CAT-1
    ADC_DMA_CH20_CAT2_ISR: is-reentrant=false, is-synchronous=true, call-type=INTERRUPT, execution-context=INTERRUPT-CAT-2
    ADC_DMA_CH21_ISR: is-reentrant=false, is-synchronous=true, call-type=INTERRUPT, execution-context=INTERRUPT-CAT-1
    ADC_DMA_CH21_CAT2_ISR: is-reentrant=false, is-synchronous=true, call-type=INTERRUPT, execution-context=INTERRUPT-CAT-2
    ADC_DMA_CH22_ISR: is-reentrant=false, is-synchronous=true, call-type=INTERRUPT, execution-context=INTERRUPT-CAT-1
    ADC_DMA_CH22_CAT2_ISR: is-reentrant=false, is-synchronous=true, call-type=INTERRUPT, execution-context=INTERRUPT-CAT-2
    ADC_DMA_CH23_ISR: is-reentrant=false, is-synchronous=true, call-type=INTERRUPT, execution-context=INTERRUPT-CAT-1
    ADC_DMA_CH23_CAT2_ISR: is-reentrant=false, is-synchronous=true, call-type=INTERRUPT, execution-context=INTERRUPT-CAT-2
    ADC_DMA_CH24_ISR: is-reentrant=false, is-synchronous=true, call-type=INTERRUPT, execution-context=INTERRUPT-CAT-1
    ADC_DMA_CH24_CAT2_ISR: is-reentrant=false, is-synchronous=true, call-type=INTERRUPT, execution-context=INTERRUPT-CAT-2
    ADC_DMA_CH25_ISR: is-reentrant=false, is-synchronous=true, call-type=INTERRUPT, execution-context=INTERRUPT-CAT-1
    ADC_DMA_CH25_CAT2_ISR: is-reentrant=false, is-synchronous=true, call-type=INTERRUPT, execution-context=INTERRUPT-CAT-2
    ADC_DMA_CH26_ISR: is-reentrant=false, is-synchronous=true, call-type=INTERRUPT, execution-context=INTERRUPT-CAT-1
    ADC_DMA_CH26_CAT2_ISR: is-reentrant=false, is-synchronous=true, call-type=INTERRUPT, execution-context=INTERRUPT-CAT-2
    ADC_DMA_CH27_ISR: is-reentrant=false, is-synchronous=true, call-type=INTERRUPT, execution-context=INTERRUPT-CAT-1
    ADC_DMA_CH27_CAT2_ISR: is-reentrant=false, is-synchronous=true, call-type=INTERRUPT, execution-context=INTERRUPT-CAT-2
    ADC_DMA_CH28_ISR: is-reentrant=false, is-synchronous=true, call-type=INTERRUPT, execution-context=INTERRUPT-CAT-1
    ADC_DMA_CH28_CAT2_ISR: is-reentrant=false, is-synchronous=true, call-type=INTERRUPT, execution-context=INTERRUPT-CAT-2
    ADC_DMA_CH29_ISR: is-reentrant=false, is-synchronous=true, call-type=INTERRUPT, execution-context=INTERRUPT-CAT-1
    ADC_DMA_CH29_CAT2_ISR: is-reentrant=false, is-synchronous=true, call-type=INTERRUPT, execution-context=INTERRUPT-CAT-2
    ADC_DMA_CH30_ISR: is-reentrant=false, is-synchronous=true, call-type=INTERRUPT, execution-context=INTERRUPT-CAT-1
    ADC_DMA_CH30_CAT2_ISR: is-reentrant=false, is-synchronous=true, call-type=INTERRUPT, execution-context=INTERRUPT-CAT-2
    ADC_DMA_CH31_ISR: is-reentrant=false, is-synchronous=true, call-type=INTERRUPT, execution-context=INTERRUPT-CAT-1
    ADC_DMA_CH31_CAT2_ISR: is-reentrant=false, is-synchronous=true, call-type=INTERRUPT, execution-context=INTERRUPT-CAT-2
    ADC_DMA_CH32_ISR: is-reentrant=false, is-synchronous=true, call-type=INTERRUPT, execution-context=INTERRUPT-CAT-1
    ADC_DMA_CH32_CAT2_ISR: is-reentrant=false, is-synchronous=true, call-type=INTERRUPT, execution-context=INTERRUPT-CAT-2
    ADC_DMA_CH33_ISR: is-reentrant=false, is-synchronous=true, call-type=INTERRUPT, execution-context=INTERRUPT-CAT-1
    ADC_DMA_CH33_CAT2_ISR: is-reentrant=false, is-synchronous=true, call-type=INTERRUPT, execution-context=INTERRUPT-CAT-2
    ADC_DMA_CH34_ISR: is-reentrant=false, is-synchronous=true, call-type=INTERRUPT, execution-context=INTERRUPT-CAT-1
    ADC_DMA_CH34_CAT2_ISR: is-reentrant=false, is-synchronous=true, call-type=INTERRUPT, execution-context=INTERRUPT-CAT-2
    ADC_DMA_CH35_ISR: is-reentrant=false, is-synchronous=true, call-type=INTERRUPT, execution-context=INTERRUPT-CAT-1
    ADC_DMA_CH35_CAT2_ISR: is-reentrant=false, is-synchronous=true, call-type=INTERRUPT, execution-context=INTERRUPT-CAT-2
    ADC_DMA_CH36_ISR: is-reentrant=false, is-synchronous=true, call-type=INTERRUPT, execution-context=INTERRUPT-CAT-1
    ADC_DMA_CH36_CAT2_ISR: is-reentrant=false, is-synchronous=true, call-type=INTERRUPT, execution-context=INTERRUPT-CAT-2
    ADC_DMA_CH37_ISR: is-reentrant=false, is-synchronous=true, call-type=INTERRUPT, execution-context=INTERRUPT-CAT-1
    ADC_DMA_CH37_CAT2_ISR: is-reentrant=false, is-synchronous=true, call-type=INTERRUPT, execution-context=INTERRUPT-CAT-2
    ADC_DMA_CH38_ISR: is-reentrant=false, is-synchronous=true, call-type=INTERRUPT, execution-context=INTERRUPT-CAT-1
    ADC_DMA_CH38_CAT2_ISR: is-reentrant=false, is-synchronous=true, call-type=INTERRUPT, execution-context=INTERRUPT-CAT-2
    ADC_DMA_CH39_ISR: is-reentrant=false, is-synchronous=true, call-type=INTERRUPT, execution-context=INTERRUPT-CAT-1
    ADC_DMA_CH39_CAT2_ISR: is-reentrant=false, is-synchronous=true, call-type=INTERRUPT, execution-context=INTERRUPT-CAT-2
    ADC_DMA_CH40_ISR: is-reentrant=false, is-synchronous=true, call-type=INTERRUPT, execution-context=INTERRUPT-CAT-1
    ADC_DMA_CH40_CAT2_ISR: is-reentrant=false, is-synchronous=true, call-type=INTERRUPT, execution-context=INTERRUPT-CAT-2
    ADC_DMA_CH41_ISR: is-reentrant=false, is-synchronous=true, call-type=INTERRUPT, execution-context=INTERRUPT-CAT-1
    ADC_DMA_CH41_CAT2_ISR: is-reentrant=false, is-synchronous=true, call-type=INTERRUPT, execution-context=INTERRUPT-CAT-2
    ADC_DMA_CH42_ISR: is-reentrant=false, is-synchronous=true, call-type=INTERRUPT, execution-context=INTERRUPT-CAT-1
    ADC_DMA_CH42_CAT2_ISR: is-reentrant=false, is-synchronous=true, call-type=INTERRUPT, execution-context=INTERRUPT-CAT-2
    ADC_DMA_CH43_ISR: is-reentrant=false, is-synchronous=true, call-type=INTERRUPT, execution-context=INTERRUPT-CAT-1
    ADC_DMA_CH43_CAT2_ISR: is-reentrant=false, is-synchronous=true, call-type=INTERRUPT, execution-context=INTERRUPT-CAT-2
    ADC_DMA_CH44_ISR: is-reentrant=false, is-synchronous=true, call-type=INTERRUPT, execution-context=INTERRUPT-CAT-1
    ADC_DMA_CH44_CAT2_ISR: is-reentrant=false, is-synchronous=true, call-type=INTERRUPT, execution-context=INTERRUPT-CAT-2
    ADC_DMA_CH45_ISR: is-reentrant=false, is-synchronous=true, call-type=INTERRUPT, execution-context=INTERRUPT-CAT-1
    ADC_DMA_CH45_CAT2_ISR: is-reentrant=false, is-synchronous=true, call-type=INTERRUPT, execution-context=INTERRUPT-CAT-2
    ADC_DMA_CH46_ISR: is-reentrant=false, is-synchronous=true, call-type=INTERRUPT, execution-context=INTERRUPT-CAT-1
    ADC_DMA_CH46_CAT2_ISR: is-reentrant=false, is-synchronous=true, call-type=INTERRUPT, execution-context=INTERRUPT-CAT-2
    ADC_DMA_CH47_ISR: is-reentrant=false, is-synchronous=true, call-type=INTERRUPT, execution-context=INTERRUPT-CAT-1
    ADC_DMA_CH47_CAT2_ISR: is-reentrant=false, is-synchronous=true, call-type=INTERRUPT, execution-context=INTERRUPT-CAT-2
    ADC_DMA_CH48_ISR: is-reentrant=false, is-synchronous=true, call-type=INTERRUPT, execution-context=INTERRUPT-CAT-1
    ADC_DMA_CH48_CAT2_ISR: is-reentrant=false, is-synchronous=true, call-type=INTERRUPT, execution-context=INTERRUPT-CAT-2
    ADC_DMA_CH49_ISR: is-reentrant=false, is-synchronous=true, call-type=INTERRUPT, execution-context=INTERRUPT-CAT-1
    ADC_DMA_CH49_CAT2_ISR: is-reentrant=false, is-synchronous=true, call-type=INTERRUPT, execution-context=INTERRUPT-CAT-2
    ADC_DMA_CH50_ISR: is-reentrant=false, is-synchronous=true, call-type=INTERRUPT, execution-context=INTERRUPT-CAT-1
    ADC_DMA_CH50_CAT2_ISR: is-reentrant=false, is-synchronous=true, call-type=INTERRUPT, execution-context=INTERRUPT-CAT-2
    ADC_DMA_CH51_ISR: is-reentrant=false, is-synchronous=true, call-type=INTERRUPT, execution-context=INTERRUPT-CAT-1
    ADC_DMA_CH51_CAT2_ISR: is-reentrant=false, is-synchronous=true, call-type=INTERRUPT, execution-context=INTERRUPT-CAT-2
    ADC_DMA_CH52_ISR: is-reentrant=false, is-synchronous=true, call-type=INTERRUPT, execution-context=INTERRUPT-CAT-1
    ADC_DMA_CH52_CAT2_ISR: is-reentrant=false, is-synchronous=true, call-type=INTERRUPT, execution-context=INTERRUPT-CAT-2
    ADC_DMA_CH53_ISR: is-reentrant=false, is-synchronous=true, call-type=INTERRUPT, execution-context=INTERRUPT-CAT-1
    ADC_DMA_CH53_CAT2_ISR: is-reentrant=false, is-synchronous=true, call-type=INTERRUPT, execution-context=INTERRUPT-CAT-2
    ADC_DMA_CH54_ISR: is-reentrant=false, is-synchronous=true, call-type=INTERRUPT, execution-context=INTERRUPT-CAT-1
    ADC_DMA_CH54_CAT2_ISR: is-reentrant=false, is-synchronous=true, call-type=INTERRUPT, execution-context=INTERRUPT-CAT-2
    ADC_DMA_CH55_ISR: is-reentrant=false, is-synchronous=true, call-type=INTERRUPT, execution-context=INTERRUPT-CAT-1
    ADC_DMA_CH55_CAT2_ISR: is-reentrant=false, is-synchronous=true, call-type=INTERRUPT, execution-context=INTERRUPT-CAT-2
    ADC_DMA_CH56_ISR: is-reentrant=false, is-synchronous=true, call-type=INTERRUPT, execution-context=INTERRUPT-CAT-1
    ADC_DMA_CH56_CAT2_ISR: is-reentrant=false, is-synchronous=true, call-type=INTERRUPT, execution-context=INTERRUPT-CAT-2
    ADC_DMA_CH57_ISR: is-reentrant=false, is-synchronous=true, call-type=INTERRUPT, execution-context=INTERRUPT-CAT-1
    ADC_DMA_CH57_CAT2_ISR: is-reentrant=false, is-synchronous=true, call-type=INTERRUPT, execution-context=INTERRUPT-CAT-2
    ADC_DMA_CH58_ISR: is-reentrant=false, is-synchronous=true, call-type=INTERRUPT, execution-context=INTERRUPT-CAT-1
    ADC_DMA_CH58_CAT2_ISR: is-reentrant=false, is-synchronous=true, call-type=INTERRUPT, execution-context=INTERRUPT-CAT-2
    ADC_DMA_CH59_ISR: is-reentrant=false, is-synchronous=true, call-type=INTERRUPT, execution-context=INTERRUPT-CAT-1
    ADC_DMA_CH59_CAT2_ISR: is-reentrant=false, is-synchronous=true, call-type=INTERRUPT, execution-context=INTERRUPT-CAT-2
    ADC_DMA_CH60_ISR: is-reentrant=false, is-synchronous=true, call-type=INTERRUPT, execution-context=INTERRUPT-CAT-1
    ADC_DMA_CH60_CAT2_ISR: is-reentrant=false, is-synchronous=true, call-type=INTERRUPT, execution-context=INTERRUPT-CAT-2
    ADC_DMA_CH61_ISR: is-reentrant=false, is-synchronous=true, call-type=INTERRUPT, execution-context=INTERRUPT-CAT-1
    ADC_DMA_CH61_CAT2_ISR: is-reentrant=false, is-synchronous=true, call-type=INTERRUPT, execution-context=INTERRUPT-CAT-2
    ADC_DMA_CH62_ISR: is-reentrant=false, is-synchronous=true, call-type=INTERRUPT, execution-context=INTERRUPT-CAT-1
    ADC_DMA_CH62_CAT2_ISR: is-reentrant=false, is-synchronous=true, call-type=INTERRUPT, execution-context=INTERRUPT-CAT-2
    ADC_DMA_CH63_ISR: is-reentrant=false, is-synchronous=true, call-type=INTERRUPT, execution-context=INTERRUPT-CAT-1
    ADC_DMA_CH63_CAT2_ISR: is-reentrant=false, is-synchronous=true, call-type=INTERRUPT, execution-context=INTERRUPT-CAT-2
    Adc_Init: service-id=0, is-reentrant=false, is-synchronous=true, call-type=REGULAR, execution-context=TASK
    Adc_SetupResultBuffer: service-id=12, is-reentrant=true, is-synchronous=true, call-type=REGULAR, execution-context=TASK
    Adc_DeInit: service-id=1, is-reentrant=false, is-synchronous=true, call-type=REGULAR, execution-context=TASK
    Adc_StartGroupConversion: service-id=2, is-reentrant=true, is-synchronous=false, call-type=REGULAR, execution-context=TASK
    Adc_StopGroupConversion: service-id=3, is-reentrant=true, is-synchronous=true, call-type=REGULAR, execution-context=TASK
    Adc_ReadGroup: service-id=4, is-reentrant=true, is-synchronous=true, call-type=REGULAR, execution-context=TASK
    Adc_EnableHardwareTrigger: service-id=5, is-reentrant=true, is-synchronous=true, call-type=REGULAR, execution-context=TASK
    Adc_DisableHardwareTrigger: service-id=6, is-reentrant=true, is-synchronous=true, call-type=REGULAR, execution-context=TASK
    Adc_EnableGroupNotification: service-id=7, is-reentrant=true, is-synchronous=true, call-type=REGULAR, execution-context=TASK
    Adc_DisableGroupNotification: service-id=8, is-reentrant=true, is-synchronous=true, call-type=REGULAR, execution-context=TASK
    Adc_GetGroupStatus: service-id=9, is-reentrant=true, is-synchronous=true, call-type=REGULAR, execution-context=TASK
    Adc_GetStreamLastPointer: service-id=11, is-reentrant=true, is-synchronous=true, call-type=REGULAR, execution-context=TASK
    Adc_GetVersionInfo: service-id=10, is-reentrant=true, is-synchronous=true, call-type=REGULAR, execution-context=TASK
    Adc_CusGetADCAnDRmAddr: service-id=20, is-reentrant=false, is-synchronous=true, call-type=REGULAR, execution-context=TASK
    Adc_EnableHwTrigger: service-id=13, is-reentrant=true, is-synchronous=true, call-type=REGULAR, execution-context=TASK
    Adc_DisableHwTrigger: service-id=14, is-reentrant=true, is-synchronous=true, call-type=REGULAR, execution-context=TASK
    Adc_HwResultReadGroup: service-id=15, is-reentrant=true, is-synchronous=true, call-type=REGULAR, execution-context=TASK
    Adc_DisableChannel: service-id=16, is-reentrant=true, is-synchronous=true, call-type=REGULAR, execution-context=TASK
    Adc_EnableChannel: service-id=17, is-reentrant=true, is-synchronous=true, call-type=REGULAR, execution-context=TASK
    Adc_SetThreshold: service-id=18, is-reentrant=true, is-synchronous=true, call-type=REGULAR, execution-context=TASK
    Adc_SelectChannelThreshold: service-id=19, is-reentrant=true, is-synchronous=true, call-type=REGULAR, execution-context=TASK
    Adc_CheckHWConsistency: service-id=26, is-reentrant=false, is-synchronous=true, call-type=REGULAR, execution-context=TASK
    Adc_EnableIntAdcErr: service-id=21, is-reentrant=false, is-synchronous=true, call-type=REGULAR, execution-context=TASK
    Adc_DisableIntAdcErr: service-id=22, is-reentrant=false, is-synchronous=true, call-type=REGULAR, execution-context=TASK
    Adc_CusSetSamplingClock: service-id=23, is-reentrant=false, is-synchronous=true, call-type=REGULAR, execution-context=TASK
    Adc_CusGetPWSAnPVCRx_y_16bit: service-id=24, is-reentrant=false, is-synchronous=true, call-type=REGULAR, execution-context=TASK
    Adc_CusGetPWSAnPVCRx_y_32bit: service-id=25, is-reentrant=false, is-synchronous=true, call-type=REGULAR, execution-context=TASK
    Adc_PrepareEnableHwTrigger: service-id=27, is-reentrant=true, is-synchronous=true, call-type=REGULAR, execution-context=TASK
