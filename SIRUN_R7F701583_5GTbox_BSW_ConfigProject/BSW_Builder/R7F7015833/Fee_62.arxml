AUTOSAR XML (schema 00048)
package /R7F7015833
  module config Fee_62
    FeeGeneral:
      FeeDevErrorDetect = true
      FeeMainFunctionPeriod = 0.01
      FeePollingMode = true
      FeeSetModeSupported = false
      FeeVersionInfoApi = false
      FeeVirtualPageSize = 8
      FeeCancelApi = false
      FeePageDirectWriteSupport = false
      FeeClusterGrp
        FeeCluster: FeeClusterIndex=0, FeeClusterStartaddress=256, FeeClusterSize=12288
        FeeCluster_1 (FeeCluster): FeeClusterIndex=1, FeeClusterStartaddress=12544, FeeClusterSize=12288
    FeePublishedInformation: FeeBlockOverhead=32, FeeClusterOverhead=24
    53 x FeeBlockConfiguration, all with FeeImmediateData=false, FeeNumberOfWriteCycles=0, FeeDeviceIndex=NULL, FeeClusterGroupRef=FeeClusterGrp:
      FeeBlockConfiguration_0: FeeBlockNumber=256, FeeBlockSize=16
      FeeBlockConfiguration_1: FeeBlockNumber=257, FeeBlockSize=16
      FeeBlockConfiguration_DIDF1A9: FeeBlockNumber=512, FeeBlockSize=8
      FeeBlockConfiguration_All_EventEntry: FeeBlockNumber=768, FeeBlockSize=3136
      FeeBlockConfiguration_UDS_InternalData: FeeBlockNumber=1024, FeeBlockSize=192
      FeeBlockConfiguration_DIDF18B: FeeBlockNumber=1280, FeeBlockSize=8
      FeeBlockConfiguration_DIDF18C: FeeBlockNumber=1536, FeeBlockSize=24
      FeeBlockConfiguration_DIDF190: FeeBlockNumber=1792, FeeBlockSize=24
      FeeBlockConfiguration_DIDF198: FeeBlockNumber=2048, FeeBlockSize=16
      FeeBlockConfiguration_DIDF1A8: FeeBlockNumber=2304, FeeBlockSize=24
      FeeBlockConfiguration_DIDF130: FeeBlockNumber=2560, FeeBlockSize=40
      FeeBlockConfiguration_DIDC001: FeeBlockNumber=2816, FeeBlockSize=72
      FeeBlockConfiguration_DIDC002: FeeBlockNumber=3072, FeeBlockSize=40
      FeeBlockConfiguration_DIDC003: FeeBlockNumber=3328, FeeBlockSize=40
      FeeBlockConfiguration_DIDC004: FeeBlockNumber=3584, FeeBlockSize=72
      FeeBlockConfiguration_DIDC005: FeeBlockNumber=3840, FeeBlockSize=40
      FeeBlockConfiguration_DIDC006: FeeBlockNumber=4096, FeeBlockSize=40
      FeeBlockConfiguration_DIDC007: FeeBlockNumber=4352, FeeBlockSize=40
      FeeBlockConfiguration_DIDC008: FeeBlockNumber=4608, FeeBlockSize=40
      FeeBlockConfiguration_DIDC009: FeeBlockNumber=4864, FeeBlockSize=8
      FeeBlockConfiguration_DIDC00A: FeeBlockNumber=5120, FeeBlockSize=40
      FeeBlockConfiguration_DIDC00B: FeeBlockNumber=5376, FeeBlockSize=8
      FeeBlockConfiguration_DIDC00C: FeeBlockNumber=5632, FeeBlockSize=8
      FeeBlockConfiguration_DIDC00D: FeeBlockNumber=5888, FeeBlockSize=8
      FeeBlockConfiguration_DIDC011: FeeBlockNumber=6144, FeeBlockSize=72
      FeeBlockConfiguration_DIDC012: FeeBlockNumber=6400, FeeBlockSize=40
      FeeBlockConfiguration_DIDC013: FeeBlockNumber=6656, FeeBlockSize=40
      FeeBlockConfiguration_DIDC014: FeeBlockNumber=6912, FeeBlockSize=72
      FeeBlockConfiguration_DIDC015: FeeBlockNumber=7168, FeeBlockSize=40
      FeeBlockConfiguration_DIDC016: FeeBlockNumber=7424, FeeBlockSize=40
      FeeBlockConfiguration_DIDC102: FeeBlockNumber=7680, FeeBlockSize=8
      FeeBlockConfiguration_DIDC106: FeeBlockNumber=7936, FeeBlockSize=16
      FeeBlockConfiguration_DIDC109: FeeBlockNumber=8192, FeeBlockSize=16
      FeeBlockConfiguration_DIDCA02: FeeBlockNumber=8448, FeeBlockSize=40
      FeeBlockConfiguration_DIDCA21: FeeBlockNumber=8704, FeeBlockSize=8
      FeeBlockConfiguration_DIDC305: FeeBlockNumber=8960, FeeBlockSize=8
      FeeBlockConfiguration_DIDC306: FeeBlockNumber=9216, FeeBlockSize=8
      FeeBlockConfiguration_DIDC307: FeeBlockNumber=9472, FeeBlockSize=8
      FeeBlockConfiguration_DIDC308: FeeBlockNumber=9728, FeeBlockSize=16
      FeeBlockConfiguration_DIDC309: FeeBlockNumber=9984, FeeBlockSize=16
      FeeBlockConfiguration_DIDC30A: FeeBlockNumber=10240, FeeBlockSize=8
      FeeBlockConfiguration_DIDC30C: FeeBlockNumber=10496, FeeBlockSize=16
      FeeBlockConfiguration_DIDCE01: FeeBlockNumber=10752, FeeBlockSize=8
      FeeBlockConfiguration_DIDCE05: FeeBlockNumber=11008, FeeBlockSize=8
      FeeBlockConfiguration_DIDCE06: FeeBlockNumber=11264, FeeBlockSize=8
      FeeBlockConfiguration_DIDCF00: FeeBlockNumber=11520, FeeBlockSize=32
      FeeBlockConfiguration_DIDC30D: FeeBlockNumber=11776, FeeBlockSize=8
      FeeBlockConfiguration_Reserved_block0: FeeBlockNumber=12032, FeeBlockSize=256
      FeeBlockConfiguration_Reserved_block1: FeeBlockNumber=12288, FeeBlockSize=256
      FeeBlockConfiguration_Reserved_block2: FeeBlockNumber=12544, FeeBlockSize=256
      FeeBlockConfiguration_27Key_error_count: FeeBlockNumber=12800, FeeBlockSize=8
      FeeBlockConfiguration_SecOc_count: FeeBlockNumber=13056, FeeBlockSize=8
      FeeBlockConfiguration_SecOc_Key: FeeBlockNumber=13312, FeeBlockSize=32
