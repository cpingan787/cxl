AUTOSAR XML (schema 00049)
package /Renesas/EcucDefs_Adc
  module config Adc: implementation-config-variant=VARIANT-POST-BUILD, module-description=Adc_Impl
    AdcPublished0 (AdcPublishedInformation): AdcChannelValueSigned=false, AdcGroupFirstChannelFixed=false, AdcMaxChannelResolution=12, AdcDmaTypeUsed=ADC_DMA_TYPE_TWO
    AdcDemEventParameterRefs0 (AdcDemEventParameterRefs): ADC_E_QUEUE_FULL=DemEventParameter0, ADC_E_LOOP_TIMEOUT=DemEventParameter1, ADC_E_REG_WRITE_VERIFY=DemEventParameter2
    AdcGeneral:
      AdcVersionCheckExternalModules = true
      AdcDeInitApi = true
      AdcDevErrorDetect = false
      AdcDemErrorDetect = true
      AdcEnableLimitCheck = false
      AdcEnableTrackHold = false
      AdcEnableQueuing = true
      AdcEnableStartStopGroupApi = true
      AdcGrpNotifCapability = true
      AdcHwTriggerApi = true
      AdcPriorityImplementation = ADC_PRIORITY_NONE
      AdcReadGroupApi = true
      AdcGetStreamLastPointerApi = true
      AdcDmaMode = false
      AdcCriticalSectionProtection = true
      AdcResultAlignment = ADC_ALIGN_RIGHT
      AdcDeviceName = R7F701583
      AdcVersionInfoApi = true
      AdcSoftStop = true
      AdcPwmDiagnosticSupport = false
      AdcPwmDiagDoubleBuff = false
      AdcExternalMuxSupport = false
      AdcEnableDisableChSupport = true
      AdcAlreadyInitDetCheck = true
      AdcEnableBufferAllocation = false
      AdcHwUnitVirtualChannel = ADC_50_36
      AdcEnableStreaming = false
      AdcFunctionalityMode = ADC_INTERRUPT_MODE
      AdcFlexibleThreshold = false
      AdcPwsaQueFullIrqCallback = Adc_FullIrqCallback
      AdcEnableSelfDiag = false
      AdcWakeUpFactorClearIsr = false
      AdcAdcaWriteVerify = WV_INIT_RUNTIME
      AdcPwmDiagWriteVerify = WV_DISABLE
      AdcDmacWriteVerify = WV_DISABLE
      AdcWufWriteVerify = WV_DISABLE
      AdcAdcaRAMMirror = ENABLE
      AdcPwmDiagRAMMirror = DISABLE
      AdcDmacRAMMirror = DISABLE
      AdcUseWriteVerifyErrorInterface = false
      AdcWriteVerifyErrorInterface = Adc_WVErrInterface
      AdcLoopTimeOut = 65535
      AdcEnableClkImmediateValue = false
      AdcSelfDiagDelayClkSrc = (unset)
    AdcConfigSet0 (AdcConfigSet)
      AdcHwUnit0 (AdcHwUnit):
        AdcClockSource = NOT_USED
        AdcHwUnitId = ADC_HWUNIT_0
        AdcPrescale = 0
        AdcHwUnitResolution = ADC_12_BIT
        AdcSamplingTime = ADC_SAMPLING_12H
        AdcSuspendMode = ADC_SYNCHRONOUS_SUSPEND
        AdcMaxNoOfDiagRunTime = 1
        AdcPwmDiagProtLength = 0
        AdcEnableOverWriteInterrupt = false
        AdcEnableLimitCheckInterrupt = false
        AdcErrorNotification = NULL
        AdcHwScanGroup0 (AdcHwScanGroup): AdcSgQueueSize=1, AdcSgProcessingMode=ADC_INTERRUPT_MODE, AdcSgId=2, AdcSgDmaChannel=DMA00, AdcSgDmaChannel2=DMA00
        5 x AdcChannel, all with AdcChannelConvTime=0, AdcChannelHighLimit=4095, AdcChannelLimitCheck=false, AdcChannelTrackHold=ADC_TH_DISABLED, AdcChannelLowLimit=0, AdcChannelRangeSelect=ADC_RANGE_ALWAYS, AdcChannelRefVoltsrcHigh=NOT_USED, AdcChannelRefVoltsrcLow=NOT_USED, AdcChannelResolution=1, AdcChannelSampTime=0, AdcExtMuxDelayCounter=0, AdcSelectDiagCh=false, AdcSelfDiagChSel=false, AdcEnablePullDown=false:
          AdcChannel{0..4}: AdcChannelId={0..4}
        AdcGroup0 (AdcGroup):
          AdcGroupAccessMode = ADC_ACCESS_MODE_SINGLE
          AdcGroupConversionMode = ADC_CONV_MODE_CONTINUOUS
          AdcGroupId = 0
          AdcScanGroup = 2
          AdcGroupPriority = 4
          AdcGroupReplacement = ADC_GROUP_REPL_ABORT_RESTART
          AdcGroupTriggSrc = ADC_TRIGG_SRC_SW
          AdcHwTrigSignal = ADC_HW_TRIG_BOTH_EDGES
          AdcHwTrigTimer = 0
          AdcNotification = IoHwAb_Adc_Notification_Group0
          AdcStreamingBufferMode = ADC_STREAM_BUFFER_LINEAR
          AdcStreamingNumSamples = 1
          AdcResultAccessMode = ADC_ISR_ACCESS
          AdcPwmDiagnosticGroup = false
          AdcSelfDiagMode = ADC_SELF_DIAG_OFF
          AdcSelfDiagVolLevSel = SEL0
          AdcGroupDefinition = AdcChannel{0..15}
        AdcGroup2 (AdcGroup):
          AdcGroupAccessMode = ADC_ACCESS_MODE_SINGLE
          AdcGroupConversionMode = ADC_CONV_MODE_CONTINUOUS
          AdcGroupId = 2
          AdcScanGroup = 2
          AdcGroupPriority = 11
          AdcGroupReplacement = ADC_GROUP_REPL_ABORT_RESTART
          AdcGroupTriggSrc = ADC_TRIGG_SRC_SW
          AdcHwTrigSignal = ADC_HW_TRIG_BOTH_EDGES
          AdcHwTrigTimer = 0
          AdcNotification = IoHwAb_Adc_Notification_Group2
          AdcStreamingBufferMode = ADC_STREAM_BUFFER_LINEAR
          AdcStreamingNumSamples = 1
          AdcResultAccessMode = ADC_ISR_ACCESS
          AdcPwmDiagnosticGroup = false
          AdcSelfDiagMode = ADC_SELF_DIAG_OFF
          AdcSelfDiagVolLevSel = SEL0
          AdcGroupDefinition = AdcChannel{0..3}
          AdcGroupHwTriggerSource = AdcHwTriggerConfig0
          AdcGroupDefinition = AdcChannel4
        AdcHwTriggerConfig0 (AdcHwTriggerConfig): AdcHwTrigger=ADCATTIN100
        AdcHwTriggerConfig1 (AdcHwTriggerConfig): AdcHwTrigger=DIAG_CH00
        11 x AdcChannel, all with AdcChannelConvTime=0, AdcChannelHighLimit=4095, AdcChannelLimitCheck=false, AdcChannelTrackHold=ADC_TH_DISABLED, AdcChannelLowLimit=0, AdcChannelRangeSelect=ADC_RANGE_ALWAYS, AdcChannelRefVoltsrcHigh=NOT_USED, AdcChannelRefVoltsrcLow=NOT_USED, AdcChannelResolution=1, AdcChannelSampTime=0, AdcExtMuxDelayCounter=0, AdcSelectDiagCh=false, AdcSelfDiagChSel=false, AdcEnablePullDown=false:
          AdcChannel{5..15}: AdcChannelId={5..15}
      AdcHwUnit1 (AdcHwUnit):
        AdcClockSource = NOT_USED
        AdcHwUnitId = ADC_HWUNIT_1
        AdcPrescale = 0
        AdcHwUnitResolution = ADC_12_BIT
        AdcSamplingTime = ADC_SAMPLING_12H
        AdcSuspendMode = ADC_SYNCHRONOUS_SUSPEND
        AdcMaxNoOfDiagRunTime = 0
        AdcPwmDiagProtLength = 0
        AdcEnableOverWriteInterrupt = false
        AdcEnableLimitCheckInterrupt = false
        AdcErrorNotification = NULL
        AdcHwScanGroup0 (AdcHwScanGroup): AdcSgQueueSize=0, AdcSgProcessingMode=ADC_INTERRUPT_MODE, AdcSgId=2, AdcSgDmaChannel=DMA00, AdcSgDmaChannel2=DMA00
        AdcChannel0 (AdcChannel):
          AdcChannelConvTime = 0
          AdcChannelHighLimit = 4095
          AdcChannelId = 0
          AdcChannelLimitCheck = false
          AdcChannelTrackHold = ADC_TH_DISABLED
          AdcChannelLowLimit = 0
          AdcChannelRangeSelect = ADC_RANGE_ALWAYS
          AdcChannelRefVoltsrcHigh = NOT_USED
          AdcChannelRefVoltsrcLow = NOT_USED
          AdcChannelResolution = 1
          AdcChannelSampTime = 0
          AdcExtMuxDelayCounter = 0
          AdcSelectDiagCh = false
          AdcSelfDiagChSel = false
          AdcEnablePullDown = false
        AdcGroup1 (AdcGroup):
          AdcGroupAccessMode = ADC_ACCESS_MODE_SINGLE
          AdcGroupConversionMode = ADC_CONV_MODE_CONTINUOUS
          AdcGroupId = 1
          AdcScanGroup = 2
          AdcGroupPriority = 10
          AdcGroupReplacement = ADC_GROUP_REPL_ABORT_RESTART
          AdcGroupTriggSrc = ADC_TRIGG_SRC_SW
          AdcHwTrigSignal = ADC_HW_TRIG_BOTH_EDGES
          AdcHwTrigTimer = 0
          AdcNotification = IoHwAb_Adc_Notification_Group1
          AdcStreamingBufferMode = ADC_STREAM_BUFFER_LINEAR
          AdcStreamingNumSamples = 1
          AdcResultAccessMode = ADC_ISR_ACCESS
          AdcPwmDiagnosticGroup = false
          AdcSelfDiagMode = ADC_SELF_DIAG_OFF
          AdcSelfDiagVolLevSel = SEL0
          AdcGroupDefinition = AdcChannel{0..7}
        7 x AdcChannel, all with AdcChannelConvTime=0, AdcChannelHighLimit=4095, AdcChannelLimitCheck=false, AdcChannelTrackHold=ADC_TH_DISABLED, AdcChannelLowLimit=0, AdcChannelRangeSelect=ADC_RANGE_ALWAYS, AdcChannelRefVoltsrcHigh=NOT_USED, AdcChannelRefVoltsrcLow=NOT_USED, AdcChannelResolution=1, AdcChannelSampTime=0, AdcExtMuxDelayCounter=0, AdcSelectDiagCh=false, AdcSelfDiagChSel=false, AdcEnablePullDown=false:
          AdcChannel{1..7}: AdcChannelId={1..7}
package /Renesas/EcucDefs_Dio
  module config Dio: implementation-config-variant=VARIANT-LINK-TIME, module-description=Dio_Impl
    DioConfig0 (DioConfig)
      7 x DioPort:
        PortGroup9_Bits0_6: DioPortId=0, DioPortName=PORTGROUP_9_BITS_0_TO_6
          UserConfigCh1 (DioChannel): DioChannelId=0, DioChannelBitPosition=0
          UserConfigCh2 (DioChannel): DioChannelId=1, DioChannelBitPosition=4
          UserConfigChGrp1 (DioChannelGroup): DioChannelGroupIdentification=NULL, DioPortMask=15, DioPortOffset=0
          UserConfigChGrp2 (DioChannelGroup): DioChannelGroupIdentification=NULL, DioPortMask=6, DioPortOffset=1
        PortGroup11_Bits0_15: DioPortId=1, DioPortName=PORTGROUP_11_BITS_0_TO_15
          UserConfigCh3 (DioChannel): DioChannelId=0, DioChannelBitPosition=0
          UserConfigCh4 (DioChannel): DioChannelId=1, DioChannelBitPosition=4
          UserConfigChGrp3 (DioChannelGroup): DioChannelGroupIdentification=NULL, DioPortMask=15, DioPortOffset=0
          UserConfigChGrp4 (DioChannelGroup): DioChannelGroupIdentification=NULL, DioPortMask=6, DioPortOffset=1
          DIO_Channel_LEVEL_SHIFT_EN_Pin11_15 (DioChannel): DioChannelId=2, DioChannelBitPosition=15
        PortGroup8_Bits0_12: DioPortId=2, DioPortName=PORTGROUP_8_BITS_0_TO_12
          DIO_Channel_CAN_STB_Pin8_6 (DioChannel): DioChannelId=0, DioChannelBitPosition=6
          DIO_Channel_ACC_INT_Pin8_5 (DioChannel): DioChannelId=1, DioChannelBitPosition=5
        PortGroup0_Bits0_14: DioPortId=3, DioPortName=PORTGROUP_0_BITS_0_TO_14
          DIO_Channel_KL30_Voltage_DET_EN_Pin0_12 (DioChannel): DioChannelId=0, DioChannelBitPosition=12
          DIO_Channel_KL30_Voltage_DET_INT_Pin0_9 (DioChannel): DioChannelId=1, DioChannelBitPosition=9
        PortGroup_1_Bits0_11: DioPortId=4, DioPortName=PORTGROUP_1_BITS_0_TO_11
          3 x DioChannel:
            DIO_Channel_KL30_DOWEN_DET_EN_Pin1_6: DioChannelId=0, DioChannelBitPosition=6
            DIO_Channel_IG1_INT_Pin1_8: DioChannelId=1, DioChannelBitPosition=8
            DIO_Channel_NAD_V2X_5V0__EN_Pin1_7: DioChannelId=2, DioChannelBitPosition=7
        PortGroup18_Bits0_3: DioPortId=5, DioPortName=PORTGROUP_18_BITS_0_TO_3
          3 x DioChannel:
            DIO_Channel_NAD_V2X_3V8_EN_Pin18_3: DioChannelId=2, DioChannelBitPosition=3
            DIO_Channel_AG591_POWERKEY_EN_Pin18_1: DioChannelId=1, DioChannelBitPosition=1
            DIO_Channel_AG591_RST_EN_Pin18_0: DioChannelId=0, DioChannelBitPosition=0
        PortGroup10_Bits0_15: DioPortId=6, DioPortName=PORTGROUP_10_BITS_0_TO_15
          DIO_Channel_NAD_TO_MCU_Pin10_13 (DioChannel): DioChannelId=0, DioChannelBitPosition=13
          DIO_Channel_MCU_TO_NAD_EN_Pin10_14 (DioChannel): DioChannelId=1, DioChannelBitPosition=14
    DioGeneral0 (DioGeneral):
      DioDevErrorDetect = false
      DioFlipChannelApi = true
      DioVersionInfoApi = true
      DioVersionCheckExternalModules = true
      DioCriticalSectionProtection = true
      DioDeviceName = R7F701583
      DioWriteVerify = WV_DISABLE
      DioUseWriteVerifyErrorInterface = false
      DioWriteVerifyErrorInterface = DioErrorReportInterface
      DioMaskedWritePortApi = true
      DioReadChannelGroupOutputValueApi = true
      DioReadChannelOutputValueApi = true
      DioRAMMirror = ENABLE
    DioDemEventParameterRefs0 (DioDemEventParameterRefs): DIO_E_REG_WRITE_VERIFY=DemEventParameter0
package /Renesas/EcucDefs_Mcu
  module config Mcu: implementation-config-variant=VARIANT-POST-BUILD, module-description=Mcu_Impl
    McuGeneralConfiguration0 (McuGeneralConfiguration):
      McuClm0MonitoringClockAccuracy = 9
      McuClm0Operation = true
      McuClm0SamplingClockAccuracy = 9
      McuClm1MonitoringClockAccuracy = 5
      McuClm1Operation = true
      McuClm1SamplingClockAccuracy = 8
      McuClm2MonitoringClockAccuracy = 14
      McuClm2Operation = true
      McuClm2SamplingClockAccuracy = 14
      McuCopyToSection = false
      McuCriticalSectionProtection = true
      McuCvmHighVoltageDetect = false
      McuCvmLowVoltageDetect = false
      McuDevErrorDetect = true
      McuDeviceName = R7F701583
      McuGetRamStateApi = false
      McuInitClock = true
      McuLoopCount = 5
      McuLowPowerSequencerOperation = false
      McuNoPll = false
      McuPerformResetApi = true
      McuPortGroupStatusBackUp = false
      McuRAMMirror = ENABLE
      McuResetReasonMultipleResets = false
      McuRetentionRamSourceAddress = 65536
      McuSwResetCallApi = false
      McuUseWriteVerifyErrorInterface = true
      McuVersionCheckExternalModules = true
      McuVersionInfoApi = true
      McuWakeUpFactorClearIsr = false
      McuWakeUpFactorsClearCentralised = true
      McuWriteVerify = WV_DISABLE
      McuWriteVerifyErrorInterface = Mcu_WVError
    McuModuleConfiguration0 (McuModuleConfiguration):
      McuClockSrcFailureNotification = DISABLED
      McuCyclicRunModeBaseAddress = 4273930240
      McuLviDetectionLevel = DETECTION_LEVEL_0
      McuLviResetMask = RESET_REQUEST
      McuNumberOfMcuModes = 1
      McuRamSectors = 1
      McuResetSetting = 1
      McuRetentionRamAddress = 4273930240
      McuClockSettingConfig0 (McuClockSettingConfig):
        Mcu8MhzRingStopRequestMask = false
        McuClkModeSelect = MCU_CPLLCLK_ID_3
        McuClockSettingId = 0
        McuCpuClockDivider = DIVBY_1_ID_1
        McuCpuMainSysClk = 80000000
        McuUnitName = CPUCLK
        McuAwoAdca00 (McuAwoAdca0): McuDivClockSel=DIVBY_1_ID_1, McuPeripheralClock=8000000, McuSrcClockSel=FRH_ID_1, McuStopRequestMask=true, McuUnitName=ADCA
        McuAwoFout0 (McuAwoFout): McuFoutDivider=1, McuPeripheralClock=16000000, McuSrcClockSel=FX_ID_1, McuStopRequestMask=true, McuUnitName=FOUT
        McuAwoTauj0 (McuAwoTauj): McuDivClockSel=DIVBY_1_ID_1, McuPeripheralClock=16000000, McuSrcClockSel=FX_ID_2, McuStopRequestMask=true, McuUnitName=TAUJ
        McuAwoWdta0 (McuAwoWdta): McuDivClockSel=DIVBY_128_ID_1, McuPeripheralClock=1875, McuStopRequestMask=true, McuUnitName=WDTA
        McuClockReferencePoint0 (McuClockReferencePoint): McuClockReferencePointFrequency=16000000
        McuIsoAdca10 (McuIsoAdca1): McuDivClockSel=DIVBY_1_ID_1, McuPeripheralClock=40000000, McuSrcClockSel=PPLLCLK_DIVBY_2_ID_3, McuUnitName=ADCA
        McuIsoCan0 (McuIsoCan): McuPeripheralClock=80000000, McuSrcClockSel=PPLLCLK_DIVBY_1_ID_2, McuStopRequestMask=true, McuUnitName=CAN
        McuIsoCanosc0 (McuIsoCanosc): McuDivClockSel=DIVBY_1_ID_1, McuPeripheralClock=16000000, McuStopRequestMask=true, McuUnitName=CANOSC
        McuIsoCsi0 (McuIsoCsi): McuPeripheralClock=16000000, McuSrcClockSel=FX_ID_3, McuUnitName=CSI
        McuIsoLin0 (McuIsoLin): McuPeripheralClock=16000000, McuSrcClockSel=FX_ID_2, McuStopRequestMask=true, McuUnitName=LIN
        McuIsoLin30 (McuIsoLin3): McuDivClockSel=DIVBY_1_ID_1, McuPeripheralClock=16000000, McuUnitName=LIN3
        McuIsoLrosc0 (McuIsoLrosc): McuPeripheralClock=240000
        McuIsoPeri10 (McuIsoPeri1): McuPeripheralClock=80000000, McuSrcClockSel=PPLLCLK_DIVBY_1_ID_1, McuUnitName=PERI1
        McuIsoPeri20 (McuIsoPeri2): McuPeripheralClock=40000000, McuSrcClockSel=PPLLCLK_DIVBY_2_ID_1, McuUnitName=PERI2
        McuMainOscSetting0 (McuMainOscSetting): McuMainOscAmplificationGain=LOW_ID_2, McuMainOsciFrequency=16000000, McuMainOscStabTimeSetting=131071, McuMainOscStopRequestMask=true
        McuPllSetting0 (McuPllSetting):
          McuCpllClk = 80000000
          McuCpllDivider = P_VALUE_6
          McuPllInputClockSelection = MCU_SELECT_MOSC
          McuPllMrValue = 2
          McuPllNrValue = 60
          McuPpllClk = 80000000
          McuPpllDivider = DIV_BY_6
          McuPpllOut = 80000000
          McuPpllSrcClock = MCU_PPLLOUT_ID_3
      McuDemEventParameterRefs0 (McuDemEventParameterRefs):
        MCU_E_CLOCK_FAILURE = DemEventParameter1
        MCU_E_CVM_SETTING_FAILURE = DemEventParameter1
        MCU_E_INCONCISTENCY_RESF_FAILURE = DemEventParameter1
        MCU_E_LVI_FAILURE = DemEventParameter1
        MCU_E_REG_WRITE_VERIFY = DemEventParameter1
        MCU_E_WRITE_TIMEOUT_FAILURE = DemEventParameter1
      McuLowPowerSequencer0 (McuLowPowerSequencer):
        McuChannelClk = CK0
        McuINTCWENDEnable = true
        McuPrescalerCk{0..2} = PCLK_DIVBY_2_POWOF_15
        McuPrescalerCk3BaudRate = 255
        McuPrescalerCk3Pre = PCLK_DIVBY_2_POWOF_15
        McuPreScaleReq = true
        McuSequencerDpins = 80
        McuTauj0TimerCount = 0
        McuTaujInterruptSelector = INTTAUJ0I0
        McuDigitalInputMode0 (McuDigitalInputMode): McuDigitalExtSensorStableTime=0, McuExternalMultiplexerSupport=MCU_WITHOUT_EXTERN_MULTIPLEXER
        McuDigitalinputSelectionZero0 (McuDigitalinputSelectionZero): McuDigitalInputData=false, McuDigitalInputPins=DPIN0
      McuModeSettingConf0 (McuModeSettingConf):
        McuMainOscOperation = true
        McuMode = 0
        McuModeTransitionReq = true
        McuModeType = HALT_MODE
        McuWakeUpFactor0 = true
        McuWakeUpFactor2 = false
        McuWakeUpFactorIso0 = false
        McuWakeUpFactor0Details0 (McuWakeUpFactor0Details): McuWakeUpFactor0Name=INTTAUJ0I0_WUF0_15
      McuPortGroupConf0 (McuPortGroupConf): McuPortGroupName=PORTGROUP_9
    McuPublishedInformation0 (McuPublishedInformation)
      McuResetReasonConf0 (McuResetReasonConf): McuResetReason=0
      McuRstRsnConfClm00 (McuRstRsnConfClm0): McuResetReason=4
      McuRstRsnConfClm10 (McuRstRsnConfClm1): McuResetReason=5
      McuRstRsnConfClm20 (McuRstRsnConfClm2): McuResetReason=6
      McuRstRsnConfClm30 (McuRstRsnConfClm3): McuResetReason=15
      McuRstRsnConfCvm0 (McuRstRsnConfCvm): McuResetReason=8
      McuRstRsnConfIso0 (McuRstRsnConfIso): McuResetReason=11
      McuRstRsnConfLvi0 (McuRstRsnConfLvi): McuResetReason=7
      McuRstRsnConfMultipleResets0 (McuRstRsnConfMultipleResets): McuResetReason=17
      McuRstRsnConfPOR0 (McuRstRsnConfPOR): McuResetReason=10
      McuRstRsnConfResf110 (McuRstRsnConfResf11): McuResetReason=12
      McuRstRsnConfResf120 (McuRstRsnConfResf12): McuResetReason=13
      McuRstRsnConfResf130 (McuRstRsnConfResf13): McuResetReason=14
      McuRstRsnConfSwRst0 (McuRstRsnConfSwRst): McuResetReason=1
      McuRstRsnConfTer0 (McuRstRsnConfTer): McuResetReason=9
      McuRstRsnConfUndef0 (McuRstRsnConfUndef): McuResetReason=16
      McuRstRsnConfUnknown0 (McuRstRsnConfUnknown): McuResetReason=18
      McuRstRsnConfWdta00 (McuRstRsnConfWdta0): McuResetReason=2
      McuRstRsnConfWdta10 (McuRstRsnConfWdta1): McuResetReason=3
    McuRamInitConfiguration0 (McuRamInitConfiguration): McuRamInitBaseAddress=4273831936, McuRamInitSize=256, McuRamInitValue=255, McuRamTypeSelection=CPU_LOCAL_RAM, McuRamWriteSizeSel=BIT_8
package /Renesas/EcucDefs_Port
  module config Port: implementation-config-variant=VARIANT-POST-BUILD, module-description=Port_Impl
    PortConfigSet0 (PortConfigSet)
      PortContainer0 (PortContainer): PortNumberOfPortPins=1
        PortPin0 (PortPin):
          PortPinDirection = PORT_PIN_IN
          PortPinDirectionChangeable = false
          PortPinId = 1
          PortPinInitialMode = PORT_PIN_MODE_ADC
          PortPinLevelValue = PORT_PIN_LEVEL_HIGH
          PortPinMode = PORT_PIN_MODE_ADC
          PortPinModeChangeable = false
      PortFilterGroupConfig0 (PortFilterGroupConfig)
      PortGroup00 (PortGroup0)
        PortPin00 (PortPin0):
          PortPinDirectionChangeable = false
          PortPinDioAltModeChangeable = false
          PortPinModeChangeable = false
          PortPinLevelValue = PORT_PIN_LEVEL_LOW
          PortPinInitialMode = CAN0TX_AT2OUT_PFC_PFCE_PMCSR
          PortPinDirection = PORT_PIN_OUT
          PortInputBufferControl = false
          PortBiDirectionControl = false
          PortPullUpOption = false
          PortPullDownOption = false
          PortOpenDrainControl = false
          PortDriveStrengthControl = false
          PortInputSelection = TYPE_1_SUPP_PIS
        PortPin10 (PortPin1):
          PortPinDirectionChangeable = false
          PortPinDioAltModeChangeable = false
          PortPinModeChangeable = false
          PortPinLevelValue = PORT_PIN_LEVEL_LOW
          PortPinInitialMode = CAN0RX_AT2IN
          PortPinDirection = PORT_PIN_IN
          PortInputBufferControl = false
          PortBiDirectionControl = false
          PortPullUpOption = false
          PortPullDownOption = false
          PortOpenDrainControl = false
          PortDriveStrengthControl = false
          PortInputSelection = TYPE_1_SUPP_PIS
        PortPin20 (PortPin2):
          PortPinDirectionChangeable = false
          PortPinDioAltModeChangeable = false
          PortPinModeChangeable = false
          PortPinLevelValue = PORT_PIN_LEVEL_LOW
          PortPinInitialMode = CAN1RX_AT7IN
          PortPinDirection = PORT_PIN_IN
          PortInputBufferControl = false
          PortBiDirectionControl = false
          PortIpControl = false
          PortPullUpOption = false
          PortPullDownOption = false
          PortOpenDrainControl = false
          PortDriveStrengthControl = false
          PortInputSelection = TYPE_1_SUPP_PIS
        PortPin30 (PortPin3):
          PortPinDirectionChangeable = false
          PortPinDioAltModeChangeable = false
          PortPinModeChangeable = false
          PortPinLevelValue = PORT_PIN_LEVEL_LOW
          PortPinInitialMode = CAN1TX_AT2OUT
          PortPinDirection = PORT_PIN_OUT
          PortInputBufferControl = false
          PortBiDirectionControl = false
          PortIpControl = false
          PortPullUpOption = false
          PortPullDownOption = false
          PortOpenDrainControl = false
          PortDriveStrengthControl = false
          PortInputSelection = TYPE_1_SUPP_PIS
        PortPin40 (PortPin4):
          PortPinDirectionChangeable = false
          PortPinDioAltModeChangeable = false
          PortPinModeChangeable = false
          PortPinLevelValue = PORT_PIN_LEVEL_LOW
          PortPinInitialMode = DIO
          PortPinDirection = PORT_PIN_IN
          PortInputBufferControl = true
          PortBiDirectionControl = false
          PortPullUpOption = false
          PortPullDownOption = false
          PortOpenDrainControl = false
          PortDriveStrengthControl = false
          PortInputSelection = TYPE_1_SUPP_PIS
        PortPin50 (PortPin5):
          PortPinDirectionChangeable = true
          PortPinDioAltModeChangeable = false
          PortPinModeChangeable = false
          PortPinLevelValue = PORT_PIN_LEVEL_HIGH
          PortPinInitialMode = DIO
          PortPinDirection = PORT_PIN_OUT
          PortInputBufferControl = false
          PortBiDirectionControl = false
          PortIpControl = false
          PortPullUpOption = false
          PortPullDownOption = false
          PortOpenDrainControl = false
          PortDriveStrengthControl = false
          PortInputSelection = TYPE_1_SUPP_PIS
        PortPin60 (PortPin6):
          PortPinDirectionChangeable = false
          PortPinDioAltModeChangeable = false
          PortPinModeChangeable = false
          PortPinLevelValue = PORT_PIN_LEVEL_LOW
          PortPinInitialMode = DIO
          PortPinDirection = PORT_PIN_IN
          PortInputBufferControl = true
          PortBiDirectionControl = false
          PortIpControl = false
          PortPullUpOption = false
          PortPullDownOption = false
          PortOpenDrainControl = false
          PortDriveStrengthControl = false
          PortInputSelection = TYPE_1_SUPP_PIS
        PortPin70 (PortPin7):
          PortPinDirectionChangeable = false
          PortPinDioAltModeChangeable = false
          PortPinModeChangeable = false
          PortPinLevelValue = PORT_PIN_LEVEL_LOW
          PortPinInitialMode = CAN3RX_AT7IN
          PortPinDirection = PORT_PIN_IN
          PortInputBufferControl = false
          PortBiDirectionControl = false
          PortPullUpOption = false
          PortPullDownOption = false
          PortOpenDrainControl = false
          PortDriveStrengthControl = false
          PortInputSelection = TYPE_1_SUPP_PIS
        PortPin80 (PortPin8):
          PortPinDirectionChangeable = false
          PortPinDioAltModeChangeable = false
          PortPinModeChangeable = false
          PortPinLevelValue = PORT_PIN_LEVEL_LOW
          PortPinInitialMode = CAN3TX_AT5OUT
          PortPinDirection = PORT_PIN_OUT
          PortInputBufferControl = false
          PortBiDirectionControl = false
          PortPullUpOption = false
          PortPullDownOption = false
          PortOpenDrainControl = false
          PortDriveStrengthControl = false
          PortInputSelection = TYPE_2_SUPP_PIS
        PortPin90 (PortPin9):
          PortPinDirectionChangeable = false
          PortPinDioAltModeChangeable = false
          PortPinModeChangeable = false
          PortPinLevelValue = PORT_PIN_LEVEL_LOW
          PortPinInitialMode = DIO
          PortPinDirection = PORT_PIN_IN
          PortInputBufferControl = true
          PortBiDirectionControl = false
          PortPullUpOption = false
          PortPullDownOption = false
          PortOpenDrainControl = false
          PortDriveStrengthControl = false
          PortInputSelection = TYPE_1_SUPP_PIS
        PortPin100 (PortPin10):
          PortPinDirectionChangeable = false
          PortPinDioAltModeChangeable = false
          PortPinModeChangeable = false
          PortPinLevelValue = PORT_PIN_LEVEL_LOW
          PortPinInitialMode = DIO
          PortPinDirection = PORT_PIN_OUT
          PortInputBufferControl = false
          PortBiDirectionControl = false
          PortPullUpOption = false
          PortPullDownOption = false
          PortOpenDrainControl = false
          PortDriveStrengthControl = false
          PortInputSelection = TYPE_2_SUPP_PIS
        PortPin110 (PortPin11):
          PortPinDirectionChangeable = false
          PortPinDioAltModeChangeable = false
          PortPinModeChangeable = false
          PortPinLevelValue = PORT_PIN_LEVEL_LOW
          PortPinInitialMode = DIO_PFC_PFCE_PMCSR
          PortPinDirection = PORT_PIN_OUT
          PortInputBufferControl = false
          PortBiDirectionControl = false
          PortPullUpOption = false
          PortPullDownOption = false
          PortOpenDrainControl = false
          PortDriveStrengthControl = false
          PortInputSelection = TYPE_1_SUPP_PIS
        PortPin120 (PortPin12):
          PortPinDirectionChangeable = false
          PortPinDioAltModeChangeable = false
          PortPinModeChangeable = false
          PortPinLevelValue = PORT_PIN_LEVEL_LOW
          PortPinInitialMode = DIO_PFC_PFCE_PMCSR
          PortPinDirection = PORT_PIN_OUT
          PortInputBufferControl = false
          PortBiDirectionControl = false
          PortPullUpOption = false
          PortPullDownOption = false
          PortOpenDrainControl = false
          PortDriveStrengthControl = false
          PortInputSelection = TYPE_1_SUPP_PIS
        PortPin130 (PortPin13):
          PortPinDirectionChangeable = false
          PortPinDioAltModeChangeable = false
          PortPinModeChangeable = false
          PortPinLevelValue = PORT_PIN_LEVEL_LOW
          PortPinInitialMode = DIO
          PortPinDirection = PORT_PIN_OUT
          PortInputBufferControl = false
          PortBiDirectionControl = false
          PortIpControl = false
          PortPullUpOption = false
          PortOpenDrainControl = false
          PortDriveStrengthControl = false
          PortInputSelection = TYPE_1_SUPP_PIS
          PortPullDownOption = false
        PortPin140 (PortPin14):
          PortPinDirectionChangeable = false
          PortPinDioAltModeChangeable = false
          PortPinModeChangeable = false
          PortPinLevelValue = PORT_PIN_LEVEL_LOW
          PortPinInitialMode = DIO
          PortPinDirection = PORT_PIN_OUT
          PortInputBufferControl = false
          PortBiDirectionControl = false
          PortIpControl = false
          PortPullUpOption = false
          PortOpenDrainControl = false
          PortDriveStrengthControl = false
          PortInputSelection = TYPE_2_SUPP_PIS
          PortPullDownOption = false
      PortGroup80 (PortGroup8)
        PortPin00 (PortPin0):
          PortPinDirectionChangeable = false
          PortPinDioAltModeChangeable = false
          PortPinModeChangeable = false
          PortPinLevelValue = PORT_PIN_LEVEL_LOW
          PortPinInitialMode = DIO_PFC_PFCE_PMCSR
          PortPinDirection = PORT_PIN_OUT
          PortInputBufferControl = false
          PortBiDirectionControl = false
          PortPullUpOption = true
          PortPullDownOption = false
          PortOpenDrainControl = false
          PortInputSelection = TYPE_2_SUPP_PIS
        PortPin10 (PortPin1):
          PortPinDirectionChangeable = false
          PortPinDioAltModeChangeable = false
          PortPinModeChangeable = false
          PortPinLevelValue = PORT_PIN_LEVEL_LOW
          PortPinInitialMode = DIO_PFC_PFCE_PMCSR
          PortPinDirection = PORT_PIN_IN
          PortInputBufferControl = true
          PortBiDirectionControl = false
          PortPullUpOption = false
          PortPullDownOption = true
          PortOpenDrainControl = false
          PortInputSelection = TYPE_2_SUPP_PIS
        PortPin20 (PortPin2):
          PortPinDirectionChangeable = false
          PortPinDioAltModeChangeable = false
          PortPinModeChangeable = false
          PortPinLevelValue = PORT_PIN_LEVEL_LOW
          PortPinInitialMode = DIO_PFC_PFCE_PMCSR
          PortPinDirection = PORT_PIN_IN
          PortInputBufferControl = true
          PortBiDirectionControl = false
          PortPullUpOption = false
          PortPullDownOption = false
          PortOpenDrainControl = false
          PortInputSelection = TYPE_2_SUPP_PIS
        PortPin30 (PortPin3):
          PortPinDirectionChangeable = false
          PortPinDioAltModeChangeable = false
          PortPinModeChangeable = false
          PortPinLevelValue = PORT_PIN_LEVEL_LOW
          PortPinInitialMode = DIO_PFC_PFCE_PMCSR
          PortPinDirection = PORT_PIN_IN
          PortInputBufferControl = true
          PortBiDirectionControl = false
          PortPullUpOption = false
          PortPullDownOption = false
          PortOpenDrainControl = false
          PortInputSelection = TYPE_2_SUPP_PIS
        PortPin40 (PortPin4):
          PortPinDirectionChangeable = false
          PortPinDioAltModeChangeable = false
          PortPinModeChangeable = false
          PortPinLevelValue = PORT_PIN_LEVEL_LOW
          PortPinInitialMode = DIO_PFC_PFCE_PMCSR
          PortPinDirection = PORT_PIN_IN
          PortInputBufferControl = true
          PortBiDirectionControl = false
          PortPullUpOption = false
          PortPullDownOption = false
          PortOpenDrainControl = false
          PortInputSelection = TYPE_2_SUPP_PIS
        PortPin50 (PortPin5):
          PortPinDirectionChangeable = false
          PortPinDioAltModeChangeable = false
          PortPinModeChangeable = false
          PortPinLevelValue = PORT_PIN_LEVEL_LOW
          PortPinInitialMode = DIO_PFC_PFCE_PMCSR
          PortPinDirection = PORT_PIN_IN
          PortInputBufferControl = true
          PortBiDirectionControl = false
          PortPullUpOption = true
          PortPullDownOption = false
          PortOpenDrainControl = false
          PortInputSelection = TYPE_2_SUPP_PIS
        PortPin60 (PortPin6):
          PortPinDirectionChangeable = false
          PortPinDioAltModeChangeable = false
          PortPinModeChangeable = false
          PortPinLevelValue = PORT_PIN_LEVEL_LOW
          PortPinInitialMode = DIO_PFC_PFCE_PMCSR
          PortPinDirection = PORT_PIN_OUT
          PortInputBufferControl = false
          PortBiDirectionControl = false
          PortPullUpOption = false
          PortPullDownOption = false
          PortOpenDrainControl = false
          PortInputSelection = TYPE_2_SUPP_PIS
        PortPin70 (PortPin7):
          PortPinDirectionChangeable = false
          PortPinDioAltModeChangeable = false
          PortPinModeChangeable = false
          PortPinLevelValue = PORT_PIN_LEVEL_LOW
          PortPinInitialMode = CSIH3CSS0_AT1OUT_PFC_PFCE_PMCSR
          PortPinDirection = PORT_PIN_OUT
          PortInputBufferControl = false
          PortBiDirectionControl = false
          PortPullUpOption = false
          PortPullDownOption = false
          PortOpenDrainControl = false
          PortInputSelection = TYPE_2_SUPP_PIS
        PortPin80 (PortPin8):
          PortPinDirectionChangeable = false
          PortPinDioAltModeChangeable = false
          PortPinModeChangeable = false
          PortPinLevelValue = PORT_PIN_LEVEL_LOW
          PortPinInitialMode = DIO_PFC_PFCE_PMCSR
          PortPinDirection = PORT_PIN_IN
          PortInputBufferControl = false
          PortBiDirectionControl = false
          PortPullUpOption = false
          PortPullDownOption = false
          PortOpenDrainControl = false
          PortInputSelection = TYPE_2_SUPP_PIS
        PortPin90 (PortPin9):
          PortPinDirectionChangeable = false
          PortPinDioAltModeChangeable = false
          PortPinModeChangeable = false
          PortPinLevelValue = PORT_PIN_LEVEL_LOW
          PortPinInitialMode = DIO_PFC_PFCE_PMCSR
          PortPinDirection = PORT_PIN_IN
          PortInputBufferControl = true
          PortBiDirectionControl = false
          PortPullUpOption = false
          PortPullDownOption = false
          PortOpenDrainControl = false
          PortInputSelection = TYPE_2_SUPP_PIS
        PortPin100 (PortPin10):
          PortPinDirectionChangeable = false
          PortPinDioAltModeChangeable = false
          PortPinModeChangeable = true
          PortPinLevelValue = PORT_PIN_LEVEL_LOW
          PortPinInitialMode = DIO_PFC_PMCSR
          PortPinDirection = PORT_PIN_IN
          PortInputBufferControl = false
          PortBiDirectionControl = false
          PortPullUpOption = false
          PortPullDownOption = false
          PortOpenDrainControl = false
          PortInputSelection = TYPE_2_SUPP_PIS
        PortPin110 (PortPin11):
          PortPinDirectionChangeable = false
          PortPinDioAltModeChangeable = false
          PortPinModeChangeable = true
          PortPinLevelValue = PORT_PIN_LEVEL_LOW
          PortPinInitialMode = DIO_PFC_PFCE_PMCSR
          PortPinDirection = PORT_PIN_IN
          PortInputBufferControl = false
          PortBiDirectionControl = false
          PortPullUpOption = false
          PortPullDownOption = false
          PortOpenDrainControl = false
          PortInputSelection = TYPE_2_SUPP_PIS
        PortPin120 (PortPin12):
          PortPinDirectionChangeable = false
          PortPinDioAltModeChangeable = false
          PortPinModeChangeable = false
          PortPinLevelValue = PORT_PIN_LEVEL_LOW
          PortPinInitialMode = DIO_PFC_PFCE_PMCSR
          PortPinDirection = PORT_PIN_OUT
          PortInputBufferControl = false
          PortBiDirectionControl = false
          PortPullUpOption = false
          PortPullDownOption = false
          PortOpenDrainControl = false
          PortInputSelection = TYPE_2_SUPP_PIS
      PortGroup90 (PortGroup9)
        PortPin00 (PortPin0):
          PortPinDirectionChangeable = false
          PortPinDioAltModeChangeable = false
          PortPinModeChangeable = false
          PortPinLevelValue = PORT_PIN_LEVEL_LOW
          PortPinInitialMode = DIO_PFC_PFCE_PMCSR
          PortPinDirection = PORT_PIN_OUT
          PortInputBufferControl = false
          PortBiDirectionControl = false
          PortPullUpOption = false
          PortPullDownOption = false
          PortOpenDrainControl = false
          PortInputSelection = TYPE_2_SUPP_PIS
        PortPin10 (PortPin1):
          PortPinDirectionChangeable = false
          PortPinDioAltModeChangeable = false
          PortPinModeChangeable = false
          PortPinLevelValue = PORT_PIN_LEVEL_LOW
          PortPinInitialMode = DIO_PFC_PFCE_PMCSR
          PortPinDirection = PORT_PIN_OUT
          PortInputBufferControl = false
          PortBiDirectionControl = false
          PortPullUpOption = false
          PortPullDownOption = false
          PortOpenDrainControl = false
          PortInputSelection = TYPE_2_SUPP_PIS
        PortPin20 (PortPin2):
          PortPinDirectionChangeable = false
          PortPinDioAltModeChangeable = false
          PortPinModeChangeable = false
          PortPinLevelValue = PORT_PIN_LEVEL_LOW
          PortPinInitialMode = CSIH2CSS2_AT2OUT_PFC_PMCSR
          PortPinDirection = PORT_PIN_OUT
          PortInputBufferControl = false
          PortBiDirectionControl = false
          PortPullUpOption = false
          PortPullDownOption = false
          PortOpenDrainControl = false
          PortInputSelection = TYPE_2_SUPP_PIS
        PortPin30 (PortPin3):
          PortPinDirectionChangeable = false
          PortPinDioAltModeChangeable = false
          PortPinModeChangeable = false
          PortPinLevelValue = PORT_PIN_LEVEL_LOW
          PortPinInitialMode = DIO_PFC_PFCE_PMCSR
          PortPinDirection = PORT_PIN_IN
          PortInputBufferControl = false
          PortBiDirectionControl = false
          PortPullUpOption = false
          PortPullDownOption = false
          PortOpenDrainControl = false
          PortInputSelection = TYPE_2_SUPP_PIS
        PortPin40 (PortPin4):
          PortPinDirectionChangeable = false
          PortPinDioAltModeChangeable = false
          PortPinModeChangeable = false
          PortPinLevelValue = PORT_PIN_LEVEL_LOW
          PortPinInitialMode = DIO_PFC_PFCE_PMCSR
          PortPinDirection = PORT_PIN_IN
          PortInputBufferControl = true
          PortBiDirectionControl = false
          PortPullUpOption = false
          PortPullDownOption = false
          PortOpenDrainControl = false
          PortInputSelection = TYPE_2_SUPP_PIS
        PortPin50 (PortPin5):
          PortPinDirectionChangeable = false
          PortPinDioAltModeChangeable = false
          PortPinModeChangeable = false
          PortPinLevelValue = PORT_PIN_LEVEL_LOW
          PortPinInitialMode = DIO_PFC_PFCE_PMCSR
          PortPinDirection = PORT_PIN_IN
          PortInputBufferControl = true
          PortBiDirectionControl = false
          PortPullUpOption = false
          PortPullDownOption = false
          PortOpenDrainControl = false
          PortInputSelection = TYPE_2_SUPP_PIS
        PortPin60 (PortPin6):
          PortPinDirectionChangeable = false
          PortPinDioAltModeChangeable = false
          PortPinModeChangeable = false
          PortPinLevelValue = PORT_PIN_LEVEL_LOW
          PortPinInitialMode = DIO_PFC_PMCSR
          PortPinDirection = PORT_PIN_OUT
          PortInputBufferControl = false
          PortBiDirectionControl = false
          PortPullUpOption = false
          PortPullDownOption = false
          PortOpenDrainControl = false
          PortInputSelection = TYPE_2_SUPP_PIS
      PortGroup100 (PortGroup10)
        PortPin00 (PortPin0):
          PortPinDirectionChangeable = false
          PortPinDioAltModeChangeable = false
          PortPinModeChangeable = false
          PortPinLevelValue = PORT_PIN_LEVEL_LOW
          PortPinInitialMode = DIO
          PortPinDirection = PORT_PIN_OUT
          PortInputBufferControl = false
          PortBiDirectionControl = false
          PortIpControl = false
          PortPullUpOption = false
          PortPullDownOption = false
          PortOpenDrainControl = false
          PortDriveStrengthControl = false
          PortInputSelection = TYPE_2_SUPP_PIS
        PortPin10 (PortPin1):
          PortPinDirectionChangeable = false
          PortPinDioAltModeChangeable = false
          PortPinModeChangeable = false
          PortPinLevelValue = PORT_PIN_LEVEL_LOW
          PortPinInitialMode = DIO
          PortPinDirection = PORT_PIN_IN
          PortInputBufferControl = false
          PortBiDirectionControl = false
          PortIpControl = false
          PortPullUpOption = false
          PortPullDownOption = false
          PortOpenDrainControl = false
          PortDriveStrengthControl = false
          PortInputSelection = TYPE_2_SUPP_PIS
        PortPin20 (PortPin2):
          PortPinDirectionChangeable = false
          PortPinDioAltModeChangeable = false
          PortPinModeChangeable = false
          PortPinLevelValue = PORT_PIN_LEVEL_LOW
          PortPinInitialMode = RIIC0SDA_AT2OUT
          PortPinDirection = PORT_PIN_OUT
          PortInputBufferControl = false
          PortBiDirectionControl = false
          PortIpControl = false
          PortPullUpOption = false
          PortPullDownOption = false
          PortOpenDrainControl = false
          PortDriveStrengthControl = false
          PortInputSelection = TYPE_2_SUPP_PIS
        PortPin30 (PortPin3):
          PortPinDirectionChangeable = true
          PortPinDioAltModeChangeable = false
          PortPinModeChangeable = true
          PortPinLevelValue = PORT_PIN_LEVEL_LOW
          PortPinInitialMode = RIIC0SCL_AT2OUT
          PortPinDirection = PORT_PIN_OUT
          PortInputBufferControl = false
          PortBiDirectionControl = false
          PortIpControl = false
          PortPullUpOption = false
          PortPullDownOption = false
          PortOpenDrainControl = false
          PortDriveStrengthControl = false
          PortInputSelection = TYPE_2_SUPP_PIS
        PortPin40 (PortPin4):
          PortPinDirectionChangeable = false
          PortPinDioAltModeChangeable = false
          PortPinModeChangeable = false
          PortPinLevelValue = PORT_PIN_LEVEL_LOW
          PortPinInitialMode = DIO
          PortPinDirection = PORT_PIN_OUT
          PortInputBufferControl = false
          PortBiDirectionControl = false
          PortIpControl = false
          PortPullUpOption = false
          PortPullDownOption = false
          PortOpenDrainControl = false
          PortDriveStrengthControl = false
          PortInputSelection = TYPE_2_SUPP_PIS
        PortPin50 (PortPin5):
          PortPinDirectionChangeable = false
          PortPinDioAltModeChangeable = false
          PortPinModeChangeable = false
          PortPinLevelValue = PORT_PIN_LEVEL_LOW
          PortPinInitialMode = DIO
          PortPinDirection = PORT_PIN_OUT
          PortInputBufferControl = false
          PortBiDirectionControl = false
          PortIpControl = false
          PortPullUpOption = false
          PortPullDownOption = false
          PortOpenDrainControl = false
          PortDriveStrengthControl = false
          PortInputSelection = TYPE_2_SUPP_PIS
        PortPin60 (PortPin6):
          PortPinDirectionChangeable = false
          PortPinDioAltModeChangeable = false
          PortPinModeChangeable = false
          PortPinLevelValue = PORT_PIN_LEVEL_LOW
          PortPinInitialMode = DIO
          PortPinDirection = PORT_PIN_IN
          PortInputBufferControl = true
          PortBiDirectionControl = false
          PortIpControl = false
          PortPullUpOption = false
          PortPullDownOption = false
          PortOpenDrainControl = false
          PortDriveStrengthControl = false
          PortInputSelection = TYPE_2_SUPP_PIS
        PortPin70 (PortPin7):
          PortPinDirectionChangeable = false
          PortPinDioAltModeChangeable = false
          PortPinModeChangeable = false
          PortPinLevelValue = PORT_PIN_LEVEL_LOW
          PortPinInitialMode = DIO_PFC_PFCE_PMCSR
          PortPinDirection = PORT_PIN_IN
          PortInputBufferControl = false
          PortBiDirectionControl = false
          PortIpControl = false
          PortPullUpOption = false
          PortPullDownOption = false
          PortOpenDrainControl = false
          PortDriveStrengthControl = false
          PortInputSelection = TYPE_2_SUPP_PIS
        PortPin80 (PortPin8):
          PortPinDirectionChangeable = false
          PortPinDioAltModeChangeable = false
          PortPinModeChangeable = false
          PortPinLevelValue = PORT_PIN_LEVEL_LOW
          PortPinInitialMode = DIO_PFC_PFCE_PMCSR
          PortPinDirection = PORT_PIN_IN
          PortInputBufferControl = false
          PortBiDirectionControl = false
          PortPullUpOption = false
          PortPullDownOption = false
          PortOpenDrainControl = false
          PortDriveStrengthControl = false
          PortInputSelection = TYPE_2_SUPP_PIS
        PortPin90 (PortPin9):
          PortPinDirectionChangeable = false
          PortPinDioAltModeChangeable = false
          PortPinModeChangeable = false
          PortPinLevelValue = PORT_PIN_LEVEL_LOW
          PortPinInitialMode = TAUD0I12_AT1IN
          PortPinDirection = PORT_PIN_IN
          PortInputBufferControl = false
          PortBiDirectionControl = false
          PortPullUpOption = false
          PortPullDownOption = false
          PortOpenDrainControl = false
          PortDriveStrengthControl = false
          PortInputSelection = TYPE_2_SUPP_PIS
        PortPin100 (PortPin10):
          PortPinDirectionChangeable = false
          PortPinDioAltModeChangeable = false
          PortPinModeChangeable = false
          PortPinLevelValue = PORT_PIN_LEVEL_LOW
          PortPinInitialMode = DIO_PFC_PFCE_PMCSR
          PortPinDirection = PORT_PIN_OUT
          PortInputBufferControl = false
          PortBiDirectionControl = false
          PortPullUpOption = false
          PortPullDownOption = false
          PortOpenDrainControl = false
          PortDriveStrengthControl = false
          PortInputSelection = TYPE_2_SUPP_PIS
        PortPin110 (PortPin11):
          PortPinDirectionChangeable = false
          PortPinDioAltModeChangeable = false
          PortPinModeChangeable = false
          PortPinLevelValue = PORT_PIN_LEVEL_LOW
          PortPinInitialMode = RLIN31RX_AT7IN
          PortPinDirection = PORT_PIN_IN
          PortInputBufferControl = false
          PortBiDirectionControl = false
          PortPullUpOption = false
          PortPullDownOption = false
          PortOpenDrainControl = false
          PortDriveStrengthControl = false
          PortInputSelection = TYPE_2_SUPP_PIS
        PortPin120 (PortPin12):
          PortPinDirectionChangeable = false
          PortPinDioAltModeChangeable = false
          PortPinModeChangeable = false
          PortPinLevelValue = PORT_PIN_LEVEL_LOW
          PortPinInitialMode = RLIN31TX_AT2OUT_PFC_PFCE_PMCSR
          PortPinDirection = PORT_PIN_OUT
          PortInputBufferControl = false
          PortBiDirectionControl = false
          PortPullUpOption = false
          PortPullDownOption = false
          PortOpenDrainControl = false
          PortDriveStrengthControl = false
          PortInputSelection = TYPE_2_SUPP_PIS
        PortPin130 (PortPin13):
          PortPinDirectionChangeable = false
          PortPinDioAltModeChangeable = false
          PortPinModeChangeable = false
          PortPinLevelValue = PORT_PIN_LEVEL_LOW
          PortPinInitialMode = DIO
          PortPinDirection = PORT_PIN_IN
          PortInputBufferControl = true
          PortBiDirectionControl = false
          PortPullUpOption = false
          PortPullDownOption = false
          PortOpenDrainControl = false
          PortDriveStrengthControl = false
          PortInputSelection = TYPE_2_SUPP_PIS
        PortPin140 (PortPin14):
          PortPinDirectionChangeable = false
          PortPinDioAltModeChangeable = false
          PortPinModeChangeable = false
          PortPinLevelValue = PORT_PIN_LEVEL_LOW
          PortPinInitialMode = DIO_PFC_PFCE_PMCSR
          PortPinDirection = PORT_PIN_OUT
          PortInputBufferControl = false
          PortBiDirectionControl = false
          PortPullUpOption = false
          PortPullDownOption = false
          PortOpenDrainControl = false
          PortDriveStrengthControl = false
          PortInputSelection = TYPE_2_SUPP_PIS
        PortPin150 (PortPin15):
          PortPinDirectionChangeable = false
          PortPinDioAltModeChangeable = false
          PortPinModeChangeable = true
          PortPinLevelValue = PORT_PIN_LEVEL_LOW
          PortPinInitialMode = DIO_PFC_PFCE_PMCSR
          PortPinDirection = PORT_PIN_OUT
          PortInputBufferControl = false
          PortBiDirectionControl = false
          PortPullUpOption = false
          PortPullDownOption = false
          PortOpenDrainControl = false
          PortDriveStrengthControl = false
          PortInputSelection = TYPE_2_SUPP_PIS
      PortGroup110 (PortGroup11)
        PortPin00 (PortPin0):
          PortPinDirectionChangeable = false
          PortPinDioAltModeChangeable = false
          PortPinModeChangeable = false
          PortPinLevelValue = PORT_PIN_LEVEL_LOW
          PortPinInitialMode = DIO_PFC_PFCE_PMCSR
          PortPinDirection = PORT_PIN_OUT
          PortInputBufferControl = false
          PortBiDirectionControl = false
          PortPullUpOption = false
          PortPullDownOption = false
          PortOpenDrainControl = false
          PortDriveStrengthControl = false
          PortInputSelection = TYPE_2_SUPP_PIS
        PortPin10 (PortPin1):
          PortPinDirectionChangeable = false
          PortPinDioAltModeChangeable = false
          PortPinModeChangeable = false
          PortPinLevelValue = PORT_PIN_LEVEL_LOW
          PortPinInitialMode = DIO_PFC_PFCE_PMCSR
          PortPinDirection = PORT_PIN_OUT
          PortInputBufferControl = false
          PortBiDirectionControl = false
          PortPullUpOption = false
          PortPullDownOption = false
          PortOpenDrainControl = false
          PortDriveStrengthControl = false
          PortInputSelection = TYPE_2_SUPP_PIS
        PortPin20 (PortPin2):
          PortPinDirectionChangeable = false
          PortPinDioAltModeChangeable = false
          PortPinModeChangeable = false
          PortPinLevelValue = PORT_PIN_LEVEL_LOW
          PortPinInitialMode = CSIH2SO_AT1OUT
          PortPinDirection = PORT_PIN_OUT
          PortInputBufferControl = false
          PortBiDirectionControl = false
          PortIpControl = true
          PortPullUpOption = false
          PortPullDownOption = false
          PortOpenDrainControl = false
          PortDriveStrengthControl = false
          PortInputSelection = TYPE_2_SUPP_PIS
        PortPin30 (PortPin3):
          PortPinDirectionChangeable = false
          PortPinDioAltModeChangeable = false
          PortPinModeChangeable = false
          PortPinLevelValue = PORT_PIN_LEVEL_LOW
          PortPinInitialMode = CSIH2SC_AT1OUT
          PortPinDirection = PORT_PIN_OUT
          PortInputBufferControl = false
          PortBiDirectionControl = false
          PortIpControl = true
          PortPullUpOption = false
          PortPullDownOption = false
          PortOpenDrainControl = false
          PortDriveStrengthControl = false
          PortInputSelection = TYPE_2_SUPP_PIS
        PortPin40 (PortPin4):
          PortPinDirectionChangeable = false
          PortPinDioAltModeChangeable = false
          PortPinModeChangeable = false
          PortPinLevelValue = PORT_PIN_LEVEL_LOW
          PortPinInitialMode = CSIH2SI_AT1IN_PFC_PFCE_PMCSR
          PortPinDirection = PORT_PIN_IN
          PortInputBufferControl = false
          PortBiDirectionControl = false
          PortPullUpOption = false
          PortPullDownOption = false
          PortOpenDrainControl = false
          PortDriveStrengthControl = false
          PortInputSelection = TYPE_2_SUPP_PIS
        PortPin50 (PortPin5):
          PortPinDirectionChangeable = false
          PortPinDioAltModeChangeable = false
          PortPinModeChangeable = false
          PortPinLevelValue = PORT_PIN_LEVEL_LOW
          PortPinInitialMode = CSIH3SI_AT3IN
          PortPinDirection = PORT_PIN_IN
          PortInputBufferControl = false
          PortBiDirectionControl = false
          PortPullUpOption = false
          PortPullDownOption = false
          PortOpenDrainControl = false
          PortDriveStrengthControl = false
          PortInputSelection = TYPE_2_SUPP_PIS
        PortPin60 (PortPin6):
          PortPinDirectionChangeable = false
          PortPinDioAltModeChangeable = false
          PortPinModeChangeable = false
          PortPinLevelValue = PORT_PIN_LEVEL_LOW
          PortPinInitialMode = CSIH3SO_AT3OUT
          PortPinDirection = PORT_PIN_OUT
          PortInputBufferControl = false
          PortBiDirectionControl = false
          PortIpControl = true
          PortPullUpOption = false
          PortPullDownOption = false
          PortOpenDrainControl = false
          PortDriveStrengthControl = false
          PortInputSelection = TYPE_2_SUPP_PIS
        PortPin70 (PortPin7):
          PortPinDirectionChangeable = false
          PortPinDioAltModeChangeable = false
          PortPinModeChangeable = false
          PortPinLevelValue = PORT_PIN_LEVEL_LOW
          PortPinInitialMode = CSIH3SC_AT3OUT_PFC_PFCE_PMCSR
          PortPinDirection = PORT_PIN_OUT
          PortInputBufferControl = false
          PortBiDirectionControl = false
          PortIpControl = true
          PortPullUpOption = false
          PortPullDownOption = false
          PortOpenDrainControl = false
          PortDriveStrengthControl = false
          PortInputSelection = TYPE_2_SUPP_PIS
        PortPin80 (PortPin8):
          PortPinDirectionChangeable = false
          PortPinDioAltModeChangeable = false
          PortPinModeChangeable = false
          PortPinLevelValue = PORT_PIN_LEVEL_LOW
          PortPinInitialMode = CSIG1SSI_AT1IN_PFC_PFCE_PMCSR
          PortPinDirection = PORT_PIN_IN
          PortInputBufferControl = false
          PortBiDirectionControl = false
          PortPullUpOption = false
          PortPullDownOption = false
          PortOpenDrainControl = false
          PortDriveStrengthControl = false
          PortInputSelection = TYPE_2_SUPP_PIS
        PortPin90 (PortPin9):
          PortPinDirectionChangeable = false
          PortPinDioAltModeChangeable = false
          PortPinModeChangeable = false
          PortPinLevelValue = PORT_PIN_LEVEL_LOW
          PortPinInitialMode = CSIG1SO_AT1OUT
          PortPinDirection = PORT_PIN_OUT
          PortInputBufferControl = false
          PortBiDirectionControl = false
          PortIpControl = true
          PortPullUpOption = false
          PortPullDownOption = false
          PortOpenDrainControl = false
          PortDriveStrengthControl = false
          PortInputSelection = TYPE_2_SUPP_PIS
        PortPin100 (PortPin10):
          PortPinDirectionChangeable = false
          PortPinDioAltModeChangeable = false
          PortPinModeChangeable = false
          PortPinLevelValue = PORT_PIN_LEVEL_LOW
          PortPinInitialMode = CSIG1SC_AT1IN_PFC_PFCE_PMCSR
          PortPinDirection = PORT_PIN_IN
          PortInputBufferControl = false
          PortBiDirectionControl = false
          PortIpControl = true
          PortPullUpOption = false
          PortPullDownOption = false
          PortOpenDrainControl = false
          PortDriveStrengthControl = false
          PortInputSelection = TYPE_2_SUPP_PIS
        PortPin110 (PortPin11):
          PortPinDirectionChangeable = false
          PortPinDioAltModeChangeable = false
          PortPinModeChangeable = false
          PortPinLevelValue = PORT_PIN_LEVEL_LOW
          PortPinInitialMode = CSIG1SI_AT1IN_PFC_PFCE_PMCSR
          PortPinDirection = PORT_PIN_IN
          PortInputBufferControl = false
          PortBiDirectionControl = false
          PortPullUpOption = false
          PortPullDownOption = false
          PortOpenDrainControl = false
          PortDriveStrengthControl = false
          PortInputSelection = TYPE_2_SUPP_PIS
        PortPin120 (PortPin12):
          PortPinDirectionChangeable = false
          PortPinDioAltModeChangeable = false
          PortPinModeChangeable = false
          PortPinLevelValue = PORT_PIN_LEVEL_LOW
          PortPinInitialMode = DIO_PFC_PFCE_PMCSR
          PortPinDirection = PORT_PIN_OUT
          PortInputBufferControl = false
          PortBiDirectionControl = false
          PortPullUpOption = false
          PortPullDownOption = false
          PortOpenDrainControl = false
          PortDriveStrengthControl = false
          PortInputSelection = TYPE_2_SUPP_PIS
        PortPin130 (PortPin13):
          PortPinDirectionChangeable = false
          PortPinDioAltModeChangeable = false
          PortPinModeChangeable = false
          PortPinLevelValue = PORT_PIN_LEVEL_LOW
          PortPinInitialMode = RLIN24RX_AT1IN_PFC_PFCE_PMCSR
          PortPinDirection = PORT_PIN_IN
          PortInputBufferControl = false
          PortBiDirectionControl = false
          PortPullUpOption = false
          PortPullDownOption = false
          PortOpenDrainControl = false
          PortDriveStrengthControl = false
          PortInputSelection = TYPE_2_SUPP_PIS
        PortPin140 (PortPin14):
          PortPinDirectionChangeable = false
          PortPinDioAltModeChangeable = false
          PortPinModeChangeable = false
          PortPinLevelValue = PORT_PIN_LEVEL_LOW
          PortPinInitialMode = RLIN24TX_AT1OUT_PFC_PFCE_PMCSR
          PortPinDirection = PORT_PIN_OUT
          PortInputBufferControl = false
          PortBiDirectionControl = false
          PortPullUpOption = false
          PortPullDownOption = false
          PortOpenDrainControl = false
          PortDriveStrengthControl = false
          PortInputSelection = TYPE_2_SUPP_PIS
        PortPin150 (PortPin15):
          PortPinDirectionChangeable = false
          PortPinDioAltModeChangeable = false
          PortPinModeChangeable = false
          PortPinLevelValue = PORT_PIN_LEVEL_LOW
          PortPinInitialMode = DIO
          PortPinDirection = PORT_PIN_OUT
          PortInputBufferControl = false
          PortBiDirectionControl = false
          PortPullUpOption = false
          PortPullDownOption = false
          PortOpenDrainControl = false
          PortDriveStrengthControl = false
          PortInputSelection = TYPE_2_SUPP_PIS
      PortGroup120 (PortGroup12)
        PortPin00 (PortPin0):
          PortPullDownOption = false
          PortPinDirectionChangeable = false
          PortPinDioAltModeChangeable = false
          PortPinModeChangeable = false
          PortPinLevelValue = PORT_PIN_LEVEL_LOW
          PortPinInitialMode = DIO_PFC_PFCE_PMCSR
          PortPinDirection = PORT_PIN_OUT
          PortInputBufferControl = false
          PortBiDirectionControl = false
          PortPullUpOption = false
          PortOpenDrainControl = false
          PortDriveStrengthControl = false
          PortInputSelection = TYPE_2_SUPP_PIS
        PortPin10 (PortPin1):
          PortPullDownOption = false
          PortPinDirectionChangeable = false
          PortPinDioAltModeChangeable = false
          PortPinModeChangeable = false
          PortPinLevelValue = PORT_PIN_LEVEL_LOW
          PortPinInitialMode = RLIN34RX_AT7IN
          PortPinDirection = PORT_PIN_IN
          PortInputBufferControl = false
          PortBiDirectionControl = false
          PortPullUpOption = false
          PortOpenDrainControl = false
          PortDriveStrengthControl = false
          PortInputSelection = TYPE_2_SUPP_PIS
        PortPin20 (PortPin2):
          PortPullDownOption = false
          PortPinDirectionChangeable = false
          PortPinDioAltModeChangeable = false
          PortPinModeChangeable = false
          PortPinLevelValue = PORT_PIN_LEVEL_LOW
          PortPinInitialMode = RLIN34TX_AT1OUT_PFC_PFCE_PMCSR
          PortPinDirection = PORT_PIN_OUT
          PortInputBufferControl = false
          PortBiDirectionControl = false
          PortPullUpOption = false
          PortOpenDrainControl = false
          PortDriveStrengthControl = false
          PortInputSelection = TYPE_2_SUPP_PIS
      PortGroup180 (PortGroup18)
        PortPin00 (PortPin0):
          PortPullDownOption = false
          PortPinDirectionChangeable = false
          PortPinDioAltModeChangeable = false
          PortPinModeChangeable = false
          PortPinLevelValue = PORT_PIN_LEVEL_LOW
          PortPinInitialMode = DIO_PFC_PMCSR
          PortPinDirection = PORT_PIN_OUT
          PortInputBufferControl = false
          PortBiDirectionControl = false
          PortPullUpOption = false
          PortOpenDrainControl = false
          PortDriveStrengthControl = false
          PortInputSelection = TYPE_2_SUPP_PIS
        PortPin10 (PortPin1):
          PortPullDownOption = false
          PortPinDirectionChangeable = false
          PortPinDioAltModeChangeable = false
          PortPinModeChangeable = false
          PortPinLevelValue = PORT_PIN_LEVEL_LOW
          PortPinInitialMode = DIO_PMCSR
          PortPinDirection = PORT_PIN_OUT
          PortInputBufferControl = false
          PortBiDirectionControl = false
          PortPullUpOption = false
          PortOpenDrainControl = false
          PortDriveStrengthControl = false
          PortInputSelection = TYPE_2_SUPP_PIS
        PortPin20 (PortPin2):
          PortPullDownOption = false
          PortPinDirectionChangeable = false
          PortPinDioAltModeChangeable = false
          PortPinModeChangeable = false
          PortPinLevelValue = PORT_PIN_LEVEL_LOW
          PortPinInitialMode = DIO_PMCSR
          PortPinDirection = PORT_PIN_IN
          PortInputBufferControl = false
          PortBiDirectionControl = false
          PortPullUpOption = false
          PortOpenDrainControl = false
          PortDriveStrengthControl = false
          PortInputSelection = TYPE_2_SUPP_PIS
        PortPin30 (PortPin3):
          PortPullDownOption = false
          PortPinDirectionChangeable = false
          PortPinDioAltModeChangeable = false
          PortPinModeChangeable = false
          PortPinLevelValue = PORT_PIN_LEVEL_LOW
          PortPinInitialMode = DIO_PMCSR
          PortPinDirection = PORT_PIN_OUT
          PortInputBufferControl = false
          PortBiDirectionControl = false
          PortPullUpOption = false
          PortOpenDrainControl = false
          PortDriveStrengthControl = false
          PortInputSelection = TYPE_2_SUPP_PIS
      PortGroup200 (PortGroup20)
        PortPin40 (PortPin4):
          PortPullDownOption = false
          PortPinDirectionChangeable = false
          PortPinDioAltModeChangeable = false
          PortPinModeChangeable = false
          PortPinLevelValue = PORT_PIN_LEVEL_LOW
          PortPinInitialMode = DIO_PFC_PMCSR
          PortPinDirection = PORT_PIN_IN
          PortInputBufferControl = false
          PortBiDirectionControl = false
          PortPullUpOption = false
          PortOpenDrainControl = false
          PortDriveStrengthControl = false
          PortInputSelection = TYPE_1_SUPP_PIS
        PortPin50 (PortPin5):
          PortPullDownOption = false
          PortPinDirectionChangeable = false
          PortPinDioAltModeChangeable = false
          PortPinModeChangeable = false
          PortPinLevelValue = PORT_PIN_LEVEL_LOW
          PortPinInitialMode = DIO_PFC_PMCSR
          PortPinDirection = PORT_PIN_OUT
          PortInputBufferControl = false
          PortBiDirectionControl = false
          PortPullUpOption = false
          PortOpenDrainControl = false
          PortDriveStrengthControl = false
          PortInputSelection = TYPE_2_SUPP_PIS
      PortGroupAnalog00 (PortGroupAnalog0)
        PortPin00 (PortPin0):
          PortPinDirectionChangeable = false
          PortPinLevelValue = PORT_PIN_LEVEL_LOW
          PortPinInitialMode = ALT_NOT_SUPPORTED
          PortPinDirection = PORT_PIN_IN
          PortInputBufferControl = false
          PortBiDirectionControl = false
        PortPin10 (PortPin1):
          PortPinDirectionChangeable = false
          PortPinLevelValue = PORT_PIN_LEVEL_LOW
          PortPinInitialMode = ALT_NOT_SUPPORTED
          PortPinDirection = PORT_PIN_IN
          PortInputBufferControl = false
          PortBiDirectionControl = false
        PortPin20 (PortPin2):
          PortPinDirectionChangeable = false
          PortPinLevelValue = PORT_PIN_LEVEL_LOW
          PortPinInitialMode = ALT_NOT_SUPPORTED
          PortPinDirection = PORT_PIN_IN
          PortInputBufferControl = false
          PortBiDirectionControl = false
        PortPin30 (PortPin3):
          PortPinDirectionChangeable = false
          PortPinLevelValue = PORT_PIN_LEVEL_LOW
          PortPinInitialMode = ALT_NOT_SUPPORTED
          PortPinDirection = PORT_PIN_IN
          PortInputBufferControl = false
          PortBiDirectionControl = false
        PortPin40 (PortPin4):
          PortPinDirectionChangeable = false
          PortPinLevelValue = PORT_PIN_LEVEL_LOW
          PortPinInitialMode = ALT_NOT_SUPPORTED
          PortPinDirection = PORT_PIN_IN
          PortInputBufferControl = false
          PortBiDirectionControl = false
        PortPin50 (PortPin5):
          PortPinDirectionChangeable = false
          PortPinLevelValue = PORT_PIN_LEVEL_LOW
          PortPinInitialMode = ALT_NOT_SUPPORTED
          PortPinDirection = PORT_PIN_IN
          PortInputBufferControl = false
          PortBiDirectionControl = false
        PortPin60 (PortPin6):
          PortPinDirectionChangeable = false
          PortPinLevelValue = PORT_PIN_LEVEL_LOW
          PortPinInitialMode = ALT_NOT_SUPPORTED
          PortPinDirection = PORT_PIN_IN
          PortInputBufferControl = false
          PortBiDirectionControl = false
        PortPin70 (PortPin7):
          PortPinDirectionChangeable = false
          PortPinLevelValue = PORT_PIN_LEVEL_LOW
          PortPinInitialMode = ALT_NOT_SUPPORTED
          PortPinDirection = PORT_PIN_IN
          PortInputBufferControl = false
          PortBiDirectionControl = false
        PortPin80 (PortPin8):
          PortPinDirectionChangeable = false
          PortPinLevelValue = PORT_PIN_LEVEL_LOW
          PortPinInitialMode = ALT_NOT_SUPPORTED
          PortPinDirection = PORT_PIN_IN
          PortInputBufferControl = false
          PortBiDirectionControl = false
        PortPin90 (PortPin9):
          PortPinDirectionChangeable = false
          PortPinLevelValue = PORT_PIN_LEVEL_LOW
          PortPinInitialMode = ALT_NOT_SUPPORTED
          PortPinDirection = PORT_PIN_IN
          PortInputBufferControl = false
          PortBiDirectionControl = false
        PortPin100 (PortPin10):
          PortPinDirectionChangeable = false
          PortPinLevelValue = PORT_PIN_LEVEL_LOW
          PortPinInitialMode = ALT_NOT_SUPPORTED
          PortPinDirection = PORT_PIN_IN
          PortInputBufferControl = false
          PortBiDirectionControl = false
        PortPin110 (PortPin11):
          PortPinDirectionChangeable = false
          PortPinLevelValue = PORT_PIN_LEVEL_LOW
          PortPinInitialMode = ALT_NOT_SUPPORTED
          PortPinDirection = PORT_PIN_IN
          PortInputBufferControl = false
          PortBiDirectionControl = false
        PortPin120 (PortPin12):
          PortPinDirectionChangeable = false
          PortPinLevelValue = PORT_PIN_LEVEL_LOW
          PortPinInitialMode = ALT_NOT_SUPPORTED
          PortPinDirection = PORT_PIN_IN
          PortInputBufferControl = false
          PortBiDirectionControl = false
        PortPin130 (PortPin13):
          PortPinDirectionChangeable = false
          PortPinLevelValue = PORT_PIN_LEVEL_LOW
          PortPinInitialMode = ALT_NOT_SUPPORTED
          PortPinDirection = PORT_PIN_IN
          PortInputBufferControl = false
          PortBiDirectionControl = false
        PortPin140 (PortPin14):
          PortPinDirectionChangeable = false
          PortPinLevelValue = PORT_PIN_LEVEL_LOW
          PortPinInitialMode = ALT_NOT_SUPPORTED
          PortPinDirection = PORT_PIN_IN
          PortInputBufferControl = false
          PortBiDirectionControl = false
        PortPin150 (PortPin15):
          PortPinDirectionChangeable = false
          PortPinLevelValue = PORT_PIN_LEVEL_LOW
          PortPinInitialMode = ALT_NOT_SUPPORTED
          PortPinDirection = PORT_PIN_IN
          PortInputBufferControl = false
          PortBiDirectionControl = false
      PortGroupAnalog10 (PortGroupAnalog1)
        PortPin00 (PortPin0):
          PortPinDirectionChangeable = false
          PortPinLevelValue = PORT_PIN_LEVEL_LOW
          PortPinInitialMode = ALT_NOT_SUPPORTED
          PortPinDirection = PORT_PIN_IN
          PortInputBufferControl = false
          PortBiDirectionControl = false
        PortPin10 (PortPin1):
          PortPinDirectionChangeable = false
          PortPinLevelValue = PORT_PIN_LEVEL_LOW
          PortPinInitialMode = ALT_NOT_SUPPORTED
          PortPinDirection = PORT_PIN_IN
          PortInputBufferControl = false
          PortBiDirectionControl = false
        PortPin20 (PortPin2):
          PortPinDirectionChangeable = false
          PortPinLevelValue = PORT_PIN_LEVEL_LOW
          PortPinInitialMode = ALT_NOT_SUPPORTED
          PortPinDirection = PORT_PIN_IN
          PortInputBufferControl = false
          PortBiDirectionControl = false
        PortPin30 (PortPin3):
          PortPinDirectionChangeable = false
          PortPinLevelValue = PORT_PIN_LEVEL_LOW
          PortPinInitialMode = ALT_NOT_SUPPORTED
          PortPinDirection = PORT_PIN_IN
          PortInputBufferControl = false
          PortBiDirectionControl = false
        PortPin40 (PortPin4):
          PortPinDirectionChangeable = false
          PortPinLevelValue = PORT_PIN_LEVEL_LOW
          PortPinInitialMode = ALT_NOT_SUPPORTED
          PortPinDirection = PORT_PIN_IN
          PortInputBufferControl = false
          PortBiDirectionControl = false
        PortPin50 (PortPin5):
          PortPinDirectionChangeable = false
          PortPinLevelValue = PORT_PIN_LEVEL_LOW
          PortPinInitialMode = ALT_NOT_SUPPORTED
          PortPinDirection = PORT_PIN_IN
          PortInputBufferControl = false
          PortBiDirectionControl = false
        PortPin60 (PortPin6):
          PortPinDirectionChangeable = false
          PortPinLevelValue = PORT_PIN_LEVEL_LOW
          PortPinInitialMode = ALT_NOT_SUPPORTED
          PortPinDirection = PORT_PIN_IN
          PortInputBufferControl = false
          PortBiDirectionControl = false
        PortPin70 (PortPin7):
          PortPinDirectionChangeable = false
          PortPinLevelValue = PORT_PIN_LEVEL_LOW
          PortPinInitialMode = ALT_NOT_SUPPORTED
          PortPinDirection = PORT_PIN_IN
          PortInputBufferControl = false
          PortBiDirectionControl = false
      PortGroupInput00 (PortGroupInput0)
        PortPin00 (PortPin0): PortPinInitialMode=ALT_NOT_SUPPORTED, PortInputBufferControl=false
      PortGroupJtag00 (PortGroupJtag0)
        PortPin00 (PortPin0):
          PortPinDirectionChangeable = false
          PortPinDioAltModeChangeable = false
          PortPinModeChangeable = false
          PortPinLevelValue = PORT_PIN_LEVEL_LOW
          PortPinInitialMode = DIO_PFCE_PMCSR
          PortPinDirection = PORT_PIN_IN
          PortInputBufferControl = false
          PortBiDirectionControl = false
          PortPullUpOption = false
          PortPullDownOption = false
          PortOpenDrainControl = false
          PortInputSelection = TYPE_2_SUPP_PIS
        PortPin10 (PortPin1):
          PortPinDirectionChangeable = false
          PortPinDioAltModeChangeable = false
          PortPinModeChangeable = false
          PortPinLevelValue = PORT_PIN_LEVEL_LOW
          PortPinInitialMode = DIO_PFC_PFCE_PMCSR
          PortPinDirection = PORT_PIN_IN
          PortInputBufferControl = false
          PortBiDirectionControl = false
          PortPullUpOption = false
          PortPullDownOption = false
          PortOpenDrainControl = false
          PortDriveStrengthControl = false
          PortInputSelection = TYPE_2_SUPP_PIS
        PortPin20 (PortPin2):
          PortPinDirectionChangeable = false
          PortPinDioAltModeChangeable = false
          PortPinModeChangeable = false
          PortPinLevelValue = PORT_PIN_LEVEL_LOW
          PortPinInitialMode = DIO_PFC_PFCE_PMCSR
          PortPinDirection = PORT_PIN_IN
          PortInputBufferControl = false
          PortBiDirectionControl = false
          PortPullUpOption = false
          PortPullDownOption = false
          PortOpenDrainControl = false
          PortDriveStrengthControl = false
          PortInputSelection = TYPE_2_SUPP_PIS
        PortPin30 (PortPin3):
          PortPinDirectionChangeable = false
          PortPinDioAltModeChangeable = false
          PortPinModeChangeable = false
          PortPinLevelValue = PORT_PIN_LEVEL_LOW
          PortPinInitialMode = DIO_PFC_PMCSR
          PortPinDirection = PORT_PIN_IN
          PortInputBufferControl = false
          PortBiDirectionControl = false
          PortPullUpOption = false
          PortPullDownOption = false
          PortOpenDrainControl = false
          PortDriveStrengthControl = false
          PortInputSelection = TYPE_2_SUPP_PIS
        PortPin40 (PortPin4):
          PortPinDirectionChangeable = false
          PortPinDioAltModeChangeable = false
          PortPinModeChangeable = false
          PortPinLevelValue = PORT_PIN_LEVEL_LOW
          PortPinInitialMode = DIO
          PortPinDirection = PORT_PIN_IN
          PortInputBufferControl = false
          PortBiDirectionControl = false
          PortPullUpOption = false
          PortPullDownOption = false
          PortOpenDrainControl = false
        PortPin50 (PortPin5):
          PortPinDirectionChangeable = false
          PortPinDioAltModeChangeable = false
          PortPinModeChangeable = false
          PortPinLevelValue = PORT_PIN_LEVEL_LOW
          PortPinInitialMode = DIO_PFC_PMCSR
          PortPinDirection = PORT_PIN_IN
          PortInputBufferControl = false
          PortBiDirectionControl = false
          PortPullUpOption = false
          PortPullDownOption = false
          PortOpenDrainControl = false
          PortDriveStrengthControl = false
          PortInputSelection = TYPE_2_SUPP_PIS
        PortPin60 (PortPin6):
          PortPinDirectionChangeable = false
          PortPinDioAltModeChangeable = false
          PortPinModeChangeable = false
          PortPinLevelValue = PORT_PIN_LEVEL_LOW
          PortPinInitialMode = DIO
          PortPinDirection = PORT_PIN_IN
          PortInputBufferControl = false
          PortBiDirectionControl = false
          PortPullUpOption = false
          PortPullDownOption = false
          PortOpenDrainControl = false
          PortDriveStrengthControl = false
          PortInputSelection = TYPE_2_SUPP_PIS
      PortGroup1
        PortPin6:
          PortBiDirectionControl = false
          PortDriveStrengthControl = false
          PortInputBufferControl = false
          PortInputSelection = TYPE_2_SUPP_PIS
          PortOpenDrainControl = false
          PortPinDioAltModeChangeable = false
          PortPinDirection = PORT_PIN_OUT
          PortPinDirectionChangeable = false
          PortPinInitialMode = DIO_PFC_PMCSR
          PortPinLevelValue = PORT_PIN_LEVEL_LOW
          PortPinModeChangeable = false
          PortPullDownOption = false
          PortPullUpOption = false
        PortPin8:
          PortBiDirectionControl = false
          PortDriveStrengthControl = false
          PortInputBufferControl = true
          PortInputSelection = TYPE_2_SUPP_PIS
          PortOpenDrainControl = false
          PortPinDioAltModeChangeable = false
          PortPinDirection = PORT_PIN_IN
          PortPinDirectionChangeable = false
          PortPinInitialMode = DIO
          PortPinLevelValue = PORT_PIN_LEVEL_LOW
          PortPinModeChangeable = false
          PortPullDownOption = false
          PortPullUpOption = false
        PortPin7:
          PortBiDirectionControl = false
          PortDriveStrengthControl = false
          PortInputBufferControl = false
          PortInputSelection = TYPE_2_SUPP_PIS
          PortOpenDrainControl = false
          PortPinDioAltModeChangeable = false
          PortPinDirection = PORT_PIN_OUT
          PortPinDirectionChangeable = false
          PortPinInitialMode = DIO_PFC_PMCSR
          PortPinLevelValue = PORT_PIN_LEVEL_LOW
          PortPinModeChangeable = false
          PortPullDownOption = false
          PortPullUpOption = false
        PortPin0:
          PortBiDirectionControl = false
          PortDriveStrengthControl = false
          PortInputBufferControl = false
          PortInputSelection = TYPE_2_SUPP_PIS
          PortOpenDrainControl = false
          PortPinDioAltModeChangeable = false
          PortPinDirection = PORT_PIN_OUT
          PortPinDirectionChangeable = false
          PortPinInitialMode = DIO
          PortPinLevelValue = PORT_PIN_LEVEL_LOW
          PortPinModeChangeable = false
          PortPullDownOption = false
          PortPullUpOption = false
        PortPin1:
          PortBiDirectionControl = false
          PortDriveStrengthControl = false
          PortInputBufferControl = false
          PortInputSelection = TYPE_2_SUPP_PIS
          PortOpenDrainControl = false
          PortPinDioAltModeChangeable = false
          PortPinDirection = PORT_PIN_OUT
          PortPinDirectionChangeable = false
          PortPinInitialMode = DIO_PMCSR
          PortPinLevelValue = PORT_PIN_LEVEL_LOW
          PortPinModeChangeable = false
          PortPullDownOption = false
          PortPullUpOption = false
        PortPin2:
          PortBiDirectionControl = false
          PortDriveStrengthControl = false
          PortInputBufferControl = true
          PortInputSelection = TYPE_2_SUPP_PIS
          PortOpenDrainControl = false
          PortPinDioAltModeChangeable = false
          PortPinDirection = PORT_PIN_IN
          PortPinDirectionChangeable = false
          PortPinInitialMode = DIO
          PortPinLevelValue = PORT_PIN_LEVEL_LOW
          PortPinModeChangeable = false
          PortPullDownOption = false
          PortPullUpOption = false
        PortPin3:
          PortBiDirectionControl = false
          PortDriveStrengthControl = false
          PortInputBufferControl = false
          PortInputSelection = TYPE_2_SUPP_PIS
          PortOpenDrainControl = false
          PortPinDioAltModeChangeable = false
          PortPinDirection = PORT_PIN_OUT
          PortPinDirectionChangeable = false
          PortPinInitialMode = DIO_PFC_PMCSR
          PortPinLevelValue = PORT_PIN_LEVEL_LOW
          PortPinModeChangeable = false
          PortPullDownOption = false
          PortPullUpOption = false
        PortPin9:
          PortBiDirectionControl = false
          PortDriveStrengthControl = false
          PortInputBufferControl = true
          PortInputSelection = TYPE_2_SUPP_PIS
          PortOpenDrainControl = false
          PortPinDioAltModeChangeable = false
          PortPinDirection = PORT_PIN_IN
          PortPinDirectionChangeable = false
          PortPinInitialMode = DIO_PFC_PMCSR
          PortPinLevelValue = PORT_PIN_LEVEL_LOW
          PortPinModeChangeable = false
          PortPullDownOption = false
          PortPullUpOption = false
        PortPin10:
          PortBiDirectionControl = false
          PortDriveStrengthControl = false
          PortInputBufferControl = false
          PortInputSelection = TYPE_2_SUPP_PIS
          PortOpenDrainControl = false
          PortPinDioAltModeChangeable = false
          PortPinDirection = PORT_PIN_OUT
          PortPinDirectionChangeable = false
          PortPinInitialMode = DIO_PFC_PMCSR
          PortPinLevelValue = PORT_PIN_LEVEL_LOW
          PortPinModeChangeable = false
          PortPullDownOption = false
          PortPullUpOption = false
        PortPin11:
          PortBiDirectionControl = false
          PortDriveStrengthControl = false
          PortInputBufferControl = false
          PortInputSelection = TYPE_2_SUPP_PIS
          PortOpenDrainControl = false
          PortPinDioAltModeChangeable = false
          PortPinDirection = PORT_PIN_OUT
          PortPinDirectionChangeable = false
          PortPinInitialMode = DIO_PFC_PMCSR
          PortPinLevelValue = PORT_PIN_LEVEL_LOW
          PortPinModeChangeable = false
          PortPullDownOption = false
          PortPullUpOption = false
        PortPin5:
          PortBiDirectionControl = false
          PortDriveStrengthControl = false
          PortInputBufferControl = false
          PortInputSelection = TYPE_2_SUPP_PIS
          PortOpenDrainControl = false
          PortPinDioAltModeChangeable = false
          PortPinDirection = PORT_PIN_OUT
          PortPinDirectionChangeable = false
          PortPinInitialMode = RLIN35TX_AT1OUT_PFC_PMCSR
          PortPinLevelValue = PORT_PIN_LEVEL_LOW
          PortPinModeChangeable = false
          PortPullDownOption = false
          PortPullUpOption = false
        PortPin4:
          PortBiDirectionControl = false
          PortDriveStrengthControl = false
          PortInputBufferControl = false
          PortInputSelection = TYPE_2_SUPP_PIS
          PortOpenDrainControl = false
          PortPinDioAltModeChangeable = false
          PortPinDirection = PORT_PIN_IN
          PortPinDirectionChangeable = false
          PortPinInitialMode = RLIN35RX_AT7IN
          PortPinLevelValue = PORT_PIN_LEVEL_LOW
          PortPinModeChangeable = false
          PortPullDownOption = false
          PortPullUpOption = false
    PortGeneral0 (PortGeneral):
      PortDevErrorDetect = false
      PortSetPinDirectionApi = true
      PortSetPinDefaultDirectionApi = true
      PortSetPinModeApi = true
      PortSetPinDefaultModeApi = true
      PortVersionInfoApi = true
      PortVersionCheckExternalModules = true
      PortDeviceName = R7F701583
      PortCriticalSectionProtection = true
      PortPinStatusBackUp = true
      PortSetToDioAltModeApi = false
      PortMaxMode = 7
      PortWriteVerify = WV_DISABLE
      PortUseWriteVerifyErrorInterface = false
      PortWriteVerifyErrorInterface = PortErrorReportInterface
      PortRAMMirror = ENABLE
      PortUnlockSequenceCount = 20
    PortDemEventParameterRefs0 (PortDemEventParameterRefs): PORT_E_WRITE_TIMEOUT_FAILURE=DemEventParameter0, PORT_E_REG_WRITE_VERIFY=DemEventParameter1
package /Renesas/EcucDefs_GSA
  module config Pwm: implementation-config-variant=VARIANT-POST-BUILD, module-description=Pwm_Impl
    PwmChannelConfigSet0 (PwmChannelConfigSet)
      3 x PwmChannel, all with PwmChannelClass=PWM_VARIABLE_PERIOD, PwmIdleState=PWM_HIGH, PwmPolarity=PWM_HIGH, PwmChannelClk=CK1, PwmComplexDriverInit=false, PwmIntrPriority=false, PwmSyncStartReq=false, PwmMcuClockReferencePoint=McuClockReferencePoint0:
        PwmChannel0: PwmChannelId=0, PwmDutycycleDefault=0, PwmNotification=Pwm_Notif0, PwmPeriodDefault=65535, PwmTimerChannelSelection=TAUJ1O0, PwmTimerMode=PWM_MASTER_CHANNEL
        PwmChannel1: PwmChannelId=1, PwmDutycycleDefault=8192, PwmNotification=Pwm_Notif1, PwmPeriodDefault=0, PwmTimerChannelSelection=TAUJ1O1, PwmTimerMode=PWM_SLAVE_CHANNEL
        PwmChannel2: PwmChannelId=2, PwmDutycycleDefault=16384, PwmNotification=Pwm_Notif2, PwmPeriodDefault=0, PwmTimerChannelSelection=TAUJ1O2, PwmTimerMode=PWM_SLAVE_CHANNEL
      4 x PwmDiagChannel, all with PwmComplexDriverInit=false, PwmDiagClk=PWMCLK1, PwmDiagLoopCount=10000, PwmIntrPriority=false, PwmNotification=NULL, PwmOffsetDelayAdjust=false, PwmSyncStartReq=false:
        PwmDiagChannel0: PwmDiagChannelId=3, PwmDiagDutycycleDefault=1638, PwmDiagOutputSelection=DIAG_CH00, PwmOffset=50, PwmPolarity=PWM_HIGH, PwmTriggerDelay=75
        PwmDiagChannel1: PwmDiagChannelId=4, PwmDiagDutycycleDefault=3276, PwmDiagOutputSelection=DIAG_CH02, PwmOffset=868, PwmPolarity=PWM_LOW, PwmTriggerDelay=250
        PwmDiagChannel2: PwmDiagChannelId=5, PwmDiagDutycycleDefault=4915, PwmDiagOutputSelection=DIAG_CH04, PwmOffset=150, PwmPolarity=PWM_HIGH, PwmTriggerDelay=175
        PwmDiagChannel3: PwmDiagChannelId=6, PwmDiagDutycycleDefault=6553, PwmDiagOutputSelection=DIAG_CH06, PwmOffset=200, PwmPolarity=PWM_HIGH, PwmTriggerDelay=225
      PwmDiagUnit0 (PwmDiagUnit): PwmDiagBaudRateClk0=10, PwmDiagBaudRateClk1=8, PwmDiagBaudRateClk2=2, PwmDiagBaudRateClk3=1
      PwmTaUnit0 (PwmTaUnit):
        PwmPrescalerCk0 = PCLK_DIVBY_2_POWOF_0
        PwmPrescalerCk1 = PCLK_DIVBY_2_POWOF_4
        PwmPrescalerCk2 = PCLK_DIVBY_2_POWOF_8
        PwmPrescalerCk3BaudRate = 255
        PwmPrescalerCk3Pre = PCLK_DIVBY_2_POWOF_15
        PwmTaUnitSelection = TAUJ1
    PwmConfigurationOfOptApiServices:
      PwmDeInitApi = true
      PwmGetOutputState = true
      PwmSetDutyCycle = true
      PwmSetOutputToIdle = true
      PwmSetPeriodAndDuty = true
      PwmVersionInfoApi = true
      PwmSelectChannelClk = true
      PwmSetChannelOutput = true
      PwmSetTriggerDelay = true
    PwmGeneral0 (PwmGeneral):
      PwmDevErrorDetect = true
      PwmDutycycleUpdatedEndperiod = true
      PwmIndex = 0
      PwmNotificationSupported = true
      PwmPeriodUpdatedEndperiod = true
      PwmAlreadyInitDetCheck = true
      PwmClearPendingInterrupts = true
      PwmCriticalSectionProtection = true
      PwmDeviceName = R7F701583
      PwmDiagnosticSupport = true
      PwmPWGARamMirror = DISABLE
      PwmPWGAWriteVerify = WV_DISABLE
      PwmSyncStartSupport = false
      PwmTAUDBRamMirror = DISABLE
      PwmTAUDBWriteVerify = WV_DISABLE
      PwmTAUJRamMirror = DISABLE
      PwmTAUJWriteVerify = WV_DISABLE
      PwmUseWriteVerifyErrorInterface = false
      PwmVersionCheckExternalModules = true
      PwmWriteVerifyErrorInterface = NULL
      PwmPowerStateConfig: PwmPowerState=0, PwmPowerStateReadyCbkRef=NULL
    PwmDemEventParameterRefs0 (PwmDemEventParameterRefs):
      PWM_E_DIAG_FAILURE = DemEventParameter2
      PWM_E_REG_WRITE_VERIFY = DemEventParameter0
      PWM_E_TIMER_FAILURE = DemEventParameter1
      PWM_E_REWRITE_FAILED = DemEventParameter3
      PWM_E_TIMEOUT_FAILURE = DemEventParameter4
package /ActiveEcuC
  module config Can: implementation-config-variant=VARIANT-POST-BUILD, module-description=Can_Impl
    CanConfigSet0 (CanConfigSet): CanControllerPclkClock=McuIsoCan0, CanControllerPplClock=McuClockReferencePoint0, CanControllerMainClock=McuIsoCanosc0
      CanController:
        CanBusoffProcessing = INTERRUPT
        CanControllerActivation = true
        CanControllerBaseAddress = 0
        CanControllerId = 0
        CanControllerSelection = RSCANFD01
        CanEnableCanCanFDGateway = false
        CanEnableTransmitHistoryInterrupt = false
        CanFDBufferMergeMode = false
        CanFDGatewayBRSBit = false
        CanFDGatewayForwardingFormat = CAN_FD_FORMAT
        CanRxProcessing = INTERRUPT
        CanTxProcessing = INTERRUPT
        CanWakeupFunctionalityAPI = false
        CanWakeupProcessing = INTERRUPT
        CanWakeupSupport = false
        CanControllerDefaultBaudrate = CanControllerBaudrateConfig
        CanCpuClockRef = McuClockReferencePoint0
        CanControllerBaudrateConfig:
          CanControllerBaudRate = 500
          CanControllerBaudRateConfigID = 0
          CanControllerPropSeg = 1
          CanControllerSeg1 = 23
          CanControllerSeg2 = 8
          CanControllerSyncJumpWidth = 1
          CanControllerFdBaudrateConfig:
            CanControllerFdBaudRate = 2000
            CanControllerPropSeg = 1
            CanControllerSeg1 = 5
            CanControllerSeg2 = 2
            CanControllerSyncJumpWidth = 1
            CanControllerTxBitRateSwitch = true
      4 x CanHardwareObject, all with CanHandleType=BASIC, CanIdType=STANDARD, CanFdPaddingValue=0, CanControllerRef=CanController:
        CanHardwareObject_Rx0: CanHwObjectCount=8, CanMemoryMode=RECEIVE_FIFO_MODE, CanObjectId=0, CanObjectType=RECEIVE
          CanHwFilter: CanHwFilterCode=0, CanHwFilterDLCCheckValue=0, CanHwFilterMask=0, CanHwFilterReceiveIdType=STANDARD, CanHwFilterSourceNode=FROM_OTHER_NODE
          CanReceiveFIFOConfiguration:
            CanEnableReceiveFIFOInterrupt = true
            CanReceiveFIFOBufferDepth = BUFFER_48
            CanReceiveFIFOPayloadLength = PAYLOAD_64
            CanReceiveFIFOInterruptSrcSel = EACH_MESSAGE
        CanHardwareObject_Rx1: CanHwObjectCount=8, CanMemoryMode=RECEIVE_FIFO_MODE, CanObjectId=1, CanObjectType=RECEIVE
          CanHwFilter: CanHwFilterCode=0, CanHwFilterDLCCheckValue=0, CanHwFilterMask=0, CanHwFilterReceiveIdType=STANDARD, CanHwFilterSourceNode=FROM_OTHER_NODE
          CanReceiveFIFOConfiguration:
            CanEnableReceiveFIFOInterrupt = true
            CanReceiveFIFOBufferDepth = BUFFER_48
            CanReceiveFIFOPayloadLength = PAYLOAD_64
            CanReceiveFIFOInterruptSrcSel = EACH_MESSAGE
        CanHardwareObject_Tx0: CanHwObjectCount=4, CanMemoryMode=TRANSMIT_RECEIVE_FIFO_MODE, CanObjectId=2, CanObjectType=TRANSMIT, CanMainFunctionRWPeriodRef=CanMainFunctionRWPeriods
          CanTxRxFIFOConfiguration: CanEnableTxRxFIFOInterrupt=true, CanTxRxFIFOBufferDepth=BUFFER_16, CanTxRxFIFOPayloadLength=PAYLOAD_64, CanTxRxFIFOInterruptSrcSel=EACH_MESSAGE
        CanHardwareObject_Tx1: CanHwObjectCount=4, CanMemoryMode=TRANSMIT_RECEIVE_FIFO_MODE, CanObjectId=3, CanObjectType=TRANSMIT, CanMainFunctionRWPeriodRef=CanMainFunctionRWPeriods
          CanTxRxFIFOConfiguration: CanEnableTxRxFIFOInterrupt=true, CanTxRxFIFOBufferDepth=BUFFER_16, CanTxRxFIFOPayloadLength=PAYLOAD_64, CanTxRxFIFOInterruptSrcSel=EACH_MESSAGE
    CanGeneral:
      CanDevErrorDetection = true
      CanIndex = 0
      CanMainFunctionModePeriod = 1
      CanMultiplexedTransmission = false
      CanPublicIcomSupport = false
      CanTimeoutDuration = 10
      CanVersionInfoApi = true
      CanCriticalSectionProtection = true
      CanVersionCheckExternalModules = true
      CanDeviceName = R7F701583
      CanAlreadyInitDetCheck = true
      CanLPduReceiveCalloutFunction = 
      CanMainFunctionBusoffPeriod = 1
      CanMainFunctionWakeupPeriod = 2
      CanSetBaudrateApi = true
      CanEnableClkImmediateValue = false
      CanInterruptConsistencyCheck = true
      CanIsrCategory = CAT2
      CanAutosarVersion = R4_2_2
      CanRamMirror = ENABLE
      CanUseWriteVerifyErrorInterface = false
      CanWakeUpFactorClearIsr = true
      CanWriteVerify = WV_DISABLE
      CanRamTest = true
      CanControllerIdOffset = 0
      CanSupportTTCANRef = CanIfPrivateCfg
      CanOsCounterRef = OsCounter0
      CanMainFunctionRWPeriods: CanMainFunctionPeriod=1
    CanGlobalConfiguration:
      CanHardwareUnitSelect = RSCANFD0
      CanClockSourceSelect = CLK_XINCAN
      CanIntervalTimerPrescalerSet = 8
      CanMirrorFunctionSupport = false
      CanEnableDLCCheck = true
      CanTransmitPrioritySelect = DEPEND_ON_ID
      CanPayloadOverflowModeSelect = DISCARD
    CanDemEventParameterRefs: CAN_E_TIMEOUT_FAILURE=DemEventParameter0, CAN_E_INT_INCONSISTENT=DemEventParameter0, CAN_E_TX_HISTORY_OVERFLOW=DemEventParameter0
  module config Fls: implementation-config-variant=VARIANT-PRE-COMPILE, module-description=Fls_Impl
    FlsConfigSet:
      FlsAcErase = 0
      FlsAcWrite = 0
      FlsCallCycle = 0.000001
      FlsDefaultMode = MEMIF_MODE_SLOW
      FlsMaxEraseNormalMode = 64
      FlsMaxReadFastMode = 20
      FlsMaxReadNormalMode = 4
      FlsMaxWriteFastMode = 4
      FlsMaxWriteNormalMode = 4
      FlsProtection = 0
      FlsJobEndNotification = JobOkNotification
      FlsJobErrorNotification = JobErrorNotification
      FlsTimeOutCountValue = 10000
      FlsSectorList
        FlsSector: FlsNumberOfSectors=1024, FlsPageSize=4, FlsSectorIndex=0, FlsSectorSize=64, FlsSectorStartaddress=0
    FlsGeneral:
      FlsAcLoadOnJobStart = true
      FlsBaseAddress = 4280287232
      FlsBlankCheckApi = false
      FlsCancelApi = true
      FlsCompareApi = true
      FlsCriticalSectionProtection = true
      FlsDevErrorDetect = true
      FlsDeviceName = R7F701583
      FlsDriverIndex = 0
      FlsEccNotificationInitCheck = true
      FlsFcuWaitCount = 32
      FlsGetJobResultApi = true
      FlsGetStatusApi = true
      FlsRAMMirror = MIRROR_DISABLE
      FlsSetModeApi = true
      FlsTimeoutMonitoring = true
      FlsTotalSize = 65536
      FlsUseInterrupts = false
      FlsUseWriteVerifyErrorInterface = true
      FlsVersionCheckExternalModules = true
      FlsVersionInfoApi = true
      FlsVirtualBoundaryAddress = 65536
      FlsWriteVerify = WV_DISABLE
      FlsUseFlashControllerHook = false
      FlsDataFlash:
        FlsDataFlashSize = 65536
        FlsDFBaseAddress = 4280287232
        FlsDFBlockSize = 64
        FlsDFTotalBlocks = 1024
        FlsReadImmediateApi = true
        FlsResumeApi = true
        FlsSuspendApi = true
        FlsEccDedNotification = EccDedNotification
        FlsEccSedNotification = EccSedNotification
        FlsCpuFrequency = McuClockSettingConfig0
    FlsPublishedInformation:
      FlsAcLocationErase = 0
      FlsAcLocationWrite = 0
      FlsAcSizeErase = 0
      FlsAcSizeWrite = 0
      FlsBlankCheckTime = 0.000213
      FlsCancelTime = 0.00005
      FlsErasedValue = 4294967295
      FlsEraseTime = 0.01
      FlsExpectedHwId = NULL
      FlsSpecifiedEraseCycles = 125000
      FlsSuspendTime = 0.0003
      FlsWriteTime = 0.0017
  module config Gpt: implementation-config-variant=VARIANT-POST-BUILD, module-description=Gpt_Impl
    GptDriverConfiguration:
      GptDevErrorDetect = false
      GptPredefTimer100us32bitEnable = true
      GptPredefTimer1usEnablingGrade = GPT_PREDEF_TIMER_1US_16_24_32BIT_ENABLED
      GptPredefTimerHarwareUnitSelection = OSTM4
      GptReportWakeupSource = false
      GptCriticalSectionProtection = true
      GptDeviceName = R7F701583
      GptClearPendingInterrupts = true
      GptVersionCheckExternalModules = true
      GptAlreadyInitDetCheck = true
      GptTimerOutputEnable = true
      GptOSTMWriteVerify = WV_INIT_RUNTIME
      GptTAUDBWriteVerify = WV_INIT_RUNTIME
      GptTAUJWriteVerify = WV_INIT_RUNTIME
      GptWUFWriteVerify = WV_DISABLE
      GptOSTMRamMirror = ENABLE
      GptTAUDBRamMirror = ENABLE
      GptTAUJRamMirror = ENABLE
      GptUseWriteVerifyErrorInterface = true
      GptWakeUpFactorClearIsr = false
      GptWriteVerifyErrorInterface = Gpt_WriteVerifyErrorCallback
      CpuClkFreqRefImmediateValue = 16000000
      GptEnableClkImmediateValue = false
      GptTimeOutWaitingTime = 2
      GptOSTMClkRefPoint = McuClockReferencePoint0
      GptClockReferencePoint: GptClockReference=McuClockReferencePoint0, CpuClockFrequencyRef=McuClockSettingConfig0
    GptConfigurationOfOptApiServices:
      GptDeinitApi = true
      GptEnableDisableNotificationApi = true
      GptTimeElapsedApi = true
      GptTimeRemainingApi = true
      GptVersionInfoApi = true
      GptWakeupFunctionalityApi = false
    GptChannelConfigSet0 (GptChannelConfigSet)
      GptChannelConfiguration0 (GptChannelConfiguration):
        GptChannelId = 0
        GptTimerInputSelection = TAUD0I9
        GptChannelMode = GPT_CH_MODE_CONTINUOUS
        GptChannelTickFrequency = 0
        GptChannelTickValueMax = 0
        GptEnableWakeup = false
        GptChannelClk = CK0
        GptNotification = Gpt_Notification_0
        GptChannelClkSrcRef = GptClockReferencePoint
      3 x GptTaUnit, all with GptPrescalerCk3BaudRate=255:
        GptTaUnit0: GptTaUnitSelection=TAUD0, GptPrescalerCk0=PCLK_DIVBY_2_POWOF_02, GptPrescalerCk1=PCLK_DIVBY_2_POWOF_02, GptPrescalerCk2=PCLK_DIVBY_2_POWOF_02, GptPrescalerCk3Pre=PCLK_DIVBY_2_POWOF_02, GptTauUnitClkRefPoint=McuIsoPeri10
        GptTaUnit1: GptTaUnitSelection=TAUB0, GptPrescalerCk0=PCLK_DIVBY_2_POWOF_04, GptPrescalerCk1=PCLK_DIVBY_2_POWOF_05, GptPrescalerCk2=PCLK_DIVBY_2_POWOF_09, GptPrescalerCk3Pre=PCLK_DIVBY_2_POWOF_15, GptTauUnitClkRefPoint=McuIsoPeri10
        GptTaUnit2: GptTaUnitSelection=TAUJ0, GptPrescalerCk0=PCLK_DIVBY_2_POWOF_15, GptPrescalerCk1=PCLK_DIVBY_2_POWOF_15, GptPrescalerCk2=PCLK_DIVBY_2_POWOF_15, GptPrescalerCk3Pre=PCLK_DIVBY_2_POWOF_15, GptTauUnitClkRefPoint=McuAwoTauj0
      7 x GptChannelConfiguration, all with GptChannelMode=GPT_CH_MODE_CONTINUOUS, GptChannelTickFrequency=0, GptChannelTickValueMax=0, GptEnableWakeup=false, GptChannelClk=CK0, GptChannelClkSrcRef=GptClockReferencePoint:
        GptChannelConfiguration1: GptChannelId=1, GptTimerInputSelection=TAUD0I8, GptNotification=NULL
        GptChannelConfiguration2: GptChannelId=2, GptTimerInputSelection=TAUB0I12, GptNotification=Gpt_Notification_1
        GptChannelConfiguration3: GptChannelId=3, GptTimerInputSelection=TAUJ0I0, GptNotification=Gpt_Notification_2
        GptChannelConfiguration4: GptChannelId=4, GptTimerInputSelection=OSTM0, GptNotification=Gpt_Notification_0
        GptChannelConfiguration5: GptChannelId=5, GptTimerInputSelection=OSTM1, GptNotification=Gpt_Notification_0
        GptChannelConfiguration6: GptChannelId=6, GptTimerInputSelection=OSTM2, GptNotification=Gpt_Notification_0
        GptChannelConfiguration7: GptChannelId=7, GptTimerInputSelection=OSTM3, GptNotification=Gpt_Notification_0
    GptDemEventParameterRefs: GPT_E_TIMEOUT_FAILURE=DemEventParameter0, GPT_E_REG_WRITE_VERIFY=DemEventParameter1
  module config Os: implementation-config-variant=VARIANT-PRE-COMPILE
    OsAppMode
    OsOS: OsStackMonitoring=false, OsStatus=STANDARD, OsUseGetServiceId=false, OsUseParameterAccess=false, OsUseResScheduler=true
      OsHooks: OsErrorHook=false, OsPostTaskHook=false, OsPreTaskHook=false, OsShutdownHook=false, OsStartupHook=false, OsProtectionHook=false
    OsCounter: OsCounterMaxAllowedValue=200, OsCounterMinCycle=1, OsCounterTicksPerBase=1, OsCounterType=SOFTWARE, OsSecondsPerTick=0
    OsAlarm: OsAlarmCounterRef=OsCounter
      OsAlarmAction
        OsAlarmActivateTask: OsAlarmActivateTaskRef=OsTask
    OsTask: OsTaskActivation=1, OsTaskPriority=1, OsTaskSchedule=FULL
  module config WdgB: definition=Wdg, implementation-config-variant=VARIANT-POST-BUILD, module-description=Wdg_Impl
    WdgGeneral1 (WdgGeneral):
      WdgCriticalSectionProtection = true
      WdgDevErrorDetect = false
      WdgDeviceName = R7F701587
      WdgDisableAllowed = false
      WdgEnableClkImmediateValue = false
      WdgErrorModeSetting = WDG_RESET_MODE
      WdgIndex = 1
      WdgInitialTimeout = 1
      WdgMaxTimeout = 5
      WdgRamMirror = ENABLE
      WdgRunArea = RAM
      WdgTriggerLocation = NULL
      WdgUseWriteVerifyErrorInterface = false
      WdgVaryingActivationCodeMode = DISABLE
      WdgVersionCheckExternalModules = false
      WdgVersionInfoApi = false
      WdgWakeUpFactorClearIsr = false
      WdgWindowSizeSelection = SIZE_100_PERCENT
      WdgWriteVerify = WV_DISABLE
      WdgClockRefImmediateValue = WDTATCKI_240000Hz
      WdgClockRef = McuIsoLrosc0
    WdgPublishedInformation: WdgTriggerMode=WDG_WINDOW
    WdgSettingsConfig: WdgDefaultMode=WDGIF_SLOW_MODE
      WdgSettingsFast: WdgClkSettingsFast=WDGCLK_DIVBY_2POWOF_9
      WdgSettingsOff
      WdgSettingsSlow: WdgClkSettingsSlow=WDGCLK_DIVBY_2POWOF_16
  module config Wdg: implementation-config-variant=VARIANT-POST-BUILD, module-description=Wdg_Impl
    WdgGeneral:
      WdgCriticalSectionProtection = true
      WdgDevErrorDetect = false
      WdgDeviceName = R7F701583
      WdgDisableAllowed = true
      WdgEnableClkImmediateValue = false
      WdgErrorModeSetting = WDG_RESET_MODE
      WdgIndex = 0
      WdgInitialTimeout = 1
      WdgMaxTimeout = 5
      WdgRamMirror = ENABLE
      WdgRunArea = RAM
      WdgTriggerLocation = NULL
      WdgUseWriteVerifyErrorInterface = false
      WdgVaryingActivationCodeMode = DISABLE
      WdgVersionCheckExternalModules = true
      WdgVersionInfoApi = false
      WdgWakeUpFactorClearIsr = false
      WdgWindowSizeSelection = SIZE_100_PERCENT
      WdgWriteVerify = WV_DISABLE
      WdgClockRefImmediateValue = WDTATCKI_1875Hz
      WdgClockRef = McuAwoWdta0
    WdgPublishedInformation: WdgTriggerMode=WDG_WINDOW
    WdgSettingsConfig: WdgDefaultMode=WDGIF_SLOW_MODE
      WdgSettingsFast: WdgClkSettingsFast=WDGCLK_DIVBY_2POWOF_9
      WdgSettingsOff
      WdgSettingsSlow: WdgClkSettingsSlow=WDGCLK_DIVBY_2POWOF_16
