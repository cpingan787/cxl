AUTOSAR XML (schema 00049)
package /ActiveEcuC
  module config Can: implementation-config-variant=VARIANT-POST-BUILD, module-description=Can_Impl
    CanConfigSet0 (CanConfigSet): CanControllerPclkClock=McuIsoCan0, CanControllerPplClock=McuClockReferencePoint0, CanControllerMainClock=McuIsoCanosc0
      CanController:
        CanBusoffProcessing = INTERRUPT
        CanControllerActivation = true
        CanControllerBaseAddress = 0
        CanControllerId = 0
        CanControllerSelection = RSCANFD01
        CanEnableCanCanFDGateway = false
        CanEnableTransmitHistoryInterrupt = false
        CanFDBufferMergeMode = false
        CanFDGatewayBRSBit = false
        CanFDGatewayForwardingFormat = CAN_FD_FORMAT
        CanRxProcessing = INTERRUPT
        CanTxProcessing = INTERRUPT
        CanWakeupFunctionalityAPI = false
        CanWakeupProcessing = INTERRUPT
        CanWakeupSupport = false
        CanControllerDefaultBaudrate = CanControllerBaudrateConfig
        CanCpuClockRef = McuClockReferencePoint0
        CanControllerBaudrateConfig:
          CanControllerBaudRate = 500
          CanControllerBaudRateConfigID = 0
          CanControllerPropSeg = 1
          CanControllerSeg1 = 23
          CanControllerSeg2 = 8
          CanControllerSyncJumpWidth = 1
          CanControllerFdBaudrateConfig:
            CanControllerFdBaudRate = 2000
            CanControllerPropSeg = 1
            CanControllerSeg1 = 5
            CanControllerSeg2 = 2
            CanControllerSyncJumpWidth = 1
            CanControllerTxBitRateSwitch = true
      4 x CanHardwareObject, all with CanHandleType=BASIC, CanIdType=STANDARD, CanFdPaddingValue=0, CanControllerRef=CanController:
        CanHardwareObject_Rx0: CanHwObjectCount=8, CanMemoryMode=RECEIVE_FIFO_MODE, CanObjectId=0, CanObjectType=RECEIVE
          CanHwFilter: CanHwFilterCode=0, CanHwFilterDLCCheckValue=0, CanHwFilterMask=0, CanHwFilterReceiveIdType=STANDARD, CanHwFilterSourceNode=FROM_OTHER_NODE
          CanReceiveFIFOConfiguration:
            CanEnableReceiveFIFOInterrupt = true
            CanReceiveFIFOBufferDepth = BUFFER_48
            CanReceiveFIFOPayloadLength = PAYLOAD_64
            CanReceiveFIFOInterruptSrcSel = EACH_MESSAGE
        CanHardwareObject_Rx1: CanHwObjectCount=8, CanMemoryMode=RECEIVE_FIFO_MODE, CanObjectId=1, CanObjectType=RECEIVE
          CanHwFilter: CanHwFilterCode=0, CanHwFilterDLCCheckValue=0, CanHwFilterMask=0, CanHwFilterReceiveIdType=STANDARD, CanHwFilterSourceNode=FROM_OTHER_NODE
          CanReceiveFIFOConfiguration:
            CanEnableReceiveFIFOInterrupt = true
            CanReceiveFIFOBufferDepth = BUFFER_48
            CanReceiveFIFOPayloadLength = PAYLOAD_64
            CanReceiveFIFOInterruptSrcSel = EACH_MESSAGE
        CanHardwareObject_Tx0: CanHwObjectCount=4, CanMemoryMode=TRANSMIT_RECEIVE_FIFO_MODE, CanObjectId=2, CanObjectType=TRANSMIT, CanMainFunctionRWPeriodRef=CanMainFunctionRWPeriods
          CanTxRxFIFOConfiguration: CanEnableTxRxFIFOInterrupt=true, CanTxRxFIFOBufferDepth=BUFFER_16, CanTxRxFIFOPayloadLength=PAYLOAD_64, CanTxRxFIFOInterruptSrcSel=EACH_MESSAGE
        CanHardwareObject_Tx1: CanHwObjectCount=4, CanMemoryMode=TRANSMIT_RECEIVE_FIFO_MODE, CanObjectId=3, CanObjectType=TRANSMIT, CanMainFunctionRWPeriodRef=CanMainFunctionRWPeriods
          CanTxRxFIFOConfiguration: CanEnableTxRxFIFOInterrupt=true, CanTxRxFIFOBufferDepth=BUFFER_16, CanTxRxFIFOPayloadLength=PAYLOAD_64, CanTxRxFIFOInterruptSrcSel=EACH_MESSAGE
    CanGeneral:
      CanDevErrorDetection = true
      CanIndex = 0
      CanMainFunctionModePeriod = 1
      CanMultiplexedTransmission = false
      CanPublicIcomSupport = false
      CanTimeoutDuration = 10
      CanVersionInfoApi = true
      CanCriticalSectionProtection = true
      CanVersionCheckExternalModules = true
      CanDeviceName = R7F701583
      CanAlreadyInitDetCheck = true
      CanLPduReceiveCalloutFunction = 
      CanMainFunctionBusoffPeriod = 1
      CanMainFunctionWakeupPeriod = 2
      CanSetBaudrateApi = true
      CanEnableClkImmediateValue = false
      CanInterruptConsistencyCheck = true
      CanIsrCategory = CAT2
      CanAutosarVersion = R4_2_2
      CanRamMirror = ENABLE
      CanUseWriteVerifyErrorInterface = false
      CanWakeUpFactorClearIsr = true
      CanWriteVerify = WV_DISABLE
      CanRamTest = true
      CanControllerIdOffset = 0
      CanSupportTTCANRef = CanIfPrivateCfg
      CanOsCounterRef = OsCounter0
      CanMainFunctionRWPeriods: CanMainFunctionPeriod=1
    CanGlobalConfiguration:
      CanHardwareUnitSelect = RSCANFD0
      CanClockSourceSelect = CLK_XINCAN
      CanIntervalTimerPrescalerSet = 8
      CanMirrorFunctionSupport = false
      CanEnableDLCCheck = true
      CanTransmitPrioritySelect = DEPEND_ON_ID
      CanPayloadOverflowModeSelect = DISCARD
    CanDemEventParameterRefs: CAN_E_TIMEOUT_FAILURE=DemEventParameter0, CAN_E_INT_INCONSISTENT=DemEventParameter0, CAN_E_TX_HISTORY_OVERFLOW=DemEventParameter0
