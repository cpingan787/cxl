AUTOSAR XML (schema 4-2-2)
# COPYRIGHT
# Copyright(c) 2016 - 2021 Renesas Electronics Corporation
package /Renesas/ModuleDescription_Icu
  bsw implementation Icu_Impl: programming-language=C, sw-version=1.1.8, vendor-id=59, ar-release-version=4.2.2, behavior=BswInternalBehavior_0, vendor-specific-module-def=Icu
    code-descriptors:
      code Icu_Code: artifact-descriptors=[{short-label=Icu.c, category=SWSRC}, {short-label=Icu.h, category=SWHDR}]
    resource consumption ResourceConsumption
      8 x memory section:
        VAR_INIT_BOOLEAN: sw-addrmethod=VAR
        VAR_NO_INIT_32: sw-addrmethod=VAR
        VAR_NO_INIT_UNSPECIFIED: sw-addrmethod=VAR
        CONFIG_DATA_UNSPECIFIED: sw-addrmethod=CONFIG_DATA
        PUBLIC_CODE: sw-addrmethod=CODE
        PRIVATE_CODE: sw-addrmethod=CODE
        APPL_CODE: sw-addrmethod=CODE
        CODE_FAST: sw-addrmethod=CODE
  bsw module description Icu: module-id=122
    provided-entrys:
      Icu_Init
      Icu_DeInit
      Icu_SetMode
      Icu_DisableWakeup
      Icu_EnableWakeup
      Icu_CheckWakeup
      Icu_SetActivationCondition
      Icu_DisableNotification
      Icu_EnableNotification
      Icu_GetInputState
      Icu_StartTimestamp
      Icu_StopTimestamp
      Icu_GetTimestampIndex
      Icu_ResetEdgeCount
      Icu_EnableEdgeCount
      Icu_DisableEdgeCount
      Icu_EnableEdgeDetection
      Icu_DisableEdgeDetection
      Icu_GetEdgeNumbers
      Icu_StartSignalMeasurement
      Icu_StopSignalMeasurement
      Icu_GetTimeElapsed
      Icu_GetDutyCycleValues
      Icu_GetInputLevel
      Icu_GetTAUInCountValue
      Icu_SynchronousInit
      Icu_SynchronousStart
      Icu_SynchronousStop
      Icu_SynchronousDeInit
      Icu_GetVersionInfo
      Icu_CheckHWConsistency
      EXT_INTP_CH00_ISR
      EXT_INTP_CH00_CAT2_ISR
      EXT_INTP_CH01_ISR
      EXT_INTP_CH01_CAT2_ISR
      EXT_INTP_CH02_ISR
      EXT_INTP_CH02_CAT2_ISR
      EXT_INTP_CH03_ISR
      EXT_INTP_CH03_CAT2_ISR
      EXT_INTP_CH04_ISR
      EXT_INTP_CH04_CAT2_ISR
      EXT_INTP_CH05_ISR
      EXT_INTP_CH05_CAT2_ISR
      EXT_INTP_CH06_ISR
      EXT_INTP_CH06_CAT2_ISR
      EXT_INTP_CH07_ISR
      EXT_INTP_CH07_CAT2_ISR
      EXT_INTP_CH08_ISR
      EXT_INTP_CH08_CAT2_ISR
      EXT_INTP_CH09_ISR
      EXT_INTP_CH09_CAT2_ISR
      EXT_INTP_CH10_ISR
      EXT_INTP_CH10_CAT2_ISR
      EXT_INTP_CH11_ISR
      EXT_INTP_CH11_CAT2_ISR
      EXT_INTP_CH12_ISR
      EXT_INTP_CH12_CAT2_ISR
      EXT_INTP_CH13_ISR
      EXT_INTP_CH13_CAT2_ISR
      EXT_INTP_CH14_ISR
      EXT_INTP_CH14_CAT2_ISR
      EXT_INTP_CH15_ISR
      EXT_INTP_CH15_CAT2_ISR
      EXT_INTP_CH16_ISR
      EXT_INTP_CH16_CAT2_ISR
      EXT_INTP_CH17_ISR
      EXT_INTP_CH17_CAT2_ISR
      EXT_INTP_CH18_ISR
      EXT_INTP_CH18_CAT2_ISR
      EXT_INTP_CH19_ISR
      EXT_INTP_CH19_CAT2_ISR
      EXT_INTP_CH20_ISR
      EXT_INTP_CH20_CAT2_ISR
      EXT_INTP_CH21_ISR
      EXT_INTP_CH21_CAT2_ISR
      EXT_INTP_CH22_ISR
      EXT_INTP_CH22_CAT2_ISR
      EXT_INTP_CH23_ISR
      EXT_INTP_CH23_CAT2_ISR
      TAUD0_CH00_ISR
      TAUD0_CH00_CAT2_ISR
      TAUD0_CH01_ISR
      TAUD0_CH01_CAT2_ISR
      TAUD0_CH02_ISR
      TAUD0_CH02_CAT2_ISR
      TAUD0_CH03_ISR
      TAUD0_CH03_CAT2_ISR
      TAUD0_CH04_ISR
      TAUD0_CH04_CAT2_ISR
      TAUD0_CH05_ISR
      TAUD0_CH05_CAT2_ISR
      TAUD0_CH06_ISR
      TAUD0_CH06_CAT2_ISR
      TAUD0_CH07_ISR
      TAUD0_CH07_CAT2_ISR
      TAUD0_CH08_ISR
      TAUD0_CH08_CAT2_ISR
      TAUD0_CH09_ISR
      TAUD0_CH09_CAT2_ISR
      TAUD0_CH10_ISR
      TAUD0_CH10_CAT2_ISR
      TAUD0_CH11_ISR
      TAUD0_CH11_CAT2_ISR
      TAUD0_CH12_ISR
      TAUD0_CH12_CAT2_ISR
      TAUD0_CH13_ISR
      TAUD0_CH13_CAT2_ISR
      TAUD0_CH14_ISR
      TAUD0_CH14_CAT2_ISR
      TAUD0_CH15_ISR
      TAUD0_CH15_CAT2_ISR
      TAUB0_CH00_ISR
      TAUB0_CH00_CAT2_ISR
      TAUB0_CH01_ISR
      TAUB0_CH01_CAT2_ISR
      TAUB0_CH02_ISR
      TAUB0_CH02_CAT2_ISR
      TAUB0_CH03_ISR
      TAUB0_CH03_CAT2_ISR
      TAUB0_CH04_ISR
      TAUB0_CH04_CAT2_ISR
      TAUB0_CH05_ISR
      TAUB0_CH05_CAT2_ISR
      TAUB0_CH06_ISR
      TAUB0_CH06_CAT2_ISR
      TAUB0_CH07_ISR
      TAUB0_CH07_CAT2_ISR
      TAUB0_CH08_ISR
      TAUB0_CH08_CAT2_ISR
      TAUB0_CH09_ISR
      TAUB0_CH09_CAT2_ISR
      TAUB0_CH10_ISR
      TAUB0_CH10_CAT2_ISR
      TAUB0_CH11_ISR
      TAUB0_CH11_CAT2_ISR
      TAUB0_CH12_ISR
      TAUB0_CH12_CAT2_ISR
      TAUB0_CH13_ISR
      TAUB0_CH13_CAT2_ISR
      TAUB0_CH14_ISR
      TAUB0_CH14_CAT2_ISR
      TAUB0_CH15_ISR
      TAUB0_CH15_CAT2_ISR
      TAUB1_CH00_ISR
      TAUB1_CH00_CAT2_ISR
      TAUB1_CH01_ISR
      TAUB1_CH01_CAT2_ISR
      TAUB1_CH02_ISR
      TAUB1_CH02_CAT2_ISR
      TAUB1_CH03_ISR
      TAUB1_CH03_CAT2_ISR
      TAUB1_CH04_ISR
      TAUB1_CH04_CAT2_ISR
      TAUB1_CH05_ISR
      TAUB1_CH05_CAT2_ISR
      TAUB1_CH06_ISR
      TAUB1_CH06_CAT2_ISR
      TAUB1_CH07_ISR
      TAUB1_CH07_CAT2_ISR
      TAUB1_CH08_ISR
      TAUB1_CH08_CAT2_ISR
      TAUB1_CH09_ISR
      TAUB1_CH09_CAT2_ISR
      TAUB1_CH10_ISR
      TAUB1_CH10_CAT2_ISR
      TAUB1_CH11_ISR
      TAUB1_CH11_CAT2_ISR
      TAUB1_CH12_ISR
      TAUB1_CH12_CAT2_ISR
      TAUB1_CH13_ISR
      TAUB1_CH13_CAT2_ISR
      TAUB1_CH14_ISR
      TAUB1_CH14_CAT2_ISR
      TAUB1_CH15_ISR
      TAUB1_CH15_CAT2_ISR
      TAUJ0_CH00_ISR
      TAUJ0_CH00_CAT2_ISR
      TAUJ0_CH01_ISR
      TAUJ0_CH01_CAT2_ISR
      TAUJ0_CH02_ISR
      TAUJ0_CH02_CAT2_ISR
      TAUJ0_CH03_ISR
      TAUJ0_CH03_CAT2_ISR
      TAUJ1_CH00_ISR
      TAUJ1_CH00_CAT2_ISR
      TAUJ1_CH01_ISR
      TAUJ1_CH01_CAT2_ISR
      TAUJ1_CH02_ISR
      TAUJ1_CH02_CAT2_ISR
      TAUJ1_CH03_ISR
      TAUJ1_CH03_CAT2_ISR
      TAUJ2_CH00_ISR
      TAUJ2_CH00_CAT2_ISR
      TAUJ2_CH01_ISR
      TAUJ2_CH01_CAT2_ISR
      TAUJ2_CH02_ISR
      TAUJ2_CH02_CAT2_ISR
      TAUJ2_CH03_ISR
      TAUJ2_CH03_CAT2_ISR
      TAUJ3_CH00_ISR
      TAUJ3_CH00_CAT2_ISR
      TAUJ3_CH01_ISR
      TAUJ3_CH01_CAT2_ISR
      TAUJ3_CH02_ISR
      TAUJ3_CH02_CAT2_ISR
      TAUJ3_CH03_ISR
      TAUJ3_CH03_CAT2_ISR
    bsw internal behavior BswInternalBehavior_0
      4 x exclusive area:
        ICU_CHANNEL_DATA_PROTECTION
        ICU_TIMESTAMP_DATA_PROTECTION
        ICU_SIGNALMEASURE_DATA_PROTECTION
        ICU_EDGECOUNT_DATA_PROTECTION
      176 x bsw interrupt entity, all with can-enter-exclusive-area=ICU_CHANNEL_DATA_PROTECTION:
        BswInterruptEntity_0: implemented-entry=EXT_INTP_CH00_ISR, interrupt-category=CAT-1, interrupt-source=INTP0
        BswInterruptEntity_1: implemented-entry=EXT_INTP_CH00_CAT2_ISR, interrupt-category=CAT-2, interrupt-source=INTP0
        BswInterruptEntity_2: implemented-entry=EXT_INTP_CH01_ISR, interrupt-category=CAT-1, interrupt-source=INTP1
        BswInterruptEntity_3: implemented-entry=EXT_INTP_CH01_CAT2_ISR, interrupt-category=CAT-2, interrupt-source=INTP1
        BswInterruptEntity_4: implemented-entry=EXT_INTP_CH02_ISR, interrupt-category=CAT-1, interrupt-source=INTP2
        BswInterruptEntity_5: implemented-entry=EXT_INTP_CH02_CAT2_ISR, interrupt-category=CAT-2, interrupt-source=INTP2
        BswInterruptEntity_6: implemented-entry=EXT_INTP_CH03_ISR, interrupt-category=CAT-1, interrupt-source=INTP3
        BswInterruptEntity_7: implemented-entry=EXT_INTP_CH03_CAT2_ISR, interrupt-category=CAT-2, interrupt-source=INTP3
        BswInterruptEntity_8: implemented-entry=EXT_INTP_CH04_ISR, interrupt-category=CAT-1, interrupt-source=INTP4
        BswInterruptEntity_9: implemented-entry=EXT_INTP_CH04_CAT2_ISR, interrupt-category=CAT-2, interrupt-source=INTP4
        BswInterruptEntity_10: implemented-entry=EXT_INTP_CH05_ISR, interrupt-category=CAT-1, interrupt-source=INTP5
        BswInterruptEntity_11: implemented-entry=EXT_INTP_CH05_CAT2_ISR, interrupt-category=CAT-2, interrupt-source=INTP5
        BswInterruptEntity_12: implemented-entry=EXT_INTP_CH06_ISR, interrupt-category=CAT-1, interrupt-source=INTP6
        BswInterruptEntity_13: implemented-entry=EXT_INTP_CH06_CAT2_ISR, interrupt-category=CAT-2, interrupt-source=INTP6
        BswInterruptEntity_14: implemented-entry=EXT_INTP_CH07_ISR, interrupt-category=CAT-1, interrupt-source=INTP7
        BswInterruptEntity_15: implemented-entry=EXT_INTP_CH07_CAT2_ISR, interrupt-category=CAT-2, interrupt-source=INTP7
        BswInterruptEntity_16: implemented-entry=EXT_INTP_CH08_ISR, interrupt-category=CAT-1, interrupt-source=INTP8
        BswInterruptEntity_17: implemented-entry=EXT_INTP_CH08_CAT2_ISR, interrupt-category=CAT-2, interrupt-source=INTP8
        BswInterruptEntity_18: implemented-entry=EXT_INTP_CH09_ISR, interrupt-category=CAT-1, interrupt-source=INTP9
        BswInterruptEntity_19: implemented-entry=EXT_INTP_CH09_CAT2_ISR, interrupt-category=CAT-2, interrupt-source=INTP9
        BswInterruptEntity_20: implemented-entry=EXT_INTP_CH10_ISR, interrupt-category=CAT-1, interrupt-source=INTP10
        BswInterruptEntity_21: implemented-entry=EXT_INTP_CH10_CAT2_ISR, interrupt-category=CAT-2, interrupt-source=INTP10
        BswInterruptEntity_22: implemented-entry=EXT_INTP_CH11_ISR, interrupt-category=CAT-1, interrupt-source=INTP11
        BswInterruptEntity_23: implemented-entry=EXT_INTP_CH11_CAT2_ISR, interrupt-category=CAT-2, interrupt-source=INTP11
        BswInterruptEntity_24: implemented-entry=EXT_INTP_CH12_ISR, interrupt-category=CAT-1, interrupt-source=INTP12
        BswInterruptEntity_25: implemented-entry=EXT_INTP_CH12_CAT2_ISR, interrupt-category=CAT-2, interrupt-source=INTP12
        BswInterruptEntity_26: implemented-entry=EXT_INTP_CH13_ISR, interrupt-category=CAT-1, interrupt-source=INTP13
        BswInterruptEntity_27: implemented-entry=EXT_INTP_CH13_CAT2_ISR, interrupt-category=CAT-2, interrupt-source=INTP13
        BswInterruptEntity_28: implemented-entry=EXT_INTP_CH14_ISR, interrupt-category=CAT-1, interrupt-source=INTP14
        BswInterruptEntity_29: implemented-entry=EXT_INTP_CH14_CAT2_ISR, interrupt-category=CAT-2, interrupt-source=INTP14
        BswInterruptEntity_30: implemented-entry=EXT_INTP_CH15_ISR, interrupt-category=CAT-1, interrupt-source=INTP15
        BswInterruptEntity_31: implemented-entry=EXT_INTP_CH15_CAT2_ISR, interrupt-category=CAT-2, interrupt-source=INTP15
        BswInterruptEntity_32: implemented-entry=EXT_INTP_CH16_ISR, interrupt-category=CAT-1, interrupt-source=INTP16
        BswInterruptEntity_33: implemented-entry=EXT_INTP_CH16_CAT2_ISR, interrupt-category=CAT-2, interrupt-source=INTP16
        BswInterruptEntity_34: implemented-entry=EXT_INTP_CH17_ISR, interrupt-category=CAT-1, interrupt-source=INTP17
        BswInterruptEntity_35: implemented-entry=EXT_INTP_CH17_CAT2_ISR, interrupt-category=CAT-2, interrupt-source=INTP17
        BswInterruptEntity_36: implemented-entry=EXT_INTP_CH18_ISR, interrupt-category=CAT-1, interrupt-source=INTP18
        BswInterruptEntity_37: implemented-entry=EXT_INTP_CH18_CAT2_ISR, interrupt-category=CAT-2, interrupt-source=INTP18
        BswInterruptEntity_38: implemented-entry=EXT_INTP_CH19_ISR, interrupt-category=CAT-1, interrupt-source=INTP19
        BswInterruptEntity_39: implemented-entry=EXT_INTP_CH19_CAT2_ISR, interrupt-category=CAT-2, interrupt-source=INTP19
        BswInterruptEntity_40: implemented-entry=EXT_INTP_CH20_ISR, interrupt-category=CAT-1, interrupt-source=INTP20
        BswInterruptEntity_41: implemented-entry=EXT_INTP_CH20_CAT2_ISR, interrupt-category=CAT-2, interrupt-source=INTP20
        BswInterruptEntity_42: implemented-entry=EXT_INTP_CH21_ISR, interrupt-category=CAT-1, interrupt-source=INTP21
        BswInterruptEntity_43: implemented-entry=EXT_INTP_CH21_CAT2_ISR, interrupt-category=CAT-2, interrupt-source=INTP21
        BswInterruptEntity_44: implemented-entry=EXT_INTP_CH22_ISR, interrupt-category=CAT-1, interrupt-source=INTP22
        BswInterruptEntity_45: implemented-entry=EXT_INTP_CH22_CAT2_ISR, interrupt-category=CAT-2, interrupt-source=INTP22
        BswInterruptEntity_46: implemented-entry=EXT_INTP_CH23_ISR, interrupt-category=CAT-1, interrupt-source=INTP23
        BswInterruptEntity_47: implemented-entry=EXT_INTP_CH23_CAT2_ISR, interrupt-category=CAT-2, interrupt-source=INTP23
        BswInterruptEntity_48: implemented-entry=TAUD0_CH00_ISR, interrupt-category=CAT-1, interrupt-source=ICTAUD0I0
        BswInterruptEntity_49: implemented-entry=TAUD0_CH00_CAT2_ISR, interrupt-category=CAT-2, interrupt-source=ICTAUD0I0
        BswInterruptEntity_50: implemented-entry=TAUD0_CH01_ISR, interrupt-category=CAT-1, interrupt-source=ICTAUD0I1
        BswInterruptEntity_51: implemented-entry=TAUD0_CH01_CAT2_ISR, interrupt-category=CAT-2, interrupt-source=ICTAUD0I1
        BswInterruptEntity_52: implemented-entry=TAUD0_CH02_ISR, interrupt-category=CAT-1, interrupt-source=ICTAUD0I2
        BswInterruptEntity_53: implemented-entry=TAUD0_CH02_CAT2_ISR, interrupt-category=CAT-2, interrupt-source=ICTAUD0I2
        BswInterruptEntity_54: implemented-entry=TAUD0_CH03_ISR, interrupt-category=CAT-1, interrupt-source=ICTAUD0I3
        BswInterruptEntity_55: implemented-entry=TAUD0_CH03_CAT2_ISR, interrupt-category=CAT-2, interrupt-source=ICTAUD0I3
        BswInterruptEntity_56: implemented-entry=TAUD0_CH04_ISR, interrupt-category=CAT-1, interrupt-source=ICTAUD0I4
        BswInterruptEntity_57: implemented-entry=TAUD0_CH04_CAT2_ISR, interrupt-category=CAT-2, interrupt-source=ICTAUD0I4
        BswInterruptEntity_58: implemented-entry=TAUD0_CH05_ISR, interrupt-category=CAT-1, interrupt-source=ICTAUD0I5
        BswInterruptEntity_59: implemented-entry=TAUD0_CH05_CAT2_ISR, interrupt-category=CAT-2, interrupt-source=ICTAUD0I5
        BswInterruptEntity_60: implemented-entry=TAUD0_CH06_ISR, interrupt-category=CAT-1, interrupt-source=ICTAUD0I6
        BswInterruptEntity_61: implemented-entry=TAUD0_CH06_CAT2_ISR, interrupt-category=CAT-2, interrupt-source=ICTAUD0I6
        BswInterruptEntity_62: implemented-entry=TAUD0_CH07_ISR, interrupt-category=CAT-1, interrupt-source=ICTAUD0I7
        BswInterruptEntity_63: implemented-entry=TAUD0_CH07_CAT2_ISR, interrupt-category=CAT-2, interrupt-source=ICTAUD0I7
        BswInterruptEntity_64: implemented-entry=TAUD0_CH08_ISR, interrupt-category=CAT-1, interrupt-source=ICTAUD0I8
        BswInterruptEntity_65: implemented-entry=TAUD0_CH08_CAT2_ISR, interrupt-category=CAT-2, interrupt-source=ICTAUD0I8
        BswInterruptEntity_66: implemented-entry=TAUD0_CH09_ISR, interrupt-category=CAT-1, interrupt-source=ICTAUD0I9
        BswInterruptEntity_67: implemented-entry=TAUD0_CH09_CAT2_ISR, interrupt-category=CAT-2, interrupt-source=ICTAUD0I9
        BswInterruptEntity_68: implemented-entry=TAUD0_CH10_ISR, interrupt-category=CAT-1, interrupt-source=ICTAUD0I10
        BswInterruptEntity_69: implemented-entry=TAUD0_CH10_CAT2_ISR, interrupt-category=CAT-2, interrupt-source=ICTAUD0I10
        BswInterruptEntity_70: implemented-entry=TAUD0_CH11_ISR, interrupt-category=CAT-1, interrupt-source=ICTAUD0I11
        BswInterruptEntity_71: implemented-entry=TAUD0_CH11_CAT2_ISR, interrupt-category=CAT-2, interrupt-source=ICTAUD0I11
        BswInterruptEntity_72: implemented-entry=TAUD0_CH12_ISR, interrupt-category=CAT-1, interrupt-source=ICTAUD0I12
        BswInterruptEntity_73: implemented-entry=TAUD0_CH12_CAT2_ISR, interrupt-category=CAT-2, interrupt-source=ICTAUD0I12
        BswInterruptEntity_74: implemented-entry=TAUD0_CH13_ISR, interrupt-category=CAT-1, interrupt-source=ICTAUD0I13
        BswInterruptEntity_75: implemented-entry=TAUD0_CH13_CAT2_ISR, interrupt-category=CAT-2, interrupt-source=ICTAUD0I13
        BswInterruptEntity_76: implemented-entry=TAUD0_CH14_ISR, interrupt-category=CAT-1, interrupt-source=ICTAUD0I14
        BswInterruptEntity_77: implemented-entry=TAUD0_CH14_CAT2_ISR, interrupt-category=CAT-2, interrupt-source=ICTAUD0I14
        BswInterruptEntity_78: implemented-entry=TAUD0_CH15_ISR, interrupt-category=CAT-1, interrupt-source=ICTAUD0I15
        BswInterruptEntity_79: implemented-entry=TAUD0_CH15_CAT2_ISR, interrupt-category=CAT-2, interrupt-source=ICTAUD0I15
        BswInterruptEntity_80: implemented-entry=TAUB0_CH00_ISR, interrupt-category=CAT-1, interrupt-source=ICTAUB0I0
        BswInterruptEntity_81: implemented-entry=TAUB0_CH00_CAT2_ISR, interrupt-category=CAT-2, interrupt-source=ICTAUB0I0
        BswInterruptEntity_82: implemented-entry=TAUB0_CH01_ISR, interrupt-category=CAT-1, interrupt-source=ICTAUB0I1
        BswInterruptEntity_83: implemented-entry=TAUB0_CH01_CAT2_ISR, interrupt-category=CAT-2, interrupt-source=ICTAUB0I1
        BswInterruptEntity_84: implemented-entry=TAUB0_CH02_ISR, interrupt-category=CAT-1, interrupt-source=ICTAUB0I2
        BswInterruptEntity_85: implemented-entry=TAUB0_CH02_CAT2_ISR, interrupt-category=CAT-2, interrupt-source=ICTAUB0I2
        BswInterruptEntity_86: implemented-entry=TAUB0_CH03_ISR, interrupt-category=CAT-1, interrupt-source=ICTAUB0I3
        BswInterruptEntity_87: implemented-entry=TAUB0_CH03_CAT2_ISR, interrupt-category=CAT-2, interrupt-source=ICTAUB0I3
        BswInterruptEntity_88: implemented-entry=TAUB0_CH04_ISR, interrupt-category=CAT-1, interrupt-source=ICTAUB0I4
        BswInterruptEntity_89: implemented-entry=TAUB0_CH04_CAT2_ISR, interrupt-category=CAT-2, interrupt-source=ICTAUB0I4
        BswInterruptEntity_90: implemented-entry=TAUB0_CH05_ISR, interrupt-category=CAT-1, interrupt-source=ICTAUB0I5
        BswInterruptEntity_91: implemented-entry=TAUB0_CH05_CAT2_ISR, interrupt-category=CAT-2, interrupt-source=ICTAUB0I5
        BswInterruptEntity_92: implemented-entry=TAUB0_CH06_ISR, interrupt-category=CAT-1, interrupt-source=ICTAUB0I6
        BswInterruptEntity_93: implemented-entry=TAUB0_CH06_CAT2_ISR, interrupt-category=CAT-2, interrupt-source=ICTAUB0I6
        BswInterruptEntity_94: implemented-entry=TAUB0_CH07_ISR, interrupt-category=CAT-1, interrupt-source=ICTAUB0I7
        BswInterruptEntity_95: implemented-entry=TAUB0_CH07_CAT2_ISR, interrupt-category=CAT-2, interrupt-source=ICTAUB0I7
        BswInterruptEntity_96: implemented-entry=TAUB0_CH08_ISR, interrupt-category=CAT-1, interrupt-source=ICTAUB0I8
        BswInterruptEntity_97: implemented-entry=TAUB0_CH08_CAT2_ISR, interrupt-category=CAT-2, interrupt-source=ICTAUB0I8
        BswInterruptEntity_98: implemented-entry=TAUB0_CH09_ISR, interrupt-category=CAT-1, interrupt-source=ICTAUB0I9
        BswInterruptEntity_99: implemented-entry=TAUB0_CH09_CAT2_ISR, interrupt-category=CAT-2, interrupt-source=ICTAUB0I9
        BswInterruptEntity_100: implemented-entry=TAUB0_CH10_ISR, interrupt-category=CAT-1, interrupt-source=ICTAUB0I10
        BswInterruptEntity_101: implemented-entry=TAUB0_CH10_CAT2_ISR, interrupt-category=CAT-2, interrupt-source=ICTAUB0I10
        BswInterruptEntity_102: implemented-entry=TAUB0_CH11_ISR, interrupt-category=CAT-1, interrupt-source=ICTAUB0I11
        BswInterruptEntity_103: implemented-entry=TAUB0_CH11_CAT2_ISR, interrupt-category=CAT-2, interrupt-source=ICTAUB0I11
        BswInterruptEntity_104: implemented-entry=TAUB0_CH12_ISR, interrupt-category=CAT-1, interrupt-source=ICTAUB0I12
        BswInterruptEntity_105: implemented-entry=TAUB0_CH12_CAT2_ISR, interrupt-category=CAT-2, interrupt-source=ICTAUB0I12
        BswInterruptEntity_106: implemented-entry=TAUB0_CH13_ISR, interrupt-category=CAT-1, interrupt-source=ICTAUB0I13
        BswInterruptEntity_107: implemented-entry=TAUB0_CH13_CAT2_ISR, interrupt-category=CAT-2, interrupt-source=ICTAUB0I13
        BswInterruptEntity_108: implemented-entry=TAUB0_CH14_ISR, interrupt-category=CAT-1, interrupt-source=ICTAUB0I14
        BswInterruptEntity_109: implemented-entry=TAUB0_CH14_CAT2_ISR, interrupt-category=CAT-2, interrupt-source=ICTAUB0I14
        BswInterruptEntity_110: implemented-entry=TAUB0_CH15_ISR, interrupt-category=CAT-1, interrupt-source=ICTAUB0I15
        BswInterruptEntity_111: implemented-entry=TAUB0_CH15_CAT2_ISR, interrupt-category=CAT-2, interrupt-source=ICTAUB0I15
        BswInterruptEntity_112: implemented-entry=TAUB1_CH00_ISR, interrupt-category=CAT-1, interrupt-source=ICTAUB1I0
        BswInterruptEntity_113: implemented-entry=TAUB1_CH00_CAT2_ISR, interrupt-category=CAT-2, interrupt-source=ICTAUB1I0
        BswInterruptEntity_114: implemented-entry=TAUB1_CH01_ISR, interrupt-category=CAT-1, interrupt-source=ICTAUB1I1
        BswInterruptEntity_115: implemented-entry=TAUB1_CH01_CAT2_ISR, interrupt-category=CAT-2, interrupt-source=ICTAUB1I1
        BswInterruptEntity_116: implemented-entry=TAUB1_CH02_ISR, interrupt-category=CAT-1, interrupt-source=ICTAUB1I2
        BswInterruptEntity_117: implemented-entry=TAUB1_CH02_CAT2_ISR, interrupt-category=CAT-2, interrupt-source=ICTAUB1I2
        BswInterruptEntity_118: implemented-entry=TAUB1_CH03_ISR, interrupt-category=CAT-1, interrupt-source=ICTAUB1I3
        BswInterruptEntity_119: implemented-entry=TAUB1_CH03_CAT2_ISR, interrupt-category=CAT-2, interrupt-source=ICTAUB1I3
        BswInterruptEntity_120: implemented-entry=TAUB1_CH04_ISR, interrupt-category=CAT-1, interrupt-source=ICTAUB1I4
        BswInterruptEntity_121: implemented-entry=TAUB1_CH04_CAT2_ISR, interrupt-category=CAT-2, interrupt-source=ICTAUB1I4
        BswInterruptEntity_122: implemented-entry=TAUB1_CH05_ISR, interrupt-category=CAT-1, interrupt-source=ICTAUB1I5
        BswInterruptEntity_123: implemented-entry=TAUB1_CH05_CAT2_ISR, interrupt-category=CAT-2, interrupt-source=ICTAUB1I5
        BswInterruptEntity_124: implemented-entry=TAUB1_CH06_ISR, interrupt-category=CAT-1, interrupt-source=ICTAUB1I6
        BswInterruptEntity_125: implemented-entry=TAUB1_CH06_CAT2_ISR, interrupt-category=CAT-2, interrupt-source=ICTAUB1I6
        BswInterruptEntity_126: implemented-entry=TAUB1_CH07_ISR, interrupt-category=CAT-1, interrupt-source=ICTAUB1I7
        BswInterruptEntity_127: implemented-entry=TAUB1_CH07_CAT2_ISR, interrupt-category=CAT-2, interrupt-source=ICTAUB1I7
        BswInterruptEntity_128: implemented-entry=TAUB1_CH08_ISR, interrupt-category=CAT-1, interrupt-source=ICTAUB1I8
        BswInterruptEntity_129: implemented-entry=TAUB1_CH08_CAT2_ISR, interrupt-category=CAT-2, interrupt-source=ICTAUB1I8
        BswInterruptEntity_130: implemented-entry=TAUB1_CH09_ISR, interrupt-category=CAT-1, interrupt-source=ICTAUB1I9
        BswInterruptEntity_131: implemented-entry=TAUB1_CH09_CAT2_ISR, interrupt-category=CAT-2, interrupt-source=ICTAUB1I9
        BswInterruptEntity_132: implemented-entry=TAUB1_CH10_ISR, interrupt-category=CAT-1, interrupt-source=ICTAUB1I10
        BswInterruptEntity_133: implemented-entry=TAUB1_CH10_CAT2_ISR, interrupt-category=CAT-2, interrupt-source=ICTAUB1I10
        BswInterruptEntity_134: implemented-entry=TAUB1_CH11_ISR, interrupt-category=CAT-1, interrupt-source=ICTAUB1I11
        BswInterruptEntity_135: implemented-entry=TAUB1_CH11_CAT2_ISR, interrupt-category=CAT-2, interrupt-source=ICTAUB1I11
        BswInterruptEntity_136: implemented-entry=TAUB1_CH12_ISR, interrupt-category=CAT-1, interrupt-source=ICTAUB1I12
        BswInterruptEntity_137: implemented-entry=TAUB1_CH12_CAT2_ISR, interrupt-category=CAT-2, interrupt-source=ICTAUB1I12
        BswInterruptEntity_138: implemented-entry=TAUB1_CH13_ISR, interrupt-category=CAT-1, interrupt-source=ICTAUB1I13
        BswInterruptEntity_139: implemented-entry=TAUB1_CH13_CAT2_ISR, interrupt-category=CAT-2, interrupt-source=ICTAUB1I13
        BswInterruptEntity_140: implemented-entry=TAUB1_CH14_ISR, interrupt-category=CAT-1, interrupt-source=ICTAUB1I14
        BswInterruptEntity_141: implemented-entry=TAUB1_CH14_CAT2_ISR, interrupt-category=CAT-2, interrupt-source=ICTAUB1I14
        BswInterruptEntity_142: implemented-entry=TAUB1_CH15_ISR, interrupt-category=CAT-1, interrupt-source=ICTAUB1I15
        BswInterruptEntity_143: implemented-entry=TAUB1_CH15_CAT2_ISR, interrupt-category=CAT-2, interrupt-source=ICTAUB1I15
        BswInterruptEntity_144: implemented-entry=TAUJ0_CH00_ISR, interrupt-category=CAT-1, interrupt-source=ICTAUJ0I0
        BswInterruptEntity_145: implemented-entry=TAUJ0_CH00_CAT2_ISR, interrupt-category=CAT-2, interrupt-source=ICTAUJ0I0
        BswInterruptEntity_146: implemented-entry=TAUJ0_CH01_ISR, interrupt-category=CAT-1, interrupt-source=ICTAUJ0I1
        BswInterruptEntity_147: implemented-entry=TAUJ0_CH01_CAT2_ISR, interrupt-category=CAT-2, interrupt-source=ICTAUJ0I1
        BswInterruptEntity_148: implemented-entry=TAUJ0_CH02_ISR, interrupt-category=CAT-1, interrupt-source=ICTAUJ0I2
        BswInterruptEntity_149: implemented-entry=TAUJ0_CH02_CAT2_ISR, interrupt-category=CAT-2, interrupt-source=ICTAUJ0I2
        BswInterruptEntity_150: implemented-entry=TAUJ0_CH03_ISR, interrupt-category=CAT-1, interrupt-source=ICTAUJ0I3
        BswInterruptEntity_151: implemented-entry=TAUJ0_CH03_CAT2_ISR, interrupt-category=CAT-2, interrupt-source=ICTAUJ0I3
        BswInterruptEntity_152: implemented-entry=TAUJ1_CH00_ISR, interrupt-category=CAT-1, interrupt-source=ICTAUJ1I0
        BswInterruptEntity_153: implemented-entry=TAUJ1_CH00_CAT2_ISR, interrupt-category=CAT-2, interrupt-source=ICTAUJ1I0
        BswInterruptEntity_154: implemented-entry=TAUJ1_CH01_ISR, interrupt-category=CAT-1, interrupt-source=ICTAUJ1I1
        BswInterruptEntity_155: implemented-entry=TAUJ1_CH01_CAT2_ISR, interrupt-category=CAT-2, interrupt-source=ICTAUJ1I1
        BswInterruptEntity_156: implemented-entry=TAUJ1_CH02_ISR, interrupt-category=CAT-1, interrupt-source=ICTAUJ1I2
        BswInterruptEntity_157: implemented-entry=TAUJ1_CH02_CAT2_ISR, interrupt-category=CAT-2, interrupt-source=ICTAUJ1I2
        BswInterruptEntity_158: implemented-entry=TAUJ1_CH03_ISR, interrupt-category=CAT-1, interrupt-source=ICTAUJ1I3
        BswInterruptEntity_159: implemented-entry=TAUJ1_CH03_CAT2_ISR, interrupt-category=CAT-2, interrupt-source=ICTAUJ1I3
        BswInterruptEntity_160: implemented-entry=TAUJ2_CH00_ISR, interrupt-category=CAT-1, interrupt-source=ICTAUJ2I0
        BswInterruptEntity_161: implemented-entry=TAUJ2_CH00_CAT2_ISR, interrupt-category=CAT-2, interrupt-source=ICTAUJ2I0
        BswInterruptEntity_162: implemented-entry=TAUJ2_CH01_ISR, interrupt-category=CAT-1, interrupt-source=ICTAUJ2I1
        BswInterruptEntity_163: implemented-entry=TAUJ2_CH01_CAT2_ISR, interrupt-category=CAT-2, interrupt-source=ICTAUJ2I1
        BswInterruptEntity_164: implemented-entry=TAUJ2_CH02_ISR, interrupt-category=CAT-1, interrupt-source=ICTAUJ2I2
        BswInterruptEntity_165: implemented-entry=TAUJ2_CH02_CAT2_ISR, interrupt-category=CAT-2, interrupt-source=ICTAUJ2I2
        BswInterruptEntity_166: implemented-entry=TAUJ2_CH03_ISR, interrupt-category=CAT-1, interrupt-source=ICTAUJ2I3
        BswInterruptEntity_167: implemented-entry=TAUJ2_CH03_CAT2_ISR, interrupt-category=CAT-2, interrupt-source=ICTAUJ2I3
        BswInterruptEntity_168: implemented-entry=TAUJ3_CH00_ISR, interrupt-category=CAT-1, interrupt-source=ICTAUJ3I0
        BswInterruptEntity_169: implemented-entry=TAUJ3_CH00_CAT2_ISR, interrupt-category=CAT-2, interrupt-source=ICTAUJ3I0
        BswInterruptEntity_170: implemented-entry=TAUJ3_CH01_ISR, interrupt-category=CAT-1, interrupt-source=ICTAUJ3I1
        BswInterruptEntity_171: implemented-entry=TAUJ3_CH01_CAT2_ISR, interrupt-category=CAT-2, interrupt-source=ICTAUJ3I1
        BswInterruptEntity_172: implemented-entry=TAUJ3_CH02_ISR, interrupt-category=CAT-1, interrupt-source=ICTAUJ3I2
        BswInterruptEntity_173: implemented-entry=TAUJ3_CH02_CAT2_ISR, interrupt-category=CAT-2, interrupt-source=ICTAUJ3I2
        BswInterruptEntity_174: implemented-entry=TAUJ3_CH03_ISR, interrupt-category=CAT-1, interrupt-source=ICTAUJ3I3
        BswInterruptEntity_175: implemented-entry=TAUJ3_CH03_CAT2_ISR, interrupt-category=CAT-2, interrupt-source=ICTAUJ3I3
      31 x bsw called entity:
        BswCalledEntity_0: implemented-entry=Icu_Init
        BswCalledEntity_1: implemented-entry=Icu_DeInit
        BswCalledEntity_2: can-enter-exclusive-area=ICU_CHANNEL_DATA_PROTECTION, implemented-entry=Icu_SetMode
        BswCalledEntity_3: can-enter-exclusive-area=ICU_CHANNEL_DATA_PROTECTION, implemented-entry=Icu_DisableWakeup
        BswCalledEntity_4: can-enter-exclusive-area=ICU_CHANNEL_DATA_PROTECTION, implemented-entry=Icu_EnableWakeup
        BswCalledEntity_5: can-enter-exclusive-area=ICU_CHANNEL_DATA_PROTECTION, implemented-entry=Icu_CheckWakeup
        BswCalledEntity_6: can-enter-exclusive-area=[ICU_CHANNEL_DATA_PROTECTION, ICU_EDGECOUNT_DATA_PROTECTION], implemented-entry=Icu_SetActivationCondition
        BswCalledEntity_7: implemented-entry=Icu_DisableNotification
        BswCalledEntity_8: can-enter-exclusive-area=ICU_CHANNEL_DATA_PROTECTION, implemented-entry=Icu_EnableNotification
        BswCalledEntity_9: can-enter-exclusive-area=ICU_CHANNEL_DATA_PROTECTION, implemented-entry=Icu_GetInputState
        BswCalledEntity_10: can-enter-exclusive-area=[ICU_TIMESTAMP_DATA_PROTECTION, ICU_CHANNEL_DATA_PROTECTION], implemented-entry=Icu_StartTimestamp
        BswCalledEntity_11: can-enter-exclusive-area=ICU_CHANNEL_DATA_PROTECTION, implemented-entry=Icu_StopTimestamp
        BswCalledEntity_12: can-enter-exclusive-area=ICU_TIMESTAMP_DATA_PROTECTION, implemented-entry=Icu_GetTimestampIndex
        BswCalledEntity_13: can-enter-exclusive-area=ICU_CHANNEL_DATA_PROTECTION, implemented-entry=Icu_ResetEdgeCount
        BswCalledEntity_14: can-enter-exclusive-area=ICU_CHANNEL_DATA_PROTECTION, implemented-entry=Icu_EnableEdgeCount
        BswCalledEntity_15: can-enter-exclusive-area=ICU_CHANNEL_DATA_PROTECTION, implemented-entry=Icu_DisableEdgeCount
        BswCalledEntity_16: can-enter-exclusive-area=ICU_CHANNEL_DATA_PROTECTION, implemented-entry=Icu_EnableEdgeDetection
        BswCalledEntity_17: can-enter-exclusive-area=ICU_CHANNEL_DATA_PROTECTION, implemented-entry=Icu_DisableEdgeDetection
        BswCalledEntity_18: can-enter-exclusive-area=[ICU_EDGECOUNT_DATA_PROTECTION, ICU_CHANNEL_DATA_PROTECTION], implemented-entry=Icu_GetEdgeNumbers
        BswCalledEntity_19: can-enter-exclusive-area=ICU_CHANNEL_DATA_PROTECTION, implemented-entry=Icu_StartSignalMeasurement
        BswCalledEntity_20: can-enter-exclusive-area=ICU_CHANNEL_DATA_PROTECTION, implemented-entry=Icu_StopSignalMeasurement
        BswCalledEntity_21: can-enter-exclusive-area=ICU_SIGNALMEASURE_DATA_PROTECTION, implemented-entry=Icu_GetTimeElapsed
        BswCalledEntity_22: can-enter-exclusive-area=ICU_SIGNALMEASURE_DATA_PROTECTION, implemented-entry=Icu_GetDutyCycleValues
        BswCalledEntity_23: implemented-entry=Icu_GetInputLevel
        BswCalledEntity_24: implemented-entry=Icu_GetTAUInCountValue
        BswCalledEntity_25: can-enter-exclusive-area=ICU_CHANNEL_DATA_PROTECTION, implemented-entry=Icu_SynchronousInit
        BswCalledEntity_26: can-enter-exclusive-area=ICU_CHANNEL_DATA_PROTECTION, implemented-entry=Icu_SynchronousStart
        BswCalledEntity_27: can-enter-exclusive-area=ICU_CHANNEL_DATA_PROTECTION, implemented-entry=Icu_SynchronousStop
        BswCalledEntity_28: implemented-entry=Icu_SynchronousDeInit
        BswCalledEntity_29: implemented-entry=Icu_GetVersionInfo
        BswCalledEntity_30: implemented-entry=Icu_CheckHWConsistency
  207 x bsw module entry, all with sw-service-impl-policy=STANDARD:
    TAUD0_CH00_CAT2_ISR: is-reentrant=true, is-synchronous=true, call-type=INTERRUPT, execution-context=INTERRUPT-CAT-2
    TAUD0_CH01_ISR: is-reentrant=true, is-synchronous=true, call-type=INTERRUPT, execution-context=INTERRUPT-CAT-1
    TAUD0_CH01_CAT2_ISR: is-reentrant=true, is-synchronous=true, call-type=INTERRUPT, execution-context=INTERRUPT-CAT-2
    TAUD0_CH00_ISR: is-reentrant=true, is-synchronous=true, call-type=INTERRUPT, execution-context=INTERRUPT-CAT-1
    TAUD0_CH02_ISR: is-reentrant=true, is-synchronous=true, call-type=INTERRUPT, execution-context=INTERRUPT-CAT-1
    TAUD0_CH02_CAT2_ISR: is-reentrant=true, is-synchronous=true, call-type=INTERRUPT, execution-context=INTERRUPT-CAT-2
    TAUD0_CH03_ISR: is-reentrant=true, is-synchronous=true, call-type=INTERRUPT, execution-context=INTERRUPT-CAT-1
    TAUD0_CH03_CAT2_ISR: is-reentrant=true, is-synchronous=true, call-type=INTERRUPT, execution-context=INTERRUPT-CAT-2
    TAUD0_CH04_ISR: is-reentrant=true, is-synchronous=true, call-type=INTERRUPT, execution-context=INTERRUPT-CAT-1
    TAUD0_CH04_CAT2_ISR: is-reentrant=true, is-synchronous=true, call-type=INTERRUPT, execution-context=INTERRUPT-CAT-2
    TAUD0_CH05_ISR: is-reentrant=true, is-synchronous=true, call-type=INTERRUPT, execution-context=INTERRUPT-CAT-1
    TAUD0_CH05_CAT2_ISR: is-reentrant=true, is-synchronous=true, call-type=INTERRUPT, execution-context=INTERRUPT-CAT-2
    TAUD0_CH06_ISR: is-reentrant=true, is-synchronous=true, call-type=INTERRUPT, execution-context=INTERRUPT-CAT-1
    TAUD0_CH06_CAT2_ISR: is-reentrant=true, is-synchronous=true, call-type=INTERRUPT, execution-context=INTERRUPT-CAT-2
    TAUD0_CH07_ISR: is-reentrant=true, is-synchronous=true, call-type=INTERRUPT, execution-context=INTERRUPT-CAT-1
    TAUD0_CH07_CAT2_ISR: is-reentrant=true, is-synchronous=true, call-type=INTERRUPT, execution-context=INTERRUPT-CAT-2
    TAUD0_CH08_ISR: is-reentrant=true, is-synchronous=true, call-type=INTERRUPT, execution-context=INTERRUPT-CAT-1
    TAUD0_CH08_CAT2_ISR: is-reentrant=true, is-synchronous=true, call-type=INTERRUPT, execution-context=INTERRUPT-CAT-2
    TAUD0_CH09_ISR: is-reentrant=true, is-synchronous=true, call-type=INTERRUPT, execution-context=INTERRUPT-CAT-1
    TAUD0_CH09_CAT2_ISR: is-reentrant=true, is-synchronous=true, call-type=INTERRUPT, execution-context=INTERRUPT-CAT-2
    TAUD0_CH10_ISR: is-reentrant=true, is-synchronous=true, call-type=INTERRUPT, execution-context=INTERRUPT-CAT-1
    TAUD0_CH10_CAT2_ISR: is-reentrant=true, is-synchronous=true, call-type=INTERRUPT, execution-context=INTERRUPT-CAT-2
    TAUD0_CH11_ISR: is-reentrant=true, is-synchronous=true, call-type=INTERRUPT, execution-context=INTERRUPT-CAT-1
    TAUD0_CH11_CAT2_ISR: is-reentrant=true, is-synchronous=true, call-type=INTERRUPT, execution-context=INTERRUPT-CAT-2
    TAUD0_CH12_ISR: is-reentrant=true, is-synchronous=true, call-type=INTERRUPT, execution-context=INTERRUPT-CAT-1
    TAUD0_CH12_CAT2_ISR: is-reentrant=true, is-synchronous=true, call-type=INTERRUPT, execution-context=INTERRUPT-CAT-2
    TAUD0_CH13_ISR: is-reentrant=true, is-synchronous=true, call-type=INTERRUPT, execution-context=INTERRUPT-CAT-1
    TAUD0_CH13_CAT2_ISR: is-reentrant=true, is-synchronous=true, call-type=INTERRUPT, execution-context=INTERRUPT-CAT-2
    TAUD0_CH14_ISR: is-reentrant=true, is-synchronous=true, call-type=INTERRUPT, execution-context=INTERRUPT-CAT-1
    TAUD0_CH14_CAT2_ISR: is-reentrant=true, is-synchronous=true, call-type=INTERRUPT, execution-context=INTERRUPT-CAT-2
    TAUD0_CH15_ISR: is-reentrant=true, is-synchronous=true, call-type=INTERRUPT, execution-context=INTERRUPT-CAT-1
    TAUD0_CH15_CAT2_ISR: is-reentrant=true, is-synchronous=true, call-type=INTERRUPT, execution-context=INTERRUPT-CAT-2
    TAUB1_CH00_ISR: is-reentrant=true, is-synchronous=true, call-type=INTERRUPT, execution-context=INTERRUPT-CAT-1
    TAUB1_CH00_CAT2_ISR: is-reentrant=true, is-synchronous=true, call-type=INTERRUPT, execution-context=INTERRUPT-CAT-2
    TAUB1_CH01_ISR: is-reentrant=true, is-synchronous=true, call-type=INTERRUPT, execution-context=INTERRUPT-CAT-1
    TAUB1_CH01_CAT2_ISR: is-reentrant=true, is-synchronous=true, call-type=INTERRUPT, execution-context=INTERRUPT-CAT-2
    TAUB1_CH02_ISR: is-reentrant=true, is-synchronous=true, call-type=INTERRUPT, execution-context=INTERRUPT-CAT-1
    TAUB1_CH02_CAT2_ISR: is-reentrant=true, is-synchronous=true, call-type=INTERRUPT, execution-context=INTERRUPT-CAT-2
    TAUB1_CH03_ISR: is-reentrant=true, is-synchronous=true, call-type=INTERRUPT, execution-context=INTERRUPT-CAT-1
    TAUB1_CH03_CAT2_ISR: is-reentrant=true, is-synchronous=true, call-type=INTERRUPT, execution-context=INTERRUPT-CAT-2
    TAUB1_CH04_ISR: is-reentrant=true, is-synchronous=true, call-type=INTERRUPT, execution-context=INTERRUPT-CAT-1
    TAUB1_CH04_CAT2_ISR: is-reentrant=true, is-synchronous=true, call-type=INTERRUPT, execution-context=INTERRUPT-CAT-2
    TAUB1_CH05_ISR: is-reentrant=true, is-synchronous=true, call-type=INTERRUPT, execution-context=INTERRUPT-CAT-1
    TAUB1_CH05_CAT2_ISR: is-reentrant=true, is-synchronous=true, call-type=INTERRUPT, execution-context=INTERRUPT-CAT-2
    TAUB1_CH06_ISR: is-reentrant=true, is-synchronous=true, call-type=INTERRUPT, execution-context=INTERRUPT-CAT-1
    TAUB1_CH06_CAT2_ISR: is-reentrant=true, is-synchronous=true, call-type=INTERRUPT, execution-context=INTERRUPT-CAT-2
    TAUB1_CH07_ISR: is-reentrant=true, is-synchronous=true, call-type=INTERRUPT, execution-context=INTERRUPT-CAT-1
    TAUB1_CH07_CAT2_ISR: is-reentrant=true, is-synchronous=true, call-type=INTERRUPT, execution-context=INTERRUPT-CAT-2
    TAUB1_CH08_ISR: is-reentrant=true, is-synchronous=true, call-type=INTERRUPT, execution-context=INTERRUPT-CAT-1
    TAUB1_CH08_CAT2_ISR: is-reentrant=true, is-synchronous=true, call-type=INTERRUPT, execution-context=INTERRUPT-CAT-2
    TAUB1_CH09_ISR: is-reentrant=true, is-synchronous=true, call-type=INTERRUPT, execution-context=INTERRUPT-CAT-1
    TAUB1_CH09_CAT2_ISR: is-reentrant=true, is-synchronous=true, call-type=INTERRUPT, execution-context=INTERRUPT-CAT-2
    TAUB1_CH10_ISR: is-reentrant=true, is-synchronous=true, call-type=INTERRUPT, execution-context=INTERRUPT-CAT-1
    TAUB1_CH10_CAT2_ISR: is-reentrant=true, is-synchronous=true, call-type=INTERRUPT, execution-context=INTERRUPT-CAT-2
    TAUB1_CH11_ISR: is-reentrant=true, is-synchronous=true, call-type=INTERRUPT, execution-context=INTERRUPT-CAT-1
    TAUB1_CH11_CAT2_ISR: is-reentrant=true, is-synchronous=true, call-type=INTERRUPT, execution-context=INTERRUPT-CAT-2
    TAUB1_CH12_ISR: is-reentrant=true, is-synchronous=true, call-type=INTERRUPT, execution-context=INTERRUPT-CAT-1
    TAUB1_CH12_CAT2_ISR: is-reentrant=true, is-synchronous=true, call-type=INTERRUPT, execution-context=INTERRUPT-CAT-2
    TAUB1_CH13_ISR: is-reentrant=true, is-synchronous=true, call-type=INTERRUPT, execution-context=INTERRUPT-CAT-1
    TAUB1_CH13_CAT2_ISR: is-reentrant=true, is-synchronous=true, call-type=INTERRUPT, execution-context=INTERRUPT-CAT-2
    TAUB1_CH14_ISR: is-reentrant=true, is-synchronous=true, call-type=INTERRUPT, execution-context=INTERRUPT-CAT-1
    TAUB1_CH14_CAT2_ISR: is-reentrant=true, is-synchronous=true, call-type=INTERRUPT, execution-context=INTERRUPT-CAT-2
    TAUB1_CH15_ISR: is-reentrant=true, is-synchronous=true, call-type=INTERRUPT, execution-context=INTERRUPT-CAT-1
    TAUB1_CH15_CAT2_ISR: is-reentrant=true, is-synchronous=true, call-type=INTERRUPT, execution-context=INTERRUPT-CAT-2
    TAUJ0_CH00_ISR: is-reentrant=true, is-synchronous=true, call-type=INTERRUPT, execution-context=INTERRUPT-CAT-1
    TAUJ0_CH00_CAT2_ISR: is-reentrant=true, is-synchronous=true, call-type=INTERRUPT, execution-context=INTERRUPT-CAT-2
    TAUJ0_CH01_ISR: is-reentrant=true, is-synchronous=true, call-type=INTERRUPT, execution-context=INTERRUPT-CAT-1
    TAUJ0_CH01_CAT2_ISR: is-reentrant=true, is-synchronous=true, call-type=INTERRUPT, execution-context=INTERRUPT-CAT-2
    TAUJ0_CH02_ISR: is-reentrant=true, is-synchronous=true, call-type=INTERRUPT, execution-context=INTERRUPT-CAT-1
    TAUJ0_CH02_CAT2_ISR: is-reentrant=true, is-synchronous=true, call-type=INTERRUPT, execution-context=INTERRUPT-CAT-2
    TAUJ0_CH03_ISR: is-reentrant=true, is-synchronous=true, call-type=INTERRUPT, execution-context=INTERRUPT-CAT-1
    TAUJ0_CH03_CAT2_ISR: is-reentrant=true, is-synchronous=true, call-type=INTERRUPT, execution-context=INTERRUPT-CAT-2
    TAUJ1_CH00_ISR: is-reentrant=true, is-synchronous=true, call-type=INTERRUPT, execution-context=INTERRUPT-CAT-1
    TAUJ1_CH00_CAT2_ISR: is-reentrant=true, is-synchronous=true, call-type=INTERRUPT, execution-context=INTERRUPT-CAT-2
    TAUJ1_CH01_ISR: is-reentrant=true, is-synchronous=true, call-type=INTERRUPT, execution-context=INTERRUPT-CAT-1
    TAUJ1_CH01_CAT2_ISR: is-reentrant=true, is-synchronous=true, call-type=INTERRUPT, execution-context=INTERRUPT-CAT-2
    TAUJ1_CH02_ISR: is-reentrant=true, is-synchronous=true, call-type=INTERRUPT, execution-context=INTERRUPT-CAT-1
    TAUJ1_CH02_CAT2_ISR: is-reentrant=true, is-synchronous=true, call-type=INTERRUPT, execution-context=INTERRUPT-CAT-2
    TAUJ1_CH03_ISR: is-reentrant=true, is-synchronous=true, call-type=INTERRUPT, execution-context=INTERRUPT-CAT-1
    TAUJ1_CH03_CAT2_ISR: is-reentrant=true, is-synchronous=true, call-type=INTERRUPT, execution-context=INTERRUPT-CAT-2
    TAUJ2_CH00_ISR: is-reentrant=true, is-synchronous=true, call-type=INTERRUPT, execution-context=INTERRUPT-CAT-1
    TAUJ2_CH00_CAT2_ISR: is-reentrant=true, is-synchronous=true, call-type=INTERRUPT, execution-context=INTERRUPT-CAT-2
    TAUJ2_CH01_ISR: is-reentrant=true, is-synchronous=true, call-type=INTERRUPT, execution-context=INTERRUPT-CAT-1
    TAUJ2_CH01_CAT2_ISR: is-reentrant=true, is-synchronous=true, call-type=INTERRUPT, execution-context=INTERRUPT-CAT-2
    TAUJ2_CH02_ISR: is-reentrant=true, is-synchronous=true, call-type=INTERRUPT, execution-context=INTERRUPT-CAT-1
    TAUJ2_CH02_CAT2_ISR: is-reentrant=true, is-synchronous=true, call-type=INTERRUPT, execution-context=INTERRUPT-CAT-2
    TAUJ2_CH03_ISR: is-reentrant=true, is-synchronous=true, call-type=INTERRUPT, execution-context=INTERRUPT-CAT-1
    TAUJ2_CH03_CAT2_ISR: is-reentrant=true, is-synchronous=true, call-type=INTERRUPT, execution-context=INTERRUPT-CAT-2
    TAUJ3_CH00_ISR: is-reentrant=true, is-synchronous=true, call-type=INTERRUPT, execution-context=INTERRUPT-CAT-1
    TAUJ3_CH00_CAT2_ISR: is-reentrant=true, is-synchronous=true, call-type=INTERRUPT, execution-context=INTERRUPT-CAT-2
    TAUJ3_CH01_ISR: is-reentrant=true, is-synchronous=true, call-type=INTERRUPT, execution-context=INTERRUPT-CAT-1
    TAUJ3_CH01_CAT2_ISR: is-reentrant=true, is-synchronous=true, call-type=INTERRUPT, execution-context=INTERRUPT-CAT-2
    TAUJ3_CH02_ISR: is-reentrant=true, is-synchronous=true, call-type=INTERRUPT, execution-context=INTERRUPT-CAT-1
    TAUJ3_CH02_CAT2_ISR: is-reentrant=true, is-synchronous=true, call-type=INTERRUPT, execution-context=INTERRUPT-CAT-2
    TAUJ3_CH03_ISR: is-reentrant=true, is-synchronous=true, call-type=INTERRUPT, execution-context=INTERRUPT-CAT-1
    TAUJ3_CH03_CAT2_ISR: is-reentrant=true, is-synchronous=true, call-type=INTERRUPT, execution-context=INTERRUPT-CAT-2
    TAUB0_CH{00..13}_ISR: is-reentrant=true, is-synchronous=true, call-type=INTERRUPT, execution-context=INTERRUPT-CAT-1
    TAUB0_CH{00..15}_CAT2_ISR: is-reentrant=true, is-synchronous=true, call-type=INTERRUPT, execution-context=INTERRUPT-CAT-2
    TAUB0_CH14_ISR: is-reentrant=true, is-synchronous=true, call-type=INTERRUPT, execution-context=INTERRUPT-CAT-1
    TAUB0_CH15_ISR: is-reentrant=true, is-synchronous=true, call-type=INTERRUPT, execution-context=INTERRUPT-CAT-1
    EXT_INTP_CH00_ISR: is-reentrant=true, is-synchronous=true, call-type=INTERRUPT, execution-context=INTERRUPT-CAT-1
    EXT_INTP_CH00_CAT2_ISR: is-reentrant=true, is-synchronous=true, call-type=INTERRUPT, execution-context=INTERRUPT-CAT-2
    EXT_INTP_CH01_ISR: is-reentrant=true, is-synchronous=true, call-type=INTERRUPT, execution-context=INTERRUPT-CAT-1
    EXT_INTP_CH01_CAT2_ISR: is-reentrant=true, is-synchronous=true, call-type=INTERRUPT, execution-context=INTERRUPT-CAT-2
    EXT_INTP_CH02_ISR: is-reentrant=true, is-synchronous=true, call-type=INTERRUPT, execution-context=INTERRUPT-CAT-1
    EXT_INTP_CH02_CAT2_ISR: is-reentrant=true, is-synchronous=true, call-type=INTERRUPT, execution-context=INTERRUPT-CAT-2
    EXT_INTP_CH03_ISR: is-reentrant=true, is-synchronous=true, call-type=INTERRUPT, execution-context=INTERRUPT-CAT-1
    EXT_INTP_CH03_CAT2_ISR: is-reentrant=true, is-synchronous=true, call-type=INTERRUPT, execution-context=INTERRUPT-CAT-2
    EXT_INTP_CH04_ISR: is-reentrant=true, is-synchronous=true, call-type=INTERRUPT, execution-context=INTERRUPT-CAT-1
    EXT_INTP_CH04_CAT2_ISR: is-reentrant=true, is-synchronous=true, call-type=INTERRUPT, execution-context=INTERRUPT-CAT-2
    EXT_INTP_CH05_ISR: is-reentrant=true, is-synchronous=true, call-type=INTERRUPT, execution-context=INTERRUPT-CAT-1
    EXT_INTP_CH05_CAT2_ISR: is-reentrant=true, is-synchronous=true, call-type=INTERRUPT, execution-context=INTERRUPT-CAT-2
    EXT_INTP_CH06_ISR: is-reentrant=true, is-synchronous=true, call-type=INTERRUPT, execution-context=INTERRUPT-CAT-1
    EXT_INTP_CH06_CAT2_ISR: is-reentrant=true, is-synchronous=true, call-type=INTERRUPT, execution-context=INTERRUPT-CAT-2
    EXT_INTP_CH07_ISR: is-reentrant=true, is-synchronous=true, call-type=INTERRUPT, execution-context=INTERRUPT-CAT-1
    EXT_INTP_CH07_CAT2_ISR: is-reentrant=true, is-synchronous=true, call-type=INTERRUPT, execution-context=INTERRUPT-CAT-2
    EXT_INTP_CH08_ISR: is-reentrant=true, is-synchronous=true, call-type=INTERRUPT, execution-context=INTERRUPT-CAT-1
    EXT_INTP_CH08_CAT2_ISR: is-reentrant=true, is-synchronous=true, call-type=INTERRUPT, execution-context=INTERRUPT-CAT-2
    EXT_INTP_CH09_ISR: is-reentrant=true, is-synchronous=true, call-type=INTERRUPT, execution-context=INTERRUPT-CAT-1
    EXT_INTP_CH09_CAT2_ISR: is-reentrant=true, is-synchronous=true, call-type=INTERRUPT, execution-context=INTERRUPT-CAT-2
    EXT_INTP_CH10_ISR: is-reentrant=true, is-synchronous=true, call-type=INTERRUPT, execution-context=INTERRUPT-CAT-1
    EXT_INTP_CH10_CAT2_ISR: is-reentrant=true, is-synchronous=true, call-type=INTERRUPT, execution-context=INTERRUPT-CAT-2
    EXT_INTP_CH11_ISR: is-reentrant=true, is-synchronous=true, call-type=INTERRUPT, execution-context=INTERRUPT-CAT-1
    EXT_INTP_CH11_CAT2_ISR: is-reentrant=true, is-synchronous=true, call-type=INTERRUPT, execution-context=INTERRUPT-CAT-2
    EXT_INTP_CH12_ISR: is-reentrant=true, is-synchronous=true, call-type=INTERRUPT, execution-context=INTERRUPT-CAT-1
    EXT_INTP_CH12_CAT2_ISR: is-reentrant=true, is-synchronous=true, call-type=INTERRUPT, execution-context=INTERRUPT-CAT-2
    EXT_INTP_CH13_ISR: is-reentrant=true, is-synchronous=true, call-type=INTERRUPT, execution-context=INTERRUPT-CAT-1
    EXT_INTP_CH13_CAT2_ISR: is-reentrant=true, is-synchronous=true, call-type=INTERRUPT, execution-context=INTERRUPT-CAT-2
    EXT_INTP_CH14_ISR: is-reentrant=true, is-synchronous=true, call-type=INTERRUPT, execution-context=INTERRUPT-CAT-1
    EXT_INTP_CH14_CAT2_ISR: is-reentrant=true, is-synchronous=true, call-type=INTERRUPT, execution-context=INTERRUPT-CAT-2
    EXT_INTP_CH15_ISR: is-reentrant=true, is-synchronous=true, call-type=INTERRUPT, execution-context=INTERRUPT-CAT-1
    EXT_INTP_CH15_CAT2_ISR: is-reentrant=true, is-synchronous=true, call-type=INTERRUPT, execution-context=INTERRUPT-CAT-2
    EXT_INTP_CH16_ISR: is-reentrant=true, is-synchronous=true, call-type=INTERRUPT, execution-context=INTERRUPT-CAT-1
    EXT_INTP_CH16_CAT2_ISR: is-reentrant=true, is-synchronous=true, call-type=INTERRUPT, execution-context=INTERRUPT-CAT-2
    EXT_INTP_CH17_ISR: is-reentrant=true, is-synchronous=true, call-type=INTERRUPT, execution-context=INTERRUPT-CAT-1
    EXT_INTP_CH17_CAT2_ISR: is-reentrant=true, is-synchronous=true, call-type=INTERRUPT, execution-context=INTERRUPT-CAT-2
    EXT_INTP_CH18_ISR: is-reentrant=true, is-synchronous=true, call-type=INTERRUPT, execution-context=INTERRUPT-CAT-1
    EXT_INTP_CH18_CAT2_ISR: is-reentrant=true, is-synchronous=true, call-type=INTERRUPT, execution-context=INTERRUPT-CAT-2
    EXT_INTP_CH19_ISR: is-reentrant=true, is-synchronous=true, call-type=INTERRUPT, execution-context=INTERRUPT-CAT-1
    EXT_INTP_CH19_CAT2_ISR: is-reentrant=true, is-synchronous=true, call-type=INTERRUPT, execution-context=INTERRUPT-CAT-2
    EXT_INTP_CH20_ISR: is-reentrant=true, is-synchronous=true, call-type=INTERRUPT, execution-context=INTERRUPT-CAT-1
    EXT_INTP_CH20_CAT2_ISR: is-reentrant=true, is-synchronous=true, call-type=INTERRUPT, execution-context=INTERRUPT-CAT-2
    EXT_INTP_CH21_ISR: is-reentrant=true, is-synchronous=true, call-type=INTERRUPT, execution-context=INTERRUPT-CAT-1
    EXT_INTP_CH21_CAT2_ISR: is-reentrant=true, is-synchronous=true, call-type=INTERRUPT, execution-context=INTERRUPT-CAT-2
    EXT_INTP_CH22_ISR: is-reentrant=true, is-synchronous=true, call-type=INTERRUPT, execution-context=INTERRUPT-CAT-1
    EXT_INTP_CH22_CAT2_ISR: is-reentrant=true, is-synchronous=true, call-type=INTERRUPT, execution-context=INTERRUPT-CAT-2
    EXT_INTP_CH23_ISR: is-reentrant=true, is-synchronous=true, call-type=INTERRUPT, execution-context=INTERRUPT-CAT-1
    EXT_INTP_CH23_CAT2_ISR: is-reentrant=true, is-synchronous=true, call-type=INTERRUPT, execution-context=INTERRUPT-CAT-2
    Icu_Init: service-id=0, is-reentrant=false, is-synchronous=true, call-type=REGULAR, execution-context=TASK
    Icu_DeInit: service-id=1, is-reentrant=false, is-synchronous=true, call-type=REGULAR, execution-context=TASK
    Icu_SetMode: service-id=2, is-reentrant=false, is-synchronous=true, call-type=REGULAR, execution-context=TASK
    Icu_DisableWakeup: service-id=3, is-reentrant=true, is-synchronous=true, call-type=REGULAR, execution-context=TASK
    Icu_EnableWakeup: service-id=4, is-reentrant=true, is-synchronous=true, call-type=REGULAR, execution-context=TASK
    Icu_CheckWakeup: service-id=21, is-reentrant=true, is-synchronous=true, call-type=REGULAR, execution-context=TASK
    Icu_SetActivationCondition: service-id=5, is-reentrant=true, is-synchronous=true, call-type=REGULAR, execution-context=TASK
    Icu_DisableNotification: service-id=6, is-reentrant=true, is-synchronous=true, call-type=REGULAR, execution-context=TASK
    Icu_EnableNotification: service-id=7, is-reentrant=true, is-synchronous=true, call-type=REGULAR, execution-context=TASK
    Icu_GetInputState: service-id=8, is-reentrant=true, is-synchronous=true, call-type=REGULAR, execution-context=TASK
    Icu_StartTimestamp: service-id=9, is-reentrant=true, is-synchronous=false, call-type=REGULAR, execution-context=TASK
    Icu_StopTimestamp: service-id=10, is-reentrant=true, is-synchronous=true, call-type=REGULAR, execution-context=TASK
    Icu_GetTimestampIndex: service-id=11, is-reentrant=true, is-synchronous=true, call-type=REGULAR, execution-context=TASK
    Icu_ResetEdgeCount: service-id=12, is-reentrant=true, is-synchronous=true, call-type=REGULAR, execution-context=TASK
    Icu_EnableEdgeCount: service-id=13, is-reentrant=true, is-synchronous=true, call-type=REGULAR, execution-context=TASK
    Icu_DisableEdgeCount: service-id=14, is-reentrant=true, is-synchronous=true, call-type=REGULAR, execution-context=TASK
    Icu_EnableEdgeDetection: service-id=22, is-reentrant=true, is-synchronous=true, call-type=REGULAR, execution-context=TASK
    Icu_DisableEdgeDetection: service-id=23, is-reentrant=true, is-synchronous=true, call-type=REGULAR, execution-context=TASK
    Icu_GetEdgeNumbers: service-id=15, is-reentrant=true, is-synchronous=true, call-type=REGULAR, execution-context=TASK
    Icu_StartSignalMeasurement: service-id=19, is-reentrant=true, is-synchronous=false, call-type=REGULAR, execution-context=TASK
    Icu_StopSignalMeasurement: service-id=20, is-reentrant=true, is-synchronous=true, call-type=REGULAR, execution-context=TASK
    Icu_GetTimeElapsed: service-id=16, is-reentrant=true, is-synchronous=true, call-type=REGULAR, execution-context=TASK
    Icu_GetDutyCycleValues: service-id=17, is-reentrant=true, is-synchronous=true, call-type=REGULAR, execution-context=TASK
    Icu_GetInputLevel: service-id=24, is-reentrant=false, is-synchronous=true, call-type=REGULAR, execution-context=TASK
    Icu_GetTAUInCountValue: service-id=25, is-reentrant=true, is-synchronous=true, call-type=REGULAR, execution-context=TASK
    Icu_SynchronousInit: service-id=26, is-reentrant=false, is-synchronous=true, call-type=REGULAR, execution-context=TASK
    Icu_SynchronousStart: service-id=27, is-reentrant=false, is-synchronous=true, call-type=REGULAR, execution-context=TASK
    Icu_SynchronousStop: service-id=28, is-reentrant=true, is-synchronous=true, call-type=REGULAR, execution-context=TASK
    Icu_SynchronousDeInit: service-id=29, is-reentrant=true, is-synchronous=true, call-type=REGULAR, execution-context=TASK
    Icu_GetVersionInfo: service-id=18, is-reentrant=true, is-synchronous=true, call-type=REGULAR, execution-context=TASK
    Icu_CheckHWConsistency: service-id=30, is-reentrant=true, is-synchronous=true, call-type=REGULAR, execution-context=TASK
