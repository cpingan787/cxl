[part 1 of 3: package /R7F7015833]
AUTOSAR XML (schema 00048)
package /R7F7015833
  module config Com
    ComGeneral:
      ComCancellationSupport = true
      ComConfigurationUseDet = false
      ComVersionInfoApi = false
      ComEnableMDTForCyclicTransmission = true
      ComEnableSignalGroupArrayApi = false
      ComMetaDataSupport = false
      ComRetryFailedTransmitRequests = false
      ComSupportedIPduGroups = 2
      ComConfigType = PC_CONFIG
    ComConfig
      DIAG_DTCInfo_IAM_CONTROLLER_0_IAM_Tx (ComIPdu):
        ComIPduCancellationSupport = false
        ComIPduDirection = SEND
        ComIPduHandleId = COM_TXPDU_COM_DIAG_DTCInfo_IAM_CONTROLLER_0_IAM_Tx
        ComIPduSignalProcessing = DEFERRED
        ComIPduType = NORMAL
        ComPduIdRef = COM_DIAG_DTCInfo_IAM_CONTROLLER_0_IAM_Tx
        ComIPduSignalRef = IDTCInfomationIAM_DIAG_DTCInfo_IAM_CONTROLLER_0_IAM_Tx
        ComIPduGroupRef = Com_TxPduGroup_CONTROLLER_0_IAM
        ComTxIPdu: ComMinimumDelayTime=0.0, ComTxIPduUnusedAreasDefault=0
          ComTxModeTrue
            ComTxMode: ComTxModeMode=DIRECT, ComTxModeNumberOfRepetitions=3, ComTxModeRepetitionPeriod=0.05, ComTxModeTimeOffset=0.0, ComTxModeTimePeriod=0.0
      ComMainFunctionTx: ComMainTxTimeBase=0.005
      IDTCInfomationIAM_DIAG_DTCInfo_IAM_CONTROLLER_0_IAM_Tx (ComSignal):
        ComBitPosition = 48
        ComBitSize = 56
        ComHandleId = IDTCInfomationIAM_DIAG_DTCInfo_IAM_CONTROLLER_0_IAM_Tx
        ComInvalidNotification = NULL_PTR
        ComRxDataTimeoutAction = NONE
        ComSignalEndianness = BIG_ENDIAN
        ComSignalInitValue = 0x0
        ComSignalLength = 0
        ComSignalType = UINT64
        ComTransferProperty = PENDING
        ComSignalDataInvalidValue = 0x0
        ComDataInvalidAction = NOTIFY
        ComTimeout = 0.0
        ComFirstTimeout = 0.0
        ComNotification = Rte_COMCbkTAck
      IAM_BKPCANFD_1000ms_FrP60_CONTROLLER_0_IAM_Tx (ComIPdu):
        ComIPduCancellationSupport = false
        ComIPduDirection = SEND
        ComIPduHandleId = COM_TXPDU_COM_IAM_BKPCANFD_1000ms_FrP60_CONTROLLER_0_IAM_Tx
        ComIPduSignalProcessing = DEFERRED
        ComIPduType = NORMAL
        ComPduIdRef = COM_IAM_BKPCANFD_1000ms_FrP60_CONTROLLER_0_IAM_Tx
        ComIPduSignalRef = ISatID10_IAM_BKPCANFD_1000ms_FrP60_CONTROLLER_0_IAM_Tx
        ComIPduSignalRef = ISatElv10_IAM_BKPCANFD_1000ms_FrP60_CONTROLLER_0_IAM_Tx
        ComIPduSignalRef = ISatCNO10_IAM_BKPCANFD_1000ms_FrP60_CONTROLLER_0_IAM_Tx
        ComIPduSignalRef = ISatID9_IAM_BKPCANFD_1000ms_FrP60_CONTROLLER_0_IAM_Tx
        ComIPduSignalRef = ISatAz10_IAM_BKPCANFD_1000ms_FrP60_CONTROLLER_0_IAM_Tx
        ComIPduSignalRef = ISatElv9_IAM_BKPCANFD_1000ms_FrP60_CONTROLLER_0_IAM_Tx
        ComIPduSignalRef = ISatCNO9_IAM_BKPCANFD_1000ms_FrP60_CONTROLLER_0_IAM_Tx
        ComIPduSignalRef = ISatAz9_IAM_BKPCANFD_1000ms_FrP60_CONTROLLER_0_IAM_Tx
        ComIPduGroupRef = Com_TxPduGroup_CONTROLLER_0_IAM
        ComTxIPdu: ComMinimumDelayTime=0.0, ComTxIPduUnusedAreasDefault=0
          ComTxModeTrue
            ComTxMode: ComTxModeMode=PERIODIC, ComTxModeNumberOfRepetitions=0, ComTxModeRepetitionPeriod=0.0, ComTxModeTimeOffset=0.0, ComTxModeTimePeriod=1.0
      8 x ComSignal, all with ComInvalidNotification=NULL_PTR, ComRxDataTimeoutAction=NONE, ComSignalEndianness=BIG_ENDIAN, ComSignalInitValue=0x0, ComSignalLength=0, ComTransferProperty=PENDING, ComSignalDataInvalidValue=0x0, ComDataInvalidAction=NOTIFY, ComTimeout=0.0, ComFirstTimeout=0.0, ComNotification=Rte_COMCbkTAck:
        ISatID10_IAM_BKPCANFD_1000ms_FrP60_CONTROLLER_0_IAM_Tx: ComBitPosition=57, ComBitSize=7, ComHandleId=ISatID10_IAM_BKPCANFD_1000ms_FrP60_CONTROLLER_0_IAM_Tx, ComSignalType=UINT8
        ISatElv10_IAM_BKPCANFD_1000ms_FrP60_CONTROLLER_0_IAM_Tx: ComBitPosition=49, ComBitSize=7, ComHandleId=ISatElv10_IAM_BKPCANFD_1000ms_FrP60_CONTROLLER_0_IAM_Tx, ComSignalType=UINT8
        ISatCNO10_IAM_BKPCANFD_1000ms_FrP60_CONTROLLER_0_IAM_Tx: ComBitPosition=41, ComBitSize=7, ComHandleId=ISatCNO10_IAM_BKPCANFD_1000ms_FrP60_CONTROLLER_0_IAM_Tx, ComSignalType=UINT8
        ISatID9_IAM_BKPCANFD_1000ms_FrP60_CONTROLLER_0_IAM_Tx: ComBitPosition=25, ComBitSize=7, ComHandleId=ISatID9_IAM_BKPCANFD_1000ms_FrP60_CONTROLLER_0_IAM_Tx, ComSignalType=UINT8
        ISatAz10_IAM_BKPCANFD_1000ms_FrP60_CONTROLLER_0_IAM_Tx: ComBitPosition=32, ComBitSize=9, ComHandleId=ISatAz10_IAM_BKPCANFD_1000ms_FrP60_CONTROLLER_0_IAM_Tx, ComSignalType=UINT16
        ISatElv9_IAM_BKPCANFD_1000ms_FrP60_CONTROLLER_0_IAM_Tx: ComBitPosition=17, ComBitSize=7, ComHandleId=ISatElv9_IAM_BKPCANFD_1000ms_FrP60_CONTROLLER_0_IAM_Tx, ComSignalType=UINT8
        ISatCNO9_IAM_BKPCANFD_1000ms_FrP60_CONTROLLER_0_IAM_Tx: ComBitPosition=8, ComBitSize=7, ComHandleId=ISatCNO9_IAM_BKPCANFD_1000ms_FrP60_CONTROLLER_0_IAM_Tx, ComSignalType=UINT8
        ISatAz9_IAM_BKPCANFD_1000ms_FrP60_CONTROLLER_0_IAM_Tx: ComBitPosition=15, ComBitSize=9, ComHandleId=ISatAz9_IAM_BKPCANFD_1000ms_FrP60_CONTROLLER_0_IAM_Tx, ComSignalType=UINT16
      IAM_BKPCANFD_1000ms_FrP61_CONTROLLER_0_IAM_Tx (ComIPdu):
        ComIPduCancellationSupport = false
        ComIPduDirection = SEND
        ComIPduHandleId = COM_TXPDU_COM_IAM_BKPCANFD_1000ms_FrP61_CONTROLLER_0_IAM_Tx
        ComIPduSignalProcessing = DEFERRED
        ComIPduType = NORMAL
        ComPduIdRef = COM_IAM_BKPCANFD_1000ms_FrP61_CONTROLLER_0_IAM_Tx
        ComIPduSignalRef = ISatID12_IAM_BKPCANFD_1000ms_FrP61_CONTROLLER_0_IAM_Tx
        ComIPduSignalRef = ISatElv12_IAM_BKPCANFD_1000ms_FrP61_CONTROLLER_0_IAM_Tx
        ComIPduSignalRef = ISatCNO12_IAM_BKPCANFD_1000ms_FrP61_CONTROLLER_0_IAM_Tx
        ComIPduSignalRef = ISatID11_IAM_BKPCANFD_1000ms_FrP61_CONTROLLER_0_IAM_Tx
        ComIPduSignalRef = ISatAz12_IAM_BKPCANFD_1000ms_FrP61_CONTROLLER_0_IAM_Tx
        ComIPduSignalRef = ISatElv11_IAM_BKPCANFD_1000ms_FrP61_CONTROLLER_0_IAM_Tx
        ComIPduSignalRef = ISatCNO11_IAM_BKPCANFD_1000ms_FrP61_CONTROLLER_0_IAM_Tx
        ComIPduSignalRef = ISatAz11_IAM_BKPCANFD_1000ms_FrP61_CONTROLLER_0_IAM_Tx
        ComIPduGroupRef = Com_TxPduGroup_CONTROLLER_0_IAM
        ComTxIPdu: ComMinimumDelayTime=0.0, ComTxIPduUnusedAreasDefault=0
          ComTxModeTrue
            ComTxMode: ComTxModeMode=PERIODIC, ComTxModeNumberOfRepetitions=0, ComTxModeRepetitionPeriod=0.0, ComTxModeTimeOffset=0.0, ComTxModeTimePeriod=1.0
      8 x ComSignal, all with ComInvalidNotification=NULL_PTR, ComRxDataTimeoutAction=NONE, ComSignalEndianness=BIG_ENDIAN, ComSignalInitValue=0x0, ComSignalLength=0, ComTransferProperty=PENDING, ComSignalDataInvalidValue=0x0, ComDataInvalidAction=NOTIFY, ComTimeout=0.0, ComFirstTimeout=0.0, ComNotification=Rte_COMCbkTAck:
        ISatID12_IAM_BKPCANFD_1000ms_FrP61_CONTROLLER_0_IAM_Tx: ComBitPosition=57, ComBitSize=7, ComHandleId=ISatID12_IAM_BKPCANFD_1000ms_FrP61_CONTROLLER_0_IAM_Tx, ComSignalType=UINT8
        ISatElv12_IAM_BKPCANFD_1000ms_FrP61_CONTROLLER_0_IAM_Tx: ComBitPosition=49, ComBitSize=7, ComHandleId=ISatElv12_IAM_BKPCANFD_1000ms_FrP61_CONTROLLER_0_IAM_Tx, ComSignalType=UINT8
        ISatCNO12_IAM_BKPCANFD_1000ms_FrP61_CONTROLLER_0_IAM_Tx: ComBitPosition=41, ComBitSize=7, ComHandleId=ISatCNO12_IAM_BKPCANFD_1000ms_FrP61_CONTROLLER_0_IAM_Tx, ComSignalType=UINT8
        ISatID11_IAM_BKPCANFD_1000ms_FrP61_CONTROLLER_0_IAM_Tx: ComBitPosition=25, ComBitSize=7, ComHandleId=ISatID11_IAM_BKPCANFD_1000ms_FrP61_CONTROLLER_0_IAM_Tx, ComSignalType=UINT8
        ISatAz12_IAM_BKPCANFD_1000ms_FrP61_CONTROLLER_0_IAM_Tx: ComBitPosition=32, ComBitSize=9, ComHandleId=ISatAz12_IAM_BKPCANFD_1000ms_FrP61_CONTROLLER_0_IAM_Tx, ComSignalType=UINT16
        ISatElv11_IAM_BKPCANFD_1000ms_FrP61_CONTROLLER_0_IAM_Tx: ComBitPosition=17, ComBitSize=7, ComHandleId=ISatElv11_IAM_BKPCANFD_1000ms_FrP61_CONTROLLER_0_IAM_Tx, ComSignalType=UINT8
        ISatCNO11_IAM_BKPCANFD_1000ms_FrP61_CONTROLLER_0_IAM_Tx: ComBitPosition=8, ComBitSize=7, ComHandleId=ISatCNO11_IAM_BKPCANFD_1000ms_FrP61_CONTROLLER_0_IAM_Tx, ComSignalType=UINT8
        ISatAz11_IAM_BKPCANFD_1000ms_FrP61_CONTROLLER_0_IAM_Tx: ComBitPosition=15, ComBitSize=9, ComHandleId=ISatAz11_IAM_BKPCANFD_1000ms_FrP61_CONTROLLER_0_IAM_Tx, ComSignalType=UINT16
      IAM_BKPCANFD_1000ms_FrP62_CONTROLLER_0_IAM_Tx (ComIPdu):
        ComIPduCancellationSupport = false
        ComIPduDirection = SEND
        ComIPduHandleId = COM_TXPDU_COM_IAM_BKPCANFD_1000ms_FrP62_CONTROLLER_0_IAM_Tx
        ComIPduSignalProcessing = DEFERRED
        ComIPduType = NORMAL
        ComPduIdRef = COM_IAM_BKPCANFD_1000ms_FrP62_CONTROLLER_0_IAM_Tx
        ComIPduSignalRef = ISatID14_IAM_BKPCANFD_1000ms_FrP62_CONTROLLER_0_IAM_Tx
        ComIPduSignalRef = ISatElv14_IAM_BKPCANFD_1000ms_FrP62_CONTROLLER_0_IAM_Tx
        ComIPduSignalRef = ISatCNO14_IAM_BKPCANFD_1000ms_FrP62_CONTROLLER_0_IAM_Tx
        ComIPduSignalRef = ISatID13_IAM_BKPCANFD_1000ms_FrP62_CONTROLLER_0_IAM_Tx
        ComIPduSignalRef = ISatAz14_IAM_BKPCANFD_1000ms_FrP62_CONTROLLER_0_IAM_Tx
        ComIPduSignalRef = ISatElv13_IAM_BKPCANFD_1000ms_FrP62_CONTROLLER_0_IAM_Tx
        ComIPduSignalRef = ISatCNO13_IAM_BKPCANFD_1000ms_FrP62_CONTROLLER_0_IAM_Tx
        ComIPduSignalRef = ISatAz13_IAM_BKPCANFD_1000ms_FrP62_CONTROLLER_0_IAM_Tx
        ComIPduGroupRef = Com_TxPduGroup_CONTROLLER_0_IAM
        ComTxIPdu: ComMinimumDelayTime=0.0, ComTxIPduUnusedAreasDefault=0
          ComTxModeTrue
            ComTxMode: ComTxModeMode=PERIODIC, ComTxModeNumberOfRepetitions=0, ComTxModeRepetitionPeriod=0.0, ComTxModeTimeOffset=0.0, ComTxModeTimePeriod=1.0
      8 x ComSignal, all with ComInvalidNotification=NULL_PTR, ComRxDataTimeoutAction=NONE, ComSignalEndianness=BIG_ENDIAN, ComSignalInitValue=0x0, ComSignalLength=0, ComTransferProperty=PENDING, ComSignalDataInvalidValue=0x0, ComDataInvalidAction=NOTIFY, ComTimeout=0.0, ComFirstTimeout=0.0, ComNotification=Rte_COMCbkTAck:
        ISatID14_IAM_BKPCANFD_1000ms_FrP62_CONTROLLER_0_IAM_Tx: ComBitPosition=57, ComBitSize=7, ComHandleId=ISatID14_IAM_BKPCANFD_1000ms_FrP62_CONTROLLER_0_IAM_Tx, ComSignalType=UINT8
        ISatElv14_IAM_BKPCANFD_1000ms_FrP62_CONTROLLER_0_IAM_Tx: ComBitPosition=49, ComBitSize=7, ComHandleId=ISatElv14_IAM_BKPCANFD_1000ms_FrP62_CONTROLLER_0_IAM_Tx, ComSignalType=UINT8
        ISatCNO14_IAM_BKPCANFD_1000ms_FrP62_CONTROLLER_0_IAM_Tx: ComBitPosition=41, ComBitSize=7, ComHandleId=ISatCNO14_IAM_BKPCANFD_1000ms_FrP62_CONTROLLER_0_IAM_Tx, ComSignalType=UINT8
        ISatID13_IAM_BKPCANFD_1000ms_FrP62_CONTROLLER_0_IAM_Tx: ComBitPosition=25, ComBitSize=7, ComHandleId=ISatID13_IAM_BKPCANFD_1000ms_FrP62_CONTROLLER_0_IAM_Tx, ComSignalType=UINT8
        ISatAz14_IAM_BKPCANFD_1000ms_FrP62_CONTROLLER_0_IAM_Tx: ComBitPosition=32, ComBitSize=9, ComHandleId=ISatAz14_IAM_BKPCANFD_1000ms_FrP62_CONTROLLER_0_IAM_Tx, ComSignalType=UINT16
        ISatElv13_IAM_BKPCANFD_1000ms_FrP62_CONTROLLER_0_IAM_Tx: ComBitPosition=17, ComBitSize=7, ComHandleId=ISatElv13_IAM_BKPCANFD_1000ms_FrP62_CONTROLLER_0_IAM_Tx, ComSignalType=UINT8
        ISatCNO13_IAM_BKPCANFD_1000ms_FrP62_CONTROLLER_0_IAM_Tx: ComBitPosition=8, ComBitSize=7, ComHandleId=ISatCNO13_IAM_BKPCANFD_1000ms_FrP62_CONTROLLER_0_IAM_Tx, ComSignalType=UINT8
        ISatAz13_IAM_BKPCANFD_1000ms_FrP62_CONTROLLER_0_IAM_Tx: ComBitPosition=15, ComBitSize=9, ComHandleId=ISatAz13_IAM_BKPCANFD_1000ms_FrP62_CONTROLLER_0_IAM_Tx, ComSignalType=UINT16
      IAM_BKPCANFD_1000ms_FrP63_CONTROLLER_0_IAM_Tx (ComIPdu):
        ComIPduCancellationSupport = false
        ComIPduDirection = SEND
        ComIPduHandleId = COM_TXPDU_COM_IAM_BKPCANFD_1000ms_FrP63_CONTROLLER_0_IAM_Tx
        ComIPduSignalProcessing = DEFERRED
        ComIPduType = NORMAL
        ComPduIdRef = COM_IAM_BKPCANFD_1000ms_FrP63_CONTROLLER_0_IAM_Tx
        ComIPduSignalRef = ISatID16_IAM_BKPCANFD_1000ms_FrP63_CONTROLLER_0_IAM_Tx
        ComIPduSignalRef = ISatElv16_IAM_BKPCANFD_1000ms_FrP63_CONTROLLER_0_IAM_Tx
        ComIPduSignalRef = ISatCNO16_IAM_BKPCANFD_1000ms_FrP63_CONTROLLER_0_IAM_Tx
        ComIPduSignalRef = ISatID15_IAM_BKPCANFD_1000ms_FrP63_CONTROLLER_0_IAM_Tx
        ComIPduSignalRef = ISatAz16_IAM_BKPCANFD_1000ms_FrP63_CONTROLLER_0_IAM_Tx
        ComIPduSignalRef = ISatElv15_IAM_BKPCANFD_1000ms_FrP63_CONTROLLER_0_IAM_Tx
        ComIPduSignalRef = ISatCNO15_IAM_BKPCANFD_1000ms_FrP63_CONTROLLER_0_IAM_Tx
        ComIPduSignalRef = ISatAz15_IAM_BKPCANFD_1000ms_FrP63_CONTROLLER_0_IAM_Tx
        ComIPduGroupRef = Com_TxPduGroup_CONTROLLER_0_IAM
        ComTxIPdu: ComMinimumDelayTime=0.0, ComTxIPduUnusedAreasDefault=0
          ComTxModeTrue
            ComTxMode: ComTxModeMode=PERIODIC, ComTxModeNumberOfRepetitions=0, ComTxModeRepetitionPeriod=0.0, ComTxModeTimeOffset=0.0, ComTxModeTimePeriod=1.0
      8 x ComSignal, all with ComInvalidNotification=NULL_PTR, ComRxDataTimeoutAction=NONE, ComSignalEndianness=BIG_ENDIAN, ComSignalInitValue=0x0, ComSignalLength=0, ComTransferProperty=PENDING, ComSignalDataInvalidValue=0x0, ComDataInvalidAction=NOTIFY, ComTimeout=0.0, ComFirstTimeout=0.0, ComNotification=Rte_COMCbkTAck:
        ISatID16_IAM_BKPCANFD_1000ms_FrP63_CONTROLLER_0_IAM_Tx: ComBitPosition=57, ComBitSize=7, ComHandleId=ISatID16_IAM_BKPCANFD_1000ms_FrP63_CONTROLLER_0_IAM_Tx, ComSignalType=UINT8
        ISatElv16_IAM_BKPCANFD_1000ms_FrP63_CONTROLLER_0_IAM_Tx: ComBitPosition=49, ComBitSize=7, ComHandleId=ISatElv16_IAM_BKPCANFD_1000ms_FrP63_CONTROLLER_0_IAM_Tx, ComSignalType=UINT8
        ISatCNO16_IAM_BKPCANFD_1000ms_FrP63_CONTROLLER_0_IAM_Tx: ComBitPosition=41, ComBitSize=7, ComHandleId=ISatCNO16_IAM_BKPCANFD_1000ms_FrP63_CONTROLLER_0_IAM_Tx, ComSignalType=UINT8
        ISatID15_IAM_BKPCANFD_1000ms_FrP63_CONTROLLER_0_IAM_Tx: ComBitPosition=25, ComBitSize=7, ComHandleId=ISatID15_IAM_BKPCANFD_1000ms_FrP63_CONTROLLER_0_IAM_Tx, ComSignalType=UINT8
        ISatAz16_IAM_BKPCANFD_1000ms_FrP63_CONTROLLER_0_IAM_Tx: ComBitPosition=32, ComBitSize=9, ComHandleId=ISatAz16_IAM_BKPCANFD_1000ms_FrP63_CONTROLLER_0_IAM_Tx, ComSignalType=UINT16
        ISatElv15_IAM_BKPCANFD_1000ms_FrP63_CONTROLLER_0_IAM_Tx: ComBitPosition=17, ComBitSize=7, ComHandleId=ISatElv15_IAM_BKPCANFD_1000ms_FrP63_CONTROLLER_0_IAM_Tx, ComSignalType=UINT8
        ISatCNO15_IAM_BKPCANFD_1000ms_FrP63_CONTROLLER_0_IAM_Tx: ComBitPosition=8, ComBitSize=7, ComHandleId=ISatCNO15_IAM_BKPCANFD_1000ms_FrP63_CONTROLLER_0_IAM_Tx, ComSignalType=UINT8
        ISatAz15_IAM_BKPCANFD_1000ms_FrP63_CONTROLLER_0_IAM_Tx: ComBitPosition=15, ComBitSize=9, ComHandleId=ISatAz15_IAM_BKPCANFD_1000ms_FrP63_CONTROLLER_0_IAM_Tx, ComSignalType=UINT16
      IAM_BKPCANFD_1000ms_FrP64_CONTROLLER_0_IAM_Tx (ComIPdu):
        ComIPduCancellationSupport = false
        ComIPduDirection = SEND
        ComIPduHandleId = COM_TXPDU_COM_IAM_BKPCANFD_1000ms_FrP64_CONTROLLER_0_IAM_Tx
        ComIPduSignalProcessing = DEFERRED
        ComIPduType = NORMAL
        ComPduIdRef = COM_IAM_BKPCANFD_1000ms_FrP64_CONTROLLER_0_IAM_Tx
        ComIPduSignalRef = ISatID20_IAM_BKPCANFD_1000ms_FrP64_CONTROLLER_0_IAM_Tx
        ComIPduSignalRef = ISatElv20_IAM_BKPCANFD_1000ms_FrP64_CONTROLLER_0_IAM_Tx
        ComIPduSignalRef = ISatCNO20_IAM_BKPCANFD_1000ms_FrP64_CONTROLLER_0_IAM_Tx
        ComIPduSignalRef = ISatID19_IAM_BKPCANFD_1000ms_FrP64_CONTROLLER_0_IAM_Tx
        ComIPduSignalRef = ISatAz20_IAM_BKPCANFD_1000ms_FrP64_CONTROLLER_0_IAM_Tx
        ComIPduSignalRef = ISatElv19_IAM_BKPCANFD_1000ms_FrP64_CONTROLLER_0_IAM_Tx
        ComIPduSignalRef = ISatCNO19_IAM_BKPCANFD_1000ms_FrP64_CONTROLLER_0_IAM_Tx
        ComIPduSignalRef = ISatAz19_IAM_BKPCANFD_1000ms_FrP64_CONTROLLER_0_IAM_Tx
        ComIPduGroupRef = Com_TxPduGroup_CONTROLLER_0_IAM
        ComTxIPdu: ComMinimumDelayTime=0.0, ComTxIPduUnusedAreasDefault=0
          ComTxModeTrue
            ComTxMode: ComTxModeMode=PERIODIC, ComTxModeNumberOfRepetitions=0, ComTxModeRepetitionPeriod=0.0, ComTxModeTimeOffset=0.0, ComTxModeTimePeriod=1.0
      8 x ComSignal, all with ComInvalidNotification=NULL_PTR, ComRxDataTimeoutAction=NONE, ComSignalEndianness=BIG_ENDIAN, ComSignalInitValue=0x0, ComSignalLength=0, ComTransferProperty=PENDING, ComSignalDataInvalidValue=0x0, ComDataInvalidAction=NOTIFY, ComTimeout=0.0, ComFirstTimeout=0.0, ComNotification=Rte_COMCbkTAck:
        ISatID20_IAM_BKPCANFD_1000ms_FrP64_CONTROLLER_0_IAM_Tx: ComBitPosition=57, ComBitSize=7, ComHandleId=ISatID20_IAM_BKPCANFD_1000ms_FrP64_CONTROLLER_0_IAM_Tx, ComSignalType=UINT8
        ISatElv20_IAM_BKPCANFD_1000ms_FrP64_CONTROLLER_0_IAM_Tx: ComBitPosition=49, ComBitSize=7, ComHandleId=ISatElv20_IAM_BKPCANFD_1000ms_FrP64_CONTROLLER_0_IAM_Tx, ComSignalType=UINT8
        ISatCNO20_IAM_BKPCANFD_1000ms_FrP64_CONTROLLER_0_IAM_Tx: ComBitPosition=41, ComBitSize=7, ComHandleId=ISatCNO20_IAM_BKPCANFD_1000ms_FrP64_CONTROLLER_0_IAM_Tx, ComSignalType=UINT8
        ISatID19_IAM_BKPCANFD_1000ms_FrP64_CONTROLLER_0_IAM_Tx: ComBitPosition=25, ComBitSize=7, ComHandleId=ISatID19_IAM_BKPCANFD_1000ms_FrP64_CONTROLLER_0_IAM_Tx, ComSignalType=UINT8
        ISatAz20_IAM_BKPCANFD_1000ms_FrP64_CONTROLLER_0_IAM_Tx: ComBitPosition=32, ComBitSize=9, ComHandleId=ISatAz20_IAM_BKPCANFD_1000ms_FrP64_CONTROLLER_0_IAM_Tx, ComSignalType=UINT16
        ISatElv19_IAM_BKPCANFD_1000ms_FrP64_CONTROLLER_0_IAM_Tx: ComBitPosition=17, ComBitSize=7, ComHandleId=ISatElv19_IAM_BKPCANFD_1000ms_FrP64_CONTROLLER_0_IAM_Tx, ComSignalType=UINT8
        ISatCNO19_IAM_BKPCANFD_1000ms_FrP64_CONTROLLER_0_IAM_Tx: ComBitPosition=8, ComBitSize=7, ComHandleId=ISatCNO19_IAM_BKPCANFD_1000ms_FrP64_CONTROLLER_0_IAM_Tx, ComSignalType=UINT8
        ISatAz19_IAM_BKPCANFD_1000ms_FrP64_CONTROLLER_0_IAM_Tx: ComBitPosition=15, ComBitSize=9, ComHandleId=ISatAz19_IAM_BKPCANFD_1000ms_FrP64_CONTROLLER_0_IAM_Tx, ComSignalType=UINT16
      IAM_BKPCANFD_1000ms_FrP65_CONTROLLER_0_IAM_Tx (ComIPdu):
        ComIPduCancellationSupport = false
        ComIPduDirection = SEND
        ComIPduHandleId = COM_TXPDU_COM_IAM_BKPCANFD_1000ms_FrP65_CONTROLLER_0_IAM_Tx
        ComIPduSignalProcessing = DEFERRED
        ComIPduType = NORMAL
        ComPduIdRef = COM_IAM_BKPCANFD_1000ms_FrP65_CONTROLLER_0_IAM_Tx
        ComIPduSignalRef = ISvGroup_IAM_BKPCANFD_1000ms_FrP65_CONTROLLER_0_IAM_Tx
        ComIPduSignalRef = ISatNum_IAM_BKPCANFD_1000ms_FrP65_CONTROLLER_0_IAM_Tx
        ComIPduGroupRef = Com_TxPduGroup_CONTROLLER_0_IAM
        ComTxIPdu: ComMinimumDelayTime=0.0, ComTxIPduUnusedAreasDefault=0
          ComTxModeTrue
            ComTxMode: ComTxModeMode=PERIODIC, ComTxModeNumberOfRepetitions=0, ComTxModeRepetitionPeriod=0.0, ComTxModeTimeOffset=0.0, ComTxModeTimePeriod=1.0
      ISvGroup_IAM_BKPCANFD_1000ms_FrP65_CONTROLLER_0_IAM_Tx (ComSignal):
        ComBitPosition = 8
        ComBitSize = 8
        ComHandleId = ISvGroup_IAM_BKPCANFD_1000ms_FrP65_CONTROLLER_0_IAM_Tx
        ComInvalidNotification = NULL_PTR
        ComRxDataTimeoutAction = NONE
        ComSignalEndianness = BIG_ENDIAN
        ComSignalInitValue = 0x0
        ComSignalLength = 0
        ComSignalType = UINT8
        ComTransferProperty = PENDING
        ComSignalDataInvalidValue = 0x0
        ComDataInvalidAction = NOTIFY
        ComTimeout = 0.0
        ComFirstTimeout = 0.0
        ComNotification = Rte_COMCbkTAck
      ISatNum_IAM_BKPCANFD_1000ms_FrP65_CONTROLLER_0_IAM_Tx (ComSignal):
        ComBitPosition = 1
        ComBitSize = 7
        ComHandleId = ISatNum_IAM_BKPCANFD_1000ms_FrP65_CONTROLLER_0_IAM_Tx
        ComInvalidNotification = NULL_PTR
        ComRxDataTimeoutAction = NONE
        ComSignalEndianness = BIG_ENDIAN
        ComSignalInitValue = 0x0
        ComSignalLength = 0
        ComSignalType = UINT8
        ComTransferProperty = PENDING
        ComSignalDataInvalidValue = 0x0
        ComDataInvalidAction = NOTIFY
        ComTimeout = 0.0
        ComFirstTimeout = 0.0
        ComNotification = Rte_COMCbkTAck
      IAM_BKPCANFD_1000ms_FrP66_CONTROLLER_0_IAM_Tx (ComIPdu):
        ComIPduCancellationSupport = false
        ComIPduDirection = SEND
        ComIPduHandleId = COM_TXPDU_COM_IAM_BKPCANFD_1000ms_FrP66_CONTROLLER_0_IAM_Tx
        ComIPduSignalProcessing = DEFERRED
        ComIPduType = NORMAL
        ComPduIdRef = COM_IAM_BKPCANFD_1000ms_FrP66_CONTROLLER_0_IAM_Tx
        ComIPduSignalRef = ISatID4_IAM_BKPCANFD_1000ms_FrP66_CONTROLLER_0_IAM_Tx
        ComIPduSignalRef = ISatElv4_IAM_BKPCANFD_1000ms_FrP66_CONTROLLER_0_IAM_Tx
        ComIPduSignalRef = ISatCNO4_IAM_BKPCANFD_1000ms_FrP66_CONTROLLER_0_IAM_Tx
        ComIPduSignalRef = ISatID3_IAM_BKPCANFD_1000ms_FrP66_CONTROLLER_0_IAM_Tx
        ComIPduSignalRef = ISatAz4_IAM_BKPCANFD_1000ms_FrP66_CONTROLLER_0_IAM_Tx
        ComIPduSignalRef = ISatElv3_IAM_BKPCANFD_1000ms_FrP66_CONTROLLER_0_IAM_Tx
        ComIPduSignalRef = ISatCNO3_IAM_BKPCANFD_1000ms_FrP66_CONTROLLER_0_IAM_Tx
        ComIPduSignalRef = ISatAz3_IAM_BKPCANFD_1000ms_FrP66_CONTROLLER_0_IAM_Tx
        ComIPduGroupRef = Com_TxPduGroup_CONTROLLER_0_IAM
        ComTxIPdu: ComMinimumDelayTime=0.0, ComTxIPduUnusedAreasDefault=0
          ComTxModeTrue
            ComTxMode: ComTxModeMode=PERIODIC, ComTxModeNumberOfRepetitions=0, ComTxModeRepetitionPeriod=0.0, ComTxModeTimeOffset=0.0, ComTxModeTimePeriod=1.0
      8 x ComSignal, all with ComInvalidNotification=NULL_PTR, ComRxDataTimeoutAction=NONE, ComSignalEndianness=BIG_ENDIAN, ComSignalInitValue=0x0, ComSignalLength=0, ComTransferProperty=PENDING, ComSignalDataInvalidValue=0x0, ComDataInvalidAction=NOTIFY, ComTimeout=0.0, ComFirstTimeout=0.0, ComNotification=Rte_COMCbkTAck:
        ISatID4_IAM_BKPCANFD_1000ms_FrP66_CONTROLLER_0_IAM_Tx: ComBitPosition=57, ComBitSize=7, ComHandleId=ISatID4_IAM_BKPCANFD_1000ms_FrP66_CONTROLLER_0_IAM_Tx, ComSignalType=UINT8
        ISatElv4_IAM_BKPCANFD_1000ms_FrP66_CONTROLLER_0_IAM_Tx: ComBitPosition=49, ComBitSize=7, ComHandleId=ISatElv4_IAM_BKPCANFD_1000ms_FrP66_CONTROLLER_0_IAM_Tx, ComSignalType=UINT8
        ISatCNO4_IAM_BKPCANFD_1000ms_FrP66_CONTROLLER_0_IAM_Tx: ComBitPosition=41, ComBitSize=7, ComHandleId=ISatCNO4_IAM_BKPCANFD_1000ms_FrP66_CONTROLLER_0_IAM_Tx, ComSignalType=UINT8
        ISatID3_IAM_BKPCANFD_1000ms_FrP66_CONTROLLER_0_IAM_Tx: ComBitPosition=25, ComBitSize=7, ComHandleId=ISatID3_IAM_BKPCANFD_1000ms_FrP66_CONTROLLER_0_IAM_Tx, ComSignalType=UINT8
        ISatAz4_IAM_BKPCANFD_1000ms_FrP66_CONTROLLER_0_IAM_Tx: ComBitPosition=32, ComBitSize=9, ComHandleId=ISatAz4_IAM_BKPCANFD_1000ms_FrP66_CONTROLLER_0_IAM_Tx, ComSignalType=UINT16
        ISatElv3_IAM_BKPCANFD_1000ms_FrP66_CONTROLLER_0_IAM_Tx: ComBitPosition=17, ComBitSize=7, ComHandleId=ISatElv3_IAM_BKPCANFD_1000ms_FrP66_CONTROLLER_0_IAM_Tx, ComSignalType=UINT8
        ISatCNO3_IAM_BKPCANFD_1000ms_FrP66_CONTROLLER_0_IAM_Tx: ComBitPosition=8, ComBitSize=7, ComHandleId=ISatCNO3_IAM_BKPCANFD_1000ms_FrP66_CONTROLLER_0_IAM_Tx, ComSignalType=UINT8
        ISatAz3_IAM_BKPCANFD_1000ms_FrP66_CONTROLLER_0_IAM_Tx: ComBitPosition=15, ComBitSize=9, ComHandleId=ISatAz3_IAM_BKPCANFD_1000ms_FrP66_CONTROLLER_0_IAM_Tx, ComSignalType=UINT16
      IAM_CONNCAN_100ms_FrP18_CONTROLLER_0_IAM_Tx (ComIPdu):
        ComIPduCancellationSupport = false
        ComIPduDirection = SEND
        ComIPduHandleId = COM_TXPDU_COM_IAM_CONNCAN_100ms_FrP18_CONTROLLER_0_IAM_Tx
        ComIPduSignalProcessing = DEFERRED
        ComIPduType = NORMAL
        ComIPduCallout = IAM_CONNCAN_100ms_FrP18_CONTROLLER_0_IAM_Tx
        ComPduIdRef = COM_IAM_CONNCAN_100ms_FrP18_CONTROLLER_0_IAM_Tx
        ComIPduSignalGroupRef = IIAM_100ms_Group18_IAM_CONNCAN_100ms_FrP18_CONTROLLER_0_IAM_Tx
        ComIPduGroupRef = Com_TxPduGroup_CONTROLLER_0_IAM
        ComTxIPdu: ComMinimumDelayTime=0.0, ComTxIPduUnusedAreasDefault=0
          ComTxModeTrue
            ComTxMode: ComTxModeMode=PERIODIC, ComTxModeNumberOfRepetitions=0, ComTxModeRepetitionPeriod=0.0, ComTxModeTimeOffset=0.0, ComTxModeTimePeriod=0.1
      IIAM_100ms_Group18_IAM_CONNCAN_100ms_FrP18_CONTROLLER_0_IAM_Tx (ComSignalGroup):
        ComHandleId = IIAM_100ms_Group18_IAM_CONNCAN_100ms_FrP18_CONTROLLER_0_IAM_Tx
        ComInvalidNotification = NULL_PTR
        ComRxDataTimeoutAction = NONE
        ComTransferProperty = PENDING
        ComDataInvalidAction = NOTIFY
        ComTimeout = 0.0
        ComFirstTimeout = 0.0
        ComNotification = Rte_COMCbkTAck
        6 x ComGroupSignal, all with ComSignalEndianness=BIG_ENDIAN, ComSignalInitValue=0x0, ComSignalLength=0:
          IPitchSigma_IIAM_100ms_Group18_IAM_CONNCAN_100ms_FrP18_CONTROLLER_0_IAM_Tx: ComBitPosition=56, ComBitSize=16, ComHandleId=IIAM_100ms_Group18_IAM_CONNCAN_100ms_FrP18_CONTROLLER_0_IAM_Tx_IPitchSigma_IIAM_100ms_Group18_IAM_CONNCAN_100ms_FrP18_CONTROLLER_0_IAM_Tx, ComSignalType=UINT16, ComSignalDataInvalidValue=0x0
          IHeadingSigma_IIAM_100ms_Group18_IAM_CONNCAN_100ms_FrP18_CONTROLLER_0_IAM_Tx: ComBitPosition=40, ComBitSize=16, ComHandleId=IIAM_100ms_Group18_IAM_CONNCAN_100ms_FrP18_CONTROLLER_0_IAM_Tx_IHeadingSigma_IIAM_100ms_Group18_IAM_CONNCAN_100ms_FrP18_CONTROLLER_0_IAM_Tx, ComSignalType=UINT16, ComSignalDataInvalidValue=0x0
          IPitchRTK_IIAM_100ms_Group18_IAM_CONNCAN_100ms_FrP18_CONTROLLER_0_IAM_Tx: ComBitPosition=24, ComBitSize=16, ComHandleId=IIAM_100ms_Group18_IAM_CONNCAN_100ms_FrP18_CONTROLLER_0_IAM_Tx_IPitchRTK_IIAM_100ms_Group18_IAM_CONNCAN_100ms_FrP18_CONTROLLER_0_IAM_Tx, ComSignalType=SINT16, ComSignalDataInvalidValue=0x0
          IIAM_100ms_Group18_Reserved1_IIAM_100ms_Group18_IAM_CONNCAN_100ms_FrP18_CONTROLLER_0_IAM_Tx: ComBitPosition=12, ComBitSize=4, ComHandleId=IIAM_100ms_Group18_IAM_CONNCAN_100ms_FrP18_CONTROLLER_0_IAM_Tx_IIAM_100ms_Group18_Reserved1_IIAM_100ms_Group18_IAM_CONNCAN_100ms_FrP18_CONTROLLER_0_IAM_Tx, ComSignalType=UINT8, ComSignalDataInvalidValue=0x0
          IIAM_100ms_PDU18_RC_IIAM_100ms_Group18_IAM_CONNCAN_100ms_FrP18_CONTROLLER_0_IAM_Tx: ComBitPosition=8, ComBitSize=4, ComHandleId=IIAM_100ms_Group18_IAM_CONNCAN_100ms_FrP18_CONTROLLER_0_IAM_Tx_IIAM_100ms_PDU18_RC_IIAM_100ms_Group18_IAM_CONNCAN_100ms_FrP18_CONTROLLER_0_IAM_Tx, ComSignalType=UINT8
          IIAM_100ms_PDU18_CRC_IIAM_100ms_Group18_IAM_CONNCAN_100ms_FrP18_CONTROLLER_0_IAM_Tx: ComBitPosition=0, ComBitSize=8, ComHandleId=IIAM_100ms_Group18_IAM_CONNCAN_100ms_FrP18_CONTROLLER_0_IAM_Tx_IIAM_100ms_PDU18_CRC_IIAM_100ms_Group18_IAM_CONNCAN_100ms_FrP18_CONTROLLER_0_IAM_Tx, ComSignalType=UINT8
      IAM_CONNCAN_200ms_FrP01_CONTROLLER_0_IAM_Tx (ComIPdu):
        ComIPduCancellationSupport = false
        ComIPduDirection = SEND
        ComIPduHandleId = COM_TXPDU_COM_IAM_CONNCAN_200ms_FrP01_CONTROLLER_0_IAM_Tx
        ComIPduSignalProcessing = DEFERRED
        ComIPduType = NORMAL
        ComPduIdRef = COM_IAM_CONNCAN_200ms_FrP01_CONTROLLER_0_IAM_Tx
        ComIPduSignalRef = IGPSTiYear_IAM_CONNCAN_200ms_FrP01_CONTROLLER_0_IAM_Tx
        ComIPduSignalRef = IGPSTiSts_IAM_CONNCAN_200ms_FrP01_CONTROLLER_0_IAM_Tx
        ComIPduSignalRef = IGPSTiSec_IAM_CONNCAN_200ms_FrP01_CONTROLLER_0_IAM_Tx
        ComIPduSignalRef = IGPSTiMins_IAM_CONNCAN_200ms_FrP01_CONTROLLER_0_IAM_Tx
        ComIPduSignalRef = IGPSTiHr_IAM_CONNCAN_200ms_FrP01_CONTROLLER_0_IAM_Tx
        ComIPduSignalRef = IGPSTiDay_IAM_CONNCAN_200ms_FrP01_CONTROLLER_0_IAM_Tx
        ComIPduSignalRef = IGPSTiMth_IAM_CONNCAN_200ms_FrP01_CONTROLLER_0_IAM_Tx
        ComIPduGroupRef = Com_TxPduGroup_CONTROLLER_0_IAM
        ComTxIPdu: ComMinimumDelayTime=0.0, ComTxIPduUnusedAreasDefault=0
          ComTxModeTrue
            ComTxMode: ComTxModeMode=PERIODIC, ComTxModeNumberOfRepetitions=0, ComTxModeRepetitionPeriod=0.0, ComTxModeTimeOffset=0.0, ComTxModeTimePeriod=0.2
      7 x ComSignal, all with ComInvalidNotification=NULL_PTR, ComRxDataTimeoutAction=NONE, ComSignalEndianness=BIG_ENDIAN, ComSignalInitValue=0x0, ComSignalLength=0, ComTransferProperty=PENDING, ComSignalDataInvalidValue=0x0, ComDataInvalidAction=NOTIFY, ComTimeout=0.0, ComFirstTimeout=0.0, ComNotification=Rte_COMCbkTAck:
        IGPSTiYear_IAM_CONNCAN_200ms_FrP01_CONTROLLER_0_IAM_Tx: ComBitPosition=56, ComBitSize=8, ComHandleId=IGPSTiYear_IAM_CONNCAN_200ms_FrP01_CONTROLLER_0_IAM_Tx, ComSignalType=UINT8
        IGPSTiSts_IAM_CONNCAN_200ms_FrP01_CONTROLLER_0_IAM_Tx: ComBitPosition=46, ComBitSize=1, ComHandleId=IGPSTiSts_IAM_CONNCAN_200ms_FrP01_CONTROLLER_0_IAM_Tx, ComSignalType=BOOLEAN
        IGPSTiSec_IAM_CONNCAN_200ms_FrP01_CONTROLLER_0_IAM_Tx: ComBitPosition=40, ComBitSize=6, ComHandleId=IGPSTiSec_IAM_CONNCAN_200ms_FrP01_CONTROLLER_0_IAM_Tx, ComSignalType=UINT8
        IGPSTiMins_IAM_CONNCAN_200ms_FrP01_CONTROLLER_0_IAM_Tx: ComBitPosition=32, ComBitSize=6, ComHandleId=IGPSTiMins_IAM_CONNCAN_200ms_FrP01_CONTROLLER_0_IAM_Tx, ComSignalType=UINT8
        IGPSTiHr_IAM_CONNCAN_200ms_FrP01_CONTROLLER_0_IAM_Tx: ComBitPosition=24, ComBitSize=5, ComHandleId=IGPSTiHr_IAM_CONNCAN_200ms_FrP01_CONTROLLER_0_IAM_Tx, ComSignalType=UINT8
        IGPSTiDay_IAM_CONNCAN_200ms_FrP01_CONTROLLER_0_IAM_Tx: ComBitPosition=16, ComBitSize=5, ComHandleId=IGPSTiDay_IAM_CONNCAN_200ms_FrP01_CONTROLLER_0_IAM_Tx, ComSignalType=UINT8
        IGPSTiMth_IAM_CONNCAN_200ms_FrP01_CONTROLLER_0_IAM_Tx: ComBitPosition=8, ComBitSize=4, ComHandleId=IGPSTiMth_IAM_CONNCAN_200ms_FrP01_CONTROLLER_0_IAM_Tx, ComSignalType=UINT8
      IAM_CONNCAN_200ms_FrP02_CONTROLLER_0_IAM_Tx (ComIPdu):
        ComIPduCancellationSupport = false
        ComIPduDirection = SEND
        ComIPduHandleId = COM_TXPDU_COM_IAM_CONNCAN_200ms_FrP02_CONTROLLER_0_IAM_Tx
        ComIPduSignalProcessing = DEFERRED
        ComIPduType = NORMAL
        ComPduIdRef = COM_IAM_CONNCAN_200ms_FrP02_CONTROLLER_0_IAM_Tx
        ComIPduSignalRef = INTPTiMth_IAM_CONNCAN_200ms_FrP02_CONTROLLER_0_IAM_Tx
        ComIPduSignalRef = INTPTiHr_IAM_CONNCAN_200ms_FrP02_CONTROLLER_0_IAM_Tx
        ComIPduSignalRef = INTPTiSec_IAM_CONNCAN_200ms_FrP02_CONTROLLER_0_IAM_Tx
        ComIPduSignalRef = INTPTiDay_IAM_CONNCAN_200ms_FrP02_CONTROLLER_0_IAM_Tx
        ComIPduSignalRef = INTPTiMins_IAM_CONNCAN_200ms_FrP02_CONTROLLER_0_IAM_Tx
        ComIPduSignalRef = INTPTiSts_IAM_CONNCAN_200ms_FrP02_CONTROLLER_0_IAM_Tx
        ComIPduSignalRef = INTPTiYear_IAM_CONNCAN_200ms_FrP02_CONTROLLER_0_IAM_Tx
        ComIPduGroupRef = Com_TxPduGroup_CONTROLLER_0_IAM
        ComTxIPdu: ComMinimumDelayTime=0.0, ComTxIPduUnusedAreasDefault=0
          ComTxModeTrue
            ComTxMode: ComTxModeMode=PERIODIC, ComTxModeNumberOfRepetitions=0, ComTxModeRepetitionPeriod=0.0, ComTxModeTimeOffset=0.0, ComTxModeTimePeriod=0.2
      7 x ComSignal, all with ComInvalidNotification=NULL_PTR, ComRxDataTimeoutAction=NONE, ComSignalEndianness=BIG_ENDIAN, ComSignalInitValue=0x0, ComSignalLength=0, ComTransferProperty=PENDING, ComSignalDataInvalidValue=0x0, ComDataInvalidAction=NOTIFY, ComTimeout=0.0, ComFirstTimeout=0.0, ComNotification=Rte_COMCbkTAck:
        INTPTiMth_IAM_CONNCAN_200ms_FrP02_CONTROLLER_0_IAM_Tx: ComBitPosition=36, ComBitSize=4, ComHandleId=INTPTiMth_IAM_CONNCAN_200ms_FrP02_CONTROLLER_0_IAM_Tx, ComSignalType=UINT8
        INTPTiHr_IAM_CONNCAN_200ms_FrP02_CONTROLLER_0_IAM_Tx: ComBitPosition=24, ComBitSize=5, ComHandleId=INTPTiHr_IAM_CONNCAN_200ms_FrP02_CONTROLLER_0_IAM_Tx, ComSignalType=UINT8
        INTPTiSec_IAM_CONNCAN_200ms_FrP02_CONTROLLER_0_IAM_Tx: ComBitPosition=18, ComBitSize=6, ComHandleId=INTPTiSec_IAM_CONNCAN_200ms_FrP02_CONTROLLER_0_IAM_Tx, ComSignalType=UINT8
        INTPTiDay_IAM_CONNCAN_200ms_FrP02_CONTROLLER_0_IAM_Tx: ComBitPosition=29, ComBitSize=5, ComHandleId=INTPTiDay_IAM_CONNCAN_200ms_FrP02_CONTROLLER_0_IAM_Tx, ComSignalType=UINT8
        INTPTiMins_IAM_CONNCAN_200ms_FrP02_CONTROLLER_0_IAM_Tx: ComBitPosition=10, ComBitSize=6, ComHandleId=INTPTiMins_IAM_CONNCAN_200ms_FrP02_CONTROLLER_0_IAM_Tx, ComSignalType=UINT8
        INTPTiSts_IAM_CONNCAN_200ms_FrP02_CONTROLLER_0_IAM_Tx: ComBitPosition=9, ComBitSize=1, ComHandleId=INTPTiSts_IAM_CONNCAN_200ms_FrP02_CONTROLLER_0_IAM_Tx, ComSignalType=BOOLEAN
        INTPTiYear_IAM_CONNCAN_200ms_FrP02_CONTROLLER_0_IAM_Tx: ComBitPosition=0, ComBitSize=8, ComHandleId=INTPTiYear_IAM_CONNCAN_200ms_FrP02_CONTROLLER_0_IAM_Tx, ComSignalType=UINT8
      IAM_CONNCAN_Event_FrS20_CONTROLLER_0_IAM_Tx (ComIPdu):
        ComIPduCancellationSupport = false
        ComIPduDirection = SEND
        ComIPduHandleId = COM_TXPDU_COM_IAM_CONNCAN_Event_FrS20_CONTROLLER_0_IAM_Tx
        ComIPduSignalProcessing = DEFERRED
        ComIPduType = NORMAL
        ComPduIdRef = COM_IAM_CONNCAN_Event_FrS20_CONTROLLER_0_IAM_Tx
        ComIPduSignalRef = IIAMComKeyEnbResp_IAM_CONNCAN_Event_FrS20_CONTROLLER_0_IAM_Tx
        ComIPduSignalRef = IIAMIdentityResp_IAM_CONNCAN_Event_FrS20_CONTROLLER_0_IAM_Tx
        ComIPduGroupRef = Com_TxPduGroup_CONTROLLER_0_IAM
        ComTxIPdu: ComMinimumDelayTime=0.0, ComTxIPduUnusedAreasDefault=0
          ComTxModeTrue
            ComTxMode: ComTxModeMode=DIRECT, ComTxModeNumberOfRepetitions=3, ComTxModeRepetitionPeriod=0.15, ComTxModeTimeOffset=0.0, ComTxModeTimePeriod=0.0
      IIAMComKeyEnbResp_IAM_CONNCAN_Event_FrS20_CONTROLLER_0_IAM_Tx (ComSignal):
        ComBitPosition = 71
        ComBitSize = 1
        ComHandleId = IIAMComKeyEnbResp_IAM_CONNCAN_Event_FrS20_CONTROLLER_0_IAM_Tx
        ComInvalidNotification = NULL_PTR
        ComRxDataTimeoutAction = NONE
        ComSignalEndianness = BIG_ENDIAN
        ComSignalInitValue = 0x0
        ComSignalLength = 0
        ComSignalType = BOOLEAN
        ComTransferProperty = TRIGGERED
        ComSignalDataInvalidValue = 0x0
        ComDataInvalidAction = NOTIFY
        ComTimeout = 0.0
        ComFirstTimeout = 0.0
        ComNotification = Rte_COMCbkTAck
      IIAMIdentityResp_IAM_CONNCAN_Event_FrS20_CONTROLLER_0_IAM_Tx (ComSignal):
        ComBitPosition = 56
        ComBitSize = 64
        ComHandleId = IIAMIdentityResp_IAM_CONNCAN_Event_FrS20_CONTROLLER_0_IAM_Tx
        ComInvalidNotification = NULL_PTR
        ComRxDataTimeoutAction = NONE
        ComSignalEndianness = BIG_ENDIAN
        ComSignalInitValue = 0x0
        ComSignalLength = 0
        ComSignalType = UINT64
        ComTransferProperty = TRIGGERED
        ComSignalDataInvalidValue = 0x0
        ComDataInvalidAction = NOTIFY
        ComTimeout = 0.0
        ComFirstTimeout = 0.0
        ComNotification = Rte_COMCbkTAck
      IAM_CONNCAN_Event_FrS21_CONTROLLER_0_IAM_Tx (ComIPdu):
        ComIPduCancellationSupport = false
        ComIPduDirection = SEND
        ComIPduHandleId = COM_TXPDU_COM_IAM_CONNCAN_Event_FrS21_CONTROLLER_0_IAM_Tx
        ComIPduSignalProcessing = DEFERRED
        ComIPduType = NORMAL
        ComPduIdRef = COM_IAM_CONNCAN_Event_FrS21_CONTROLLER_0_IAM_Tx
        ComIPduSignalRef = IAIParkngSpcIDIAM_IAM_CONNCAN_Event_FrS21_CONTROLLER_0_IAM_Tx
        ComIPduSignalRef = IAIParkngReqIAM_IAM_CONNCAN_Event_FrS21_CONTROLLER_0_IAM_Tx
        ComIPduGroupRef = Com_TxPduGroup_CONTROLLER_0_IAM
        ComTxIPdu: ComMinimumDelayTime=0.0, ComTxIPduUnusedAreasDefault=0
          ComTxModeTrue
            ComTxMode: ComTxModeMode=DIRECT, ComTxModeNumberOfRepetitions=3, ComTxModeRepetitionPeriod=0.05, ComTxModeTimeOffset=0.0, ComTxModeTimePeriod=0.0
      IAIParkngSpcIDIAM_IAM_CONNCAN_Event_FrS21_CONTROLLER_0_IAM_Tx (ComSignal):
        ComBitPosition = 56
        ComBitSize = 8
        ComHandleId = IAIParkngSpcIDIAM_IAM_CONNCAN_Event_FrS21_CONTROLLER_0_IAM_Tx
        ComInvalidNotification = NULL_PTR
        ComRxDataTimeoutAction = NONE
        ComSignalEndianness = BIG_ENDIAN
        ComSignalInitValue = 0x0
        ComSignalLength = 0
        ComSignalType = UINT8
        ComTransferProperty = TRIGGERED
        ComSignalDataInvalidValue = 0x0
        ComDataInvalidAction = NOTIFY
        ComTimeout = 0.0
        ComFirstTimeout = 0.0
        ComNotification = Rte_COMCbkTAck
      IAIParkngReqIAM_IAM_CONNCAN_Event_FrS21_CONTROLLER_0_IAM_Tx (ComSignal):
        ComBitPosition = 48
        ComBitSize = 8
        ComHandleId = IAIParkngReqIAM_IAM_CONNCAN_Event_FrS21_CONTROLLER_0_IAM_Tx
        ComInvalidNotification = NULL_PTR
        ComRxDataTimeoutAction = NONE
        ComSignalEndianness = BIG_ENDIAN
        ComSignalInitValue = 0x0
        ComSignalLength = 0
        ComSignalType = UINT8
        ComTransferProperty = TRIGGERED
        ComSignalDataInvalidValue = 0x0
        ComDataInvalidAction = NOTIFY
        ComTimeout = 0.0
        ComFirstTimeout = 0.0
        ComNotification = Rte_COMCbkTAck
      IAM_CONNCANFD_100ms_FrP19_CONTROLLER_0_IAM_Tx (ComIPdu):
        ComIPduCancellationSupport = false
        ComIPduDirection = SEND
        ComIPduHandleId = COM_TXPDU_COM_IAM_CONNCANFD_100ms_FrP19_CONTROLLER_0_IAM_Tx
        ComIPduSignalProcessing = DEFERRED
        ComIPduType = NORMAL
        ComPduIdRef = COM_IAM_CONNCANFD_100ms_FrP19_CONTROLLER_0_IAM_Tx
        ComIPduSignalRef = IIAMtoIPDResv14_IAM_CONNCANFD_100ms_FrP19_CONTROLLER_0_IAM_Tx
        ComIPduSignalRef = IIAMtoIPDResv13_IAM_CONNCANFD_100ms_FrP19_CONTROLLER_0_IAM_Tx
        ComIPduSignalRef = IIAMtoIPDResv15_IAM_CONNCANFD_100ms_FrP19_CONTROLLER_0_IAM_Tx
        ComIPduSignalRef = IIAMtoIPD_Rsrv03_IAM_CONNCANFD_100ms_FrP19_CONTROLLER_0_IAM_Tx
        ComIPduSignalRef = IIAMtoIPD_Rsrv12_IAM_CONNCANFD_100ms_FrP19_CONTROLLER_0_IAM_Tx
        ComIPduSignalRef = IIAMtoIPD_Rsrv11_IAM_CONNCANFD_100ms_FrP19_CONTROLLER_0_IAM_Tx
        ComIPduSignalRef = IIAMtoIPD_Rsrv10_IAM_CONNCANFD_100ms_FrP19_CONTROLLER_0_IAM_Tx
        ComIPduSignalRef = IIAMtoIPD_Rsrv08_IAM_CONNCANFD_100ms_FrP19_CONTROLLER_0_IAM_Tx
        ComIPduSignalRef = IIAMtoIPD_Rsrv09_IAM_CONNCANFD_100ms_FrP19_CONTROLLER_0_IAM_Tx
        ComIPduSignalRef = IIAMtoIPD_Rsrv06_IAM_CONNCANFD_100ms_FrP19_CONTROLLER_0_IAM_Tx
        ComIPduSignalRef = IIAMtoIPD_Rsrv07_IAM_CONNCANFD_100ms_FrP19_CONTROLLER_0_IAM_Tx
        ComIPduSignalRef = IIAMtoIPD_Rsrv02_IAM_CONNCANFD_100ms_FrP19_CONTROLLER_0_IAM_Tx
        ComIPduSignalRef = IIAMtoIPD_Rsrv04_IAM_CONNCANFD_100ms_FrP19_CONTROLLER_0_IAM_Tx
        ComIPduSignalRef = IIAMtoIPD_Rsrv05_IAM_CONNCANFD_100ms_FrP19_CONTROLLER_0_IAM_Tx
        ComIPduSignalRef = IIAMtoIPD_Rsrv01_IAM_CONNCANFD_100ms_FrP19_CONTROLLER_0_IAM_Tx
        ComIPduGroupRef = Com_TxPduGroup_CONTROLLER_0_IAM
        ComTxIPdu: ComMinimumDelayTime=0.0, ComTxIPduUnusedAreasDefault=0
          ComTxModeTrue
            ComTxMode: ComTxModeMode=PERIODIC, ComTxModeNumberOfRepetitions=0, ComTxModeRepetitionPeriod=0.0, ComTxModeTimeOffset=0.0, ComTxModeTimePeriod=0.1
      15 x ComSignal, all with ComInvalidNotification=NULL_PTR, ComRxDataTimeoutAction=NONE, ComSignalEndianness=BIG_ENDIAN, ComSignalInitValue=0x0, ComSignalLength=0, ComTransferProperty=PENDING, ComSignalDataInvalidValue=0x0, ComDataInvalidAction=NOTIFY, ComTimeout=0.0, ComFirstTimeout=0.0, ComNotification=Rte_COMCbkTAck:
        IIAMtoIPDResv14_IAM_CONNCANFD_100ms_FrP19_CONTROLLER_0_IAM_Tx: ComBitPosition=128, ComBitSize=8, ComHandleId=IIAMtoIPDResv14_IAM_CONNCANFD_100ms_FrP19_CONTROLLER_0_IAM_Tx, ComSignalType=UINT8
        IIAMtoIPDResv13_IAM_CONNCANFD_100ms_FrP19_CONTROLLER_0_IAM_Tx: ComBitPosition=120, ComBitSize=8, ComHandleId=IIAMtoIPDResv13_IAM_CONNCANFD_100ms_FrP19_CONTROLLER_0_IAM_Tx, ComSignalType=UINT8
        IIAMtoIPDResv15_IAM_CONNCANFD_100ms_FrP19_CONTROLLER_0_IAM_Tx: ComBitPosition=72, ComBitSize=16, ComHandleId=IIAMtoIPDResv15_IAM_CONNCANFD_100ms_FrP19_CONTROLLER_0_IAM_Tx, ComSignalType=UINT16
        IIAMtoIPD_Rsrv03_IAM_CONNCANFD_100ms_FrP19_CONTROLLER_0_IAM_Tx: ComBitPosition=62, ComBitSize=2, ComHandleId=IIAMtoIPD_Rsrv03_IAM_CONNCANFD_100ms_FrP19_CONTROLLER_0_IAM_Tx, ComSignalType=UINT8
        IIAMtoIPD_Rsrv12_IAM_CONNCANFD_100ms_FrP19_CONTROLLER_0_IAM_Tx: ComBitPosition=48, ComBitSize=16, ComHandleId=IIAMtoIPD_Rsrv12_IAM_CONNCANFD_100ms_FrP19_CONTROLLER_0_IAM_Tx, ComSignalType=UINT16
        IIAMtoIPD_Rsrv11_IAM_CONNCANFD_100ms_FrP19_CONTROLLER_0_IAM_Tx: ComBitPosition=32, ComBitSize=8, ComHandleId=IIAMtoIPD_Rsrv11_IAM_CONNCANFD_100ms_FrP19_CONTROLLER_0_IAM_Tx, ComSignalType=UINT8
        IIAMtoIPD_Rsrv10_IAM_CONNCANFD_100ms_FrP19_CONTROLLER_0_IAM_Tx: ComBitPosition=24, ComBitSize=8, ComHandleId=IIAMtoIPD_Rsrv10_IAM_CONNCANFD_100ms_FrP19_CONTROLLER_0_IAM_Tx, ComSignalType=UINT8
        IIAMtoIPD_Rsrv08_IAM_CONNCANFD_100ms_FrP19_CONTROLLER_0_IAM_Tx: ComBitPosition=20, ComBitSize=4, ComHandleId=IIAMtoIPD_Rsrv08_IAM_CONNCANFD_100ms_FrP19_CONTROLLER_0_IAM_Tx, ComSignalType=UINT8
        IIAMtoIPD_Rsrv09_IAM_CONNCANFD_100ms_FrP19_CONTROLLER_0_IAM_Tx: ComBitPosition=16, ComBitSize=4, ComHandleId=IIAMtoIPD_Rsrv09_IAM_CONNCANFD_100ms_FrP19_CONTROLLER_0_IAM_Tx, ComSignalType=UINT8
        IIAMtoIPD_Rsrv06_IAM_CONNCANFD_100ms_FrP19_CONTROLLER_0_IAM_Tx: ComBitPosition=13, ComBitSize=3, ComHandleId=IIAMtoIPD_Rsrv06_IAM_CONNCANFD_100ms_FrP19_CONTROLLER_0_IAM_Tx, ComSignalType=UINT8
        IIAMtoIPD_Rsrv07_IAM_CONNCANFD_100ms_FrP19_CONTROLLER_0_IAM_Tx: ComBitPosition=10, ComBitSize=3, ComHandleId=IIAMtoIPD_Rsrv07_IAM_CONNCANFD_100ms_FrP19_CONTROLLER_0_IAM_Tx, ComSignalType=UINT8
        IIAMtoIPD_Rsrv02_IAM_CONNCANFD_100ms_FrP19_CONTROLLER_0_IAM_Tx: ComBitPosition=8, ComBitSize=2, ComHandleId=IIAMtoIPD_Rsrv02_IAM_CONNCANFD_100ms_FrP19_CONTROLLER_0_IAM_Tx, ComSignalType=UINT8
        IIAMtoIPD_Rsrv04_IAM_CONNCANFD_100ms_FrP19_CONTROLLER_0_IAM_Tx: ComBitPosition=5, ComBitSize=3, ComHandleId=IIAMtoIPD_Rsrv04_IAM_CONNCANFD_100ms_FrP19_CONTROLLER_0_IAM_Tx, ComSignalType=UINT8
        IIAMtoIPD_Rsrv05_IAM_CONNCANFD_100ms_FrP19_CONTROLLER_0_IAM_Tx: ComBitPosition=2, ComBitSize=3, ComHandleId=IIAMtoIPD_Rsrv05_IAM_CONNCANFD_100ms_FrP19_CONTROLLER_0_IAM_Tx, ComSignalType=UINT8
        IIAMtoIPD_Rsrv01_IAM_CONNCANFD_100ms_FrP19_CONTROLLER_0_IAM_Tx: ComBitPosition=0, ComBitSize=2, ComHandleId=IIAMtoIPD_Rsrv01_IAM_CONNCANFD_100ms_FrP19_CONTROLLER_0_IAM_Tx, ComSignalType=UINT8
      IAM_CONNCANFD_Event_FrS04_CONTROLLER_0_IAM_Tx (ComIPdu):
        ComIPduCancellationSupport = false
        ComIPduDirection = SEND
        ComIPduHandleId = COM_TXPDU_COM_IAM_CONNCANFD_Event_FrS04_CONTROLLER_0_IAM_Tx
        ComIPduSignalProcessing = DEFERRED
        ComIPduType = NORMAL
        ComPduIdRef = COM_IAM_CONNCANFD_Event_FrS04_CONTROLLER_0_IAM_Tx
        ComIPduSignalRef = IIAMReststs_IAM_CONNCANFD_Event_FrS04_CONTROLLER_0_IAM_Tx
        ComIPduSignalRef = IPkUpPntID_IAM_CONNCANFD_Event_FrS04_CONTROLLER_0_IAM_Tx
        ComIPduGroupRef = Com_TxPduGroup_CONTROLLER_0_IAM
        ComTxIPdu: ComMinimumDelayTime=0.0, ComTxIPduUnusedAreasDefault=0
          ComTxModeTrue
            ComTxMode: ComTxModeMode=DIRECT, ComTxModeNumberOfRepetitions=3, ComTxModeRepetitionPeriod=0.05, ComTxModeTimeOffset=0.0, ComTxModeTimePeriod=0.0
      IIAMReststs_IAM_CONNCANFD_Event_FrS04_CONTROLLER_0_IAM_Tx (ComSignal):
        ComBitPosition = 32
        ComBitSize = 2
        ComHandleId = IIAMReststs_IAM_CONNCANFD_Event_FrS04_CONTROLLER_0_IAM_Tx
        ComInvalidNotification = NULL_PTR
        ComRxDataTimeoutAction = NONE
        ComSignalEndianness = BIG_ENDIAN
        ComSignalInitValue = 0x0
        ComSignalLength = 0
        ComSignalType = UINT8
        ComTransferProperty = TRIGGERED
        ComSignalDataInvalidValue = 0x0
        ComDataInvalidAction = NOTIFY
        ComTimeout = 0.0
        ComFirstTimeout = 0.0
        ComNotification = Rte_COMCbkTAck
      IPkUpPntID_IAM_CONNCANFD_Event_FrS04_CONTROLLER_0_IAM_Tx (ComSignal):
        ComBitPosition = 3
        ComBitSize = 4
        ComHandleId = IPkUpPntID_IAM_CONNCANFD_Event_FrS04_CONTROLLER_0_IAM_Tx
        ComInvalidNotification = NULL_PTR
        ComRxDataTimeoutAction = NONE
        ComSignalEndianness = BIG_ENDIAN
        ComSignalInitValue = 0x0
        ComSignalLength = 0
        ComSignalType = UINT8
        ComTransferProperty = TRIGGERED
        ComSignalDataInvalidValue = 0x0
        ComDataInvalidAction = NOTIFY
        ComTimeout = 0.0
        ComFirstTimeout = 0.0
        ComNotification = Rte_COMCbkTAck
      IAM_CONNCANFD_Event_FrS42_CONTROLLER_0_IAM_Tx (ComIPdu):
        ComIPduCancellationSupport = false
        ComIPduDirection = SEND
        ComIPduHandleId = COM_TXPDU_COM_IAM_CONNCANFD_Event_FrS42_CONTROLLER_0_IAM_Tx
        ComIPduSignalProcessing = DEFERRED
        ComIPduType = NORMAL
        ComPduIdRef = COM_IAM_CONNCANFD_Event_FrS42_CONTROLLER_0_IAM_Tx
        ComIPduSignalRef = IRmtKeyVldReq_IAM_CONNCANFD_Event_FrS42_CONTROLLER_0_IAM_Tx
        ComIPduSignalRef = IRmtFindMyCarCtrl_IAM_CONNCANFD_Event_FrS42_CONTROLLER_0_IAM_Tx
        ComIPduSignalRef = IRmtFindCarTimeInfo_IAM_CONNCANFD_Event_FrS42_CONTROLLER_0_IAM_Tx
        ComIPduSignalRef = IRmtKeyVldTimeInfo_IAM_CONNCANFD_Event_FrS42_CONTROLLER_0_IAM_Tx
        ComIPduGroupRef = Com_TxPduGroup_CONTROLLER_0_IAM
        ComTxIPdu: ComMinimumDelayTime=0.0, ComTxIPduUnusedAreasDefault=0
          ComTxModeTrue
            ComTxMode: ComTxModeMode=DIRECT, ComTxModeNumberOfRepetitions=3, ComTxModeRepetitionPeriod=0.05, ComTxModeTimeOffset=0.0, ComTxModeTimePeriod=0.0
      4 x ComSignal, all with ComInvalidNotification=NULL_PTR, ComRxDataTimeoutAction=NONE, ComSignalEndianness=BIG_ENDIAN, ComSignalInitValue=0x0, ComSignalLength=0, ComTransferProperty=TRIGGERED, ComSignalDataInvalidValue=0x0, ComDataInvalidAction=NOTIFY, ComTimeout=0.0, ComFirstTimeout=0.0, ComNotification=Rte_COMCbkTAck:
        IRmtKeyVldReq_IAM_CONNCANFD_Event_FrS42_CONTROLLER_0_IAM_Tx: ComBitPosition=47, ComBitSize=1, ComHandleId=IRmtKeyVldReq_IAM_CONNCANFD_Event_FrS42_CONTROLLER_0_IAM_Tx, ComSignalType=BOOLEAN
        IRmtFindMyCarCtrl_IAM_CONNCANFD_Event_FrS42_CONTROLLER_0_IAM_Tx: ComBitPosition=34, ComBitSize=3, ComHandleId=IRmtFindMyCarCtrl_IAM_CONNCANFD_Event_FrS42_CONTROLLER_0_IAM_Tx, ComSignalType=UINT8
        IRmtFindCarTimeInfo_IAM_CONNCANFD_Event_FrS42_CONTROLLER_0_IAM_Tx: ComBitPosition=24, ComBitSize=8, ComHandleId=IRmtFindCarTimeInfo_IAM_CONNCANFD_Event_FrS42_CONTROLLER_0_IAM_Tx, ComSignalType=UINT8
        IRmtKeyVldTimeInfo_IAM_CONNCANFD_Event_FrS42_CONTROLLER_0_IAM_Tx: ComBitPosition=16, ComBitSize=8, ComHandleId=IRmtKeyVldTimeInfo_IAM_CONNCANFD_Event_FrS42_CONTROLLER_0_IAM_Tx, ComSignalType=UINT8
      IAM_CONNCANFD_Event_FrS43_CONTROLLER_0_IAM_Tx (ComIPdu):
        ComIPduCancellationSupport = false
        ComIPduDirection = SEND
        ComIPduHandleId = COM_TXPDU_COM_IAM_CONNCANFD_Event_FrS43_CONTROLLER_0_IAM_Tx
        ComIPduSignalProcessing = DEFERRED
        ComIPduType = NORMAL
        ComPduIdRef = COM_IAM_CONNCANFD_Event_FrS43_CONTROLLER_0_IAM_Tx
        ComIPduSignalRef = IRmtAltngChrgCrntReq_IAM_CONNCANFD_Event_FrS43_CONTROLLER_0_IAM_Tx
        ComIPduSignalRef = IRmtFridgeReq_IAM_CONNCANFD_Event_FrS43_CONTROLLER_0_IAM_Tx
        ComIPduSignalRef = IRmtHldFdgeAftLckSet_IAM_CONNCANFD_Event_FrS43_CONTROLLER_0_IAM_Tx
        ComIPduSignalRef = IRmtHldFdgeAftLckTemSet_IAM_CONNCANFD_Event_FrS43_CONTROLLER_0_IAM_Tx
        ComIPduSignalRef = IRmtHldFdgeAftLckTimeSet_IAM_CONNCANFD_Event_FrS43_CONTROLLER_0_IAM_Tx
        ComIPduSignalRef = IRmtFridgeWorkingTimeReq_IAM_CONNCANFD_Event_FrS43_CONTROLLER_0_IAM_Tx
        ComIPduSignalRef = IRmtFridgeTemReq_IAM_CONNCANFD_Event_FrS43_CONTROLLER_0_IAM_Tx
        ComIPduSignalRef = IRmtStrgWhlHeatReq_IAM_CONNCANFD_Event_FrS43_CONTROLLER_0_IAM_Tx
        ComIPduSignalRef = IRmtCtrlPwrLftgtReq_IAM_CONNCANFD_Event_FrS43_CONTROLLER_0_IAM_Tx
        ComIPduSignalRef = IRmtBattWarmReq_IAM_CONNCANFD_Event_FrS43_CONTROLLER_0_IAM_Tx
        ComIPduSignalRef = IRmtACTrgtAirMdReq_IAM_CONNCANFD_Event_FrS43_CONTROLLER_0_IAM_Tx
        ComIPduSignalRef = IRmtCtrlWinReq_IAM_CONNCANFD_Event_FrS43_CONTROLLER_0_IAM_Tx
        ComIPduSignalRef = IRmtThrdRowLSeatVentReq_IAM_CONNCANFD_Event_FrS43_CONTROLLER_0_IAM_Tx
        ComIPduSignalRef = IRmtThrdRowRSeatHeatReq_IAM_CONNCANFD_Event_FrS43_CONTROLLER_0_IAM_Tx
        ComIPduSignalRef = IRmtThrdRowRSeatVentReq_IAM_CONNCANFD_Event_FrS43_CONTROLLER_0_IAM_Tx
        ComIPduSignalRef = IRmtThrdRowLSeatHeatReq_IAM_CONNCANFD_Event_FrS43_CONTROLLER_0_IAM_Tx
        ComIPduSignalRef = IRmtCtrlWinDecSpa_IAM_CONNCANFD_Event_FrS43_CONTROLLER_0_IAM_Tx
        ComIPduSignalRef = IRmtSlientUnlckTimeSet_IAM_CONNCANFD_Event_FrS43_CONTROLLER_0_IAM_Tx
        ComIPduSignalRef = IRVSTimeSet_IAM_CONNCANFD_Event_FrS43_CONTROLLER_0_IAM_Tx
        ComIPduSignalRef = IRmtChrgTrgtSOCReq_IAM_CONNCANFD_Event_FrS43_CONTROLLER_0_IAM_Tx
        ComIPduSignalRef = IRVSStartReq_IAM_CONNCANFD_Event_FrS43_CONTROLLER_0_IAM_Tx
        ComIPduSignalRef = IRmtReserStMinute_IAM_CONNCANFD_Event_FrS43_CONTROLLER_0_IAM_Tx
        ComIPduSignalRef = IRmtReserCtrlReq_IAM_CONNCANFD_Event_FrS43_CONTROLLER_0_IAM_Tx
        ComIPduSignalRef = IRmtReserSpMinute_IAM_CONNCANFD_Event_FrS43_CONTROLLER_0_IAM_Tx
        ComIPduSignalRef = IRmtDrvrSeatVentReq_IAM_CONNCANFD_Event_FrS43_CONTROLLER_0_IAM_Tx
        ComIPduSignalRef = IRmtPsngSeatHeatReq_IAM_CONNCANFD_Event_FrS43_CONTROLLER_0_IAM_Tx
        ComIPduSignalRef = IRmtReserSpHour_IAM_CONNCANFD_Event_FrS43_CONTROLLER_0_IAM_Tx
        ComIPduSignalRef = IRmtDrvrSeatHeatReq_IAM_CONNCANFD_Event_FrS43_CONTROLLER_0_IAM_Tx
        ComIPduSignalRef = IRmtACReq_IAM_CONNCANFD_Event_FrS43_CONTROLLER_0_IAM_Tx
        ComIPduSignalRef = IRmtReserStHour_IAM_CONNCANFD_Event_FrS43_CONTROLLER_0_IAM_Tx
        ComIPduSignalRef = IRmtACWorkingTimeReq_IAM_CONNCANFD_Event_FrS43_CONTROLLER_0_IAM_Tx
        ComIPduSignalRef = IRVSStopReq_IAM_CONNCANFD_Event_FrS43_CONTROLLER_0_IAM_Tx
        ComIPduSignalRef = IRmtACTrgtTemReq_IAM_CONNCANFD_Event_FrS43_CONTROLLER_0_IAM_Tx
        ComIPduSignalRef = IRmtExtrLckCtrlReq_IAM_CONNCANFD_Event_FrS43_CONTROLLER_0_IAM_Tx
        ComIPduSignalRef = IRmtPsngSeatVentReq_IAM_CONNCANFD_Event_FrS43_CONTROLLER_0_IAM_Tx
        ComIPduSignalRef = IRmtHtdRrWndReq_IAM_CONNCANFD_Event_FrS43_CONTROLLER_0_IAM_Tx
        ComIPduSignalRef = IRmtSecRowLSeatHeatReq_IAM_CONNCANFD_Event_FrS43_CONTROLLER_0_IAM_Tx
        ComIPduSignalRef = IRmtSecRowLSeatVentReq_IAM_CONNCANFD_Event_FrS43_CONTROLLER_0_IAM_Tx
        ComIPduSignalRef = IRmtSecRowRSeatHeatReq_IAM_CONNCANFD_Event_FrS43_CONTROLLER_0_IAM_Tx
        ComIPduSignalRef = IRmtSecRowRSeatVentReq_IAM_CONNCANFD_Event_FrS43_CONTROLLER_0_IAM_Tx
        ComIPduSignalRef = IRmtACTrgtRcctnReq_IAM_CONNCANFD_Event_FrS43_CONTROLLER_0_IAM_Tx
        ComIPduSignalRef = IRmtACTrgtBlwLvlReq_IAM_CONNCANFD_Event_FrS43_CONTROLLER_0_IAM_Tx
        ComIPduGroupRef = Com_TxPduGroup_CONTROLLER_0_IAM
        ComTxIPdu: ComMinimumDelayTime=0.0, ComTxIPduUnusedAreasDefault=0
          ComTxModeTrue
            ComTxMode: ComTxModeMode=DIRECT, ComTxModeNumberOfRepetitions=3, ComTxModeRepetitionPeriod=0.05, ComTxModeTimeOffset=0.0, ComTxModeTimePeriod=0.0
      42 x ComSignal, all with ComInvalidNotification=NULL_PTR, ComRxDataTimeoutAction=NONE, ComSignalEndianness=BIG_ENDIAN, ComSignalInitValue=0x0, ComSignalLength=0, ComTransferProperty=TRIGGERED, ComSignalDataInvalidValue=0x0, ComDataInvalidAction=NOTIFY, ComTimeout=0.0, ComFirstTimeout=0.0, ComNotification=Rte_COMCbkTAck:
        IRmtAltngChrgCrntReq_IAM_CONNCANFD_Event_FrS43_CONTROLLER_0_IAM_Tx: ComBitPosition=208, ComBitSize=8, ComHandleId=IRmtAltngChrgCrntReq_IAM_CONNCANFD_Event_FrS43_CONTROLLER_0_IAM_Tx, ComSignalType=UINT8
        IRmtFridgeReq_IAM_CONNCANFD_Event_FrS43_CONTROLLER_0_IAM_Tx: ComBitPosition=205, ComBitSize=3, ComHandleId=IRmtFridgeReq_IAM_CONNCANFD_Event_FrS43_CONTROLLER_0_IAM_Tx, ComSignalType=UINT8
        IRmtHldFdgeAftLckSet_IAM_CONNCANFD_Event_FrS43_CONTROLLER_0_IAM_Tx: ComBitPosition=202, ComBitSize=3, ComHandleId=IRmtHldFdgeAftLckSet_IAM_CONNCANFD_Event_FrS43_CONTROLLER_0_IAM_Tx, ComSignalType=UINT8
        IRmtHldFdgeAftLckTemSet_IAM_CONNCANFD_Event_FrS43_CONTROLLER_0_IAM_Tx: ComBitPosition=192, ComBitSize=8, ComHandleId=IRmtHldFdgeAftLckTemSet_IAM_CONNCANFD_Event_FrS43_CONTROLLER_0_IAM_Tx, ComSignalType=UINT8
        IRmtHldFdgeAftLckTimeSet_IAM_CONNCANFD_Event_FrS43_CONTROLLER_0_IAM_Tx: ComBitPosition=184, ComBitSize=8, ComHandleId=IRmtHldFdgeAftLckTimeSet_IAM_CONNCANFD_Event_FrS43_CONTROLLER_0_IAM_Tx, ComSignalType=UINT8
        IRmtFridgeWorkingTimeReq_IAM_CONNCANFD_Event_FrS43_CONTROLLER_0_IAM_Tx: ComBitPosition=176, ComBitSize=8, ComHandleId=IRmtFridgeWorkingTimeReq_IAM_CONNCANFD_Event_FrS43_CONTROLLER_0_IAM_Tx, ComSignalType=UINT8
        IRmtFridgeTemReq_IAM_CONNCANFD_Event_FrS43_CONTROLLER_0_IAM_Tx: ComBitPosition=168, ComBitSize=8, ComHandleId=IRmtFridgeTemReq_IAM_CONNCANFD_Event_FrS43_CONTROLLER_0_IAM_Tx, ComSignalType=UINT8
        IRmtStrgWhlHeatReq_IAM_CONNCANFD_Event_FrS43_CONTROLLER_0_IAM_Tx: ComBitPosition=165, ComBitSize=3, ComHandleId=IRmtStrgWhlHeatReq_IAM_CONNCANFD_Event_FrS43_CONTROLLER_0_IAM_Tx, ComSignalType=UINT8
        IRmtCtrlPwrLftgtReq_IAM_CONNCANFD_Event_FrS43_CONTROLLER_0_IAM_Tx: ComBitPosition=157, ComBitSize=3, ComHandleId=IRmtCtrlPwrLftgtReq_IAM_CONNCANFD_Event_FrS43_CONTROLLER_0_IAM_Tx, ComSignalType=UINT8
        IRmtBattWarmReq_IAM_CONNCANFD_Event_FrS43_CONTROLLER_0_IAM_Tx: ComBitPosition=154, ComBitSize=3, ComHandleId=IRmtBattWarmReq_IAM_CONNCANFD_Event_FrS43_CONTROLLER_0_IAM_Tx, ComSignalType=UINT8
        IRmtACTrgtAirMdReq_IAM_CONNCANFD_Event_FrS43_CONTROLLER_0_IAM_Tx: ComBitPosition=148, ComBitSize=4, ComHandleId=IRmtACTrgtAirMdReq_IAM_CONNCANFD_Event_FrS43_CONTROLLER_0_IAM_Tx, ComSignalType=UINT8
        IRmtCtrlWinReq_IAM_CONNCANFD_Event_FrS43_CONTROLLER_0_IAM_Tx: ComBitPosition=144, ComBitSize=4, ComHandleId=IRmtCtrlWinReq_IAM_CONNCANFD_Event_FrS43_CONTROLLER_0_IAM_Tx, ComSignalType=UINT8
        IRmtThrdRowLSeatVentReq_IAM_CONNCANFD_Event_FrS43_CONTROLLER_0_IAM_Tx: ComBitPosition=141, ComBitSize=3, ComHandleId=IRmtThrdRowLSeatVentReq_IAM_CONNCANFD_Event_FrS43_CONTROLLER_0_IAM_Tx, ComSignalType=UINT8
        IRmtThrdRowRSeatHeatReq_IAM_CONNCANFD_Event_FrS43_CONTROLLER_0_IAM_Tx: ComBitPosition=138, ComBitSize=3, ComHandleId=IRmtThrdRowRSeatHeatReq_IAM_CONNCANFD_Event_FrS43_CONTROLLER_0_IAM_Tx, ComSignalType=UINT8
        IRmtThrdRowRSeatVentReq_IAM_CONNCANFD_Event_FrS43_CONTROLLER_0_IAM_Tx: ComBitPosition=133, ComBitSize=3, ComHandleId=IRmtThrdRowRSeatVentReq_IAM_CONNCANFD_Event_FrS43_CONTROLLER_0_IAM_Tx, ComSignalType=UINT8
        IRmtThrdRowLSeatHeatReq_IAM_CONNCANFD_Event_FrS43_CONTROLLER_0_IAM_Tx: ComBitPosition=130, ComBitSize=3, ComHandleId=IRmtThrdRowLSeatHeatReq_IAM_CONNCANFD_Event_FrS43_CONTROLLER_0_IAM_Tx, ComSignalType=UINT8
        IRmtCtrlWinDecSpa_IAM_CONNCANFD_Event_FrS43_CONTROLLER_0_IAM_Tx: ComBitPosition=120, ComBitSize=8, ComHandleId=IRmtCtrlWinDecSpa_IAM_CONNCANFD_Event_FrS43_CONTROLLER_0_IAM_Tx, ComSignalType=UINT8
        IRmtSlientUnlckTimeSet_IAM_CONNCANFD_Event_FrS43_CONTROLLER_0_IAM_Tx: ComBitPosition=112, ComBitSize=8, ComHandleId=IRmtSlientUnlckTimeSet_IAM_CONNCANFD_Event_FrS43_CONTROLLER_0_IAM_Tx, ComSignalType=UINT8
        IRVSTimeSet_IAM_CONNCANFD_Event_FrS43_CONTROLLER_0_IAM_Tx: ComBitPosition=104, ComBitSize=8, ComHandleId=IRVSTimeSet_IAM_CONNCANFD_Event_FrS43_CONTROLLER_0_IAM_Tx, ComSignalType=UINT8
        IRmtChrgTrgtSOCReq_IAM_CONNCANFD_Event_FrS43_CONTROLLER_0_IAM_Tx: ComBitPosition=97, ComBitSize=7, ComHandleId=IRmtChrgTrgtSOCReq_IAM_CONNCANFD_Event_FrS43_CONTROLLER_0_IAM_Tx, ComSignalType=UINT8
        IRVSStartReq_IAM_CONNCANFD_Event_FrS43_CONTROLLER_0_IAM_Tx: ComBitPosition=96, ComBitSize=1, ComHandleId=IRVSStartReq_IAM_CONNCANFD_Event_FrS43_CONTROLLER_0_IAM_Tx, ComSignalType=BOOLEAN
        IRmtReserStMinute_IAM_CONNCANFD_Event_FrS43_CONTROLLER_0_IAM_Tx: ComBitPosition=90, ComBitSize=6, ComHandleId=IRmtReserStMinute_IAM_CONNCANFD_Event_FrS43_CONTROLLER_0_IAM_Tx, ComSignalType=UINT8
        IRmtReserCtrlReq_IAM_CONNCANFD_Event_FrS43_CONTROLLER_0_IAM_Tx: ComBitPosition=88, ComBitSize=2, ComHandleId=IRmtReserCtrlReq_IAM_CONNCANFD_Event_FrS43_CONTROLLER_0_IAM_Tx, ComSignalType=UINT8
        IRmtReserSpMinute_IAM_CONNCANFD_Event_FrS43_CONTROLLER_0_IAM_Tx: ComBitPosition=82, ComBitSize=6, ComHandleId=IRmtReserSpMinute_IAM_CONNCANFD_Event_FrS43_CONTROLLER_0_IAM_Tx, ComSignalType=UINT8
        IRmtDrvrSeatVentReq_IAM_CONNCANFD_Event_FrS43_CONTROLLER_0_IAM_Tx: ComBitPosition=77, ComBitSize=3, ComHandleId=IRmtDrvrSeatVentReq_IAM_CONNCANFD_Event_FrS43_CONTROLLER_0_IAM_Tx, ComSignalType=UINT8
        IRmtPsngSeatHeatReq_IAM_CONNCANFD_Event_FrS43_CONTROLLER_0_IAM_Tx: ComBitPosition=74, ComBitSize=3, ComHandleId=IRmtPsngSeatHeatReq_IAM_CONNCANFD_Event_FrS43_CONTROLLER_0_IAM_Tx, ComSignalType=UINT8
        IRmtReserSpHour_IAM_CONNCANFD_Event_FrS43_CONTROLLER_0_IAM_Tx: ComBitPosition=67, ComBitSize=5, ComHandleId=IRmtReserSpHour_IAM_CONNCANFD_Event_FrS43_CONTROLLER_0_IAM_Tx, ComSignalType=UINT8
        IRmtDrvrSeatHeatReq_IAM_CONNCANFD_Event_FrS43_CONTROLLER_0_IAM_Tx: ComBitPosition=64, ComBitSize=3, ComHandleId=IRmtDrvrSeatHeatReq_IAM_CONNCANFD_Event_FrS43_CONTROLLER_0_IAM_Tx, ComSignalType=UINT8
        IRmtACReq_IAM_CONNCANFD_Event_FrS43_CONTROLLER_0_IAM_Tx: ComBitPosition=61, ComBitSize=3, ComHandleId=IRmtACReq_IAM_CONNCANFD_Event_FrS43_CONTROLLER_0_IAM_Tx, ComSignalType=UINT8
        IRmtReserStHour_IAM_CONNCANFD_Event_FrS43_CONTROLLER_0_IAM_Tx: ComBitPosition=56, ComBitSize=5, ComHandleId=IRmtReserStHour_IAM_CONNCANFD_Event_FrS43_CONTROLLER_0_IAM_Tx, ComSignalType=UINT8
        IRmtACWorkingTimeReq_IAM_CONNCANFD_Event_FrS43_CONTROLLER_0_IAM_Tx: ComBitPosition=48, ComBitSize=8, ComHandleId=IRmtACWorkingTimeReq_IAM_CONNCANFD_Event_FrS43_CONTROLLER_0_IAM_Tx, ComSignalType=UINT8
        IRVSStopReq_IAM_CONNCANFD_Event_FrS43_CONTROLLER_0_IAM_Tx: ComBitPosition=47, ComBitSize=1, ComHandleId=IRVSStopReq_IAM_CONNCANFD_Event_FrS43_CONTROLLER_0_IAM_Tx, ComSignalType=BOOLEAN
        IRmtACTrgtTemReq_IAM_CONNCANFD_Event_FrS43_CONTROLLER_0_IAM_Tx: ComBitPosition=41, ComBitSize=6, ComHandleId=IRmtACTrgtTemReq_IAM_CONNCANFD_Event_FrS43_CONTROLLER_0_IAM_Tx, ComSignalType=UINT8
        IRmtExtrLckCtrlReq_IAM_CONNCANFD_Event_FrS43_CONTROLLER_0_IAM_Tx: ComBitPosition=37, ComBitSize=3, ComHandleId=IRmtExtrLckCtrlReq_IAM_CONNCANFD_Event_FrS43_CONTROLLER_0_IAM_Tx, ComSignalType=UINT8
        IRmtPsngSeatVentReq_IAM_CONNCANFD_Event_FrS43_CONTROLLER_0_IAM_Tx: ComBitPosition=34, ComBitSize=3, ComHandleId=IRmtPsngSeatVentReq_IAM_CONNCANFD_Event_FrS43_CONTROLLER_0_IAM_Tx, ComSignalType=UINT8
        IRmtHtdRrWndReq_IAM_CONNCANFD_Event_FrS43_CONTROLLER_0_IAM_Tx: ComBitPosition=32, ComBitSize=2, ComHandleId=IRmtHtdRrWndReq_IAM_CONNCANFD_Event_FrS43_CONTROLLER_0_IAM_Tx, ComSignalType=UINT8
        IRmtSecRowLSeatHeatReq_IAM_CONNCANFD_Event_FrS43_CONTROLLER_0_IAM_Tx: ComBitPosition=29, ComBitSize=3, ComHandleId=IRmtSecRowLSeatHeatReq_IAM_CONNCANFD_Event_FrS43_CONTROLLER_0_IAM_Tx, ComSignalType=UINT8
        IRmtSecRowLSeatVentReq_IAM_CONNCANFD_Event_FrS43_CONTROLLER_0_IAM_Tx: ComBitPosition=26, ComBitSize=3, ComHandleId=IRmtSecRowLSeatVentReq_IAM_CONNCANFD_Event_FrS43_CONTROLLER_0_IAM_Tx, ComSignalType=UINT8
        IRmtSecRowRSeatHeatReq_IAM_CONNCANFD_Event_FrS43_CONTROLLER_0_IAM_Tx: ComBitPosition=21, ComBitSize=3, ComHandleId=IRmtSecRowRSeatHeatReq_IAM_CONNCANFD_Event_FrS43_CONTROLLER_0_IAM_Tx, ComSignalType=UINT8
        IRmtSecRowRSeatVentReq_IAM_CONNCANFD_Event_FrS43_CONTROLLER_0_IAM_Tx: ComBitPosition=18, ComBitSize=3, ComHandleId=IRmtSecRowRSeatVentReq_IAM_CONNCANFD_Event_FrS43_CONTROLLER_0_IAM_Tx, ComSignalType=UINT8
        IRmtACTrgtRcctnReq_IAM_CONNCANFD_Event_FrS43_CONTROLLER_0_IAM_Tx: ComBitPosition=16, ComBitSize=2, ComHandleId=IRmtACTrgtRcctnReq_IAM_CONNCANFD_Event_FrS43_CONTROLLER_0_IAM_Tx, ComSignalType=UINT8
        IRmtACTrgtBlwLvlReq_IAM_CONNCANFD_Event_FrS43_CONTROLLER_0_IAM_Tx: ComBitPosition=12, ComBitSize=4, ComHandleId=IRmtACTrgtBlwLvlReq_IAM_CONNCANFD_Event_FrS43_CONTROLLER_0_IAM_Tx, ComSignalType=UINT8
      IAM_CONNCANFD_Event_FrS44_CONTROLLER_0_IAM_Tx (ComIPdu):
        ComIPduCancellationSupport = false
        ComIPduDirection = SEND
        ComIPduHandleId = COM_TXPDU_COM_IAM_CONNCANFD_Event_FrS44_CONTROLLER_0_IAM_Tx
        ComIPduSignalProcessing = DEFERRED
        ComIPduType = NORMAL
        ComPduIdRef = COM_IAM_CONNCANFD_Event_FrS44_CONTROLLER_0_IAM_Tx
        ComIPduSignalRef = IRmtDisChrgCtrlReq_IAM_CONNCANFD_Event_FrS44_CONTROLLER_0_IAM_Tx
        ComIPduSignalRef = IRmtChrgCtrlReq_IAM_CONNCANFD_Event_FrS44_CONTROLLER_0_IAM_Tx
        ComIPduGroupRef = Com_TxPduGroup_CONTROLLER_0_IAM
        ComTxIPdu: ComMinimumDelayTime=0.0, ComTxIPduUnusedAreasDefault=0
          ComTxModeTrue
            ComTxMode: ComTxModeMode=DIRECT, ComTxModeNumberOfRepetitions=3, ComTxModeRepetitionPeriod=0.05, ComTxModeTimeOffset=0.0, ComTxModeTimePeriod=0.0
      IRmtDisChrgCtrlReq_IAM_CONNCANFD_Event_FrS44_CONTROLLER_0_IAM_Tx (ComSignal):
        ComBitPosition = 58
        ComBitSize = 2
        ComHandleId = IRmtDisChrgCtrlReq_IAM_CONNCANFD_Event_FrS44_CONTROLLER_0_IAM_Tx
        ComInvalidNotification = NULL_PTR
        ComRxDataTimeoutAction = NONE
        ComSignalEndianness = BIG_ENDIAN
        ComSignalInitValue = 0x0
        ComSignalLength = 0
        ComSignalType = UINT8
        ComTransferProperty = TRIGGERED
        ComSignalDataInvalidValue = 0x0
        ComDataInvalidAction = NOTIFY
        ComTimeout = 0.0
        ComFirstTimeout = 0.0
        ComNotification = Rte_COMCbkTAck
      IRmtChrgCtrlReq_IAM_CONNCANFD_Event_FrS44_CONTROLLER_0_IAM_Tx (ComSignal):
        ComBitPosition = 56
        ComBitSize = 2
        ComHandleId = IRmtChrgCtrlReq_IAM_CONNCANFD_Event_FrS44_CONTROLLER_0_IAM_Tx
        ComInvalidNotification = NULL_PTR
        ComRxDataTimeoutAction = NONE
        ComSignalEndianness = BIG_ENDIAN
        ComSignalInitValue = 0x0
        ComSignalLength = 0
        ComSignalType = UINT8
        ComTransferProperty = TRIGGERED
        ComSignalDataInvalidValue = 0x0
        ComDataInvalidAction = NOTIFY
        ComTimeout = 0.0
        ComFirstTimeout = 0.0
        ComNotification = Rte_COMCbkTAck
      IAM_CONNCANFD_EvtInfo_CONTROLLER_0_IAM_Tx (ComIPdu):
        ComIPduCancellationSupport = false
        ComIPduDirection = SEND
        ComIPduHandleId = COM_TXPDU_COM_IAM_CONNCANFD_EvtInfo_CONTROLLER_0_IAM_Tx
        ComIPduSignalProcessing = DEFERRED
        ComIPduType = NORMAL
        ComPduIdRef = COM_IAM_CONNCANFD_EvtInfo_CONTROLLER_0_IAM_Tx
        ComIPduSignalRef = IEvtPotclSigIAM_IAM_CONNCANFD_EvtInfo_CONTROLLER_0_IAM_Tx
        ComIPduGroupRef = Com_TxPduGroup_CONTROLLER_0_IAM
        ComTxIPdu: ComMinimumDelayTime=0.0, ComTxIPduUnusedAreasDefault=0
          ComTxModeTrue
            ComTxMode: ComTxModeMode=DIRECT, ComTxModeNumberOfRepetitions=3, ComTxModeRepetitionPeriod=0.05, ComTxModeTimeOffset=0.0, ComTxModeTimePeriod=0.0
      IEvtPotclSigIAM_IAM_CONNCANFD_EvtInfo_CONTROLLER_0_IAM_Tx (ComSignal):
        ComBitPosition = 56
        ComBitSize = 64
        ComHandleId = IEvtPotclSigIAM_IAM_CONNCANFD_EvtInfo_CONTROLLER_0_IAM_Tx
        ComInvalidNotification = NULL_PTR
        ComRxDataTimeoutAction = NONE
        ComSignalEndianness = BIG_ENDIAN
        ComSignalInitValue = 0x0
        ComSignalLength = 0
        ComSignalType = UINT64
        ComTransferProperty = TRIGGERED
        ComSignalDataInvalidValue = 0x0
        ComDataInvalidAction = NOTIFY
        ComTimeout = 0.0
        ComFirstTimeout = 0.0
        ComNotification = Rte_COMCbkTAck
      IAM_SecOC_ComKeyResp_CONTROLLER_0_IAM_Tx (ComIPdu):
        ComIPduCancellationSupport = false
        ComIPduDirection = SEND
        ComIPduHandleId = COM_TXPDU_COM_IAM_SecOC_ComKeyResp_CONTROLLER_0_IAM_Tx
        ComIPduSignalProcessing = DEFERRED
        ComIPduType = NORMAL
        ComIPduCallout = IAM_SecOC_ComKeyResp_CONTROLLER_0_IAM_Tx
        ComPduIdRef = COM_IAM_SecOC_ComKeyResp_CONTROLLER_0_IAM_Tx
        ComIPduSignalRef = IIAMTripCntResetResp_IAM_SecOC_ComKeyResp_CONTROLLER_0_IAM_Tx
        ComIPduGroupRef = Com_TxPduGroup_CONTROLLER_0_IAM
        ComTxIPdu: ComMinimumDelayTime=0.0, ComTxIPduUnusedAreasDefault=0
          ComTxModeTrue
            ComTxMode: ComTxModeMode=DIRECT, ComTxModeNumberOfRepetitions=3, ComTxModeRepetitionPeriod=0.05, ComTxModeTimeOffset=0.0, ComTxModeTimePeriod=0.0
      IIAMTripCntResetResp_IAM_SecOC_ComKeyResp_CONTROLLER_0_IAM_Tx (ComSignal):
        ComBitPosition = 6
        ComBitSize = 1
        ComHandleId = IIAMTripCntResetResp_IAM_SecOC_ComKeyResp_CONTROLLER_0_IAM_Tx
        ComInvalidNotification = NULL_PTR
        ComRxDataTimeoutAction = NONE
        ComSignalEndianness = BIG_ENDIAN
        ComSignalInitValue = 0x0
        ComSignalLength = 0
        ComSignalType = BOOLEAN
        ComTransferProperty = TRIGGERED
        ComSignalDataInvalidValue = 0x0
        ComDataInvalidAction = NOTIFY
        ComTimeout = 0.0
        ComFirstTimeout = 0.0
        ComNotification = Rte_COMCbkTAck
      IAM_SecOC_Log_CONTROLLER_0_IAM_Tx (ComIPdu):
        ComIPduCancellationSupport = false
        ComIPduDirection = SEND
        ComIPduHandleId = COM_TXPDU_COM_IAM_SecOC_Log_CONTROLLER_0_IAM_Tx
        ComIPduSignalProcessing = DEFERRED
        ComIPduType = NORMAL
        ComPduIdRef = COM_IAM_SecOC_Log_CONTROLLER_0_IAM_Tx
        ComIPduSignalRef = IIAMTripCnt_IAM_SecOC_Log_CONTROLLER_0_IAM_Tx
        ComIPduSignalRef = IIAMKeyStatus_IAM_SecOC_Log_CONTROLLER_0_IAM_Tx
        ComIPduSignalRef = IIAMResetCnt_IAM_SecOC_Log_CONTROLLER_0_IAM_Tx
        ComIPduSignalRef = IIAMTripNvmTag_IAM_SecOC_Log_CONTROLLER_0_IAM_Tx
        ComIPduSignalRef = IIAMErrorCount_IAM_SecOC_Log_CONTROLLER_0_IAM_Tx
        ComIPduSignalRef = IIAMFailedReason_IAM_SecOC_Log_CONTROLLER_0_IAM_Tx
        ComIPduSignalRef = IIAMAlgFlag_IAM_SecOC_Log_CONTROLLER_0_IAM_Tx
        ComIPduSignalRef = IIAMDataId_IAM_SecOC_Log_CONTROLLER_0_IAM_Tx
        ComIPduGroupRef = Com_TxPduGroup_CONTROLLER_0_IAM
        ComTxIPdu: ComMinimumDelayTime=0.0, ComTxIPduUnusedAreasDefault=0
          ComTxModeTrue
            ComTxMode: ComTxModeMode=DIRECT, ComTxModeNumberOfRepetitions=0, ComTxModeRepetitionPeriod=0.0, ComTxModeTimeOffset=0.0, ComTxModeTimePeriod=0.0
      8 x ComSignal, all with ComInvalidNotification=NULL_PTR, ComRxDataTimeoutAction=NONE, ComSignalEndianness=BIG_ENDIAN, ComSignalInitValue=0x0, ComSignalLength=0, ComSignalDataInvalidValue=0x0, ComDataInvalidAction=NOTIFY, ComTimeout=0.0, ComFirstTimeout=0.0, ComNotification=Rte_COMCbkTAck:
        IIAMTripCnt_IAM_SecOC_Log_CONTROLLER_0_IAM_Tx: ComBitPosition=56, ComBitSize=24, ComHandleId=IIAMTripCnt_IAM_SecOC_Log_CONTROLLER_0_IAM_Tx, ComSignalType=UINT32, ComTransferProperty=TRIGGERED
        IIAMKeyStatus_IAM_SecOC_Log_CONTROLLER_0_IAM_Tx: ComBitPosition=39, ComBitSize=1, ComHandleId=IIAMKeyStatus_IAM_SecOC_Log_CONTROLLER_0_IAM_Tx, ComSignalType=BOOLEAN, ComTransferProperty=TRIGGERED
        IIAMResetCnt_IAM_SecOC_Log_CONTROLLER_0_IAM_Tx: ComBitPosition=35, ComBitSize=4, ComHandleId=IIAMResetCnt_IAM_SecOC_Log_CONTROLLER_0_IAM_Tx, ComSignalType=UINT8, ComTransferProperty=TRIGGERED
        IIAMTripNvmTag_IAM_SecOC_Log_CONTROLLER_0_IAM_Tx: ComBitPosition=34, ComBitSize=1, ComHandleId=IIAMTripNvmTag_IAM_SecOC_Log_CONTROLLER_0_IAM_Tx, ComSignalType=BOOLEAN, ComTransferProperty=TRIGGERED
        IIAMErrorCount_IAM_SecOC_Log_CONTROLLER_0_IAM_Tx: ComBitPosition=24, ComBitSize=16, ComHandleId=IIAMErrorCount_IAM_SecOC_Log_CONTROLLER_0_IAM_Tx, ComSignalType=UINT16, ComTransferProperty=TRIGGERED
        IIAMFailedReason_IAM_SecOC_Log_CONTROLLER_0_IAM_Tx: ComBitPosition=4, ComBitSize=4, ComHandleId=IIAMFailedReason_IAM_SecOC_Log_CONTROLLER_0_IAM_Tx, ComSignalType=UINT8, ComTransferProperty=TRIGGERED
        IIAMAlgFlag_IAM_SecOC_Log_CONTROLLER_0_IAM_Tx: ComBitPosition=3, ComBitSize=1, ComHandleId=IIAMAlgFlag_IAM_SecOC_Log_CONTROLLER_0_IAM_Tx, ComSignalType=BOOLEAN, ComTransferProperty=TRIGGERED
        IIAMDataId_IAM_SecOC_Log_CONTROLLER_0_IAM_Tx: ComBitPosition=8, ComBitSize=11, ComHandleId=IIAMDataId_IAM_SecOC_Log_CONTROLLER_0_IAM_Tx, ComSignalType=UINT16, ComTransferProperty=PENDING
      IAM_ZONE_CONNCANFD_100ms_FrP56_CONTROLLER_0_IAM_Tx (ComIPdu):
        ComIPduCancellationSupport = false
        ComIPduDirection = SEND
        ComIPduHandleId = COM_TXPDU_COM_IAM_ZONE_CONNCANFD_100ms_FrP56_CONTROLLER_0_IAM_Tx
        ComIPduSignalProcessing = DEFERRED
        ComIPduType = NORMAL
        ComIPduCallout = IAM_ZONE_CONNCANFD_100ms_FrP56_CONTROLLER_0_IAM_Tx
        ComPduIdRef = COM_IAM_ZONE_CONNCANFD_100ms_FrP56_CONTROLLER_0_IAM_Tx
        ComIPduSignalGroupRef = IIAM_100ms_Group56_IAM_ZONE_CONNCANFD_100ms_FrP56_CONTROLLER_0_IAM_Tx
        ComIPduGroupRef = Com_TxPduGroup_CONTROLLER_0_IAM
        ComTxIPdu: ComMinimumDelayTime=0.0, ComTxIPduUnusedAreasDefault=0
          ComTxModeTrue
            ComTxMode: ComTxModeMode=PERIODIC, ComTxModeNumberOfRepetitions=0, ComTxModeRepetitionPeriod=0.0, ComTxModeTimeOffset=0.0, ComTxModeTimePeriod=0.1
      IIAM_100ms_Group56_IAM_ZONE_CONNCANFD_100ms_FrP56_CONTROLLER_0_IAM_Tx (ComSignalGroup):
        ComHandleId = IIAM_100ms_Group56_IAM_ZONE_CONNCANFD_100ms_FrP56_CONTROLLER_0_IAM_Tx
        ComInvalidNotification = NULL_PTR
        ComRxDataTimeoutAction = NONE
        ComTransferProperty = PENDING
        ComDataInvalidAction = NOTIFY
        ComTimeout = 0.0
        ComFirstTimeout = 0.0
        ComNotification = Rte_COMCbkTAck
        6 x ComGroupSignal, all with ComSignalEndianness=BIG_ENDIAN, ComSignalInitValue=0x0, ComSignalLength=0, ComSignalDataInvalidValue=0x0:
          IIAM_100ms_Group56_Reserved2_IIAM_100ms_Group56_IAM_ZONE_CONNCANFD_100ms_FrP56_CONTROLLER_0_IAM_Tx: ComBitPosition=56, ComBitSize=8, ComHandleId=IIAM_100ms_Group56_IAM_ZONE_CONNCANFD_100ms_FrP56_CONTROLLER_0_IAM_Tx_IIAM_100ms_Group56_Reserved2_IIAM_100ms_Group56_IAM_ZONE_CONNCANFD_100ms_FrP56_CONTROLLER_0_IAM_Tx, ComSignalType=UINT8
          ILatitudeRTK_IIAM_100ms_Group56_IAM_ZONE_CONNCANFD_100ms_FrP56_CONTROLLER_0_IAM_Tx: ComBitPosition=48, ComBitSize=40, ComHandleId=IIAM_100ms_Group56_IAM_ZONE_CONNCANFD_100ms_FrP56_CONTROLLER_0_IAM_Tx_ILatitudeRTK_IIAM_100ms_Group56_IAM_ZONE_CONNCANFD_100ms_FrP56_CONTROLLER_0_IAM_Tx, ComSignalType=SINT64
          IIAM_GNSS_Signal_Status_IIAM_100ms_Group56_IAM_ZONE_CONNCANFD_100ms_FrP56_CONTROLLER_0_IAM_Tx: ComBitPosition=14, ComBitSize=2, ComHandleId=IIAM_100ms_Group56_IAM_ZONE_CONNCANFD_100ms_FrP56_CONTROLLER_0_IAM_Tx_IIAM_GNSS_Signal_Status_IIAM_100ms_Group56_IAM_ZONE_CONNCANFD_100ms_FrP56_CONTROLLER_0_IAM_Tx, ComSignalType=UINT8
          IIAM_100ms_Group56_Reserved1_IIAM_100ms_Group56_IAM_ZONE_CONNCANFD_100ms_FrP56_CONTROLLER_0_IAM_Tx: ComBitPosition=12, ComBitSize=2, ComHandleId=IIAM_100ms_Group56_IAM_ZONE_CONNCANFD_100ms_FrP56_CONTROLLER_0_IAM_Tx_IIAM_100ms_Group56_Reserved1_IIAM_100ms_Group56_IAM_ZONE_CONNCANFD_100ms_FrP56_CONTROLLER_0_IAM_Tx, ComSignalType=UINT8
          IIAM_100ms_Group56_RC_IIAM_100ms_Group56_IAM_ZONE_CONNCANFD_100ms_FrP56_CONTROLLER_0_IAM_Tx: ComBitPosition=8, ComBitSize=4, ComHandleId=IIAM_100ms_Group56_IAM_ZONE_CONNCANFD_100ms_FrP56_CONTROLLER_0_IAM_Tx_IIAM_100ms_Group56_RC_IIAM_100ms_Group56_IAM_ZONE_CONNCANFD_100ms_FrP56_CONTROLLER_0_IAM_Tx, ComSignalType=UINT8
          IIAM_100ms_Group56_CRC_IIAM_100ms_Group56_IAM_ZONE_CONNCANFD_100ms_FrP56_CONTROLLER_0_IAM_Tx: ComBitPosition=0, ComBitSize=8, ComHandleId=IIAM_100ms_Group56_IAM_ZONE_CONNCANFD_100ms_FrP56_CONTROLLER_0_IAM_Tx_IIAM_100ms_Group56_CRC_IIAM_100ms_Group56_IAM_ZONE_CONNCANFD_100ms_FrP56_CONTROLLER_0_IAM_Tx, ComSignalType=UINT8
      TBOX_CONNCAN_20ms_FrP02_CONTROLLER_0_IAM_Tx (ComIPdu):
        ComIPduCancellationSupport = false
        ComIPduDirection = SEND
        ComIPduHandleId = COM_TXPDU_COM_TBOX_CONNCAN_20ms_FrP02_CONTROLLER_0_IAM_Tx
        ComIPduSignalProcessing = DEFERRED
        ComIPduType = NORMAL
        ComPduIdRef = COM_TBOX_CONNCAN_20ms_FrP02_CONTROLLER_0_IAM_Tx
        ComIPduSignalRef = IeCallSysSta_TBOX_CONNCAN_20ms_FrP02_CONTROLLER_0_IAM_Tx
        ComIPduGroupRef = Com_TxPduGroup_CONTROLLER_0_IAM
        ComTxIPdu: ComMinimumDelayTime=0.0, ComTxIPduUnusedAreasDefault=0
          ComTxModeTrue
            ComTxMode: ComTxModeMode=PERIODIC, ComTxModeNumberOfRepetitions=0, ComTxModeRepetitionPeriod=0.0, ComTxModeTimeOffset=0.0, ComTxModeTimePeriod=0.02
      IeCallSysSta_TBOX_CONNCAN_20ms_FrP02_CONTROLLER_0_IAM_Tx (ComSignal):
        ComBitPosition = 56
        ComBitSize = 2
        ComHandleId = IeCallSysSta_TBOX_CONNCAN_20ms_FrP02_CONTROLLER_0_IAM_Tx
        ComInvalidNotification = NULL_PTR
        ComRxDataTimeoutAction = NONE
        ComSignalEndianness = BIG_ENDIAN
        ComSignalInitValue = 0x0
        ComSignalLength = 0
        ComSignalType = UINT8
        ComTransferProperty = PENDING
        ComSignalDataInvalidValue = 0x0
        ComDataInvalidAction = NOTIFY
        ComTimeout = 0.0
        ComFirstTimeout = 0.0
        ComNotification = Rte_COMCbkTAck
      IAM_BKPCANFD_1000ms_FrP49_CONTROLLER_0_IAM_Tx (ComIPdu):
        ComIPduCancellationSupport = false
        ComIPduDirection = SEND
        ComIPduHandleId = COM_TXPDU_COM_IAM_BKPCANFD_1000ms_FrP49_CONTROLLER_0_IAM_Tx
        ComIPduSignalProcessing = DEFERRED
        ComIPduType = NORMAL
        ComPduIdRef = COM_IAM_BKPCANFD_1000ms_FrP49_CONTROLLER_0_IAM_Tx
        ComIPduSignalRef = ISatID6_IAM_BKPCANFD_1000ms_FrP49_CONTROLLER_0_IAM_Tx
        ComIPduSignalRef = ISatElv6_IAM_BKPCANFD_1000ms_FrP49_CONTROLLER_0_IAM_Tx
        ComIPduSignalRef = ISatCNO6_IAM_BKPCANFD_1000ms_FrP49_CONTROLLER_0_IAM_Tx
        ComIPduSignalRef = ISatID5_IAM_BKPCANFD_1000ms_FrP49_CONTROLLER_0_IAM_Tx
        ComIPduSignalRef = ISatAz6_IAM_BKPCANFD_1000ms_FrP49_CONTROLLER_0_IAM_Tx
        ComIPduSignalRef = ISatElv5_IAM_BKPCANFD_1000ms_FrP49_CONTROLLER_0_IAM_Tx
        ComIPduSignalRef = ISatCNO5_IAM_BKPCANFD_1000ms_FrP49_CONTROLLER_0_IAM_Tx
        ComIPduSignalRef = ISatAz5_IAM_BKPCANFD_1000ms_FrP49_CONTROLLER_0_IAM_Tx
        ComIPduGroupRef = Com_TxPduGroup_CONTROLLER_0_IAM
        ComTxIPdu: ComMinimumDelayTime=0.0, ComTxIPduUnusedAreasDefault=0
          ComTxModeTrue
            ComTxMode: ComTxModeMode=PERIODIC, ComTxModeNumberOfRepetitions=0, ComTxModeRepetitionPeriod=0.0, ComTxModeTimeOffset=0.0, ComTxModeTimePeriod=1.0
      8 x ComSignal, all with ComInvalidNotification=NULL_PTR, ComRxDataTimeoutAction=NONE, ComSignalEndianness=BIG_ENDIAN, ComSignalInitValue=0x0, ComSignalLength=0, ComTransferProperty=PENDING, ComSignalDataInvalidValue=0x0, ComDataInvalidAction=NOTIFY, ComTimeout=0.0, ComFirstTimeout=0.0, ComNotification=Rte_COMCbkTAck:
        ISatID6_IAM_BKPCANFD_1000ms_FrP49_CONTROLLER_0_IAM_Tx: ComBitPosition=57, ComBitSize=7, ComHandleId=ISatID6_IAM_BKPCANFD_1000ms_FrP49_CONTROLLER_0_IAM_Tx, ComSignalType=UINT8
        ISatElv6_IAM_BKPCANFD_1000ms_FrP49_CONTROLLER_0_IAM_Tx: ComBitPosition=49, ComBitSize=7, ComHandleId=ISatElv6_IAM_BKPCANFD_1000ms_FrP49_CONTROLLER_0_IAM_Tx, ComSignalType=UINT8
        ISatCNO6_IAM_BKPCANFD_1000ms_FrP49_CONTROLLER_0_IAM_Tx: ComBitPosition=41, ComBitSize=7, ComHandleId=ISatCNO6_IAM_BKPCANFD_1000ms_FrP49_CONTROLLER_0_IAM_Tx, ComSignalType=UINT8
        ISatID5_IAM_BKPCANFD_1000ms_FrP49_CONTROLLER_0_IAM_Tx: ComBitPosition=25, ComBitSize=7, ComHandleId=ISatID5_IAM_BKPCANFD_1000ms_FrP49_CONTROLLER_0_IAM_Tx, ComSignalType=UINT8
        ISatAz6_IAM_BKPCANFD_1000ms_FrP49_CONTROLLER_0_IAM_Tx: ComBitPosition=32, ComBitSize=9, ComHandleId=ISatAz6_IAM_BKPCANFD_1000ms_FrP49_CONTROLLER_0_IAM_Tx, ComSignalType=UINT16
        ISatElv5_IAM_BKPCANFD_1000ms_FrP49_CONTROLLER_0_IAM_Tx: ComBitPosition=17, ComBitSize=7, ComHandleId=ISatElv5_IAM_BKPCANFD_1000ms_FrP49_CONTROLLER_0_IAM_Tx, ComSignalType=UINT8
        ISatCNO5_IAM_BKPCANFD_1000ms_FrP49_CONTROLLER_0_IAM_Tx: ComBitPosition=8, ComBitSize=7, ComHandleId=ISatCNO5_IAM_BKPCANFD_1000ms_FrP49_CONTROLLER_0_IAM_Tx, ComSignalType=UINT8
        ISatAz5_IAM_BKPCANFD_1000ms_FrP49_CONTROLLER_0_IAM_Tx: ComBitPosition=15, ComBitSize=9, ComHandleId=ISatAz5_IAM_BKPCANFD_1000ms_FrP49_CONTROLLER_0_IAM_Tx, ComSignalType=UINT16
      IAM_BKPCANFD_1000ms_FrP55_CONTROLLER_0_IAM_Tx (ComIPdu):
        ComIPduCancellationSupport = false
        ComIPduDirection = SEND
        ComIPduHandleId = COM_TXPDU_COM_IAM_BKPCANFD_1000ms_FrP55_CONTROLLER_0_IAM_Tx
        ComIPduSignalProcessing = DEFERRED
        ComIPduType = NORMAL
        ComPduIdRef = COM_IAM_BKPCANFD_1000ms_FrP55_CONTROLLER_0_IAM_Tx
        ComIPduSignalRef = ISatID2_IAM_BKPCANFD_1000ms_FrP55_CONTROLLER_0_IAM_Tx
        ComIPduSignalRef = ISatElv2_IAM_BKPCANFD_1000ms_FrP55_CONTROLLER_0_IAM_Tx
        ComIPduSignalRef = ISatCNO2_IAM_BKPCANFD_1000ms_FrP55_CONTROLLER_0_IAM_Tx
        ComIPduSignalRef = ISatID1_IAM_BKPCANFD_1000ms_FrP55_CONTROLLER_0_IAM_Tx
        ComIPduSignalRef = ISatAz2_IAM_BKPCANFD_1000ms_FrP55_CONTROLLER_0_IAM_Tx
        ComIPduSignalRef = ISatElv1_IAM_BKPCANFD_1000ms_FrP55_CONTROLLER_0_IAM_Tx
        ComIPduSignalRef = ISatCNO1_IAM_BKPCANFD_1000ms_FrP55_CONTROLLER_0_IAM_Tx
        ComIPduSignalRef = ISatAz1_IAM_BKPCANFD_1000ms_FrP55_CONTROLLER_0_IAM_Tx
        ComIPduGroupRef = Com_TxPduGroup_CONTROLLER_0_IAM
        ComTxIPdu: ComMinimumDelayTime=0.0, ComTxIPduUnusedAreasDefault=0
          ComTxModeTrue
            ComTxMode: ComTxModeMode=PERIODIC, ComTxModeNumberOfRepetitions=0, ComTxModeRepetitionPeriod=0.0, ComTxModeTimeOffset=0.0, ComTxModeTimePeriod=1.0
      8 x ComSignal, all with ComInvalidNotification=NULL_PTR, ComRxDataTimeoutAction=NONE, ComSignalEndianness=BIG_ENDIAN, ComSignalInitValue=0x0, ComSignalLength=0, ComTransferProperty=PENDING, ComSignalDataInvalidValue=0x0, ComDataInvalidAction=NOTIFY, ComTimeout=0.0, ComFirstTimeout=0.0, ComNotification=Rte_COMCbkTAck:
        ISatID2_IAM_BKPCANFD_1000ms_FrP55_CONTROLLER_0_IAM_Tx: ComBitPosition=57, ComBitSize=7, ComHandleId=ISatID2_IAM_BKPCANFD_1000ms_FrP55_CONTROLLER_0_IAM_Tx, ComSignalType=UINT8
        ISatElv2_IAM_BKPCANFD_1000ms_FrP55_CONTROLLER_0_IAM_Tx: ComBitPosition=49, ComBitSize=7, ComHandleId=ISatElv2_IAM_BKPCANFD_1000ms_FrP55_CONTROLLER_0_IAM_Tx, ComSignalType=UINT8
        ISatCNO2_IAM_BKPCANFD_1000ms_FrP55_CONTROLLER_0_IAM_Tx: ComBitPosition=41, ComBitSize=7, ComHandleId=ISatCNO2_IAM_BKPCANFD_1000ms_FrP55_CONTROLLER_0_IAM_Tx, ComSignalType=UINT8
        ISatID1_IAM_BKPCANFD_1000ms_FrP55_CONTROLLER_0_IAM_Tx: ComBitPosition=25, ComBitSize=7, ComHandleId=ISatID1_IAM_BKPCANFD_1000ms_FrP55_CONTROLLER_0_IAM_Tx, ComSignalType=UINT8
        ISatAz2_IAM_BKPCANFD_1000ms_FrP55_CONTROLLER_0_IAM_Tx: ComBitPosition=32, ComBitSize=9, ComHandleId=ISatAz2_IAM_BKPCANFD_1000ms_FrP55_CONTROLLER_0_IAM_Tx, ComSignalType=UINT16
        ISatElv1_IAM_BKPCANFD_1000ms_FrP55_CONTROLLER_0_IAM_Tx: ComBitPosition=17, ComBitSize=7, ComHandleId=ISatElv1_IAM_BKPCANFD_1000ms_FrP55_CONTROLLER_0_IAM_Tx, ComSignalType=UINT8
        ISatCNO1_IAM_BKPCANFD_1000ms_FrP55_CONTROLLER_0_IAM_Tx: ComBitPosition=8, ComBitSize=7, ComHandleId=ISatCNO1_IAM_BKPCANFD_1000ms_FrP55_CONTROLLER_0_IAM_Tx, ComSignalType=UINT8
        ISatAz1_IAM_BKPCANFD_1000ms_FrP55_CONTROLLER_0_IAM_Tx: ComBitPosition=15, ComBitSize=9, ComHandleId=ISatAz1_IAM_BKPCANFD_1000ms_FrP55_CONTROLLER_0_IAM_Tx, ComSignalType=UINT16
      IAM_BKPCANFD_1000ms_FrP58_CONTROLLER_0_IAM_Tx (ComIPdu):
        ComIPduCancellationSupport = false
        ComIPduDirection = SEND
        ComIPduHandleId = COM_TXPDU_COM_IAM_BKPCANFD_1000ms_FrP58_CONTROLLER_0_IAM_Tx
        ComIPduSignalProcessing = DEFERRED
        ComIPduType = NORMAL
        ComPduIdRef = COM_IAM_BKPCANFD_1000ms_FrP58_CONTROLLER_0_IAM_Tx
        ComIPduSignalRef = ISatID18_IAM_BKPCANFD_1000ms_FrP58_CONTROLLER_0_IAM_Tx
        ComIPduSignalRef = ISatElv18_IAM_BKPCANFD_1000ms_FrP58_CONTROLLER_0_IAM_Tx
        ComIPduSignalRef = ISatCNO18_IAM_BKPCANFD_1000ms_FrP58_CONTROLLER_0_IAM_Tx
        ComIPduSignalRef = ISatID17_IAM_BKPCANFD_1000ms_FrP58_CONTROLLER_0_IAM_Tx
        ComIPduSignalRef = ISatAz18_IAM_BKPCANFD_1000ms_FrP58_CONTROLLER_0_IAM_Tx
        ComIPduSignalRef = ISatElv17_IAM_BKPCANFD_1000ms_FrP58_CONTROLLER_0_IAM_Tx
        ComIPduSignalRef = ISatCNO17_IAM_BKPCANFD_1000ms_FrP58_CONTROLLER_0_IAM_Tx
        ComIPduSignalRef = ISatAz17_IAM_BKPCANFD_1000ms_FrP58_CONTROLLER_0_IAM_Tx
        ComIPduGroupRef = Com_TxPduGroup_CONTROLLER_0_IAM
        ComTxIPdu: ComMinimumDelayTime=0.0, ComTxIPduUnusedAreasDefault=0
          ComTxModeTrue
            ComTxMode: ComTxModeMode=PERIODIC, ComTxModeNumberOfRepetitions=0, ComTxModeRepetitionPeriod=0.0, ComTxModeTimeOffset=0.0, ComTxModeTimePeriod=1.0
      8 x ComSignal, all with ComInvalidNotification=NULL_PTR, ComRxDataTimeoutAction=NONE, ComSignalEndianness=BIG_ENDIAN, ComSignalInitValue=0x0, ComSignalLength=0, ComTransferProperty=PENDING, ComSignalDataInvalidValue=0x0, ComDataInvalidAction=NOTIFY, ComTimeout=0.0, ComFirstTimeout=0.0, ComNotification=Rte_COMCbkTAck:
        ISatID18_IAM_BKPCANFD_1000ms_FrP58_CONTROLLER_0_IAM_Tx: ComBitPosition=57, ComBitSize=7, ComHandleId=ISatID18_IAM_BKPCANFD_1000ms_FrP58_CONTROLLER_0_IAM_Tx, ComSignalType=UINT8
        ISatElv18_IAM_BKPCANFD_1000ms_FrP58_CONTROLLER_0_IAM_Tx: ComBitPosition=49, ComBitSize=7, ComHandleId=ISatElv18_IAM_BKPCANFD_1000ms_FrP58_CONTROLLER_0_IAM_Tx, ComSignalType=UINT8
        ISatCNO18_IAM_BKPCANFD_1000ms_FrP58_CONTROLLER_0_IAM_Tx: ComBitPosition=41, ComBitSize=7, ComHandleId=ISatCNO18_IAM_BKPCANFD_1000ms_FrP58_CONTROLLER_0_IAM_Tx, ComSignalType=UINT8
        ISatID17_IAM_BKPCANFD_1000ms_FrP58_CONTROLLER_0_IAM_Tx: ComBitPosition=25, ComBitSize=7, ComHandleId=ISatID17_IAM_BKPCANFD_1000ms_FrP58_CONTROLLER_0_IAM_Tx, ComSignalType=UINT8
        ISatAz18_IAM_BKPCANFD_1000ms_FrP58_CONTROLLER_0_IAM_Tx: ComBitPosition=32, ComBitSize=9, ComHandleId=ISatAz18_IAM_BKPCANFD_1000ms_FrP58_CONTROLLER_0_IAM_Tx, ComSignalType=UINT16
        ISatElv17_IAM_BKPCANFD_1000ms_FrP58_CONTROLLER_0_IAM_Tx: ComBitPosition=17, ComBitSize=7, ComHandleId=ISatElv17_IAM_BKPCANFD_1000ms_FrP58_CONTROLLER_0_IAM_Tx, ComSignalType=UINT8
        ISatCNO17_IAM_BKPCANFD_1000ms_FrP58_CONTROLLER_0_IAM_Tx: ComBitPosition=8, ComBitSize=7, ComHandleId=ISatCNO17_IAM_BKPCANFD_1000ms_FrP58_CONTROLLER_0_IAM_Tx, ComSignalType=UINT8
        ISatAz17_IAM_BKPCANFD_1000ms_FrP58_CONTROLLER_0_IAM_Tx: ComBitPosition=15, ComBitSize=9, ComHandleId=ISatAz17_IAM_BKPCANFD_1000ms_FrP58_CONTROLLER_0_IAM_Tx, ComSignalType=UINT16
      IAM_BKPCANFD_1000ms_FrP59_CONTROLLER_0_IAM_Tx (ComIPdu):
        ComIPduCancellationSupport = false
        ComIPduDirection = SEND
        ComIPduHandleId = COM_TXPDU_COM_IAM_BKPCANFD_1000ms_FrP59_CONTROLLER_0_IAM_Tx
        ComIPduSignalProcessing = DEFERRED
        ComIPduType = NORMAL
        ComPduIdRef = COM_IAM_BKPCANFD_1000ms_FrP59_CONTROLLER_0_IAM_Tx
        ComIPduSignalRef = ISatID8_IAM_BKPCANFD_1000ms_FrP59_CONTROLLER_0_IAM_Tx
        ComIPduSignalRef = ISatElv8_IAM_BKPCANFD_1000ms_FrP59_CONTROLLER_0_IAM_Tx
        ComIPduSignalRef = ISatCNO8_IAM_BKPCANFD_1000ms_FrP59_CONTROLLER_0_IAM_Tx
        ComIPduSignalRef = ISatID7_IAM_BKPCANFD_1000ms_FrP59_CONTROLLER_0_IAM_Tx
        ComIPduSignalRef = ISatAz8_IAM_BKPCANFD_1000ms_FrP59_CONTROLLER_0_IAM_Tx
        ComIPduSignalRef = ISatElv7_IAM_BKPCANFD_1000ms_FrP59_CONTROLLER_0_IAM_Tx
        ComIPduSignalRef = ISatCNO7_IAM_BKPCANFD_1000ms_FrP59_CONTROLLER_0_IAM_Tx
        ComIPduSignalRef = ISatAz7_IAM_BKPCANFD_1000ms_FrP59_CONTROLLER_0_IAM_Tx
        ComIPduGroupRef = Com_TxPduGroup_CONTROLLER_0_IAM
        ComTxIPdu: ComMinimumDelayTime=0.0, ComTxIPduUnusedAreasDefault=0
          ComTxModeTrue
            ComTxMode: ComTxModeMode=PERIODIC, ComTxModeNumberOfRepetitions=0, ComTxModeRepetitionPeriod=0.0, ComTxModeTimeOffset=0.0, ComTxModeTimePeriod=1.0
      8 x ComSignal, all with ComInvalidNotification=NULL_PTR, ComRxDataTimeoutAction=NONE, ComSignalEndianness=BIG_ENDIAN, ComSignalInitValue=0x0, ComSignalLength=0, ComTransferProperty=PENDING, ComSignalDataInvalidValue=0x0, ComDataInvalidAction=NOTIFY, ComTimeout=0.0, ComFirstTimeout=0.0, ComNotification=Rte_COMCbkTAck:
        ISatID8_IAM_BKPCANFD_1000ms_FrP59_CONTROLLER_0_IAM_Tx: ComBitPosition=57, ComBitSize=7, ComHandleId=ISatID8_IAM_BKPCANFD_1000ms_FrP59_CONTROLLER_0_IAM_Tx, ComSignalType=UINT8
        ISatElv8_IAM_BKPCANFD_1000ms_FrP59_CONTROLLER_0_IAM_Tx: ComBitPosition=49, ComBitSize=7, ComHandleId=ISatElv8_IAM_BKPCANFD_1000ms_FrP59_CONTROLLER_0_IAM_Tx, ComSignalType=UINT8
        ISatCNO8_IAM_BKPCANFD_1000ms_FrP59_CONTROLLER_0_IAM_Tx: ComBitPosition=41, ComBitSize=7, ComHandleId=ISatCNO8_IAM_BKPCANFD_1000ms_FrP59_CONTROLLER_0_IAM_Tx, ComSignalType=UINT8
        ISatID7_IAM_BKPCANFD_1000ms_FrP59_CONTROLLER_0_IAM_Tx: ComBitPosition=25, ComBitSize=7, ComHandleId=ISatID7_IAM_BKPCANFD_1000ms_FrP59_CONTROLLER_0_IAM_Tx, ComSignalType=UINT8
        ISatAz8_IAM_BKPCANFD_1000ms_FrP59_CONTROLLER_0_IAM_Tx: ComBitPosition=32, ComBitSize=9, ComHandleId=ISatAz8_IAM_BKPCANFD_1000ms_FrP59_CONTROLLER_0_IAM_Tx, ComSignalType=UINT16
        ISatElv7_IAM_BKPCANFD_1000ms_FrP59_CONTROLLER_0_IAM_Tx: ComBitPosition=17, ComBitSize=7, ComHandleId=ISatElv7_IAM_BKPCANFD_1000ms_FrP59_CONTROLLER_0_IAM_Tx, ComSignalType=UINT8
        ISatCNO7_IAM_BKPCANFD_1000ms_FrP59_CONTROLLER_0_IAM_Tx: ComBitPosition=8, ComBitSize=7, ComHandleId=ISatCNO7_IAM_BKPCANFD_1000ms_FrP59_CONTROLLER_0_IAM_Tx, ComSignalType=UINT8
        ISatAz7_IAM_BKPCANFD_1000ms_FrP59_CONTROLLER_0_IAM_Tx: ComBitPosition=15, ComBitSize=9, ComHandleId=ISatAz7_IAM_BKPCANFD_1000ms_FrP59_CONTROLLER_0_IAM_Tx, ComSignalType=UINT16
      synthesized_IAM_ZONE__Event_FrS03_CONTROLLER_0_IAM_Tx (ComIPdu):
        ComIPduCancellationSupport = false
        ComIPduDirection = SEND
        ComIPduHandleId = COM_TXPDU_COM_synthesized_IAM_ZONE_CONNCANFD_E_CONTROLLER_0_IAM_Tx
        ComIPduSignalProcessing = DEFERRED
        ComIPduType = NORMAL
        ComPduIdRef = COM_synthesized_IAM_ZONE_CONNCANFD_E_CONTROLLER_0_IAM_Tx
        ComIPduSignalRef = ISumnLoctnLongd_synthesized_IAM_ZONE_CONNCANFD_E_CONTROLLER_0_IAM_Tx
        ComIPduSignalRef = IAutodDrvngSysCtrlReq_synthesized_IAM_ZONE_CONNCANFD_E_CONTROLLER_0_IAM_Tx
        ComIPduSignalRef = ISumnLoctnLatd_synthesized_IAM_ZONE_CONNCANFD_E_CONTROLLER_0_IAM_Tx
        ComIPduGroupRef = Com_TxPduGroup_CONTROLLER_0_IAM
        ComTxIPdu: ComMinimumDelayTime=0.0, ComTxIPduUnusedAreasDefault=0
          ComTxModeTrue
            ComTxMode: ComTxModeMode=DIRECT, ComTxModeNumberOfRepetitions=3, ComTxModeRepetitionPeriod=0.05, ComTxModeTimeOffset=0.0, ComTxModeTimePeriod=0.0
      3 x ComSignal, all with ComInvalidNotification=NULL_PTR, ComRxDataTimeoutAction=NONE, ComSignalEndianness=BIG_ENDIAN, ComSignalInitValue=0x0, ComSignalLength=0, ComTransferProperty=TRIGGERED, ComSignalDataInvalidValue=0x0, ComDataInvalidAction=NOTIFY, ComTimeout=0.0, ComFirstTimeout=0.0, ComNotification=Rte_COMCbkTAck:
        ISumnLoctnLongd_synthesized_IAM_ZONE_CONNCANFD_E_CONTROLLER_0_IAM_Tx: ComBitPosition=64, ComBitSize=32, ComHandleId=ISumnLoctnLongd_synthesized_IAM_ZONE_CONNCANFD_E_CONTROLLER_0_IAM_Tx, ComSignalType=SINT32
        IAutodDrvngSysCtrlReq_synthesized_IAM_ZONE_CONNCANFD_E_CONTROLLER_0_IAM_Tx: ComBitPosition=32, ComBitSize=8, ComHandleId=IAutodDrvngSysCtrlReq_synthesized_IAM_ZONE_CONNCANFD_E_CONTROLLER_0_IAM_Tx, ComSignalType=SINT8
        ISumnLoctnLatd_synthesized_IAM_ZONE_CONNCANFD_E_CONTROLLER_0_IAM_Tx: ComBitPosition=24, ComBitSize=32, ComHandleId=ISumnLoctnLatd_synthesized_IAM_ZONE_CONNCANFD_E_CONTROLLER_0_IAM_Tx, ComSignalType=SINT32
      synthesized_IAM_ZONE__Event_FrS02_CONTROLLER_0_IAM_Tx (ComIPdu):
        ComIPduCancellationSupport = false
        ComIPduDirection = SEND
        ComIPduHandleId = COM_TXPDU_COM_synthesized_IAM_ZONE_CONNCA_0000_CONTROLLER_0_IAM_Tx
        ComIPduSignalProcessing = DEFERRED
        ComIPduType = NORMAL
        ComPduIdRef = COM_synthesized_IAM_ZONE_CONNCA_0000_CONTROLLER_0_IAM_Tx
        ComIPduSignalRef = IAPPPlnngPathLatdP10_synthesized_IAM_ZONE_CONNCA_0000_CONTROLLER_0_IAM_Tx
        ComIPduSignalRef = IAPPPlnngPathLongdP10_synthesized_IAM_ZONE_CONNCA_0000_CONTROLLER_0_IAM_Tx
        ComIPduSignalRef = IAPPPlnngPathLongdP9_synthesized_IAM_ZONE_CONNCA_0000_CONTROLLER_0_IAM_Tx
        ComIPduSignalRef = IAPPPlnngPathLatdP9_synthesized_IAM_ZONE_CONNCA_0000_CONTROLLER_0_IAM_Tx
        ComIPduSignalRef = IAPPPlnngPathLatdP8_synthesized_IAM_ZONE_CONNCA_0000_CONTROLLER_0_IAM_Tx
        ComIPduSignalRef = IAPPPlnngPathLongdP8_synthesized_IAM_ZONE_CONNCA_0000_CONTROLLER_0_IAM_Tx
        ComIPduSignalRef = IAPPPlnngPathLatdP7_synthesized_IAM_ZONE_CONNCA_0000_CONTROLLER_0_IAM_Tx
        ComIPduSignalRef = IAPPPlnngPathLongdP7_synthesized_IAM_ZONE_CONNCA_0000_CONTROLLER_0_IAM_Tx
        ComIPduSignalRef = IAPPPlnngPathLatdP6_synthesized_IAM_ZONE_CONNCA_0000_CONTROLLER_0_IAM_Tx
        ComIPduSignalRef = IAPPPlnngPathLongdP6_synthesized_IAM_ZONE_CONNCA_0000_CONTROLLER_0_IAM_Tx
        ComIPduGroupRef = Com_TxPduGroup_CONTROLLER_0_IAM
        ComTxIPdu: ComMinimumDelayTime=0.0, ComTxIPduUnusedAreasDefault=0
          ComTxModeTrue
            ComTxMode: ComTxModeMode=DIRECT, ComTxModeNumberOfRepetitions=3, ComTxModeRepetitionPeriod=0.05, ComTxModeTimeOffset=0.0, ComTxModeTimePeriod=0.0
      10 x ComSignal, all with ComBitSize=32, ComInvalidNotification=NULL_PTR, ComRxDataTimeoutAction=NONE, ComSignalEndianness=BIG_ENDIAN, ComSignalInitValue=0x0, ComSignalLength=0, ComSignalType=SINT32, ComTransferProperty=TRIGGERED, ComSignalDataInvalidValue=0x0, ComDataInvalidAction=NOTIFY, ComTimeout=0.0, ComFirstTimeout=0.0, ComNotification=Rte_COMCbkTAck:
        IAPPPlnngPathLatdP10_synthesized_IAM_ZONE_CONNCA_0000_CONTROLLER_0_IAM_Tx: ComBitPosition=312, ComHandleId=IAPPPlnngPathLatdP10_synthesized_IAM_ZONE_CONNCA_0000_CONTROLLER_0_IAM_Tx
        IAPPPlnngPathLongdP10_synthesized_IAM_ZONE_CONNCA_0000_CONTROLLER_0_IAM_Tx: ComBitPosition=280, ComHandleId=IAPPPlnngPathLongdP10_synthesized_IAM_ZONE_CONNCA_0000_CONTROLLER_0_IAM_Tx
        IAPPPlnngPathLongdP9_synthesized_IAM_ZONE_CONNCA_0000_CONTROLLER_0_IAM_Tx: ComBitPosition=248, ComHandleId=IAPPPlnngPathLongdP9_synthesized_IAM_ZONE_CONNCA_0000_CONTROLLER_0_IAM_Tx
        IAPPPlnngPathLatdP9_synthesized_IAM_ZONE_CONNCA_0000_CONTROLLER_0_IAM_Tx: ComBitPosition=216, ComHandleId=IAPPPlnngPathLatdP9_synthesized_IAM_ZONE_CONNCA_0000_CONTROLLER_0_IAM_Tx
        IAPPPlnngPathLatdP8_synthesized_IAM_ZONE_CONNCA_0000_CONTROLLER_0_IAM_Tx: ComBitPosition=184, ComHandleId=IAPPPlnngPathLatdP8_synthesized_IAM_ZONE_CONNCA_0000_CONTROLLER_0_IAM_Tx
        IAPPPlnngPathLongdP8_synthesized_IAM_ZONE_CONNCA_0000_CONTROLLER_0_IAM_Tx: ComBitPosition=152, ComHandleId=IAPPPlnngPathLongdP8_synthesized_IAM_ZONE_CONNCA_0000_CONTROLLER_0_IAM_Tx
        IAPPPlnngPathLatdP7_synthesized_IAM_ZONE_CONNCA_0000_CONTROLLER_0_IAM_Tx: ComBitPosition=120, ComHandleId=IAPPPlnngPathLatdP7_synthesized_IAM_ZONE_CONNCA_0000_CONTROLLER_0_IAM_Tx
        IAPPPlnngPathLongdP7_synthesized_IAM_ZONE_CONNCA_0000_CONTROLLER_0_IAM_Tx: ComBitPosition=88, ComHandleId=IAPPPlnngPathLongdP7_synthesized_IAM_ZONE_CONNCA_0000_CONTROLLER_0_IAM_Tx
        IAPPPlnngPathLatdP6_synthesized_IAM_ZONE_CONNCA_0000_CONTROLLER_0_IAM_Tx: ComBitPosition=56, ComHandleId=IAPPPlnngPathLatdP6_synthesized_IAM_ZONE_CONNCA_0000_CONTROLLER_0_IAM_Tx
        IAPPPlnngPathLongdP6_synthesized_IAM_ZONE_CONNCA_0000_CONTROLLER_0_IAM_Tx: ComBitPosition=24, ComHandleId=IAPPPlnngPathLongdP6_synthesized_IAM_ZONE_CONNCA_0000_CONTROLLER_0_IAM_Tx
      synthesized_IAM_ZONE__Event_FrS01_CONTROLLER_0_IAM_Tx (ComIPdu):
        ComIPduCancellationSupport = false
        ComIPduDirection = SEND
        ComIPduHandleId = COM_TXPDU_COM_synthesized_IAM_ZONE_CONNCA_0001_CONTROLLER_0_IAM_Tx
        ComIPduSignalProcessing = DEFERRED
        ComIPduType = NORMAL
        ComPduIdRef = COM_synthesized_IAM_ZONE_CONNCA_0001_CONTROLLER_0_IAM_Tx
        ComIPduSignalRef = IAPPPlnngPathLatdP2_synthesized_IAM_ZONE_CONNCA_0001_CONTROLLER_0_IAM_Tx
        ComIPduSignalRef = IAPPPlnngPathLatdP5_synthesized_IAM_ZONE_CONNCA_0001_CONTROLLER_0_IAM_Tx
        ComIPduSignalRef = IAPPPlnngPathLongdP5_synthesized_IAM_ZONE_CONNCA_0001_CONTROLLER_0_IAM_Tx
        ComIPduSignalRef = IAPPPlnngPathLatdP4_synthesized_IAM_ZONE_CONNCA_0001_CONTROLLER_0_IAM_Tx
        ComIPduSignalRef = IAPPPlnngPathLongdP4_synthesized_IAM_ZONE_CONNCA_0001_CONTROLLER_0_IAM_Tx
        ComIPduSignalRef = IAPPPlnngPathLatdP3_synthesized_IAM_ZONE_CONNCA_0001_CONTROLLER_0_IAM_Tx
        ComIPduSignalRef = IAPPPlnngPathLongdP3_synthesized_IAM_ZONE_CONNCA_0001_CONTROLLER_0_IAM_Tx
        ComIPduSignalRef = IAPPPlnngPathLongdP2_synthesized_IAM_ZONE_CONNCA_0001_CONTROLLER_0_IAM_Tx
        ComIPduSignalRef = IAPPPlnngPathLatdP1_synthesized_IAM_ZONE_CONNCA_0001_CONTROLLER_0_IAM_Tx
        ComIPduSignalRef = IAPPPlnngPathLongdP1_synthesized_IAM_ZONE_CONNCA_0001_CONTROLLER_0_IAM_Tx
        ComIPduGroupRef = Com_TxPduGroup_CONTROLLER_0_IAM
        ComTxIPdu: ComMinimumDelayTime=0.0, ComTxIPduUnusedAreasDefault=0
          ComTxModeTrue
            ComTxMode: ComTxModeMode=DIRECT, ComTxModeNumberOfRepetitions=3, ComTxModeRepetitionPeriod=0.05, ComTxModeTimeOffset=0.0, ComTxModeTimePeriod=0.0
      10 x ComSignal, all with ComBitSize=32, ComInvalidNotification=NULL_PTR, ComRxDataTimeoutAction=NONE, ComSignalEndianness=BIG_ENDIAN, ComSignalInitValue=0x0, ComSignalLength=0, ComSignalType=SINT32, ComTransferProperty=TRIGGERED, ComSignalDataInvalidValue=0x0, ComDataInvalidAction=NOTIFY, ComTimeout=0.0, ComFirstTimeout=0.0, ComNotification=Rte_COMCbkTAck:
        IAPPPlnngPathLatdP2_synthesized_IAM_ZONE_CONNCA_0001_CONTROLLER_0_IAM_Tx: ComBitPosition=120, ComHandleId=IAPPPlnngPathLatdP2_synthesized_IAM_ZONE_CONNCA_0001_CONTROLLER_0_IAM_Tx
        IAPPPlnngPathLatdP5_synthesized_IAM_ZONE_CONNCA_0001_CONTROLLER_0_IAM_Tx: ComBitPosition=312, ComHandleId=IAPPPlnngPathLatdP5_synthesized_IAM_ZONE_CONNCA_0001_CONTROLLER_0_IAM_Tx
        IAPPPlnngPathLongdP5_synthesized_IAM_ZONE_CONNCA_0001_CONTROLLER_0_IAM_Tx: ComBitPosition=280, ComHandleId=IAPPPlnngPathLongdP5_synthesized_IAM_ZONE_CONNCA_0001_CONTROLLER_0_IAM_Tx
        IAPPPlnngPathLatdP4_synthesized_IAM_ZONE_CONNCA_0001_CONTROLLER_0_IAM_Tx: ComBitPosition=248, ComHandleId=IAPPPlnngPathLatdP4_synthesized_IAM_ZONE_CONNCA_0001_CONTROLLER_0_IAM_Tx
        IAPPPlnngPathLongdP4_synthesized_IAM_ZONE_CONNCA_0001_CONTROLLER_0_IAM_Tx: ComBitPosition=216, ComHandleId=IAPPPlnngPathLongdP4_synthesized_IAM_ZONE_CONNCA_0001_CONTROLLER_0_IAM_Tx
        IAPPPlnngPathLatdP3_synthesized_IAM_ZONE_CONNCA_0001_CONTROLLER_0_IAM_Tx: ComBitPosition=184, ComHandleId=IAPPPlnngPathLatdP3_synthesized_IAM_ZONE_CONNCA_0001_CONTROLLER_0_IAM_Tx
        IAPPPlnngPathLongdP3_synthesized_IAM_ZONE_CONNCA_0001_CONTROLLER_0_IAM_Tx: ComBitPosition=152, ComHandleId=IAPPPlnngPathLongdP3_synthesized_IAM_ZONE_CONNCA_0001_CONTROLLER_0_IAM_Tx
        IAPPPlnngPathLongdP2_synthesized_IAM_ZONE_CONNCA_0001_CONTROLLER_0_IAM_Tx: ComBitPosition=88, ComHandleId=IAPPPlnngPathLongdP2_synthesized_IAM_ZONE_CONNCA_0001_CONTROLLER_0_IAM_Tx
        IAPPPlnngPathLatdP1_synthesized_IAM_ZONE_CONNCA_0001_CONTROLLER_0_IAM_Tx: ComBitPosition=56, ComHandleId=IAPPPlnngPathLatdP1_synthesized_IAM_ZONE_CONNCA_0001_CONTROLLER_0_IAM_Tx
        IAPPPlnngPathLongdP1_synthesized_IAM_ZONE_CONNCA_0001_CONTROLLER_0_IAM_Tx: ComBitPosition=24, ComHandleId=IAPPPlnngPathLongdP1_synthesized_IAM_ZONE_CONNCA_0001_CONTROLLER_0_IAM_Tx
      synthesized_IAM_BKPCANFD_20ms_Fr_CONTROLLER_0_IAM_Tx (ComIPdu):
        ComIPduCancellationSupport = false
        ComIPduDirection = SEND
        ComIPduHandleId = COM_TXPDU_COM_synthesized_IAM_BKPCANFD_20ms_Fr_CONTROLLER_0_IAM_Tx
        ComIPduSignalProcessing = DEFERRED
        ComIPduType = NORMAL
        ComPduIdRef = COM_synthesized_IAM_BKPCANFD_20ms_Fr_CONTROLLER_0_IAM_Tx
        ComIPduSignalRef = IP2PExeAvlbl_synthesized_IAM_BKPCANFD_20ms_Fr_CONTROLLER_0_IAM_Tx
        ComIPduSignalRef = IP2PExeAvlblV_synthesized_IAM_BKPCANFD_20ms_Fr_CONTROLLER_0_IAM_Tx
        ComIPduGroupRef = Com_TxPduGroup_CONTROLLER_0_IAM
        ComTxIPdu: ComMinimumDelayTime=0.0, ComTxIPduUnusedAreasDefault=0
          ComTxModeTrue
            ComTxMode: ComTxModeMode=PERIODIC, ComTxModeNumberOfRepetitions=0, ComTxModeRepetitionPeriod=0.0, ComTxModeTimeOffset=0.0, ComTxModeTimePeriod=0.02
      IP2PExeAvlbl_synthesized_IAM_BKPCANFD_20ms_Fr_CONTROLLER_0_IAM_Tx (ComSignal):
        ComBitPosition = 15
        ComBitSize = 8
        ComHandleId = IP2PExeAvlbl_synthesized_IAM_BKPCANFD_20ms_Fr_CONTROLLER_0_IAM_Tx
        ComInvalidNotification = NULL_PTR
        ComRxDataTimeoutAction = NONE
        ComSignalEndianness = BIG_ENDIAN
        ComSignalInitValue = 0x0
        ComSignalLength = 0
        ComSignalType = SINT8
        ComTransferProperty = PENDING
        ComSignalDataInvalidValue = 0x0
        ComDataInvalidAction = NOTIFY
        ComTimeout = 0.0
        ComFirstTimeout = 0.0
        ComNotification = Rte_COMCbkTAck
      IP2PExeAvlblV_synthesized_IAM_BKPCANFD_20ms_Fr_CONTROLLER_0_IAM_Tx (ComSignal):
        ComBitPosition = 14
        ComBitSize = 1
        ComHandleId = IP2PExeAvlblV_synthesized_IAM_BKPCANFD_20ms_Fr_CONTROLLER_0_IAM_Tx
        ComInvalidNotification = NULL_PTR
        ComRxDataTimeoutAction = NONE
        ComSignalEndianness = BIG_ENDIAN
        ComSignalInitValue = 0x0
        ComSignalLength = 0
        ComSignalType = BOOLEAN
        ComTransferProperty = PENDING
        ComSignalDataInvalidValue = 0x0
        ComDataInvalidAction = NOTIFY
        ComTimeout = 0.0
        ComFirstTimeout = 0.0
        ComNotification = Rte_COMCbkTAck
      IAM_CONNCANFD_100ms_ConFrP03_CONTROLLER_0_IAM_Tx_Pdu13 (ComIPdu):
        ComIPduCancellationSupport = false
        ComIPduDirection = SEND
        ComIPduHandleId = COM_TXPDU_Com_Contained_Tx_0x36A_Pdu13
        ComIPduSignalProcessing = DEFERRED
        ComIPduType = NORMAL
        ComIPduCallout = IAM_CONNCANFD_100ms_ConFrP03_CONTROLLER_0_IAM_Tx_Pdu13
        ComPduIdRef = Com_Contained_Tx_0x36A_Pdu13
        ComIPduSignalGroupRef = IIAM_ZONE_100ms_Group13_IAM_CONNCANFD_100ms_ConFrP03_CONTROLLER_0_IAM_Tx
        ComIPduGroupRef = Com_TxPduGroup_CONTROLLER_0_IAM
        ComTxIPdu: ComMinimumDelayTime=0.0, ComTxIPduUnusedAreasDefault=0
          ComTxModeTrue
            ComTxMode: ComTxModeMode=PERIODIC, ComTxModeNumberOfRepetitions=0, ComTxModeRepetitionPeriod=0.0, ComTxModeTimeOffset=0.0, ComTxModeTimePeriod=0.1
      IIAM_ZONE_100ms_Group40_IAM_CONNCANFD_100ms_ConFrP03_CONTROLLER_0_IAM_Tx (ComSignalGroup):
        ComHandleId = IIAM_ZONE_100ms_Group40_IAM_CONNCANFD_100ms_ConFrP03_CONTROLLER_0_IAM_Tx
        ComInvalidNotification = NULL_PTR
        ComRxDataTimeoutAction = NONE
        ComTransferProperty = PENDING
        ComDataInvalidAction = NOTIFY
        ComTimeout = 0.0
        ComFirstTimeout = 0.0
        ComNotification = Rte_COMCbkTAck
        6 x ComGroupSignal, all with ComSignalEndianness=BIG_ENDIAN, ComSignalInitValue=0x0, ComSignalLength=0, ComSignalDataInvalidValue=0x0:
          IIAM_ZONE_100ms_Group40_Reserved2: ComBitPosition=56, ComBitSize=8, ComHandleId=IIAM_ZONE_100ms_Group40_IAM_CONNCANFD_100ms_ConFrP03_CONTROLLER_0_IAM_Tx_IIAM_ZONE_100ms_Group40_Reserved2, ComSignalType=SINT8
          IHeadingRTK_IIAM_ZONE_100ms_Group40_IAM_CONNCANFD_100ms_ConFrP03_CONTROLLER_0_IAM_Tx: ComBitPosition=48, ComBitSize=16, ComHandleId=IIAM_ZONE_100ms_Group40_IAM_CONNCANFD_100ms_ConFrP03_CONTROLLER_0_IAM_Tx_IHeadingRTK_IIAM_ZONE_100ms_Group40_IAM_CONNCANFD_100ms_ConFrP03_CONTROLLER_0_IAM_Tx, ComSignalType=SINT16
          IAltitudeRTK_IIAM_ZONE_100ms_Group40_IAM_CONNCANFD_100ms_ConFrP03_CONTROLLER_0_IAM_Tx: ComBitPosition=32, ComBitSize=24, ComHandleId=IIAM_ZONE_100ms_Group40_IAM_CONNCANFD_100ms_ConFrP03_CONTROLLER_0_IAM_Tx_IAltitudeRTK_IIAM_ZONE_100ms_Group40_IAM_CONNCANFD_100ms_ConFrP03_CONTROLLER_0_IAM_Tx, ComSignalType=SINT32
          IIAM_ZONE_100ms_Group40_Reserved1: ComBitPosition=12, ComBitSize=4, ComHandleId=IIAM_ZONE_100ms_Group40_IAM_CONNCANFD_100ms_ConFrP03_CONTROLLER_0_IAM_Tx_IIAM_ZONE_100ms_Group40_Reserved1, ComSignalType=SINT8
          IIAM_ZONE_100ms_Group40_RC_IIAM_ZONE_100ms_Group40_IAM_CONNCANFD_100ms_ConFrP03_CONTROLLER_0_IAM_Tx: ComBitPosition=8, ComBitSize=4, ComHandleId=IIAM_ZONE_100ms_Group40_IAM_CONNCANFD_100ms_ConFrP03_CONTROLLER_0_IAM_Tx_IIAM_ZONE_100ms_Group40_RC_IIAM_ZONE_100ms_Group40_IAM_CONNCANFD_100ms_ConFrP03_CONTROLLER_0_IAM_Tx, ComSignalType=SINT8
          IIAM_ZONE_100ms_Group40_CRC_IIAM_ZONE_100ms_Group40_IAM_CONNCANFD_100ms_ConFrP03_CONTROLLER_0_IAM_Tx: ComBitPosition=0, ComBitSize=8, ComHandleId=IIAM_ZONE_100ms_Group40_IAM_CONNCANFD_100ms_ConFrP03_CONTROLLER_0_IAM_Tx_IIAM_ZONE_100ms_Group40_CRC_IIAM_ZONE_100ms_Group40_IAM_CONNCANFD_100ms_ConFrP03_CONTROLLER_0_IAM_Tx, ComSignalType=SINT8
      IEmgcCallTrigd_IAM_CONNCANFD_100ms_ConFrP03_CONTROLLER_0_IAM_Tx (ComSignal):
        ComBitPosition = 19
        ComBitSize = 1
        ComHandleId = IEmgcCallTrigd_IAM_CONNCANFD_100ms_ConFrP03_CONTROLLER_0_IAM_Tx
        ComInvalidNotification = NULL_PTR
        ComRxDataTimeoutAction = NONE
        ComSignalEndianness = BIG_ENDIAN
        ComSignalInitValue = 0x0
        ComSignalLength = 0
        ComSignalType = BOOLEAN
        ComTransferProperty = PENDING
        ComSignalDataInvalidValue = 0x0
        ComDataInvalidAction = NOTIFY
        ComTimeout = 0.0
        ComFirstTimeout = 0.0
        ComNotification = Rte_COMCbkTAck
      IEmgcCallFlrSts_IAM_CONNCANFD_100ms_ConFrP03_CONTROLLER_0_IAM_Tx (ComSignal):
        ComBitPosition = 16
        ComBitSize = 2
        ComHandleId = IEmgcCallFlrSts_IAM_CONNCANFD_100ms_ConFrP03_CONTROLLER_0_IAM_Tx
        ComInvalidNotification = NULL_PTR
        ComRxDataTimeoutAction = NONE
        ComSignalEndianness = BIG_ENDIAN
        ComSignalInitValue = 0x0
        ComSignalLength = 0
        ComSignalType = SINT8
        ComTransferProperty = PENDING
        ComSignalDataInvalidValue = 0x0
        ComDataInvalidAction = NOTIFY
        ComTimeout = 0.0
        ComFirstTimeout = 0.0
        ComNotification = Rte_COMCbkTAck
      3 x ComSignalGroup, all with ComInvalidNotification=NULL_PTR, ComRxDataTimeoutAction=NONE, ComTransferProperty=PENDING, ComDataInvalidAction=NOTIFY, ComTimeout=0.0, ComFirstTimeout=0.0, ComNotification=Rte_COMCbkTAck:
        IIAM_ZONE_100ms_Group35_IAM_CONNCANFD_100ms_ConFrP03_CONTROLLER_0_IAM_Tx: ComHandleId=IIAM_ZONE_100ms_Group35_IAM_CONNCANFD_100ms_ConFrP03_CONTROLLER_0_IAM_Tx
          5 x ComGroupSignal, all with ComSignalEndianness=BIG_ENDIAN, ComSignalInitValue=0x0, ComSignalLength=0, ComSignalDataInvalidValue=0x0:
            IIAM_ZONE_100ms_PDU35_RC_IIAM_ZONE_100ms_Group35_IAM_CONNCANFD_100ms_ConFrP03_CONTROLLER_0_IAM_Tx: ComBitPosition=8, ComBitSize=4, ComHandleId=IIAM_ZONE_100ms_Group35_IAM_CONNCANFD_100ms_ConFrP03_CONTROLLER_0_IAM_Tx_IIAM_ZONE_100ms_PDU35_RC_IIAM_ZONE_100ms_Group35_IAM_CONNCANFD_100ms_ConFrP03_CONTROLLER_0_IAM_Tx, ComSignalType=SINT8
            IGNSSF9HCounter_IIAM_ZONE_100ms_Group35_IAM_CONNCANFD_100ms_ConFrP03_CONTROLLER_0_IAM_Tx: ComBitPosition=12, ComBitSize=4, ComHandleId=IIAM_ZONE_100ms_Group35_IAM_CONNCANFD_100ms_ConFrP03_CONTROLLER_0_IAM_Tx_IGNSSF9HCounter_IIAM_ZONE_100ms_Group35_IAM_CONNCANFD_100ms_ConFrP03_CONTROLLER_0_IAM_Tx, ComSignalType=SINT8
            IGNSSUTCTime_IIAM_ZONE_100ms_Group35_IAM_CONNCANFD_100ms_ConFrP03_CONTROLLER_0_IAM_Tx: ComBitPosition=60, ComBitSize=44, ComHandleId=IIAM_ZONE_100ms_Group35_IAM_CONNCANFD_100ms_ConFrP03_CONTROLLER_0_IAM_Tx_IGNSSUTCTime_IIAM_ZONE_100ms_Group35_IAM_CONNCANFD_100ms_ConFrP03_CONTROLLER_0_IAM_Tx, ComSignalType=SINT64
            IIAM_ZONE_100ms_Group35_Reserved1: ComBitPosition=56, ComBitSize=4, ComHandleId=IIAM_ZONE_100ms_Group35_IAM_CONNCANFD_100ms_ConFrP03_CONTROLLER_0_IAM_Tx_IIAM_ZONE_100ms_Group35_Reserved1, ComSignalType=SINT8
            IIAM_ZONE_100ms_PDU35_CRC_IIAM_ZONE_100ms_Group35_IAM_CONNCANFD_100ms_ConFrP03_CONTROLLER_0_IAM_Tx: ComBitPosition=0, ComBitSize=8, ComHandleId=IIAM_ZONE_100ms_Group35_IAM_CONNCANFD_100ms_ConFrP03_CONTROLLER_0_IAM_Tx_IIAM_ZONE_100ms_PDU35_CRC_IIAM_ZONE_100ms_Group35_IAM_CONNCANFD_100ms_ConFrP03_CONTROLLER_0_IAM_Tx, ComSignalType=SINT8
        IIAM_ZONE_100ms_Group34_IAM_CONNCANFD_100ms_ConFrP03_CONTROLLER_0_IAM_Tx: ComHandleId=IIAM_ZONE_100ms_Group34_IAM_CONNCANFD_100ms_ConFrP03_CONTROLLER_0_IAM_Tx
          9 x ComGroupSignal, all with ComSignalEndianness=BIG_ENDIAN, ComSignalInitValue=0x0, ComSignalLength=0:
            IIAM_ZONE_100ms_Group34_IIAM_ZONE_100ms_Group34_Reserved2: ComBitPosition=22, ComBitSize=2, ComHandleId=IIAM_ZONE_100ms_Group34_IAM_CONNCANFD_100ms_ConFrP03_CONTROLLER_0_IAM_Tx_IIAM_ZONE_100ms_Group34_IIAM_ZONE_100ms_Group34_Reserved2, ComSignalType=SINT8, ComSignalDataInvalidValue=0x0
            IHdop_IIAM_ZONE_100ms_Group34_IAM_CONNCANFD_100ms_ConFrP03_CONTROLLER_0_IAM_Tx: ComBitPosition=56, ComBitSize=14, ComHandleId=IIAM_ZONE_100ms_Group34_IAM_CONNCANFD_100ms_ConFrP03_CONTROLLER_0_IAM_Tx_IHdop_IIAM_ZONE_100ms_Group34_IAM_CONNCANFD_100ms_ConFrP03_CONTROLLER_0_IAM_Tx, ComSignalType=SINT16, ComSignalDataInvalidValue=0x0
            IIAM_ZONE_100ms_Group34_IIAM_ZONE_100ms_Group34_Reserved3: ComBitPosition=38, ComBitSize=2, ComHandleId=IIAM_ZONE_100ms_Group34_IAM_CONNCANFD_100ms_ConFrP03_CONTROLLER_0_IAM_Tx_IIAM_ZONE_100ms_Group34_IIAM_ZONE_100ms_Group34_Reserved3, ComSignalType=SINT8, ComSignalDataInvalidValue=0x0
            IVdop_IIAM_ZONE_100ms_Group34_IAM_CONNCANFD_100ms_ConFrP03_CONTROLLER_0_IAM_Tx: ComBitPosition=40, ComBitSize=14, ComHandleId=IIAM_ZONE_100ms_Group34_IAM_CONNCANFD_100ms_ConFrP03_CONTROLLER_0_IAM_Tx_IVdop_IIAM_ZONE_100ms_Group34_IAM_CONNCANFD_100ms_ConFrP03_CONTROLLER_0_IAM_Tx, ComSignalType=SINT16, ComSignalDataInvalidValue=0x0
            IIAM_ZONE_100ms_Group34_IIAM_ZONE_100ms_Group34_Reserved4: ComBitPosition=54, ComBitSize=2, ComHandleId=IIAM_ZONE_100ms_Group34_IAM_CONNCANFD_100ms_ConFrP03_CONTROLLER_0_IAM_Tx_IIAM_ZONE_100ms_Group34_IIAM_ZONE_100ms_Group34_Reserved4, ComSignalType=SINT8, ComSignalDataInvalidValue=0x0
            IPdop_IIAM_ZONE_100ms_Group34_IAM_CONNCANFD_100ms_ConFrP03_CONTROLLER_0_IAM_Tx: ComBitPosition=24, ComBitSize=14, ComHandleId=IIAM_ZONE_100ms_Group34_IAM_CONNCANFD_100ms_ConFrP03_CONTROLLER_0_IAM_Tx_IPdop_IIAM_ZONE_100ms_Group34_IAM_CONNCANFD_100ms_ConFrP03_CONTROLLER_0_IAM_Tx, ComSignalType=SINT16, ComSignalDataInvalidValue=0x0
            IIAM_ZONE_100ms_Group34_IIAM_ZONE_100ms_Group34_Reserved1: ComBitPosition=12, ComBitSize=4, ComHandleId=IIAM_ZONE_100ms_Group34_IAM_CONNCANFD_100ms_ConFrP03_CONTROLLER_0_IAM_Tx_IIAM_ZONE_100ms_Group34_IIAM_ZONE_100ms_Group34_Reserved1, ComSignalType=SINT8, ComSignalDataInvalidValue=0x0
            IIAM_ZONE_100ms_Group34_RC_IIAM_ZONE_100ms_Group34_IAM_CONNCANFD_100ms_ConFrP03_CONTROLLER_0_IAM_Tx: ComBitPosition=8, ComBitSize=4, ComHandleId=IIAM_ZONE_100ms_Group34_IAM_CONNCANFD_100ms_ConFrP03_CONTROLLER_0_IAM_Tx_IIAM_ZONE_100ms_Group34_RC_IIAM_ZONE_100ms_Group34_IAM_CONNCANFD_100ms_ConFrP03_CONTROLLER_0_IAM_Tx, ComSignalType=SINT8, ComSignalDataInvalidValue=0x0
            IIAM_ZONE_100ms_Group34_CRC_IIAM_ZONE_100ms_Group34_IAM_CONNCANFD_100ms_ConFrP03_CONTROLLER_0_IAM_Tx: ComBitPosition=0, ComBitSize=8, ComHandleId=IIAM_ZONE_100ms_Group34_IAM_CONNCANFD_100ms_ConFrP03_CONTROLLER_0_IAM_Tx_IIAM_ZONE_100ms_Group34_CRC_IIAM_ZONE_100ms_Group34_IAM_CONNCANFD_100ms_ConFrP03_CONTROLLER_0_IAM_Tx, ComSignalType=SINT8
        IIAM_ZONE_100ms_Group13_IAM_CONNCANFD_100ms_ConFrP03_CONTROLLER_0_IAM_Tx: ComHandleId=IIAM_ZONE_100ms_Group13_IAM_CONNCANFD_100ms_ConFrP03_CONTROLLER_0_IAM_Tx
          6 x ComGroupSignal, all with ComSignalEndianness=BIG_ENDIAN, ComSignalInitValue=0x0, ComSignalLength=0, ComSignalDataInvalidValue=0x0:
            IGNSSUTCTimeH_IIAM_ZONE_100ms_Group13_IAM_CONNCANFD_100ms_ConFrP03_CONTROLLER_0_IAM_Tx: ComBitPosition=56, ComBitSize=16, ComHandleId=IIAM_ZONE_100ms_Group13_IAM_CONNCANFD_100ms_ConFrP03_CONTROLLER_0_IAM_Tx_IGNSSUTCTimeH_IIAM_ZONE_100ms_Group13_IAM_CONNCANFD_100ms_ConFrP03_CONTROLLER_0_IAM_Tx, ComSignalType=SINT16
            IGNSSSeq_IIAM_ZONE_100ms_Group13_IAM_CONNCANFD_100ms_ConFrP03_CONTROLLER_0_IAM_Tx: ComBitPosition=40, ComBitSize=32, ComHandleId=IIAM_ZONE_100ms_Group13_IAM_CONNCANFD_100ms_ConFrP03_CONTROLLER_0_IAM_Tx_IGNSSSeq_IIAM_ZONE_100ms_Group13_IAM_CONNCANFD_100ms_ConFrP03_CONTROLLER_0_IAM_Tx, ComSignalType=SINT32
            IFixType_IIAM_ZONE_100ms_Group13_IAM_CONNCANFD_100ms_ConFrP03_CONTROLLER_0_IAM_Tx: ComBitPosition=14, ComBitSize=2, ComHandleId=IIAM_ZONE_100ms_Group13_IAM_CONNCANFD_100ms_ConFrP03_CONTROLLER_0_IAM_Tx_IFixType_IIAM_ZONE_100ms_Group13_IAM_CONNCANFD_100ms_ConFrP03_CONTROLLER_0_IAM_Tx, ComSignalType=SINT8
            IIAM_ZONE_100ms_Group13_Reserved_IIAM_ZONE_100ms_Group13_IAM_CONNCANFD_100ms_ConFrP03_CONTROLLER_0_IAM_Tx: ComBitPosition=12, ComBitSize=2, ComHandleId=IIAM_ZONE_100ms_Group13_IAM_CONNCANFD_100ms_ConFrP03_CONTROLLER_0_IAM_Tx_IIAM_ZONE_100ms_Group13_Reserved_IIAM_ZONE_100ms_Group13_IAM_CONNCANFD_100ms_ConFrP03_CONTROLLER_0_IAM_Tx, ComSignalType=SINT8
            IIAM_ZONE_100ms_Group13_RC_IIAM_ZONE_100ms_Group13_IAM_CONNCANFD_100ms_ConFrP03_CONTROLLER_0_IAM_Tx: ComBitPosition=8, ComBitSize=4, ComHandleId=IIAM_ZONE_100ms_Group13_IAM_CONNCANFD_100ms_ConFrP03_CONTROLLER_0_IAM_Tx_IIAM_ZONE_100ms_Group13_RC_IIAM_ZONE_100ms_Group13_IAM_CONNCANFD_100ms_ConFrP03_CONTROLLER_0_IAM_Tx, ComSignalType=SINT8
            IIAM_ZONE_100ms_Group13_CRC_IIAM_ZONE_100ms_Group13_IAM_CONNCANFD_100ms_ConFrP03_CONTROLLER_0_IAM_Tx: ComBitPosition=0, ComBitSize=8, ComHandleId=IIAM_ZONE_100ms_Group13_IAM_CONNCANFD_100ms_ConFrP03_CONTROLLER_0_IAM_Tx_IIAM_ZONE_100ms_Group13_CRC_IIAM_ZONE_100ms_Group13_IAM_CONNCANFD_100ms_ConFrP03_CONTROLLER_0_IAM_Tx, ComSignalType=SINT8
      IAM_CONNCANFD_100ms_ConFrP02_CONTROLLER_0_IAM_Tx_PDU06 (ComIPdu):
        ComIPduCancellationSupport = false
        ComIPduDirection = SEND
        ComIPduHandleId = COM_TXPDU_Com_Contained_Tx_0x377_Pdu06
        ComIPduSignalProcessing = DEFERRED
        ComIPduType = NORMAL
        ComIPduCallout = IAM_CONNCANFD_100ms_ConFrP02_CONTROLLER_0_IAM_Tx_PDU06
        ComPduIdRef = Com_Contained_Tx_0x377_Pdu06
        ComIPduSignalRef = INorthVelocityRTK_IAM_CONNCANFD_100ms_ConFrP02_CONTROLLER_0_IAM_Tx
        ComIPduSignalRef = IEastVelocityRTK_IAM_CONNCANFD_100ms_ConFrP02_CONTROLLER_0_IAM_Tx
        ComIPduSignalRef = ISatNoInPositionRTK_IAM_CONNCANFD_100ms_ConFrP02_CONTROLLER_0_IAM_Tx
        ComIPduSignalRef = ISatNoInAttitudeRTK_IAM_CONNCANFD_100ms_ConFrP02_CONTROLLER_0_IAM_Tx
        ComIPduGroupRef = Com_TxPduGroup_CONTROLLER_0_IAM
        ComTxIPdu: ComMinimumDelayTime=0.0, ComTxIPduUnusedAreasDefault=0
          ComTxModeTrue
            ComTxMode: ComTxModeMode=PERIODIC, ComTxModeNumberOfRepetitions=0, ComTxModeRepetitionPeriod=0.0, ComTxModeTimeOffset=0.0, ComTxModeTimePeriod=0.1
      IIAM_100ms_Group08_IAM_CONNCANFD_100ms_ConFrP02_CONTROLLER_0_IAM_Tx (ComSignalGroup):
        ComHandleId = IIAM_100ms_Group08_IAM_CONNCANFD_100ms_ConFrP02_CONTROLLER_0_IAM_Tx
        ComInvalidNotification = NULL_PTR
        ComRxDataTimeoutAction = NONE
        ComTransferProperty = PENDING
        ComDataInvalidAction = NOTIFY
        ComTimeout = 0.0
        ComFirstTimeout = 0.0
        ComNotification = Rte_COMCbkTAck
        6 x ComGroupSignal, all with ComSignalInitValue=0x0, ComSignalLength=0, ComSignalDataInvalidValue=0x0:
          IAltSigma_IIAM_100ms_Group08_IAM_CONNCANFD_100ms_ConFrP02_CONTROLLER_0_IAM_Tx: ComBitPosition=56, ComBitSize=16, ComHandleId=IIAM_100ms_Group08_IAM_CONNCANFD_100ms_ConFrP02_CONTROLLER_0_IAM_Tx_IAltSigma_IIAM_100ms_Group08_IAM_CONNCANFD_100ms_ConFrP02_CONTROLLER_0_IAM_Tx, ComSignalEndianness=BIG_ENDIAN, ComSignalType=SINT16
          ILonSigma_IIAM_100ms_Group08_IAM_CONNCANFD_100ms_ConFrP02_CONTROLLER_0_IAM_Tx: ComBitPosition=40, ComBitSize=16, ComHandleId=IIAM_100ms_Group08_IAM_CONNCANFD_100ms_ConFrP02_CONTROLLER_0_IAM_Tx_ILonSigma_IIAM_100ms_Group08_IAM_CONNCANFD_100ms_ConFrP02_CONTROLLER_0_IAM_Tx, ComSignalEndianness=BIG_ENDIAN, ComSignalType=SINT16
          ILatSigma_IIAM_100ms_Group08_IAM_CONNCANFD_100ms_ConFrP02_CONTROLLER_0_IAM_Tx: ComBitPosition=24, ComBitSize=16, ComHandleId=IIAM_100ms_Group08_IAM_CONNCANFD_100ms_ConFrP02_CONTROLLER_0_IAM_Tx_ILatSigma_IIAM_100ms_Group08_IAM_CONNCANFD_100ms_ConFrP02_CONTROLLER_0_IAM_Tx, ComSignalEndianness=BIG_ENDIAN, ComSignalType=SINT16
          IIAM_100ms_Group08_Reserved1_IIAM_100ms_Group08_IAM_CONNCANFD_100ms_ConFrP02_CONTROLLER_0_IAM_Tx: ComBitPosition=12, ComBitSize=4, ComHandleId=IIAM_100ms_Group08_IAM_CONNCANFD_100ms_ConFrP02_CONTROLLER_0_IAM_Tx_IIAM_100ms_Group08_Reserved1_IIAM_100ms_Group08_IAM_CONNCANFD_100ms_ConFrP02_CONTROLLER_0_IAM_Tx, ComSignalEndianness=LITTLE_ENDIAN, ComSignalType=SINT8
          IIAM_100ms_Group08_RC_IIAM_100ms_Group08_IAM_CONNCANFD_100ms_ConFrP02_CONTROLLER_0_IAM_Tx: ComBitPosition=8, ComBitSize=4, ComHandleId=IIAM_100ms_Group08_IAM_CONNCANFD_100ms_ConFrP02_CONTROLLER_0_IAM_Tx_IIAM_100ms_Group08_RC_IIAM_100ms_Group08_IAM_CONNCANFD_100ms_ConFrP02_CONTROLLER_0_IAM_Tx, ComSignalEndianness=BIG_ENDIAN, ComSignalType=SINT8
          IIAM_100ms_Group08_CRC_IIAM_100ms_Group08_IAM_CONNCANFD_100ms_ConFrP02_CONTROLLER_0_IAM_Tx: ComBitPosition=0, ComBitSize=8, ComHandleId=IIAM_100ms_Group08_IAM_CONNCANFD_100ms_ConFrP02_CONTROLLER_0_IAM_Tx_IIAM_100ms_Group08_CRC_IIAM_100ms_Group08_IAM_CONNCANFD_100ms_ConFrP02_CONTROLLER_0_IAM_Tx, ComSignalEndianness=BIG_ENDIAN, ComSignalType=SINT8
      9 x ComSignal, all with ComInvalidNotification=NULL_PTR, ComRxDataTimeoutAction=NONE, ComSignalEndianness=BIG_ENDIAN, ComSignalInitValue=0x0, ComSignalLength=0, ComTransferProperty=PENDING, ComSignalDataInvalidValue=0x0, ComDataInvalidAction=NOTIFY, ComTimeout=0.0, ComFirstTimeout=0.0, ComNotification=Rte_COMCbkTAck:
        IDownVelocityRTK_IAM_CONNCANFD_100ms_ConFrP02_CONTROLLER_0_IAM_Tx: ComBitPosition=56, ComBitSize=16, ComHandleId=IDownVelocityRTK_IAM_CONNCANFD_100ms_ConFrP02_CONTROLLER_0_IAM_Tx, ComSignalType=SINT16
        IVeldownsigma_IAM_CONNCANFD_100ms_ConFrP02_CONTROLLER_0_IAM_Tx: ComBitPosition=40, ComBitSize=16, ComHandleId=IVeldownsigma_IAM_CONNCANFD_100ms_ConFrP02_CONTROLLER_0_IAM_Tx, ComSignalType=SINT16
        IBaseLineLen_IAM_CONNCANFD_100ms_ConFrP02_CONTROLLER_0_IAM_Tx: ComBitPosition=24, ComBitSize=16, ComHandleId=IBaseLineLen_IAM_CONNCANFD_100ms_ConFrP02_CONTROLLER_0_IAM_Tx, ComSignalType=SINT16
        IPositionAttitudeStatus_IAM_CONNCANFD_100ms_ConFrP02_CONTROLLER_0_IAM_Tx: ComBitPosition=8, ComBitSize=8, ComHandleId=IPositionAttitudeStatus_IAM_CONNCANFD_100ms_ConFrP02_CONTROLLER_0_IAM_Tx, ComSignalType=SINT8
        IDiffAgeInfo_IAM_CONNCANFD_100ms_ConFrP02_CONTROLLER_0_IAM_Tx: ComBitPosition=0, ComBitSize=8, ComHandleId=IDiffAgeInfo_IAM_CONNCANFD_100ms_ConFrP02_CONTROLLER_0_IAM_Tx, ComSignalType=SINT8
        INorthVelocityRTK_IAM_CONNCANFD_100ms_ConFrP02_CONTROLLER_0_IAM_Tx: ComBitPosition=56, ComBitSize=24, ComHandleId=INorthVelocityRTK_IAM_CONNCANFD_100ms_ConFrP02_CONTROLLER_0_IAM_Tx, ComSignalType=SINT32
        IEastVelocityRTK_IAM_CONNCANFD_100ms_ConFrP02_CONTROLLER_0_IAM_Tx: ComBitPosition=32, ComBitSize=24, ComHandleId=IEastVelocityRTK_IAM_CONNCANFD_100ms_ConFrP02_CONTROLLER_0_IAM_Tx, ComSignalType=SINT32
        ISatNoInPositionRTK_IAM_CONNCANFD_100ms_ConFrP02_CONTROLLER_0_IAM_Tx: ComBitPosition=8, ComBitSize=8, ComHandleId=ISatNoInPositionRTK_IAM_CONNCANFD_100ms_ConFrP02_CONTROLLER_0_IAM_Tx, ComSignalType=SINT8
        ISatNoInAttitudeRTK_IAM_CONNCANFD_100ms_ConFrP02_CONTROLLER_0_IAM_Tx: ComBitPosition=0, ComBitSize=8, ComHandleId=ISatNoInAttitudeRTK_IAM_CONNCANFD_100ms_ConFrP02_CONTROLLER_0_IAM_Tx, ComSignalType=SINT8
      IAM_CONNCANFD_100ms_ConFrP41_CONTROLLER_0_IAM_Tx_Pdu03 (ComIPdu):
        ComIPduCancellationSupport = false
        ComIPduDirection = SEND
        ComIPduHandleId = COM_TXPDU_Com_Contained_Tx_0x3A2_Pdu03
        ComIPduSignalProcessing = DEFERRED
        ComIPduType = NORMAL
        ComIPduCallout = IAM_CONNCANFD_100ms_ConFrP41_CONTROLLER_0_IAM_Tx_Pdu03
        ComPduIdRef = Com_Contained_Tx_0x3A2_Pdu03
        ComIPduSignalRef = IVeleastsigma_IAM_CONNCANFD_100ms_ConFrP41_CONTROLLER_0_IAM_Tx
        ComIPduSignalRef = IVelnorthsigma_IAM_CONNCANFD_100ms_ConFrP41_CONTROLLER_0_IAM_Tx
        ComIPduSignalRef = IGNSSAntennasInfo_IAM_CONNCANFD_100ms_ConFrP41_CONTROLLER_0_IAM_Tx
        ComIPduSignalRef = IGNSSAntennasBroken_IAM_CONNCANFD_100ms_ConFrP41_CONTROLLER_0_IAM_Tx
        ComIPduSignalRef = IDiffDataLinkBroken_IAM_CONNCANFD_100ms_ConFrP41_CONTROLLER_0_IAM_Tx
        ComIPduSignalRef = ICANprotocolinternalversion_IAM_CONNCANFD_100ms_ConFrP41_CONTROLLER_0_IAM_Tx
        ComIPduGroupRef = Com_TxPduGroup_CONTROLLER_0_IAM
        ComTxIPdu: ComMinimumDelayTime=0.0, ComTxIPduUnusedAreasDefault=0
          ComTxModeTrue
            ComTxMode: ComTxModeMode=PERIODIC, ComTxModeNumberOfRepetitions=0, ComTxModeRepetitionPeriod=0.0, ComTxModeTimeOffset=0.0, ComTxModeTimePeriod=0.1
      IIAM_ZONE_100ms_Group57_IAM_CONNCANFD_100ms_ConFrP41_CONTROLLER_0_IAM_Tx (ComSignalGroup):
        ComHandleId = IIAM_ZONE_100ms_Group57_IAM_CONNCANFD_100ms_ConFrP41_CONTROLLER_0_IAM_Tx
        ComInvalidNotification = NULL_PTR
        ComRxDataTimeoutAction = NONE
        ComTransferProperty = PENDING
        ComDataInvalidAction = NOTIFY
        ComTimeout = 0.0
        ComFirstTimeout = 0.0
        ComNotification = Rte_COMCbkTAck
        5 x ComGroupSignal, all with ComSignalEndianness=BIG_ENDIAN, ComSignalInitValue=0x0, ComSignalLength=0, ComSignalDataInvalidValue=0x0:
          IIAM_ZONE_100ms_Group57_Reserved2: ComBitPosition=56, ComBitSize=8, ComHandleId=IIAM_ZONE_100ms_Group57_IAM_CONNCANFD_100ms_ConFrP41_CONTROLLER_0_IAM_Tx_IIAM_ZONE_100ms_Group57_Reserved2, ComSignalType=SINT8
          ILongitudeRTK_IIAM_ZONE_100ms_Group57_IAM_CONNCANFD_100ms_ConFrP41_CONTROLLER_0_IAM_Tx: ComBitPosition=48, ComBitSize=40, ComHandleId=IIAM_ZONE_100ms_Group57_IAM_CONNCANFD_100ms_ConFrP41_CONTROLLER_0_IAM_Tx_ILongitudeRTK_IIAM_ZONE_100ms_Group57_IAM_CONNCANFD_100ms_ConFrP41_CONTROLLER_0_IAM_Tx, ComSignalType=SINT64
          IIAM_ZONE_100ms_Group57_Reserved1: ComBitPosition=12, ComBitSize=4, ComHandleId=IIAM_ZONE_100ms_Group57_IAM_CONNCANFD_100ms_ConFrP41_CONTROLLER_0_IAM_Tx_IIAM_ZONE_100ms_Group57_Reserved1, ComSignalType=SINT8
          IIAM_ZONE_100ms_Group57_RC: ComBitPosition=8, ComBitSize=4, ComHandleId=IIAM_ZONE_100ms_Group57_IAM_CONNCANFD_100ms_ConFrP41_CONTROLLER_0_IAM_Tx_IIAM_ZONE_100ms_Group57_RC, ComSignalType=SINT8
          IIAM_ZONE_100ms_Group57_CRC_IIAM_ZONE_100ms_Group57_IAM_CONNCANFD_100ms_ConFrP41_CONTROLLER_0_IAM_Tx: ComBitPosition=0, ComBitSize=8, ComHandleId=IIAM_ZONE_100ms_Group57_IAM_CONNCANFD_100ms_ConFrP41_CONTROLLER_0_IAM_Tx_IIAM_ZONE_100ms_Group57_CRC_IIAM_ZONE_100ms_Group57_IAM_CONNCANFD_100ms_ConFrP41_CONTROLLER_0_IAM_Tx, ComSignalType=SINT8
      23 x ComSignal, all with ComInvalidNotification=NULL_PTR, ComRxDataTimeoutAction=NONE, ComSignalEndianness=BIG_ENDIAN, ComSignalInitValue=0x0, ComSignalLength=0, ComTransferProperty=PENDING, ComSignalDataInvalidValue=0x0, ComDataInvalidAction=NOTIFY, ComTimeout=0.0, ComFirstTimeout=0.0, ComNotification=Rte_COMCbkTAck:
        ITBOXReserSpMinute_IAM_CONNCANFD_100ms_ConFrP41_CONTROLLER_0_IAM_Tx: ComBitPosition=58, ComBitSize=6, ComHandleId=ITBOXReserSpMinute_IAM_CONNCANFD_100ms_ConFrP41_CONTROLLER_0_IAM_Tx, ComSignalType=SINT8
        ITBOXReserSpHour_IAM_CONNCANFD_100ms_ConFrP41_CONTROLLER_0_IAM_Tx: ComBitPosition=48, ComBitSize=5, ComHandleId=ITBOXReserSpHour_IAM_CONNCANFD_100ms_ConFrP41_CONTROLLER_0_IAM_Tx, ComSignalType=SINT8
        ITBOXReserStMinute_IAM_CONNCANFD_100ms_ConFrP41_CONTROLLER_0_IAM_Tx: ComBitPosition=42, ComBitSize=6, ComHandleId=ITBOXReserStMinute_IAM_CONNCANFD_100ms_ConFrP41_CONTROLLER_0_IAM_Tx, ComSignalType=SINT8
        ITBOXV2XReq_IAM_CONNCANFD_100ms_ConFrP41_CONTROLLER_0_IAM_Tx: ComBitPosition=35, ComBitSize=2, ComHandleId=ITBOXV2XReq_IAM_CONNCANFD_100ms_ConFrP41_CONTROLLER_0_IAM_Tx, ComSignalType=SINT8
        ITBOXV2XSpSOCReq_IAM_CONNCANFD_100ms_ConFrP41_CONTROLLER_0_IAM_Tx: ComBitPosition=32, ComBitSize=3, ComHandleId=ITBOXV2XSpSOCReq_IAM_CONNCANFD_100ms_ConFrP41_CONTROLLER_0_IAM_Tx, ComSignalType=SINT8
        ITBOXReserStTimeV_IAM_CONNCANFD_100ms_ConFrP41_CONTROLLER_0_IAM_Tx: ComBitPosition=31, ComBitSize=1, ComHandleId=ITBOXReserStTimeV_IAM_CONNCANFD_100ms_ConFrP41_CONTROLLER_0_IAM_Tx, ComSignalType=BOOLEAN
        ITBOXSprOfbdChrgReq_IAM_CONNCANFD_100ms_ConFrP41_CONTROLLER_0_IAM_Tx: ComBitPosition=29, ComBitSize=2, ComHandleId=ITBOXSprOfbdChrgReq_IAM_CONNCANFD_100ms_ConFrP41_CONTROLLER_0_IAM_Tx, ComSignalType=SINT8
        ITBOXReserCtrlReq_IAM_CONNCANFD_100ms_ConFrP41_CONTROLLER_0_IAM_Tx: ComBitPosition=22, ComBitSize=2, ComHandleId=ITBOXReserCtrlReq_IAM_CONNCANFD_100ms_ConFrP41_CONTROLLER_0_IAM_Tx, ComSignalType=SINT8
        ITBOXReserStHour_IAM_CONNCANFD_100ms_ConFrP41_CONTROLLER_0_IAM_Tx: ComBitPosition=17, ComBitSize=5, ComHandleId=ITBOXReserStHour_IAM_CONNCANFD_100ms_ConFrP41_CONTROLLER_0_IAM_Tx, ComSignalType=SINT8
        ITBOXChrgTrgtSOCReq_IAM_CONNCANFD_100ms_ConFrP41_CONTROLLER_0_IAM_Tx: ComBitPosition=10, ComBitSize=3, ComHandleId=ITBOXChrgTrgtSOCReq_IAM_CONNCANFD_100ms_ConFrP41_CONTROLLER_0_IAM_Tx, ComSignalType=SINT8
        ITBOXChrgCtrlReq_IAM_CONNCANFD_100ms_ConFrP41_CONTROLLER_0_IAM_Tx: ComBitPosition=8, ComBitSize=2, ComHandleId=ITBOXChrgCtrlReq_IAM_CONNCANFD_100ms_ConFrP41_CONTROLLER_0_IAM_Tx, ComSignalType=SINT8
        ITBOXEleccLckCtrlReq_IAM_CONNCANFD_100ms_ConFrP41_CONTROLLER_0_IAM_Tx: ComBitPosition=0, ComBitSize=2, ComHandleId=ITBOXEleccLckCtrlReq_IAM_CONNCANFD_100ms_ConFrP41_CONTROLLER_0_IAM_Tx, ComSignalType=SINT8
        ICellularRSSI_IAM_CONNCANFD_100ms_ConFrP41_CONTROLLER_0_IAM_Tx: ComBitPosition=56, ComBitSize=8, ComHandleId=ICellularRSSI_IAM_CONNCANFD_100ms_ConFrP41_CONTROLLER_0_IAM_Tx, ComSignalType=SINT8
        ITgtRembParkngChosenSpcID_IAM_CONNCANFD_100ms_ConFrP41_CONTROLLER_0_IAM_Tx: ComBitPosition=52, ComBitSize=4, ComHandleId=ITgtRembParkngChosenSpcID_IAM_CONNCANFD_100ms_ConFrP41_CONTROLLER_0_IAM_Tx, ComSignalType=SINT8
        ITrfcInfoSignDist_IAM_CONNCANFD_100ms_ConFrP41_CONTROLLER_0_IAM_Tx: ComBitPosition=41, ComBitSize=15, ComHandleId=ITrfcInfoSignDist_IAM_CONNCANFD_100ms_ConFrP41_CONTROLLER_0_IAM_Tx, ComSignalType=SINT16
        ITrfcWrnngSignDist_IAM_CONNCANFD_100ms_ConFrP41_CONTROLLER_0_IAM_Tx: ComBitPosition=25, ComBitSize=15, ComHandleId=ITrfcWrnngSignDist_IAM_CONNCANFD_100ms_ConFrP41_CONTROLLER_0_IAM_Tx, ComSignalType=SINT16
        ITrfcForbidDist_IAM_CONNCANFD_100ms_ConFrP41_CONTROLLER_0_IAM_Tx: ComBitPosition=9, ComBitSize=15, ComHandleId=ITrfcForbidDist_IAM_CONNCANFD_100ms_ConFrP41_CONTROLLER_0_IAM_Tx, ComSignalType=SINT16
        IVeleastsigma_IAM_CONNCANFD_100ms_ConFrP41_CONTROLLER_0_IAM_Tx: ComBitPosition=56, ComBitSize=16, ComHandleId=IVeleastsigma_IAM_CONNCANFD_100ms_ConFrP41_CONTROLLER_0_IAM_Tx, ComSignalType=SINT16
        IVelnorthsigma_IAM_CONNCANFD_100ms_ConFrP41_CONTROLLER_0_IAM_Tx: ComBitPosition=40, ComBitSize=16, ComHandleId=IVelnorthsigma_IAM_CONNCANFD_100ms_ConFrP41_CONTROLLER_0_IAM_Tx, ComSignalType=SINT16
        IGNSSAntennasInfo_IAM_CONNCANFD_100ms_ConFrP41_CONTROLLER_0_IAM_Tx: ComBitPosition=24, ComBitSize=8, ComHandleId=IGNSSAntennasInfo_IAM_CONNCANFD_100ms_ConFrP41_CONTROLLER_0_IAM_Tx, ComSignalType=SINT8
        IGNSSAntennasBroken_IAM_CONNCANFD_100ms_ConFrP41_CONTROLLER_0_IAM_Tx: ComBitPosition=16, ComBitSize=8, ComHandleId=IGNSSAntennasBroken_IAM_CONNCANFD_100ms_ConFrP41_CONTROLLER_0_IAM_Tx, ComSignalType=SINT8
        IDiffDataLinkBroken_IAM_CONNCANFD_100ms_ConFrP41_CONTROLLER_0_IAM_Tx: ComBitPosition=8, ComBitSize=8, ComHandleId=IDiffDataLinkBroken_IAM_CONNCANFD_100ms_ConFrP41_CONTROLLER_0_IAM_Tx, ComSignalType=SINT8
        ICANprotocolinternalversion_IAM_CONNCANFD_100ms_ConFrP41_CONTROLLER_0_IAM_Tx: ComBitPosition=0, ComBitSize=8, ComHandleId=ICANprotocolinternalversion_IAM_CONNCANFD_100ms_ConFrP41_CONTROLLER_0_IAM_Tx, ComSignalType=SINT8
      Com_RxPduGroup_CONTROLLER_0_IAM (ComIPduGroup): ComIPduGroupHandleId=Com_RxPduGroup_CONTROLLER_0_IAM
      SDM_SFCANFD_Event_FrS14_CONTROLLER_0_IAM_Rx (ComIPdu):
        ComIPduCancellationSupport = false
        ComIPduDirection = RECEIVE
        ComIPduHandleId = COM_RXPDU_COM_SDM_SFCANFD_Event_FrS14_CONTROLLER_0_IAM_Rx
        ComIPduSignalProcessing = DEFERRED
        ComIPduType = NORMAL
        ComPduIdRef = COM_SDM_SFCANFD_Event_FrS14_CONTROLLER_0_IAM_Rx
        ComIPduSignalRef = IMaxLatDeltaVelForeCall_SDM_SFCANFD_Event_FrS14_CONTROLLER_0_IAM_Rx
        ComIPduSignalRef = IMaxLongtDeltaVelForeCall_SDM_SFCANFD_Event_FrS14_CONTROLLER_0_IAM_Rx
        ComIPduGroupRef = Com_RxPduGroup_CONTROLLER_0_IAM
      ComMainFunctionRx: ComMainRxTimeBase=0.005
      IMaxLatDeltaVelForeCall_SDM_SFCANFD_Event_FrS14_CONTROLLER_0_IAM_Rx (ComSignal):
        ComBitPosition = 48
        ComBitSize = 8
        ComHandleId = IMaxLatDeltaVelForeCall_SDM_SFCANFD_Event_FrS14_CONTROLLER_0_IAM_Rx
        ComInvalidNotification = NULL_PTR
        ComRxDataTimeoutAction = NONE
        ComSignalEndianness = BIG_ENDIAN
        ComSignalInitValue = 0x0
        ComSignalLength = 0
        ComSignalType = UINT8
        ComTransferProperty = TRIGGERED
        ComSignalDataInvalidValue = 0x0
        ComDataInvalidAction = NOTIFY
        ComTimeout = 0.0
        ComFirstTimeout = 0.0
        ComNotification = Rte_COMCbk
      IMaxLongtDeltaVelForeCall_SDM_SFCANFD_Event_FrS14_CONTROLLER_0_IAM_Rx (ComSignal):
        ComBitPosition = 56
        ComBitSize = 8
        ComHandleId = IMaxLongtDeltaVelForeCall_SDM_SFCANFD_Event_FrS14_CONTROLLER_0_IAM_Rx
        ComInvalidNotification = NULL_PTR
        ComRxDataTimeoutAction = NONE
        ComSignalEndianness = BIG_ENDIAN
        ComSignalInitValue = 0x0
        ComSignalLength = 0
        ComSignalType = UINT8
        ComTransferProperty = TRIGGERED
        ComSignalDataInvalidValue = 0x0
        ComDataInvalidAction = NOTIFY
        ComTimeout = 0.0
        ComFirstTimeout = 0.0
        ComNotification = Rte_COMCbk
      ICBAD_BKPCANFD_Event_FrS04_CONTROLLER_0_IAM_Rx (ComIPdu):
        ComIPduCancellationSupport = false
        ComIPduDirection = RECEIVE
        ComIPduHandleId = COM_RXPDU_COM_ICBAD_BKPCANFD_Event_FrS04_CONTROLLER_0_IAM_Rx
        ComIPduSignalProcessing = DEFERRED
        ComIPduType = NORMAL
        ComPduIdRef = COM_ICBAD_BKPCANFD_Event_FrS04_CONTROLLER_0_IAM_Rx
        ComIPduSignalRef = IIECUPlnngPathLatdP1_ICBAD_BKPCANFD_Event_FrS04_CONTROLLER_0_IAM_Rx
        ComIPduSignalRef = IIECUPlnngPathLongdP1_ICBAD_BKPCANFD_Event_FrS04_CONTROLLER_0_IAM_Rx
        ComIPduSignalRef = IIECUPlnngPathLatdP2_ICBAD_BKPCANFD_Event_FrS04_CONTROLLER_0_IAM_Rx
        ComIPduSignalRef = IIECUPlnngPathLongdP2_ICBAD_BKPCANFD_Event_FrS04_CONTROLLER_0_IAM_Rx
        ComIPduSignalRef = IIECUPlnngPathLatdP3_ICBAD_BKPCANFD_Event_FrS04_CONTROLLER_0_IAM_Rx
        ComIPduSignalRef = IIECUPlnngPathLongdP3_ICBAD_BKPCANFD_Event_FrS04_CONTROLLER_0_IAM_Rx
        ComIPduSignalRef = IIECUPlnngPathLatdP4_ICBAD_BKPCANFD_Event_FrS04_CONTROLLER_0_IAM_Rx
        ComIPduSignalRef = IIECUPlnngPathLongdP4_ICBAD_BKPCANFD_Event_FrS04_CONTROLLER_0_IAM_Rx
        ComIPduSignalRef = IIECUPlnngPathLatdP5_ICBAD_BKPCANFD_Event_FrS04_CONTROLLER_0_IAM_Rx
        ComIPduSignalRef = IIECUPlnngPathLongdP5_ICBAD_BKPCANFD_Event_FrS04_CONTROLLER_0_IAM_Rx
        ComIPduGroupRef = Com_RxPduGroup_CONTROLLER_0_IAM
      10 x ComSignal, all with ComBitSize=32, ComInvalidNotification=NULL_PTR, ComRxDataTimeoutAction=NONE, ComSignalEndianness=BIG_ENDIAN, ComSignalInitValue=0x0, ComSignalLength=0, ComSignalType=UINT32, ComTransferProperty=TRIGGERED, ComSignalDataInvalidValue=0x0, ComDataInvalidAction=NOTIFY, ComTimeout=0.0, ComFirstTimeout=0.0, ComNotification=Rte_COMCbk:
        IIECUPlnngPathLatdP1_ICBAD_BKPCANFD_Event_FrS04_CONTROLLER_0_IAM_Rx: ComBitPosition=24, ComHandleId=IIECUPlnngPathLatdP1_ICBAD_BKPCANFD_Event_FrS04_CONTROLLER_0_IAM_Rx
        IIECUPlnngPathLongdP1_ICBAD_BKPCANFD_Event_FrS04_CONTROLLER_0_IAM_Rx: ComBitPosition=56, ComHandleId=IIECUPlnngPathLongdP1_ICBAD_BKPCANFD_Event_FrS04_CONTROLLER_0_IAM_Rx
        IIECUPlnngPathLatdP2_ICBAD_BKPCANFD_Event_FrS04_CONTROLLER_0_IAM_Rx: ComBitPosition=88, ComHandleId=IIECUPlnngPathLatdP2_ICBAD_BKPCANFD_Event_FrS04_CONTROLLER_0_IAM_Rx
        IIECUPlnngPathLongdP2_ICBAD_BKPCANFD_Event_FrS04_CONTROLLER_0_IAM_Rx: ComBitPosition=120, ComHandleId=IIECUPlnngPathLongdP2_ICBAD_BKPCANFD_Event_FrS04_CONTROLLER_0_IAM_Rx
        IIECUPlnngPathLatdP3_ICBAD_BKPCANFD_Event_FrS04_CONTROLLER_0_IAM_Rx: ComBitPosition=152, ComHandleId=IIECUPlnngPathLatdP3_ICBAD_BKPCANFD_Event_FrS04_CONTROLLER_0_IAM_Rx
        IIECUPlnngPathLongdP3_ICBAD_BKPCANFD_Event_FrS04_CONTROLLER_0_IAM_Rx: ComBitPosition=184, ComHandleId=IIECUPlnngPathLongdP3_ICBAD_BKPCANFD_Event_FrS04_CONTROLLER_0_IAM_Rx
        IIECUPlnngPathLatdP4_ICBAD_BKPCANFD_Event_FrS04_CONTROLLER_0_IAM_Rx: ComBitPosition=216, ComHandleId=IIECUPlnngPathLatdP4_ICBAD_BKPCANFD_Event_FrS04_CONTROLLER_0_IAM_Rx
        IIECUPlnngPathLongdP4_ICBAD_BKPCANFD_Event_FrS04_CONTROLLER_0_IAM_Rx: ComBitPosition=248, ComHandleId=IIECUPlnngPathLongdP4_ICBAD_BKPCANFD_Event_FrS04_CONTROLLER_0_IAM_Rx
        IIECUPlnngPathLatdP5_ICBAD_BKPCANFD_Event_FrS04_CONTROLLER_0_IAM_Rx: ComBitPosition=280, ComHandleId=IIECUPlnngPathLatdP5_ICBAD_BKPCANFD_Event_FrS04_CONTROLLER_0_IAM_Rx
        IIECUPlnngPathLongdP5_ICBAD_BKPCANFD_Event_FrS04_CONTROLLER_0_IAM_Rx: ComBitPosition=312, ComHandleId=IIECUPlnngPathLongdP5_ICBAD_BKPCANFD_Event_FrS04_CONTROLLER_0_IAM_Rx
      ICBAD_BKPCANFD_Event_FrS05_CONTROLLER_0_IAM_Rx (ComIPdu):
        ComIPduCancellationSupport = false
        ComIPduDirection = RECEIVE
        ComIPduHandleId = COM_RXPDU_COM_ICBAD_BKPCANFD_Event_FrS05_CONTROLLER_0_IAM_Rx
        ComIPduSignalProcessing = DEFERRED
        ComIPduType = NORMAL
        ComPduIdRef = COM_ICBAD_BKPCANFD_Event_FrS05_CONTROLLER_0_IAM_Rx
        ComIPduSignalRef = IIECUPlnngPathLatdP6_ICBAD_BKPCANFD_Event_FrS05_CONTROLLER_0_IAM_Rx
        ComIPduSignalRef = IIECUPlnngPathLongdP6_ICBAD_BKPCANFD_Event_FrS05_CONTROLLER_0_IAM_Rx
        ComIPduSignalRef = IIECUPlnngPathLatdP7_ICBAD_BKPCANFD_Event_FrS05_CONTROLLER_0_IAM_Rx
        ComIPduSignalRef = IIECUPlnngPathLongdP7_ICBAD_BKPCANFD_Event_FrS05_CONTROLLER_0_IAM_Rx
        ComIPduSignalRef = IIECUPlnngPathLatdP8_ICBAD_BKPCANFD_Event_FrS05_CONTROLLER_0_IAM_Rx
        ComIPduSignalRef = IIECUPlnngPathLongdP8_ICBAD_BKPCANFD_Event_FrS05_CONTROLLER_0_IAM_Rx
        ComIPduSignalRef = IIECUPlnngPathLatdP9_ICBAD_BKPCANFD_Event_FrS05_CONTROLLER_0_IAM_Rx
        ComIPduSignalRef = IIECUPlnngPathLongdP9_ICBAD_BKPCANFD_Event_FrS05_CONTROLLER_0_IAM_Rx
        ComIPduSignalRef = IIECUPlnngPathLatdP10_ICBAD_BKPCANFD_Event_FrS05_CONTROLLER_0_IAM_Rx
        ComIPduSignalRef = IIECUPlnngPathLongdP10_ICBAD_BKPCANFD_Event_FrS05_CONTROLLER_0_IAM_Rx
        ComIPduGroupRef = Com_RxPduGroup_CONTROLLER_0_IAM
      10 x ComSignal, all with ComBitSize=32, ComInvalidNotification=NULL_PTR, ComRxDataTimeoutAction=NONE, ComSignalEndianness=BIG_ENDIAN, ComSignalInitValue=0x0, ComSignalLength=0, ComSignalType=UINT32, ComTransferProperty=TRIGGERED, ComSignalDataInvalidValue=0x0, ComDataInvalidAction=NOTIFY, ComTimeout=0.0, ComFirstTimeout=0.0, ComNotification=Rte_COMCbk:
        IIECUPlnngPathLatdP6_ICBAD_BKPCANFD_Event_FrS05_CONTROLLER_0_IAM_Rx: ComBitPosition=24, ComHandleId=IIECUPlnngPathLatdP6_ICBAD_BKPCANFD_Event_FrS05_CONTROLLER_0_IAM_Rx
        IIECUPlnngPathLongdP6_ICBAD_BKPCANFD_Event_FrS05_CONTROLLER_0_IAM_Rx: ComBitPosition=56, ComHandleId=IIECUPlnngPathLongdP6_ICBAD_BKPCANFD_Event_FrS05_CONTROLLER_0_IAM_Rx
        IIECUPlnngPathLatdP7_ICBAD_BKPCANFD_Event_FrS05_CONTROLLER_0_IAM_Rx: ComBitPosition=88, ComHandleId=IIECUPlnngPathLatdP7_ICBAD_BKPCANFD_Event_FrS05_CONTROLLER_0_IAM_Rx
        IIECUPlnngPathLongdP7_ICBAD_BKPCANFD_Event_FrS05_CONTROLLER_0_IAM_Rx: ComBitPosition=120, ComHandleId=IIECUPlnngPathLongdP7_ICBAD_BKPCANFD_Event_FrS05_CONTROLLER_0_IAM_Rx
        IIECUPlnngPathLatdP8_ICBAD_BKPCANFD_Event_FrS05_CONTROLLER_0_IAM_Rx: ComBitPosition=152, ComHandleId=IIECUPlnngPathLatdP8_ICBAD_BKPCANFD_Event_FrS05_CONTROLLER_0_IAM_Rx
        IIECUPlnngPathLongdP8_ICBAD_BKPCANFD_Event_FrS05_CONTROLLER_0_IAM_Rx: ComBitPosition=184, ComHandleId=IIECUPlnngPathLongdP8_ICBAD_BKPCANFD_Event_FrS05_CONTROLLER_0_IAM_Rx
        IIECUPlnngPathLatdP9_ICBAD_BKPCANFD_Event_FrS05_CONTROLLER_0_IAM_Rx: ComBitPosition=216, ComHandleId=IIECUPlnngPathLatdP9_ICBAD_BKPCANFD_Event_FrS05_CONTROLLER_0_IAM_Rx
        IIECUPlnngPathLongdP9_ICBAD_BKPCANFD_Event_FrS05_CONTROLLER_0_IAM_Rx: ComBitPosition=248, ComHandleId=IIECUPlnngPathLongdP9_ICBAD_BKPCANFD_Event_FrS05_CONTROLLER_0_IAM_Rx
        IIECUPlnngPathLatdP10_ICBAD_BKPCANFD_Event_FrS05_CONTROLLER_0_IAM_Rx: ComBitPosition=280, ComHandleId=IIECUPlnngPathLatdP10_ICBAD_BKPCANFD_Event_FrS05_CONTROLLER_0_IAM_Rx
        IIECUPlnngPathLongdP10_ICBAD_BKPCANFD_Event_FrS05_CONTROLLER_0_IAM_Rx: ComBitPosition=312, ComHandleId=IIECUPlnngPathLongdP10_ICBAD_BKPCANFD_Event_FrS05_CONTROLLER_0_IAM_Rx
      ICBVC_SecOC_ComKeyReq_CONTROLLER_0_IAM_Rx (ComIPdu):
        ComIPduCancellationSupport = false
        ComIPduDirection = RECEIVE
        ComIPduHandleId = COM_RXPDU_COM_ICBVC_SecOC_ComKeyReq_CONTROLLER_0_IAM_Rx
        ComIPduSignalProcessing = DEFERRED
        ComIPduType = NORMAL
        ComPduIdRef = COM_ICBVC_SecOC_ComKeyReq_CONTROLLER_0_IAM_Rx
        ComIPduSignalRef = ITripCntResetReq_ICBVC_SecOC_ComKeyReq_CONTROLLER_0_IAM_Rx
        ComIPduSignalRef = IComKeyEnbReq_ICBVC_SecOC_ComKeyReq_CONTROLLER_0_IAM_Rx
        ComIPduGroupRef = Com_RxPduGroup_CONTROLLER_0_IAM
      ITripCntResetReq_ICBVC_SecOC_ComKeyReq_CONTROLLER_0_IAM_Rx (ComSignal):
        ComBitPosition = 6
        ComBitSize = 1
        ComHandleId = ITripCntResetReq_ICBVC_SecOC_ComKeyReq_CONTROLLER_0_IAM_Rx
        ComInvalidNotification = NULL_PTR
        ComRxDataTimeoutAction = NONE
        ComSignalEndianness = BIG_ENDIAN
        ComSignalInitValue = 0x0
        ComSignalLength = 0
        ComSignalType = BOOLEAN
        ComTransferProperty = TRIGGERED
        ComSignalDataInvalidValue = 0x0
        ComDataInvalidAction = NOTIFY
        ComTimeout = 0.0
        ComFirstTimeout = 0.0
        ComNotification = Rte_COMCbk
      IComKeyEnbReq_ICBVC_SecOC_ComKeyReq_CONTROLLER_0_IAM_Rx (ComSignal):
        ComBitPosition = 7
        ComBitSize = 1
        ComHandleId = IComKeyEnbReq_ICBVC_SecOC_ComKeyReq_CONTROLLER_0_IAM_Rx
        ComInvalidNotification = NULL_PTR
        ComRxDataTimeoutAction = NONE
        ComSignalEndianness = BIG_ENDIAN
        ComSignalInitValue = 0x0
        ComSignalLength = 0
        ComSignalType = BOOLEAN
        ComTransferProperty = TRIGGERED
        ComSignalDataInvalidValue = 0x0
        ComDataInvalidAction = NOTIFY
        ComTimeout = 0.0
        ComFirstTimeout = 0.0
        ComNotification = Rte_COMCbk
      ICBAD_ZONE_CHCANFD_20ms_FrP13_CONTROLLER_0_IAM_Rx (ComIPdu):
        ComIPduCancellationSupport = false
        ComIPduDirection = RECEIVE
        ComIPduHandleId = COM_RXPDU_COM_ICBAD_ZONE_CHCANFD_20ms_FrP13_CONTROLLER_0_IAM_Rx
        ComIPduSignalProcessing = DEFERRED
        ComIPduType = NORMAL
        ComIPduCallout = ICBAD_ZONE_CHCANFD_20ms_FrP13_CONTROLLER_0_IAM_Rx
        ComPduIdRef = COM_ICBAD_ZONE_CHCANFD_20ms_FrP13_CONTROLLER_0_IAM_Rx
        ComIPduSignalGroupRef = IICBAD_ZONE_20ms_Group13_ICBAD_ZONE_CHCANFD_20ms_FrP13_CONTROLLER_0_IAM_Rx
        ComIPduGroupRef = Com_RxPduGroup_CONTROLLER_0_IAM
      IICBAD_ZONE_20ms_Group13_ICBAD_ZONE_CHCANFD_20ms_FrP13_CONTROLLER_0_IAM_Rx (ComSignalGroup):
        ComHandleId = IICBAD_ZONE_20ms_Group13_ICBAD_ZONE_CHCANFD_20ms_FrP13_CONTROLLER_0_IAM_Rx
        ComInvalidNotification = NULL_PTR
        ComRxDataTimeoutAction = NONE
        ComTransferProperty = PENDING
        ComDataInvalidAction = NOTIFY
        ComTimeout = 0.0
        ComFirstTimeout = 0.0
        ComNotification = Rte_COMCbk
        14 x ComGroupSignal, all with ComSignalEndianness=BIG_ENDIAN, ComSignalInitValue=0x0, ComSignalLength=0, ComSignalDataInvalidValue=0x0:
          IICBAD_ZONE_20ms_Group13_CRC_IICBAD_ZONE_20ms_Group13_ICBAD_ZONE_CHCANFD_20ms_FrP13_CONTROLLER_0_IAM_Rx: ComBitPosition=0, ComBitSize=8, ComHandleId=IICBAD_ZONE_20ms_Group13_ICBAD_ZONE_CHCANFD_20ms_FrP13_CONTROLLER_0_IAM_Rx_IICBAD_ZONE_20ms_Group13_CRC_IICBAD_ZONE_20ms_Group13_ICBAD_ZONE_CHCANFD_20ms_FrP13_CONTROLLER_0_IAM_Rx, ComSignalType=UINT8
          IICBAD_ZONE_20ms_Group13_RC_IICBAD_ZONE_20ms_Group13_ICBAD_ZONE_CHCANFD_20ms_FrP13_CONTROLLER_0_IAM_Rx: ComBitPosition=8, ComBitSize=4, ComHandleId=IICBAD_ZONE_20ms_Group13_ICBAD_ZONE_CHCANFD_20ms_FrP13_CONTROLLER_0_IAM_Rx_IICBAD_ZONE_20ms_Group13_RC_IICBAD_ZONE_20ms_Group13_ICBAD_ZONE_CHCANFD_20ms_FrP13_CONTROLLER_0_IAM_Rx, ComSignalType=UINT8
          IICBAD_ZONE_20ms_Group13_Reserve_IICBAD_ZONE_20ms_Group13_ICBAD_ZONE_CHCANFD_20ms_FrP13_CONTROLLER_0_IAM_Rx: ComBitPosition=12, ComBitSize=1, ComHandleId=IICBAD_ZONE_20ms_Group13_ICBAD_ZONE_CHCANFD_20ms_FrP13_CONTROLLER_0_IAM_Rx_IICBAD_ZONE_20ms_Group13_Reserve_IICBAD_ZONE_20ms_Group13_ICBAD_ZONE_CHCANFD_20ms_FrP13_CONTROLLER_0_IAM_Rx, ComSignalType=BOOLEAN
          ITJAICASysFltSts_IICBAD_ZONE_20ms_Group13_ICBAD_ZONE_CHCANFD_20ms_FrP13_CONTROLLER_0_IAM_Rx: ComBitPosition=13, ComBitSize=3, ComHandleId=IICBAD_ZONE_20ms_Group13_ICBAD_ZONE_CHCANFD_20ms_FrP13_CONTROLLER_0_IAM_Rx_ITJAICASysFltSts_IICBAD_ZONE_20ms_Group13_ICBAD_ZONE_CHCANFD_20ms_FrP13_CONTROLLER_0_IAM_Rx, ComSignalType=UINT8
          IICBAD_ZONE_20ms_Group13_Re_0000_IICBAD_ZONE_20ms_Group13_ICBAD_ZONE_CHCANFD_20ms_FrP13_CONTROLLER_0_IAM_Rx: ComBitPosition=16, ComBitSize=2, ComHandleId=IICBAD_ZONE_20ms_Group13_ICBAD_ZONE_CHCANFD_20ms_FrP13_CONTROLLER_0_IAM_Rx_IICBAD_ZONE_20ms_Group13_Re_0000_IICBAD_ZONE_20ms_Group13_ICBAD_ZONE_CHCANFD_20ms_FrP13_CONTROLLER_0_IAM_Rx, ComSignalType=UINT8
          ILKASysFltSts_IICBAD_ZONE_20ms_Group13_ICBAD_ZONE_CHCANFD_20ms_FrP13_CONTROLLER_0_IAM_Rx: ComBitPosition=18, ComBitSize=3, ComHandleId=IICBAD_ZONE_20ms_Group13_ICBAD_ZONE_CHCANFD_20ms_FrP13_CONTROLLER_0_IAM_Rx_ILKASysFltSts_IICBAD_ZONE_20ms_Group13_ICBAD_ZONE_CHCANFD_20ms_FrP13_CONTROLLER_0_IAM_Rx, ComSignalType=UINT8
          IICBAD_ZONE_20ms_Group13_Re_0001_IICBAD_ZONE_20ms_Group13_ICBAD_ZONE_CHCANFD_20ms_FrP13_CONTROLLER_0_IAM_Rx: ComBitPosition=21, ComBitSize=3, ComHandleId=IICBAD_ZONE_20ms_Group13_ICBAD_ZONE_CHCANFD_20ms_FrP13_CONTROLLER_0_IAM_Rx_IICBAD_ZONE_20ms_Group13_Re_0001_IICBAD_ZONE_20ms_Group13_ICBAD_ZONE_CHCANFD_20ms_FrP13_CONTROLLER_0_IAM_Rx, ComSignalType=UINT8
          IICBAD_ZONE_20ms_Group13_Re_0002_IICBAD_ZONE_20ms_Group13_ICBAD_ZONE_CHCANFD_20ms_FrP13_CONTROLLER_0_IAM_Rx: ComBitPosition=24, ComBitSize=2, ComHandleId=IICBAD_ZONE_20ms_Group13_ICBAD_ZONE_CHCANFD_20ms_FrP13_CONTROLLER_0_IAM_Rx_IICBAD_ZONE_20ms_Group13_Re_0002_IICBAD_ZONE_20ms_Group13_ICBAD_ZONE_CHCANFD_20ms_FrP13_CONTROLLER_0_IAM_Rx, ComSignalType=UINT8
          ITJAICASysSts_IICBAD_ZONE_20ms_Group13_ICBAD_ZONE_CHCANFD_20ms_FrP13_CONTROLLER_0_IAM_Rx: ComBitPosition=26, ComBitSize=3, ComHandleId=IICBAD_ZONE_20ms_Group13_ICBAD_ZONE_CHCANFD_20ms_FrP13_CONTROLLER_0_IAM_Rx_ITJAICASysSts_IICBAD_ZONE_20ms_Group13_ICBAD_ZONE_CHCANFD_20ms_FrP13_CONTROLLER_0_IAM_Rx, ComSignalType=UINT8
          ILKASysSts_IICBAD_ZONE_20ms_Group13_ICBAD_ZONE_CHCANFD_20ms_FrP13_CONTROLLER_0_IAM_Rx: ComBitPosition=29, ComBitSize=3, ComHandleId=IICBAD_ZONE_20ms_Group13_ICBAD_ZONE_CHCANFD_20ms_FrP13_CONTROLLER_0_IAM_Rx_ILKASysSts_IICBAD_ZONE_20ms_Group13_ICBAD_ZONE_CHCANFD_20ms_FrP13_CONTROLLER_0_IAM_Rx, ComSignalType=UINT8
          IICBAD_ZONE_20ms_Group13_Re_0003_IICBAD_ZONE_20ms_Group13_ICBAD_ZONE_CHCANFD_20ms_FrP13_CONTROLLER_0_IAM_Rx: ComBitPosition=32, ComBitSize=8, ComHandleId=IICBAD_ZONE_20ms_Group13_ICBAD_ZONE_CHCANFD_20ms_FrP13_CONTROLLER_0_IAM_Rx_IICBAD_ZONE_20ms_Group13_Re_0003_IICBAD_ZONE_20ms_Group13_ICBAD_ZONE_CHCANFD_20ms_FrP13_CONTROLLER_0_IAM_Rx, ComSignalType=UINT8
          IICBAD_ZONE_20ms_Group13_Re_0004_IICBAD_ZONE_20ms_Group13_ICBAD_ZONE_CHCANFD_20ms_FrP13_CONTROLLER_0_IAM_Rx: ComBitPosition=40, ComBitSize=8, ComHandleId=IICBAD_ZONE_20ms_Group13_ICBAD_ZONE_CHCANFD_20ms_FrP13_CONTROLLER_0_IAM_Rx_IICBAD_ZONE_20ms_Group13_Re_0004_IICBAD_ZONE_20ms_Group13_ICBAD_ZONE_CHCANFD_20ms_FrP13_CONTROLLER_0_IAM_Rx, ComSignalType=UINT8
          IICBAD_ZONE_20ms_Group13_Re_0005_IICBAD_ZONE_20ms_Group13_ICBAD_ZONE_CHCANFD_20ms_FrP13_CONTROLLER_0_IAM_Rx: ComBitPosition=48, ComBitSize=8, ComHandleId=IICBAD_ZONE_20ms_Group13_ICBAD_ZONE_CHCANFD_20ms_FrP13_CONTROLLER_0_IAM_Rx_IICBAD_ZONE_20ms_Group13_Re_0005_IICBAD_ZONE_20ms_Group13_ICBAD_ZONE_CHCANFD_20ms_FrP13_CONTROLLER_0_IAM_Rx, ComSignalType=UINT8
          IICBAD_ZONE_20ms_Group13_Re_0006_IICBAD_ZONE_20ms_Group13_ICBAD_ZONE_CHCANFD_20ms_FrP13_CONTROLLER_0_IAM_Rx: ComBitPosition=56, ComBitSize=8, ComHandleId=IICBAD_ZONE_20ms_Group13_ICBAD_ZONE_CHCANFD_20ms_FrP13_CONTROLLER_0_IAM_Rx_IICBAD_ZONE_20ms_Group13_Re_0006_IICBAD_ZONE_20ms_Group13_ICBAD_ZONE_CHCANFD_20ms_FrP13_CONTROLLER_0_IAM_Rx, ComSignalType=UINT8
      TC_ZONE_PTCANFD_10ms_FrP01_CONTROLLER_0_IAM_Rx (ComIPdu):
        ComIPduCancellationSupport = false
        ComIPduDirection = RECEIVE
        ComIPduHandleId = COM_RXPDU_COM_TC_ZONE_PTCANFD_10ms_FrP01_CONTROLLER_0_IAM_Rx
        ComIPduSignalProcessing = DEFERRED
        ComIPduType = NORMAL
        ComIPduCallout = TC_ZONE_PTCANFD_10ms_FrP01_CONTROLLER_0_IAM_Rx
        ComPduIdRef = COM_TC_ZONE_PTCANFD_10ms_FrP01_CONTROLLER_0_IAM_Rx
        ComIPduSignalGroupRef = ITC_ZONE_10ms_Group01_TC_ZONE_PTCANFD_10ms_FrP01_CONTROLLER_0_IAM_Rx
        ComIPduGroupRef = Com_RxPduGroup_CONTROLLER_0_IAM
      ITC_ZONE_10ms_Group01_TC_ZONE_PTCANFD_10ms_FrP01_CONTROLLER_0_IAM_Rx (ComSignalGroup):
        ComHandleId = ITC_ZONE_10ms_Group01_TC_ZONE_PTCANFD_10ms_FrP01_CONTROLLER_0_IAM_Rx
        ComInvalidNotification = NULL_PTR
        ComRxDataTimeoutAction = NONE
        ComTransferProperty = PENDING
        ComDataInvalidAction = NOTIFY
        ComTimeout = 0.0
        ComFirstTimeout = 0.0
        ComNotification = Rte_COMCbk
        10 x ComGroupSignal, all with ComSignalEndianness=BIG_ENDIAN, ComSignalInitValue=0x0, ComSignalLength=0, ComSignalDataInvalidValue=0x0:
          ITC_ZONE_10ms_Group01_CRC_ITC_ZONE_10ms_Group01_TC_ZONE_PTCANFD_10ms_FrP01_CONTROLLER_0_IAM_Rx: ComBitPosition=0, ComBitSize=8, ComHandleId=ITC_ZONE_10ms_Group01_TC_ZONE_PTCANFD_10ms_FrP01_CONTROLLER_0_IAM_Rx_ITC_ZONE_10ms_Group01_CRC_ITC_ZONE_10ms_Group01_TC_ZONE_PTCANFD_10ms_FrP01_CONTROLLER_0_IAM_Rx, ComSignalType=UINT8
          ITC_ZONE_10ms_Group01_RC_ITC_ZONE_10ms_Group01_TC_ZONE_PTCANFD_10ms_FrP01_CONTROLLER_0_IAM_Rx: ComBitPosition=8, ComBitSize=4, ComHandleId=ITC_ZONE_10ms_Group01_TC_ZONE_PTCANFD_10ms_FrP01_CONTROLLER_0_IAM_Rx_ITC_ZONE_10ms_Group01_RC_ITC_ZONE_10ms_Group01_TC_ZONE_PTCANFD_10ms_FrP01_CONTROLLER_0_IAM_Rx, ComSignalType=UINT8
          ITC_ZONE_10ms_Group01_Reserved1_ITC_ZONE_10ms_Group01_TC_ZONE_PTCANFD_10ms_FrP01_CONTROLLER_0_IAM_Rx: ComBitPosition=12, ComBitSize=4, ComHandleId=ITC_ZONE_10ms_Group01_TC_ZONE_PTCANFD_10ms_FrP01_CONTROLLER_0_IAM_Rx_ITC_ZONE_10ms_Group01_Reserved1_ITC_ZONE_10ms_Group01_TC_ZONE_PTCANFD_10ms_FrP01_CONTROLLER_0_IAM_Rx, ComSignalType=UINT8
          ITMDmpngCtrlToq_ITC_ZONE_10ms_Group01_TC_ZONE_PTCANFD_10ms_FrP01_CONTROLLER_0_IAM_Rx: ComBitPosition=29, ComBitSize=11, ComHandleId=ITC_ZONE_10ms_Group01_TC_ZONE_PTCANFD_10ms_FrP01_CONTROLLER_0_IAM_Rx_ITMDmpngCtrlToq_ITC_ZONE_10ms_Group01_TC_ZONE_PTCANFD_10ms_FrP01_CONTROLLER_0_IAM_Rx, ComSignalType=UINT16
          ITMInvtrCrnt_ITC_ZONE_10ms_Group01_TC_ZONE_PTCANFD_10ms_FrP01_CONTROLLER_0_IAM_Rx: ComBitPosition=32, ComBitSize=11, ComHandleId=ITC_ZONE_10ms_Group01_TC_ZONE_PTCANFD_10ms_FrP01_CONTROLLER_0_IAM_Rx_ITMInvtrCrnt_ITC_ZONE_10ms_Group01_TC_ZONE_PTCANFD_10ms_FrP01_CONTROLLER_0_IAM_Rx, ComSignalType=UINT16
          ITMInvtrVolV_ITC_ZONE_10ms_Group01_TC_ZONE_PTCANFD_10ms_FrP01_CONTROLLER_0_IAM_Rx: ComBitPosition=27, ComBitSize=1, ComHandleId=ITC_ZONE_10ms_Group01_TC_ZONE_PTCANFD_10ms_FrP01_CONTROLLER_0_IAM_Rx_ITMInvtrVolV_ITC_ZONE_10ms_Group01_TC_ZONE_PTCANFD_10ms_FrP01_CONTROLLER_0_IAM_Rx, ComSignalType=BOOLEAN
          ITMInvtrCrntV_ITC_ZONE_10ms_Group01_TC_ZONE_PTCANFD_10ms_FrP01_CONTROLLER_0_IAM_Rx: ComBitPosition=28, ComBitSize=1, ComHandleId=ITC_ZONE_10ms_Group01_TC_ZONE_PTCANFD_10ms_FrP01_CONTROLLER_0_IAM_Rx_ITMInvtrCrntV_ITC_ZONE_10ms_Group01_TC_ZONE_PTCANFD_10ms_FrP01_CONTROLLER_0_IAM_Rx, ComSignalType=BOOLEAN
          ITMInvtrVol_ITC_ZONE_10ms_Group01_TC_ZONE_PTCANFD_10ms_FrP01_CONTROLLER_0_IAM_Rx: ComBitPosition=54, ComBitSize=10, ComHandleId=ITC_ZONE_10ms_Group01_TC_ZONE_PTCANFD_10ms_FrP01_CONTROLLER_0_IAM_Rx_ITMInvtrVol_ITC_ZONE_10ms_Group01_TC_ZONE_PTCANFD_10ms_FrP01_CONTROLLER_0_IAM_Rx, ComSignalType=UINT16
          ITMPhaseCurrent_ITC_ZONE_10ms_Group01_TC_ZONE_PTCANFD_10ms_FrP01_CONTROLLER_0_IAM_Rx: ComBitPosition=56, ComBitSize=11, ComHandleId=ITC_ZONE_10ms_Group01_TC_ZONE_PTCANFD_10ms_FrP01_CONTROLLER_0_IAM_Rx_ITMPhaseCurrent_ITC_ZONE_10ms_Group01_TC_ZONE_PTCANFD_10ms_FrP01_CONTROLLER_0_IAM_Rx, ComSignalType=UINT16
          ITC_ZONE_10ms_Group01_Reserved2_ITC_ZONE_10ms_Group01_TC_ZONE_PTCANFD_10ms_FrP01_CONTROLLER_0_IAM_Rx: ComBitPosition=51, ComBitSize=3, ComHandleId=ITC_ZONE_10ms_Group01_TC_ZONE_PTCANFD_10ms_FrP01_CONTROLLER_0_IAM_Rx_ITC_ZONE_10ms_Group01_Reserved2_ITC_ZONE_10ms_Group01_TC_ZONE_PTCANFD_10ms_FrP01_CONTROLLER_0_IAM_Rx, ComSignalType=UINT8
      ICM_INFOCANFD_EvtInfo_CONTROLLER_0_IAM_Rx (ComIPdu):
        ComIPduCancellationSupport = false
        ComIPduDirection = RECEIVE
        ComIPduHandleId = COM_RXPDU_COM_ICM_INFOCANFD_EvtInfo_CONTROLLER_0_IAM_Rx
        ComIPduSignalProcessing = DEFERRED
        ComIPduType = NORMAL
        ComPduIdRef = COM_ICM_INFOCANFD_EvtInfo_CONTROLLER_0_IAM_Rx
        ComIPduSignalRef = IEvtPotclSigFICM_ICM_INFOCANFD_EvtInfo_CONTROLLER_0_IAM_Rx
        ComIPduGroupRef = Com_RxPduGroup_CONTROLLER_0_IAM
      IEvtPotclSigFICM_ICM_INFOCANFD_EvtInfo_CONTROLLER_0_IAM_Rx (ComSignal):
        ComBitPosition = 56
        ComBitSize = 64
        ComHandleId = IEvtPotclSigFICM_ICM_INFOCANFD_EvtInfo_CONTROLLER_0_IAM_Rx
        ComInvalidNotification = NULL_PTR
        ComRxDataTimeoutAction = NONE
        ComSignalEndianness = BIG_ENDIAN
        ComSignalInitValue = 0x0
        ComSignalLength = 0
        ComSignalType = UINT64
        ComTransferProperty = TRIGGERED
        ComSignalDataInvalidValue = 0x0
        ComDataInvalidAction = NOTIFY
        ComTimeout = 0.0
        ComFirstTimeout = 0.0
        ComNotification = Rte_COMCbk
      AMP_INFOCAN_EvtInfo_CONTROLLER_0_IAM_Rx (ComIPdu):
        ComIPduCancellationSupport = false
        ComIPduDirection = RECEIVE
        ComIPduHandleId = COM_RXPDU_COM_AMP_INFOCAN_EvtInfo_CONTROLLER_0_IAM_Rx
        ComIPduSignalProcessing = DEFERRED
        ComIPduType = NORMAL
        ComPduIdRef = COM_AMP_INFOCAN_EvtInfo_CONTROLLER_0_IAM_Rx
        ComIPduSignalRef = IEvtPotclSigAMP_AMP_INFOCAN_EvtInfo_CONTROLLER_0_IAM_Rx
        ComIPduGroupRef = Com_RxPduGroup_CONTROLLER_0_IAM
      IEvtPotclSigAMP_AMP_INFOCAN_EvtInfo_CONTROLLER_0_IAM_Rx (ComSignal):
        ComBitPosition = 56
        ComBitSize = 64
        ComHandleId = IEvtPotclSigAMP_AMP_INFOCAN_EvtInfo_CONTROLLER_0_IAM_Rx
        ComInvalidNotification = NULL_PTR
        ComRxDataTimeoutAction = NONE
        ComSignalEndianness = BIG_ENDIAN
        ComSignalInitValue = 0x0
        ComSignalLength = 0
        ComSignalType = UINT64
        ComTransferProperty = TRIGGERED
        ComSignalDataInvalidValue = 0x0
        ComDataInvalidAction = NOTIFY
        ComTimeout = 0.0
        ComFirstTimeout = 0.0
        ComNotification = Rte_COMCbk
      ECM_ERCANFD_10ms_FrP00_CONTROLLER_0_IAM_Rx (ComIPdu):
        ComIPduCancellationSupport = false
        ComIPduDirection = RECEIVE
        ComIPduHandleId = COM_RXPDU_COM_ECM_ERCANFD_10ms_FrP00_CONTROLLER_0_IAM_Rx
        ComIPduSignalProcessing = DEFERRED
        ComIPduType = NORMAL
        ComIPduCallout = ECM_ERCANFD_10ms_FrP00_CONTROLLER_0_IAM_Rx
        ComPduIdRef = COM_ECM_ERCANFD_10ms_FrP00_CONTROLLER_0_IAM_Rx
        ComIPduSignalGroupRef = IECM_010ms_Group00_ECM_ERCANFD_10ms_FrP00_CONTROLLER_0_IAM_Rx
        ComIPduGroupRef = Com_RxPduGroup_CONTROLLER_0_IAM
      IECM_010ms_Group00_ECM_ERCANFD_10ms_FrP00_CONTROLLER_0_IAM_Rx (ComSignalGroup):
        ComHandleId = IECM_010ms_Group00_ECM_ERCANFD_10ms_FrP00_CONTROLLER_0_IAM_Rx
        ComInvalidNotification = NULL_PTR
        ComRxDataTimeoutAction = NONE
        ComTransferProperty = PENDING
        ComDataInvalidAction = NOTIFY
        ComTimeout = 0.0
        ComFirstTimeout = 0.0
        ComNotification = Rte_COMCbk
        13 x ComGroupSignal, all with ComSignalEndianness=BIG_ENDIAN, ComSignalInitValue=0x0, ComSignalLength=0, ComSignalDataInvalidValue=0x0:
          IECM_010ms_Group00_CRC_IECM_010ms_Group00_ECM_ERCANFD_10ms_FrP00_CONTROLLER_0_IAM_Rx: ComBitPosition=0, ComBitSize=8, ComHandleId=IECM_010ms_Group00_ECM_ERCANFD_10ms_FrP00_CONTROLLER_0_IAM_Rx_IECM_010ms_Group00_CRC_IECM_010ms_Group00_ECM_ERCANFD_10ms_FrP00_CONTROLLER_0_IAM_Rx, ComSignalType=UINT8
          IECM_010ms_Group00_RC_IECM_010ms_Group00_ECM_ERCANFD_10ms_FrP00_CONTROLLER_0_IAM_Rx: ComBitPosition=8, ComBitSize=4, ComHandleId=IECM_010ms_Group00_ECM_ERCANFD_10ms_FrP00_CONTROLLER_0_IAM_Rx_IECM_010ms_Group00_RC_IECM_010ms_Group00_ECM_ERCANFD_10ms_FrP00_CONTROLLER_0_IAM_Rx, ComSignalType=UINT8
          IEnActuStdyStaToqV_IECM_010ms_Group00_ECM_ERCANFD_10ms_FrP00_CONTROLLER_0_IAM_Rx: ComBitPosition=12, ComBitSize=1, ComHandleId=IECM_010ms_Group00_ECM_ERCANFD_10ms_FrP00_CONTROLLER_0_IAM_Rx_IEnActuStdyStaToqV_IECM_010ms_Group00_ECM_ERCANFD_10ms_FrP00_CONTROLLER_0_IAM_Rx, ComSignalType=BOOLEAN
          IEnRunA_IECM_010ms_Group00_ECM_ERCANFD_10ms_FrP00_CONTROLLER_0_IAM_Rx: ComBitPosition=13, ComBitSize=1, ComHandleId=IECM_010ms_Group00_ECM_ERCANFD_10ms_FrP00_CONTROLLER_0_IAM_Rx_IEnRunA_IECM_010ms_Group00_ECM_ERCANFD_10ms_FrP00_CONTROLLER_0_IAM_Rx, ComSignalType=BOOLEAN
          IEnSpdSts_IECM_010ms_Group00_ECM_ERCANFD_10ms_FrP00_CONTROLLER_0_IAM_Rx: ComBitPosition=14, ComBitSize=2, ComHandleId=IECM_010ms_Group00_ECM_ERCANFD_10ms_FrP00_CONTROLLER_0_IAM_Rx_IEnSpdSts_IECM_010ms_Group00_ECM_ERCANFD_10ms_FrP00_CONTROLLER_0_IAM_Rx, ComSignalType=UINT8
          IEnSpd_IECM_010ms_Group00_ECM_ERCANFD_10ms_FrP00_CONTROLLER_0_IAM_Rx: ComBitPosition=24, ComBitSize=16, ComHandleId=IECM_010ms_Group00_ECM_ERCANFD_10ms_FrP00_CONTROLLER_0_IAM_Rx_IEnSpd_IECM_010ms_Group00_ECM_ERCANFD_10ms_FrP00_CONTROLLER_0_IAM_Rx, ComSignalType=UINT16
          IECM_010ms_Group00_Reserved2_IECM_010ms_Group00_ECM_ERCANFD_10ms_FrP00_CONTROLLER_0_IAM_Rx: ComBitPosition=32, ComBitSize=1, ComHandleId=IECM_010ms_Group00_ECM_ERCANFD_10ms_FrP00_CONTROLLER_0_IAM_Rx_IECM_010ms_Group00_Reserved2_IECM_010ms_Group00_ECM_ERCANFD_10ms_FrP00_CONTROLLER_0_IAM_Rx, ComSignalType=BOOLEAN
          IEnCtrlrRunCrkTrmlSts_IECM_010ms_Group00_ECM_ERCANFD_10ms_FrP00_CONTROLLER_0_IAM_Rx: ComBitPosition=33, ComBitSize=1, ComHandleId=IECM_010ms_Group00_ECM_ERCANFD_10ms_FrP00_CONTROLLER_0_IAM_Rx_IEnCtrlrRunCrkTrmlSts_IECM_010ms_Group00_ECM_ERCANFD_10ms_FrP00_CONTROLLER_0_IAM_Rx, ComSignalType=BOOLEAN
          IECM_010ms_Group00_Reserved1_IECM_010ms_Group00_ECM_ERCANFD_10ms_FrP00_CONTROLLER_0_IAM_Rx: ComBitPosition=34, ComBitSize=6, ComHandleId=IECM_010ms_Group00_ECM_ERCANFD_10ms_FrP00_CONTROLLER_0_IAM_Rx_IECM_010ms_Group00_Reserved1_IECM_010ms_Group00_ECM_ERCANFD_10ms_FrP00_CONTROLLER_0_IAM_Rx, ComSignalType=UINT8
          IEnActuStdyStaToq_IECM_010ms_Group00_ECM_ERCANFD_10ms_FrP00_CONTROLLER_0_IAM_Rx: ComBitPosition=52, ComBitSize=12, ComHandleId=IECM_010ms_Group00_ECM_ERCANFD_10ms_FrP00_CONTROLLER_0_IAM_Rx_IEnActuStdyStaToq_IECM_010ms_Group00_ECM_ERCANFD_10ms_FrP00_CONTROLLER_0_IAM_Rx, ComSignalType=UINT16
          IECM_010ms_Group00_Reserved3_IECM_010ms_Group00_ECM_ERCANFD_10ms_FrP00_CONTROLLER_0_IAM_Rx: ComBitPosition=48, ComBitSize=4, ComHandleId=IECM_010ms_Group00_ECM_ERCANFD_10ms_FrP00_CONTROLLER_0_IAM_Rx_IECM_010ms_Group00_Reserved3_IECM_010ms_Group00_ECM_ERCANFD_10ms_FrP00_CONTROLLER_0_IAM_Rx, ComSignalType=UINT8
          IEnToqResvA_IECM_010ms_Group00_ECM_ERCANFD_10ms_FrP00_CONTROLLER_0_IAM_Rx: ComBitPosition=56, ComBitSize=2, ComHandleId=IECM_010ms_Group00_ECM_ERCANFD_10ms_FrP00_CONTROLLER_0_IAM_Rx_IEnToqResvA_IECM_010ms_Group00_ECM_ERCANFD_10ms_FrP00_CONTROLLER_0_IAM_Rx, ComSignalType=UINT8
          IECM_010ms_Group00_Reserved4_IECM_010ms_Group00_ECM_ERCANFD_10ms_FrP00_CONTROLLER_0_IAM_Rx: ComBitPosition=58, ComBitSize=6, ComHandleId=IECM_010ms_Group00_ECM_ERCANFD_10ms_FrP00_CONTROLLER_0_IAM_Rx_IECM_010ms_Group00_Reserved4_IECM_010ms_Group00_ECM_ERCANFD_10ms_FrP00_CONTROLLER_0_IAM_Rx, ComSignalType=UINT8
      LHZCU_LHBKBCANFD_10ms_FrP01_CONTROLLER_0_IAM_Rx (ComIPdu):
        ComIPduCancellationSupport = false
        ComIPduDirection = RECEIVE
        ComIPduHandleId = COM_RXPDU_COM_LHZCU_LHBKBCANFD_10ms_FrP01_CONTROLLER_0_IAM_Rx
        ComIPduSignalProcessing = DEFERRED
        ComIPduType = NORMAL
        ComIPduCallout = LHZCU_LHBKBCANFD_10ms_FrP01_CONTROLLER_0_IAM_Rx
        ComPduIdRef = COM_LHZCU_LHBKBCANFD_10ms_FrP01_CONTROLLER_0_IAM_Rx
        ComIPduSignalGroupRef = ILHZCU_10ms_Group01_LHZCU_LHBKBCANFD_10ms_FrP01_CONTROLLER_0_IAM_Rx
        ComIPduGroupRef = Com_RxPduGroup_CONTROLLER_0_IAM
      ILHZCU_10ms_Group01_LHZCU_LHBKBCANFD_10ms_FrP01_CONTROLLER_0_IAM_Rx (ComSignalGroup):
        ComHandleId = ILHZCU_10ms_Group01_LHZCU_LHBKBCANFD_10ms_FrP01_CONTROLLER_0_IAM_Rx
        ComInvalidNotification = NULL_PTR
        ComRxDataTimeoutAction = NONE
        ComTransferProperty = PENDING
        ComDataInvalidAction = NOTIFY
        ComTimeout = 0.0
        ComFirstTimeout = 0.0
        ComNotification = Rte_COMCbk
        24 x ComGroupSignal, all with ComSignalEndianness=BIG_ENDIAN, ComSignalInitValue=0x0, ComSignalLength=0, ComSignalDataInvalidValue=0x0:
          ILHZCU_10ms_Group01_CRC_ILHZCU_10ms_Group01_LHZCU_LHBKBCANFD_10ms_FrP01_CONTROLLER_0_IAM_Rx: ComBitPosition=0, ComBitSize=8, ComHandleId=ILHZCU_10ms_Group01_LHZCU_LHBKBCANFD_10ms_FrP01_CONTROLLER_0_IAM_Rx_ILHZCU_10ms_Group01_CRC_ILHZCU_10ms_Group01_LHZCU_LHBKBCANFD_10ms_FrP01_CONTROLLER_0_IAM_Rx, ComSignalType=UINT8
          ILHZCU_10ms_Group01_RC_ILHZCU_10ms_Group01_LHZCU_LHBKBCANFD_10ms_FrP01_CONTROLLER_0_IAM_Rx: ComBitPosition=8, ComBitSize=4, ComHandleId=ILHZCU_10ms_Group01_LHZCU_LHBKBCANFD_10ms_FrP01_CONTROLLER_0_IAM_Rx_ILHZCU_10ms_Group01_RC_ILHZCU_10ms_Group01_LHZCU_LHBKBCANFD_10ms_FrP01_CONTROLLER_0_IAM_Rx, ComSignalType=UINT8
          ISCUFltLvlWarn_ILHZCU_10ms_Group01_LHZCU_LHBKBCANFD_10ms_FrP01_CONTROLLER_0_IAM_Rx: ComBitPosition=12, ComBitSize=2, ComHandleId=ILHZCU_10ms_Group01_LHZCU_LHBKBCANFD_10ms_FrP01_CONTROLLER_0_IAM_Rx_ISCUFltLvlWarn_ILHZCU_10ms_Group01_LHZCU_LHBKBCANFD_10ms_FrP01_CONTROLLER_0_IAM_Rx, ComSignalType=UINT8
          ISCUDrvMd_ILHZCU_10ms_Group01_LHZCU_LHBKBCANFD_10ms_FrP01_CONTROLLER_0_IAM_Rx: ComBitPosition=14, ComBitSize=2, ComHandleId=ILHZCU_10ms_Group01_LHZCU_LHBKBCANFD_10ms_FrP01_CONTROLLER_0_IAM_Rx_ISCUDrvMd_ILHZCU_10ms_Group01_LHZCU_LHBKBCANFD_10ms_FrP01_CONTROLLER_0_IAM_Rx, ComSignalType=UINT8
          ISCUExtdShiftrFlr_ILHZCU_10ms_Group01_LHZCU_LHBKBCANFD_10ms_FrP01_CONTROLLER_0_IAM_Rx: ComBitPosition=16, ComBitSize=4, ComHandleId=ILHZCU_10ms_Group01_LHZCU_LHBKBCANFD_10ms_FrP01_CONTROLLER_0_IAM_Rx_ISCUExtdShiftrFlr_ILHZCU_10ms_Group01_LHZCU_LHBKBCANFD_10ms_FrP01_CONTROLLER_0_IAM_Rx, ComSignalType=UINT8
          ISCUShiftrOpngRmndr_ILHZCU_10ms_Group01_LHZCU_LHBKBCANFD_10ms_FrP01_CONTROLLER_0_IAM_Rx: ComBitPosition=20, ComBitSize=4, ComHandleId=ILHZCU_10ms_Group01_LHZCU_LHBKBCANFD_10ms_FrP01_CONTROLLER_0_IAM_Rx_ISCUShiftrOpngRmndr_ILHZCU_10ms_Group01_LHZCU_LHBKBCANFD_10ms_FrP01_CONTROLLER_0_IAM_Rx, ComSignalType=UINT8
          IKeyAuthResp_ILHZCU_10ms_Group01_LHZCU_LHBKBCANFD_10ms_FrP01_CONTROLLER_0_IAM_Rx: ComBitPosition=24, ComBitSize=1, ComHandleId=ILHZCU_10ms_Group01_LHZCU_LHBKBCANFD_10ms_FrP01_CONTROLLER_0_IAM_Rx_IKeyAuthResp_ILHZCU_10ms_Group01_LHZCU_LHBKBCANFD_10ms_FrP01_CONTROLLER_0_IAM_Rx, ComSignalType=BOOLEAN
          ISCUParkLckReq_ILHZCU_10ms_Group01_LHZCU_LHBKBCANFD_10ms_FrP01_CONTROLLER_0_IAM_Rx: ComBitPosition=25, ComBitSize=2, ComHandleId=ILHZCU_10ms_Group01_LHZCU_LHBKBCANFD_10ms_FrP01_CONTROLLER_0_IAM_Rx_ISCUParkLckReq_ILHZCU_10ms_Group01_LHZCU_LHBKBCANFD_10ms_FrP01_CONTROLLER_0_IAM_Rx, ComSignalType=UINT8
          ISCUParkLckReqV_ILHZCU_10ms_Group01_LHZCU_LHBKBCANFD_10ms_FrP01_CONTROLLER_0_IAM_Rx: ComBitPosition=27, ComBitSize=1, ComHandleId=ILHZCU_10ms_Group01_LHZCU_LHBKBCANFD_10ms_FrP01_CONTROLLER_0_IAM_Rx_ISCUParkLckReqV_ILHZCU_10ms_Group01_LHZCU_LHBKBCANFD_10ms_FrP01_CONTROLLER_0_IAM_Rx, ComSignalType=BOOLEAN
          ILHZCU_10ms_Group01_Reserved1_ILHZCU_10ms_Group01_LHZCU_LHBKBCANFD_10ms_FrP01_CONTROLLER_0_IAM_Rx: ComBitPosition=28, ComBitSize=3, ComHandleId=ILHZCU_10ms_Group01_LHZCU_LHBKBCANFD_10ms_FrP01_CONTROLLER_0_IAM_Rx_ILHZCU_10ms_Group01_Reserved1_ILHZCU_10ms_Group01_LHZCU_LHBKBCANFD_10ms_FrP01_CONTROLLER_0_IAM_Rx, ComSignalType=UINT8
          IDigKeyAuthReq_ILHZCU_10ms_Group01_LHZCU_LHBKBCANFD_10ms_FrP01_CONTROLLER_0_IAM_Rx: ComBitPosition=31, ComBitSize=1, ComHandleId=ILHZCU_10ms_Group01_LHZCU_LHBKBCANFD_10ms_FrP01_CONTROLLER_0_IAM_Rx_IDigKeyAuthReq_ILHZCU_10ms_Group01_LHZCU_LHBKBCANFD_10ms_FrP01_CONTROLLER_0_IAM_Rx, ComSignalType=BOOLEAN
          ISCUShiftrLvrRawPosn_ILHZCU_10ms_Group01_LHZCU_LHBKBCANFD_10ms_FrP01_CONTROLLER_0_IAM_Rx: ComBitPosition=32, ComBitSize=3, ComHandleId=ILHZCU_10ms_Group01_LHZCU_LHBKBCANFD_10ms_FrP01_CONTROLLER_0_IAM_Rx_ISCUShiftrLvrRawPosn_ILHZCU_10ms_Group01_LHZCU_LHBKBCANFD_10ms_FrP01_CONTROLLER_0_IAM_Rx, ComSignalType=UINT8
          ISCUParkLckReqVEPMCU_ILHZCU_10ms_Group01_LHZCU_LHBKBCANFD_10ms_FrP01_CONTROLLER_0_IAM_Rx: ComBitPosition=35, ComBitSize=1, ComHandleId=ILHZCU_10ms_Group01_LHZCU_LHBKBCANFD_10ms_FrP01_CONTROLLER_0_IAM_Rx_ISCUParkLckReqVEPMCU_ILHZCU_10ms_Group01_LHZCU_LHBKBCANFD_10ms_FrP01_CONTROLLER_0_IAM_Rx, ComSignalType=BOOLEAN
          IScurtKeyInvd_ILHZCU_10ms_Group01_LHZCU_LHBKBCANFD_10ms_FrP01_CONTROLLER_0_IAM_Rx: ComBitPosition=36, ComBitSize=1, ComHandleId=ILHZCU_10ms_Group01_LHZCU_LHBKBCANFD_10ms_FrP01_CONTROLLER_0_IAM_Rx_IScurtKeyInvd_ILHZCU_10ms_Group01_LHZCU_LHBKBCANFD_10ms_FrP01_CONTROLLER_0_IAM_Rx, ComSignalType=BOOLEAN
          ILHZCU_10ms_Group01_Reserved2_ILHZCU_10ms_Group01_LHZCU_LHBKBCANFD_10ms_FrP01_CONTROLLER_0_IAM_Rx: ComBitPosition=37, ComBitSize=1, ComHandleId=ILHZCU_10ms_Group01_LHZCU_LHBKBCANFD_10ms_FrP01_CONTROLLER_0_IAM_Rx_ILHZCU_10ms_Group01_Reserved2_ILHZCU_10ms_Group01_LHZCU_LHBKBCANFD_10ms_FrP01_CONTROLLER_0_IAM_Rx, ComSignalType=BOOLEAN
          ISCUParkLckReqEPMCU_ILHZCU_10ms_Group01_LHZCU_LHBKBCANFD_10ms_FrP01_CONTROLLER_0_IAM_Rx: ComBitPosition=38, ComBitSize=2, ComHandleId=ILHZCU_10ms_Group01_LHZCU_LHBKBCANFD_10ms_FrP01_CONTROLLER_0_IAM_Rx_ISCUParkLckReqEPMCU_ILHZCU_10ms_Group01_LHZCU_LHBKBCANFD_10ms_FrP01_CONTROLLER_0_IAM_Rx, ComSignalType=UINT8
          ISCUShiftrPosnInvsn_ILHZCU_10ms_Group01_LHZCU_LHBKBCANFD_10ms_FrP01_CONTROLLER_0_IAM_Rx: ComBitPosition=40, ComBitSize=4, ComHandleId=ILHZCU_10ms_Group01_LHZCU_LHBKBCANFD_10ms_FrP01_CONTROLLER_0_IAM_Rx_ISCUShiftrPosnInvsn_ILHZCU_10ms_Group01_LHZCU_LHBKBCANFD_10ms_FrP01_CONTROLLER_0_IAM_Rx, ComSignalType=UINT8
          ISCUShiftrLvrPosn_ILHZCU_10ms_Group01_LHZCU_LHBKBCANFD_10ms_FrP01_CONTROLLER_0_IAM_Rx: ComBitPosition=44, ComBitSize=4, ComHandleId=ILHZCU_10ms_Group01_LHZCU_LHBKBCANFD_10ms_FrP01_CONTROLLER_0_IAM_Rx_ISCUShiftrLvrPosn_ILHZCU_10ms_Group01_LHZCU_LHBKBCANFD_10ms_FrP01_CONTROLLER_0_IAM_Rx, ComSignalType=UINT8
          IDrvrReqParkBtn_ILHZCU_10ms_Group01_LHZCU_LHBKBCANFD_10ms_FrP01_CONTROLLER_0_IAM_Rx: ComBitPosition=48, ComBitSize=2, ComHandleId=ILHZCU_10ms_Group01_LHZCU_LHBKBCANFD_10ms_FrP01_CONTROLLER_0_IAM_Rx_IDrvrReqParkBtn_ILHZCU_10ms_Group01_LHZCU_LHBKBCANFD_10ms_FrP01_CONTROLLER_0_IAM_Rx, ComSignalType=UINT8
          ISCUShiftrLvrPosnLtchActv_ILHZCU_10ms_Group01_LHZCU_LHBKBCANFD_10ms_FrP01_CONTROLLER_0_IAM_Rx: ComBitPosition=50, ComBitSize=1, ComHandleId=ILHZCU_10ms_Group01_LHZCU_LHBKBCANFD_10ms_FrP01_CONTROLLER_0_IAM_Rx_ISCUShiftrLvrPosnLtchActv_ILHZCU_10ms_Group01_LHZCU_LHBKBCANFD_10ms_FrP01_CONTROLLER_0_IAM_Rx, ComSignalType=BOOLEAN
          ISecuKeyVldSts_ILHZCU_10ms_Group01_LHZCU_LHBKBCANFD_10ms_FrP01_CONTROLLER_0_IAM_Rx: ComBitPosition=51, ComBitSize=1, ComHandleId=ILHZCU_10ms_Group01_LHZCU_LHBKBCANFD_10ms_FrP01_CONTROLLER_0_IAM_Rx_ISecuKeyVldSts_ILHZCU_10ms_Group01_LHZCU_LHBKBCANFD_10ms_FrP01_CONTROLLER_0_IAM_Rx, ComSignalType=BOOLEAN
          ISCUDrvrIntrvnActv_ILHZCU_10ms_Group01_LHZCU_LHBKBCANFD_10ms_FrP01_CONTROLLER_0_IAM_Rx: ComBitPosition=52, ComBitSize=1, ComHandleId=ILHZCU_10ms_Group01_LHZCU_LHBKBCANFD_10ms_FrP01_CONTROLLER_0_IAM_Rx_ISCUDrvrIntrvnActv_ILHZCU_10ms_Group01_LHZCU_LHBKBCANFD_10ms_FrP01_CONTROLLER_0_IAM_Rx, ComSignalType=BOOLEAN
          ISCUAPAUnderCtrlActv_ILHZCU_10ms_Group01_LHZCU_LHBKBCANFD_10ms_FrP01_CONTROLLER_0_IAM_Rx: ComBitPosition=53, ComBitSize=3, ComHandleId=ILHZCU_10ms_Group01_LHZCU_LHBKBCANFD_10ms_FrP01_CONTROLLER_0_IAM_Rx_ISCUAPAUnderCtrlActv_ILHZCU_10ms_Group01_LHZCU_LHBKBCANFD_10ms_FrP01_CONTROLLER_0_IAM_Rx, ComSignalType=UINT8
          IDigKeyPEValidReq_ILHZCU_10ms_Group01_LHZCU_LHBKBCANFD_10ms_FrP01_CONTROLLER_0_IAM_Rx: ComBitPosition=56, ComBitSize=8, ComHandleId=ILHZCU_10ms_Group01_LHZCU_LHBKBCANFD_10ms_FrP01_CONTROLLER_0_IAM_Rx_IDigKeyPEValidReq_ILHZCU_10ms_Group01_LHZCU_LHBKBCANFD_10ms_FrP01_CONTROLLER_0_IAM_Rx, ComSignalType=UINT8
      RZCU_PTCANFD_10ms_FrP01_CONTROLLER_0_IAM_Rx (ComIPdu):
        ComIPduCancellationSupport = false
        ComIPduDirection = RECEIVE
        ComIPduHandleId = COM_RXPDU_COM_RZCU_PTCANFD_10ms_FrP01_CONTROLLER_0_IAM_Rx
        ComIPduSignalProcessing = DEFERRED
        ComIPduType = NORMAL
        ComIPduCallout = RZCU_PTCANFD_10ms_FrP01_CONTROLLER_0_IAM_Rx
        ComPduIdRef = COM_RZCU_PTCANFD_10ms_FrP01_CONTROLLER_0_IAM_Rx
        ComIPduSignalGroupRef = IRZCU_10ms_Group01_RZCU_PTCANFD_10ms_FrP01_CONTROLLER_0_IAM_Rx
        ComIPduGroupRef = Com_RxPduGroup_CONTROLLER_0_IAM
      IRZCU_10ms_Group01_RZCU_PTCANFD_10ms_FrP01_CONTROLLER_0_IAM_Rx (ComSignalGroup):
        ComHandleId = IRZCU_10ms_Group01_RZCU_PTCANFD_10ms_FrP01_CONTROLLER_0_IAM_Rx
        ComInvalidNotification = NULL_PTR
        ComRxDataTimeoutAction = NONE
        ComTransferProperty = PENDING
        ComDataInvalidAction = NOTIFY
        ComTimeout = 0.0
        ComFirstTimeout = 0.0
        ComNotification = Rte_COMCbk
        18 x ComGroupSignal, all with ComSignalEndianness=BIG_ENDIAN, ComSignalInitValue=0x0, ComSignalLength=0, ComSignalDataInvalidValue=0x0:
          IRZCU_10ms_Group01_CRC_IRZCU_10ms_Group01_RZCU_PTCANFD_10ms_FrP01_CONTROLLER_0_IAM_Rx: ComBitPosition=0, ComBitSize=8, ComHandleId=IRZCU_10ms_Group01_RZCU_PTCANFD_10ms_FrP01_CONTROLLER_0_IAM_Rx_IRZCU_10ms_Group01_CRC_IRZCU_10ms_Group01_RZCU_PTCANFD_10ms_FrP01_CONTROLLER_0_IAM_Rx, ComSignalType=UINT8
          IRZCU_10ms_Group01_RC_IRZCU_10ms_Group01_RZCU_PTCANFD_10ms_FrP01_CONTROLLER_0_IAM_Rx: ComBitPosition=8, ComBitSize=4, ComHandleId=IRZCU_10ms_Group01_RZCU_PTCANFD_10ms_FrP01_CONTROLLER_0_IAM_Rx_IRZCU_10ms_Group01_RC_IRZCU_10ms_Group01_RZCU_PTCANFD_10ms_FrP01_CONTROLLER_0_IAM_Rx, ComSignalType=UINT8
          IElecMotEmgcShutDwn_IRZCU_10ms_Group01_RZCU_PTCANFD_10ms_FrP01_CONTROLLER_0_IAM_Rx: ComBitPosition=12, ComBitSize=1, ComHandleId=IRZCU_10ms_Group01_RZCU_PTCANFD_10ms_FrP01_CONTROLLER_0_IAM_Rx_IElecMotEmgcShutDwn_IRZCU_10ms_Group01_RZCU_PTCANFD_10ms_FrP01_CONTROLLER_0_IAM_Rx, ComSignalType=BOOLEAN
          IEPTHVEmgcPwrOffReq_IRZCU_10ms_Group01_RZCU_PTCANFD_10ms_FrP01_CONTROLLER_0_IAM_Rx: ComBitPosition=13, ComBitSize=1, ComHandleId=IRZCU_10ms_Group01_RZCU_PTCANFD_10ms_FrP01_CONTROLLER_0_IAM_Rx_IEPTHVEmgcPwrOffReq_IRZCU_10ms_Group01_RZCU_PTCANFD_10ms_FrP01_CONTROLLER_0_IAM_Rx, ComSignalType=BOOLEAN
          IEPTMainRelayDrvReq_IRZCU_10ms_Group01_RZCU_PTCANFD_10ms_FrP01_CONTROLLER_0_IAM_Rx: ComBitPosition=14, ComBitSize=2, ComHandleId=IRZCU_10ms_Group01_RZCU_PTCANFD_10ms_FrP01_CONTROLLER_0_IAM_Rx_IEPTMainRelayDrvReq_IRZCU_10ms_Group01_RZCU_PTCANFD_10ms_FrP01_CONTROLLER_0_IAM_Rx, ComSignalType=UINT8
          IEPTStCmdOn_IRZCU_10ms_Group01_RZCU_PTCANFD_10ms_FrP01_CONTROLLER_0_IAM_Rx: ComBitPosition=16, ComBitSize=1, ComHandleId=IRZCU_10ms_Group01_RZCU_PTCANFD_10ms_FrP01_CONTROLLER_0_IAM_Rx_IEPTStCmdOn_IRZCU_10ms_Group01_RZCU_PTCANFD_10ms_FrP01_CONTROLLER_0_IAM_Rx, ComSignalType=BOOLEAN
          IEPTAccelActuPosV_IRZCU_10ms_Group01_RZCU_PTCANFD_10ms_FrP01_CONTROLLER_0_IAM_Rx: ComBitPosition=17, ComBitSize=1, ComHandleId=IRZCU_10ms_Group01_RZCU_PTCANFD_10ms_FrP01_CONTROLLER_0_IAM_Rx_IEPTAccelActuPosV_IRZCU_10ms_Group01_RZCU_PTCANFD_10ms_FrP01_CONTROLLER_0_IAM_Rx, ComSignalType=BOOLEAN
          IAutoChrgngMngmnt_IRZCU_10ms_Group01_RZCU_PTCANFD_10ms_FrP01_CONTROLLER_0_IAM_Rx: ComBitPosition=18, ComBitSize=2, ComHandleId=IRZCU_10ms_Group01_RZCU_PTCANFD_10ms_FrP01_CONTROLLER_0_IAM_Rx_IAutoChrgngMngmnt_IRZCU_10ms_Group01_RZCU_PTCANFD_10ms_FrP01_CONTROLLER_0_IAM_Rx, ComSignalType=UINT8
          IEPTBrkPdlDscrtInptStsV_IRZCU_10ms_Group01_RZCU_PTCANFD_10ms_FrP01_CONTROLLER_0_IAM_Rx: ComBitPosition=20, ComBitSize=1, ComHandleId=IRZCU_10ms_Group01_RZCU_PTCANFD_10ms_FrP01_CONTROLLER_0_IAM_Rx_IEPTBrkPdlDscrtInptStsV_IRZCU_10ms_Group01_RZCU_PTCANFD_10ms_FrP01_CONTROLLER_0_IAM_Rx, ComSignalType=BOOLEAN
          IEPTBrkPdlDscrtInptSts_IRZCU_10ms_Group01_RZCU_PTCANFD_10ms_FrP01_CONTROLLER_0_IAM_Rx: ComBitPosition=21, ComBitSize=1, ComHandleId=IRZCU_10ms_Group01_RZCU_PTCANFD_10ms_FrP01_CONTROLLER_0_IAM_Rx_IEPTBrkPdlDscrtInptSts_IRZCU_10ms_Group01_RZCU_PTCANFD_10ms_FrP01_CONTROLLER_0_IAM_Rx, ComSignalType=BOOLEAN
          IRVSEPTRdy_IRZCU_10ms_Group01_RZCU_PTCANFD_10ms_FrP01_CONTROLLER_0_IAM_Rx: ComBitPosition=22, ComBitSize=1, ComHandleId=IRZCU_10ms_Group01_RZCU_PTCANFD_10ms_FrP01_CONTROLLER_0_IAM_Rx_IRVSEPTRdy_IRZCU_10ms_Group01_RZCU_PTCANFD_10ms_FrP01_CONTROLLER_0_IAM_Rx, ComSignalType=BOOLEAN
          IEPTCrkAbotd_IRZCU_10ms_Group01_RZCU_PTCANFD_10ms_FrP01_CONTROLLER_0_IAM_Rx: ComBitPosition=23, ComBitSize=1, ComHandleId=IRZCU_10ms_Group01_RZCU_PTCANFD_10ms_FrP01_CONTROLLER_0_IAM_Rx_IEPTCrkAbotd_IRZCU_10ms_Group01_RZCU_PTCANFD_10ms_FrP01_CONTROLLER_0_IAM_Rx, ComSignalType=BOOLEAN
          IRZCU_10ms_Group01_Reserved1_IRZCU_10ms_Group01_RZCU_PTCANFD_10ms_FrP01_CONTROLLER_0_IAM_Rx: ComBitPosition=24, ComBitSize=5, ComHandleId=IRZCU_10ms_Group01_RZCU_PTCANFD_10ms_FrP01_CONTROLLER_0_IAM_Rx_IRZCU_10ms_Group01_Reserved1_IRZCU_10ms_Group01_RZCU_PTCANFD_10ms_FrP01_CONTROLLER_0_IAM_Rx, ComSignalType=UINT8
          IEPTHVDCDCMdReq_IRZCU_10ms_Group01_RZCU_PTCANFD_10ms_FrP01_CONTROLLER_0_IAM_Rx: ComBitPosition=29, ComBitSize=3, ComHandleId=IRZCU_10ms_Group01_RZCU_PTCANFD_10ms_FrP01_CONTROLLER_0_IAM_Rx_IEPTHVDCDCMdReq_IRZCU_10ms_Group01_RZCU_PTCANFD_10ms_FrP01_CONTROLLER_0_IAM_Rx, ComSignalType=UINT8
          IEPTAccelActuPos_IRZCU_10ms_Group01_RZCU_PTCANFD_10ms_FrP01_CONTROLLER_0_IAM_Rx: ComBitPosition=32, ComBitSize=8, ComHandleId=IRZCU_10ms_Group01_RZCU_PTCANFD_10ms_FrP01_CONTROLLER_0_IAM_Rx_IEPTAccelActuPos_IRZCU_10ms_Group01_RZCU_PTCANFD_10ms_FrP01_CONTROLLER_0_IAM_Rx, ComSignalType=UINT8
          IEPTAccelEfctvPos_IRZCU_10ms_Group01_RZCU_PTCANFD_10ms_FrP01_CONTROLLER_0_IAM_Rx: ComBitPosition=40, ComBitSize=8, ComHandleId=IRZCU_10ms_Group01_RZCU_PTCANFD_10ms_FrP01_CONTROLLER_0_IAM_Rx_IEPTAccelEfctvPos_IRZCU_10ms_Group01_RZCU_PTCANFD_10ms_FrP01_CONTROLLER_0_IAM_Rx, ComSignalType=UINT8
          IRZCU_10ms_Group01_Reserved2_IRZCU_10ms_Group01_RZCU_PTCANFD_10ms_FrP01_CONTROLLER_0_IAM_Rx: ComBitPosition=48, ComBitSize=8, ComHandleId=IRZCU_10ms_Group01_RZCU_PTCANFD_10ms_FrP01_CONTROLLER_0_IAM_Rx_IRZCU_10ms_Group01_Reserved2_IRZCU_10ms_Group01_RZCU_PTCANFD_10ms_FrP01_CONTROLLER_0_IAM_Rx, ComSignalType=UINT8
          IRZCU_10ms_Group01_Reserved3_IRZCU_10ms_Group01_RZCU_PTCANFD_10ms_FrP01_CONTROLLER_0_IAM_Rx: ComBitPosition=56, ComBitSize=8, ComHandleId=IRZCU_10ms_Group01_RZCU_PTCANFD_10ms_FrP01_CONTROLLER_0_IAM_Rx_IRZCU_10ms_Group01_Reserved3_IRZCU_10ms_Group01_RZCU_PTCANFD_10ms_FrP01_CONTROLLER_0_IAM_Rx, ComSignalType=UINT8
      IBS_CHCANFD_10ms_FrP04_CONTROLLER_0_IAM_Rx (ComIPdu):
        ComIPduCancellationSupport = false
        ComIPduDirection = RECEIVE
        ComIPduHandleId = COM_RXPDU_COM_IBS_CHCANFD_10ms_FrP04_CONTROLLER_0_IAM_Rx
        ComIPduSignalProcessing = DEFERRED
        ComIPduType = NORMAL
        ComIPduCallout = IBS_CHCANFD_10ms_FrP04_CONTROLLER_0_IAM_Rx
        ComPduIdRef = COM_IBS_CHCANFD_10ms_FrP04_CONTROLLER_0_IAM_Rx
        ComIPduSignalGroupRef = IIBS_10ms_Group04_IBS_CHCANFD_10ms_FrP04_CONTROLLER_0_IAM_Rx
        ComIPduGroupRef = Com_RxPduGroup_CONTROLLER_0_IAM
      IIBS_10ms_Group04_IBS_CHCANFD_10ms_FrP04_CONTROLLER_0_IAM_Rx (ComSignalGroup):
        ComHandleId = IIBS_10ms_Group04_IBS_CHCANFD_10ms_FrP04_CONTROLLER_0_IAM_Rx
        ComInvalidNotification = NULL_PTR
        ComRxDataTimeoutAction = NONE
        ComTransferProperty = PENDING
        ComDataInvalidAction = NOTIFY
        ComTimeout = 0.0
        ComFirstTimeout = 0.0
        ComNotification = Rte_COMCbk
        11 x ComGroupSignal, all with ComSignalEndianness=BIG_ENDIAN, ComSignalInitValue=0x0, ComSignalLength=0, ComSignalDataInvalidValue=0x0:
          IIBS_10ms_Group04_CRC_IIBS_10ms_Group04_IBS_CHCANFD_10ms_FrP04_CONTROLLER_0_IAM_Rx: ComBitPosition=0, ComBitSize=8, ComHandleId=IIBS_10ms_Group04_IBS_CHCANFD_10ms_FrP04_CONTROLLER_0_IAM_Rx_IIBS_10ms_Group04_CRC_IIBS_10ms_Group04_IBS_CHCANFD_10ms_FrP04_CONTROLLER_0_IAM_Rx, ComSignalType=UINT8
          IIBS_10ms_Group04_RC_IIBS_10ms_Group04_IBS_CHCANFD_10ms_FrP04_CONTROLLER_0_IAM_Rx: ComBitPosition=8, ComBitSize=4, ComHandleId=IIBS_10ms_Group04_IBS_CHCANFD_10ms_FrP04_CONTROLLER_0_IAM_Rx_IIBS_10ms_Group04_RC_IIBS_10ms_Group04_IBS_CHCANFD_10ms_FrP04_CONTROLLER_0_IAM_Rx, ComSignalType=UINT8
          IIBS_10ms_Group04_Reserved1_IIBS_10ms_Group04_IBS_CHCANFD_10ms_FrP04_CONTROLLER_0_IAM_Rx: ComBitPosition=12, ComBitSize=4, ComHandleId=IIBS_10ms_Group04_IBS_CHCANFD_10ms_FrP04_CONTROLLER_0_IAM_Rx_IIBS_10ms_Group04_Reserved1_IIBS_10ms_Group04_IBS_CHCANFD_10ms_FrP04_CONTROLLER_0_IAM_Rx, ComSignalType=UINT8
          IBrkPdlPos_IIBS_10ms_Group04_IBS_CHCANFD_10ms_FrP04_CONTROLLER_0_IAM_Rx: ComBitPosition=16, ComBitSize=8, ComHandleId=IIBS_10ms_Group04_IBS_CHCANFD_10ms_FrP04_CONTROLLER_0_IAM_Rx_IBrkPdlPos_IIBS_10ms_Group04_IBS_CHCANFD_10ms_FrP04_CONTROLLER_0_IAM_Rx, ComSignalType=UINT8
          IIBS_10ms_Group04_Reserved2_IIBS_10ms_Group04_IBS_CHCANFD_10ms_FrP04_CONTROLLER_0_IAM_Rx: ComBitPosition=24, ComBitSize=6, ComHandleId=IIBS_10ms_Group04_IBS_CHCANFD_10ms_FrP04_CONTROLLER_0_IAM_Rx_IIBS_10ms_Group04_Reserved2_IIBS_10ms_Group04_IBS_CHCANFD_10ms_FrP04_CONTROLLER_0_IAM_Rx, ComSignalType=UINT8
          IBrkSysBrkLghtsReqd_IIBS_10ms_Group04_IBS_CHCANFD_10ms_FrP04_CONTROLLER_0_IAM_Rx: ComBitPosition=30, ComBitSize=1, ComHandleId=IIBS_10ms_Group04_IBS_CHCANFD_10ms_FrP04_CONTROLLER_0_IAM_Rx_IBrkSysBrkLghtsReqd_IIBS_10ms_Group04_IBS_CHCANFD_10ms_FrP04_CONTROLLER_0_IAM_Rx, ComSignalType=BOOLEAN
          IBrkPdlPosV_IIBS_10ms_Group04_IBS_CHCANFD_10ms_FrP04_CONTROLLER_0_IAM_Rx: ComBitPosition=31, ComBitSize=1, ComHandleId=IIBS_10ms_Group04_IBS_CHCANFD_10ms_FrP04_CONTROLLER_0_IAM_Rx_IBrkPdlPosV_IIBS_10ms_Group04_IBS_CHCANFD_10ms_FrP04_CONTROLLER_0_IAM_Rx, ComSignalType=BOOLEAN
          IIBS_10ms_Group04_Reserved3_IIBS_10ms_Group04_IBS_CHCANFD_10ms_FrP04_CONTROLLER_0_IAM_Rx: ComBitPosition=32, ComBitSize=8, ComHandleId=IIBS_10ms_Group04_IBS_CHCANFD_10ms_FrP04_CONTROLLER_0_IAM_Rx_IIBS_10ms_Group04_Reserved3_IIBS_10ms_Group04_IBS_CHCANFD_10ms_FrP04_CONTROLLER_0_IAM_Rx, ComSignalType=UINT8
          IIBS_10ms_Group04_Reserved4_IIBS_10ms_Group04_IBS_CHCANFD_10ms_FrP04_CONTROLLER_0_IAM_Rx: ComBitPosition=40, ComBitSize=8, ComHandleId=IIBS_10ms_Group04_IBS_CHCANFD_10ms_FrP04_CONTROLLER_0_IAM_Rx_IIBS_10ms_Group04_Reserved4_IIBS_10ms_Group04_IBS_CHCANFD_10ms_FrP04_CONTROLLER_0_IAM_Rx, ComSignalType=UINT8
          IIBS_10ms_Group04_Reserved5_IIBS_10ms_Group04_IBS_CHCANFD_10ms_FrP04_CONTROLLER_0_IAM_Rx: ComBitPosition=48, ComBitSize=8, ComHandleId=IIBS_10ms_Group04_IBS_CHCANFD_10ms_FrP04_CONTROLLER_0_IAM_Rx_IIBS_10ms_Group04_Reserved5_IIBS_10ms_Group04_IBS_CHCANFD_10ms_FrP04_CONTROLLER_0_IAM_Rx, ComSignalType=UINT8
          IIBS_10ms_Group04_Reserved6_IIBS_10ms_Group04_IBS_CHCANFD_10ms_FrP04_CONTROLLER_0_IAM_Rx: ComBitPosition=56, ComBitSize=8, ComHandleId=IIBS_10ms_Group04_IBS_CHCANFD_10ms_FrP04_CONTROLLER_0_IAM_Rx_IIBS_10ms_Group04_Reserved6_IIBS_10ms_Group04_IBS_CHCANFD_10ms_FrP04_CONTROLLER_0_IAM_Rx, ComSignalType=UINT8
      PEU_PTCANFD_10ms_FrP04_SigGWtoCO_CONTROLLER_0_IAM_Rx (ComIPdu):
        ComIPduCancellationSupport = false
        ComIPduDirection = RECEIVE
        ComIPduHandleId = COM_RXPDU_COM_PEU_PTCANFD_10ms_FrP04_SigGWtoCO_CONTROLLER_0_IAM_Rx
        ComIPduSignalProcessing = DEFERRED
        ComIPduType = NORMAL
        ComPduIdRef = COM_PEU_PTCANFD_10ms_FrP04_SigGWtoCO_CONTROLLER_0_IAM_Rx
        ComIPduSignalRef = ISAMInvtrVolV_PEU_RZCUCANFD_CONN_PEU_PTCANFD_10ms_FrP04_SigGWtoCO_CONTROLLER_0_IAM_Rx
        ComIPduSignalRef = ISAMInvtrCrntV_PEU_RZCUCANFD_CON_PEU_PTCANFD_10ms_FrP04_SigGWtoCO_CONTROLLER_0_IAM_Rx
        ComIPduSignalRef = ISAMInvtrVol_PEU_RZCUCANFD_CONNC_PEU_PTCANFD_10ms_FrP04_SigGWtoCO_CONTROLLER_0_IAM_Rx
        ComIPduGroupRef = Com_RxPduGroup_CONTROLLER_0_IAM
      3 x ComSignal, all with ComInvalidNotification=NULL_PTR, ComRxDataTimeoutAction=NONE, ComSignalEndianness=BIG_ENDIAN, ComSignalInitValue=0x0, ComSignalLength=0, ComTransferProperty=PENDING, ComSignalDataInvalidValue=0x0, ComDataInvalidAction=NOTIFY, ComTimeout=0.0, ComFirstTimeout=0.0, ComNotification=Rte_COMCbk:
        ISAMInvtrVolV_PEU_RZCUCANFD_CONN_PEU_PTCANFD_10ms_FrP04_SigGWtoCO_CONTROLLER_0_IAM_Rx: ComBitPosition=27, ComBitSize=1, ComHandleId=ISAMInvtrVolV_PEU_RZCUCANFD_CONN_PEU_PTCANFD_10ms_FrP04_SigGWtoCO_CONTROLLER_0_IAM_Rx, ComSignalType=BOOLEAN
        ISAMInvtrCrntV_PEU_RZCUCANFD_CON_PEU_PTCANFD_10ms_FrP04_SigGWtoCO_CONTROLLER_0_IAM_Rx: ComBitPosition=28, ComBitSize=1, ComHandleId=ISAMInvtrCrntV_PEU_RZCUCANFD_CON_PEU_PTCANFD_10ms_FrP04_SigGWtoCO_CONTROLLER_0_IAM_Rx, ComSignalType=BOOLEAN
        ISAMInvtrVol_PEU_RZCUCANFD_CONNC_PEU_PTCANFD_10ms_FrP04_SigGWtoCO_CONTROLLER_0_IAM_Rx: ComBitPosition=54, ComBitSize=10, ComHandleId=ISAMInvtrVol_PEU_RZCUCANFD_CONNC_PEU_PTCANFD_10ms_FrP04_SigGWtoCO_CONTROLLER_0_IAM_Rx, ComSignalType=UINT16
      DLP_BDCAN_EvtInfo_CONTROLLER_0_IAM_Rx (ComIPdu):
        ComIPduCancellationSupport = false
        ComIPduDirection = RECEIVE
        ComIPduHandleId = COM_RXPDU_COM_DLP_BDCAN_EvtInfo_CONTROLLER_0_IAM_Rx
        ComIPduSignalProcessing = DEFERRED
        ComIPduType = NORMAL
        ComPduIdRef = COM_DLP_BDCAN_EvtInfo_CONTROLLER_0_IAM_Rx
        ComIPduSignalRef = IEvtPotclSigDLP_DLP_BDCAN_EvtInfo_CONTROLLER_0_IAM_Rx
        ComIPduGroupRef = Com_RxPduGroup_CONTROLLER_0_IAM
      IEvtPotclSigDLP_DLP_BDCAN_EvtInfo_CONTROLLER_0_IAM_Rx (ComSignal):
        ComBitPosition = 56
        ComBitSize = 64
        ComHandleId = IEvtPotclSigDLP_DLP_BDCAN_EvtInfo_CONTROLLER_0_IAM_Rx
        ComInvalidNotification = NULL_PTR
        ComRxDataTimeoutAction = NONE
        ComSignalEndianness = BIG_ENDIAN
        ComSignalInitValue = 0x0
        ComSignalLength = 0
        ComSignalType = UINT64
        ComTransferProperty = TRIGGERED
        ComSignalDataInvalidValue = 0x0
        ComDataInvalidAction = NOTIFY
        ComTimeout = 0.0
        ComFirstTimeout = 0.0
        ComNotification = Rte_COMCbk
      PEU_PTCANFD_5ms_FrP02_SigGwTOCON_CONTROLLER_0_IAM_Rx (ComIPdu):
        ComIPduCancellationSupport = false
        ComIPduDirection = RECEIVE
        ComIPduHandleId = COM_RXPDU_COM_PEU_PTCANFD_5ms_FrP02_SigGwTOCON_CONTROLLER_0_IAM_Rx
        ComIPduSignalProcessing = DEFERRED
        ComIPduType = NORMAL
        ComIPduCallout = PEU_PTCANFD_5ms_FrP02_SigGwTOCON_CONTROLLER_0_IAM_Rx
        ComPduIdRef = COM_PEU_PTCANFD_5ms_FrP02_SigGwTOCON_CONTROLLER_0_IAM_Rx
        ComIPduSignalRef = IPEU_ZONE_5ms_Group02_CRC_RZCUCA_PEU_PTCANFD_5ms_FrP02_SigGwTOCON_CONTROLLER_0_IAM_Rx
        ComIPduSignalRef = IPEU_ZONE_5ms_Group02_RC_RZCUCAN_PEU_PTCANFD_5ms_FrP02_SigGwTOCON_CONTROLLER_0_IAM_Rx
        ComIPduSignalRef = ISAMSta_PEU_RZCUCANFD_CONNCANFD_PEU_PTCANFD_5ms_FrP02_SigGwTOCON_CONTROLLER_0_IAM_Rx
        ComIPduSignalRef = ISAMSpd_PEU_RZCUCANFD_CONNCANFD_PEU_PTCANFD_5ms_FrP02_SigGwTOCON_CONTROLLER_0_IAM_Rx
        ComIPduSignalRef = ISAMActuToq_PEU_RZCUCANFD_CONNCA_PEU_PTCANFD_5ms_FrP02_SigGwTOCON_CONTROLLER_0_IAM_Rx
        ComIPduSignalRef = ISAMActuToqV_PEU_RZCUCANFD_CONNC_PEU_PTCANFD_5ms_FrP02_SigGwTOCON_CONTROLLER_0_IAM_Rx
        ComIPduSignalRef = ISAMDmpngCtrlA_PEU_RZCUCANFD_CON_PEU_PTCANFD_5ms_FrP02_SigGwTOCON_CONTROLLER_0_IAM_Rx
        ComIPduSignalRef = IPEU_ZONE_5ms_Group02_Reserved1__PEU_PTCANFD_5ms_FrP02_SigGwTOCON_CONTROLLER_0_IAM_Rx
        ComIPduSignalRef = ISAMSpdV_PEU_RZCUCANFD_CONNCANFD_PEU_PTCANFD_5ms_FrP02_SigGwTOCON_CONTROLLER_0_IAM_Rx
        ComIPduSignalRef = IPEU_ZONE_5ms_Group02_Reserved2__PEU_PTCANFD_5ms_FrP02_SigGwTOCON_CONTROLLER_0_IAM_Rx
        ComIPduSignalRef = ISAMFltLvlSts_PEU_RZCUCANFD_CONN_PEU_PTCANFD_5ms_FrP02_SigGwTOCON_CONTROLLER_0_IAM_Rx
        ComIPduSignalRef = IPEU_ZONE_5ms_Group02_Reserved3__PEU_PTCANFD_5ms_FrP02_SigGwTOCON_CONTROLLER_0_IAM_Rx
        ComIPduGroupRef = Com_RxPduGroup_CONTROLLER_0_IAM
      12 x ComSignal, all with ComInvalidNotification=NULL_PTR, ComRxDataTimeoutAction=NONE, ComSignalEndianness=BIG_ENDIAN, ComSignalInitValue=0x0, ComSignalLength=0, ComTransferProperty=PENDING, ComSignalDataInvalidValue=0x0, ComDataInvalidAction=NOTIFY, ComTimeout=0.0, ComFirstTimeout=0.0, ComNotification=Rte_COMCbk:
        IPEU_ZONE_5ms_Group02_CRC_RZCUCA_PEU_PTCANFD_5ms_FrP02_SigGwTOCON_CONTROLLER_0_IAM_Rx: ComBitPosition=0, ComBitSize=8, ComHandleId=IPEU_ZONE_5ms_Group02_CRC_RZCUCA_PEU_PTCANFD_5ms_FrP02_SigGwTOCON_CONTROLLER_0_IAM_Rx, ComSignalType=UINT8
        IPEU_ZONE_5ms_Group02_RC_RZCUCAN_PEU_PTCANFD_5ms_FrP02_SigGwTOCON_CONTROLLER_0_IAM_Rx: ComBitPosition=8, ComBitSize=4, ComHandleId=IPEU_ZONE_5ms_Group02_RC_RZCUCAN_PEU_PTCANFD_5ms_FrP02_SigGwTOCON_CONTROLLER_0_IAM_Rx, ComSignalType=UINT8
        ISAMSta_PEU_RZCUCANFD_CONNCANFD_PEU_PTCANFD_5ms_FrP02_SigGwTOCON_CONTROLLER_0_IAM_Rx: ComBitPosition=12, ComBitSize=4, ComHandleId=ISAMSta_PEU_RZCUCANFD_CONNCANFD_PEU_PTCANFD_5ms_FrP02_SigGwTOCON_CONTROLLER_0_IAM_Rx, ComSignalType=UINT8
        ISAMSpd_PEU_RZCUCANFD_CONNCANFD_PEU_PTCANFD_5ms_FrP02_SigGwTOCON_CONTROLLER_0_IAM_Rx: ComBitPosition=24, ComBitSize=16, ComHandleId=ISAMSpd_PEU_RZCUCANFD_CONNCANFD_PEU_PTCANFD_5ms_FrP02_SigGwTOCON_CONTROLLER_0_IAM_Rx, ComSignalType=UINT16
        ISAMActuToq_PEU_RZCUCANFD_CONNCA_PEU_PTCANFD_5ms_FrP02_SigGwTOCON_CONTROLLER_0_IAM_Rx: ComBitPosition=40, ComBitSize=11, ComHandleId=ISAMActuToq_PEU_RZCUCANFD_CONNCA_PEU_PTCANFD_5ms_FrP02_SigGwTOCON_CONTROLLER_0_IAM_Rx, ComSignalType=UINT16
        ISAMActuToqV_PEU_RZCUCANFD_CONNC_PEU_PTCANFD_5ms_FrP02_SigGwTOCON_CONTROLLER_0_IAM_Rx: ComBitPosition=35, ComBitSize=1, ComHandleId=ISAMActuToqV_PEU_RZCUCANFD_CONNC_PEU_PTCANFD_5ms_FrP02_SigGwTOCON_CONTROLLER_0_IAM_Rx, ComSignalType=BOOLEAN
        ISAMDmpngCtrlA_PEU_RZCUCANFD_CON_PEU_PTCANFD_5ms_FrP02_SigGwTOCON_CONTROLLER_0_IAM_Rx: ComBitPosition=36, ComBitSize=1, ComHandleId=ISAMDmpngCtrlA_PEU_RZCUCANFD_CON_PEU_PTCANFD_5ms_FrP02_SigGwTOCON_CONTROLLER_0_IAM_Rx, ComSignalType=BOOLEAN
        IPEU_ZONE_5ms_Group02_Reserved1__PEU_PTCANFD_5ms_FrP02_SigGwTOCON_CONTROLLER_0_IAM_Rx: ComBitPosition=37, ComBitSize=2, ComHandleId=IPEU_ZONE_5ms_Group02_Reserved1__PEU_PTCANFD_5ms_FrP02_SigGwTOCON_CONTROLLER_0_IAM_Rx, ComSignalType=UINT8
        ISAMSpdV_PEU_RZCUCANFD_CONNCANFD_PEU_PTCANFD_5ms_FrP02_SigGwTOCON_CONTROLLER_0_IAM_Rx: ComBitPosition=39, ComBitSize=1, ComHandleId=ISAMSpdV_PEU_RZCUCANFD_CONNCANFD_PEU_PTCANFD_5ms_FrP02_SigGwTOCON_CONTROLLER_0_IAM_Rx, ComSignalType=BOOLEAN
        IPEU_ZONE_5ms_Group02_Reserved2__PEU_PTCANFD_5ms_FrP02_SigGwTOCON_CONTROLLER_0_IAM_Rx: ComBitPosition=48, ComBitSize=4, ComHandleId=IPEU_ZONE_5ms_Group02_Reserved2__PEU_PTCANFD_5ms_FrP02_SigGwTOCON_CONTROLLER_0_IAM_Rx, ComSignalType=UINT8
        ISAMFltLvlSts_PEU_RZCUCANFD_CONN_PEU_PTCANFD_5ms_FrP02_SigGwTOCON_CONTROLLER_0_IAM_Rx: ComBitPosition=52, ComBitSize=4, ComHandleId=ISAMFltLvlSts_PEU_RZCUCANFD_CONN_PEU_PTCANFD_5ms_FrP02_SigGwTOCON_CONTROLLER_0_IAM_Rx, ComSignalType=UINT8
        IPEU_ZONE_5ms_Group02_Reserved3__PEU_PTCANFD_5ms_FrP02_SigGwTOCON_CONTROLLER_0_IAM_Rx: ComBitPosition=56, ComBitSize=8, ComHandleId=IPEU_ZONE_5ms_Group02_Reserved3__PEU_PTCANFD_5ms_FrP02_SigGwTOCON_CONTROLLER_0_IAM_Rx, ComSignalType=UINT8
      TC_PTCANFD_10ms_FrP01_SigGWTORZC_CONTROLLER_0_IAM_Rx (ComIPdu):
        ComIPduCancellationSupport = false
        ComIPduDirection = RECEIVE
        ComIPduHandleId = COM_RXPDU_COM_TC_PTCANFD_10ms_FrP01_SigGWTORZC_CONTROLLER_0_IAM_Rx
        ComIPduSignalProcessing = DEFERRED
        ComIPduType = NORMAL
        ComIPduCallout = TC_PTCANFD_10ms_FrP01_SigGWTORZC_CONTROLLER_0_IAM_Rx
        ComPduIdRef = COM_TC_PTCANFD_10ms_FrP01_SigGWTORZC_CONTROLLER_0_IAM_Rx
        ComIPduSignalRef = ITC_10ms_Group01_CRC_CONNCANFD_S_TC_PTCANFD_10ms_FrP01_SigGWTORZC_CONTROLLER_0_IAM_Rx
        ComIPduSignalRef = ITC_10ms_Group01_RC_CONNCANFD_SF_TC_PTCANFD_10ms_FrP01_SigGWTORZC_CONTROLLER_0_IAM_Rx
        ComIPduSignalRef = ITMFltLvlSts_CONNCANFD_SFCANFD_R_TC_PTCANFD_10ms_FrP01_SigGWTORZC_CONTROLLER_0_IAM_Rx
        ComIPduSignalRef = ITMActuToq_CONNCANFD_SFCANFD_RZC_TC_PTCANFD_10ms_FrP01_SigGWTORZC_CONTROLLER_0_IAM_Rx
        ComIPduSignalRef = ITMActuToqV_CONNCANFD_SFCANFD_RZ_TC_PTCANFD_10ms_FrP01_SigGWTORZC_CONTROLLER_0_IAM_Rx
        ComIPduSignalRef = ITMSta_CONNCANFD_SFCANFD_RZCUCAN_TC_PTCANFD_10ms_FrP01_SigGWTORZC_CONTROLLER_0_IAM_Rx
        ComIPduSignalRef = ITC_10ms_Group01_Reserved1_CONNC_TC_PTCANFD_10ms_FrP01_SigGWTORZC_CONTROLLER_0_IAM_Rx
        ComIPduSignalRef = ITMSpdV_CONNCANFD_SFCANFD_RZCUCA_TC_PTCANFD_10ms_FrP01_SigGWTORZC_CONTROLLER_0_IAM_Rx
        ComIPduSignalRef = ITMHVILSts_CONNCANFD_SFCANFD_RZC_TC_PTCANFD_10ms_FrP01_SigGWTORZC_CONTROLLER_0_IAM_Rx
        ComIPduSignalRef = ITMDmpngCtrlA_CONNCANFD_SFCANFD__TC_PTCANFD_10ms_FrP01_SigGWTORZC_CONTROLLER_0_IAM_Rx
        ComIPduSignalRef = ITMSpd_CONNCANFD_SFCANFD_RZCUCAN_TC_PTCANFD_10ms_FrP01_SigGWTORZC_CONTROLLER_0_IAM_Rx
        ComIPduSignalRef = ITC_10ms_Group01_Reserved{2..8}_CONNC_TC_PTCANFD_10ms_FrP01_SigGWTORZC_CONTROLLER_0_IAM_Rx
        ComIPduSignalRef = ITC_10ms_Group01_Reserved10_CONN_TC_PTCANFD_10ms_FrP01_SigGWTORZC_CONTROLLER_0_IAM_Rx
        ComIPduSignalRef = ITMSenLossEn_CONNCANFD_SFCANFD_R_TC_PTCANFD_10ms_FrP01_SigGWTORZC_CONTROLLER_0_IAM_Rx
        ComIPduSignalRef = ITC_10ms_Group01_Reserved9_CONNC_TC_PTCANFD_10ms_FrP01_SigGWTORZC_CONTROLLER_0_IAM_Rx
        ComIPduSignalRef = ITC_10ms_Group01_Reserved11_CONN_TC_PTCANFD_10ms_FrP01_SigGWTORZC_CONTROLLER_0_IAM_Rx
        ComIPduGroupRef = Com_RxPduGroup_CONTROLLER_0_IAM
      22 x ComSignal, all with ComInvalidNotification=NULL_PTR, ComRxDataTimeoutAction=NONE, ComSignalEndianness=BIG_ENDIAN, ComSignalInitValue=0x0, ComSignalLength=0, ComTransferProperty=PENDING, ComSignalDataInvalidValue=0x0, ComDataInvalidAction=NOTIFY, ComTimeout=0.0, ComFirstTimeout=0.0, ComNotification=Rte_COMCbk:
        ITC_10ms_Group01_CRC_CONNCANFD_S_TC_PTCANFD_10ms_FrP01_SigGWTORZC_CONTROLLER_0_IAM_Rx: ComBitPosition=0, ComBitSize=8, ComHandleId=ITC_10ms_Group01_CRC_CONNCANFD_S_TC_PTCANFD_10ms_FrP01_SigGWTORZC_CONTROLLER_0_IAM_Rx, ComSignalType=UINT8
        ITC_10ms_Group01_RC_CONNCANFD_SF_TC_PTCANFD_10ms_FrP01_SigGWTORZC_CONTROLLER_0_IAM_Rx: ComBitPosition=8, ComBitSize=4, ComHandleId=ITC_10ms_Group01_RC_CONNCANFD_SF_TC_PTCANFD_10ms_FrP01_SigGWTORZC_CONTROLLER_0_IAM_Rx, ComSignalType=UINT8
        ITMFltLvlSts_CONNCANFD_SFCANFD_R_TC_PTCANFD_10ms_FrP01_SigGWTORZC_CONTROLLER_0_IAM_Rx: ComBitPosition=12, ComBitSize=4, ComHandleId=ITMFltLvlSts_CONNCANFD_SFCANFD_R_TC_PTCANFD_10ms_FrP01_SigGWTORZC_CONTROLLER_0_IAM_Rx, ComSignalType=UINT8
        ITMActuToq_CONNCANFD_SFCANFD_RZC_TC_PTCANFD_10ms_FrP01_SigGWTORZC_CONTROLLER_0_IAM_Rx: ComBitPosition=24, ComBitSize=11, ComHandleId=ITMActuToq_CONNCANFD_SFCANFD_RZC_TC_PTCANFD_10ms_FrP01_SigGWTORZC_CONTROLLER_0_IAM_Rx, ComSignalType=UINT16
        ITMActuToqV_CONNCANFD_SFCANFD_RZ_TC_PTCANFD_10ms_FrP01_SigGWTORZC_CONTROLLER_0_IAM_Rx: ComBitPosition=19, ComBitSize=1, ComHandleId=ITMActuToqV_CONNCANFD_SFCANFD_RZ_TC_PTCANFD_10ms_FrP01_SigGWTORZC_CONTROLLER_0_IAM_Rx, ComSignalType=BOOLEAN
        ITMSta_CONNCANFD_SFCANFD_RZCUCAN_TC_PTCANFD_10ms_FrP01_SigGWTORZC_CONTROLLER_0_IAM_Rx: ComBitPosition=20, ComBitSize=4, ComHandleId=ITMSta_CONNCANFD_SFCANFD_RZCUCAN_TC_PTCANFD_10ms_FrP01_SigGWTORZC_CONTROLLER_0_IAM_Rx, ComSignalType=UINT8
        ITC_10ms_Group01_Reserved1_CONNC_TC_PTCANFD_10ms_FrP01_SigGWTORZC_CONTROLLER_0_IAM_Rx: ComBitPosition=32, ComBitSize=4, ComHandleId=ITC_10ms_Group01_Reserved1_CONNC_TC_PTCANFD_10ms_FrP01_SigGWTORZC_CONTROLLER_0_IAM_Rx, ComSignalType=UINT8
        ITMSpdV_CONNCANFD_SFCANFD_RZCUCA_TC_PTCANFD_10ms_FrP01_SigGWTORZC_CONTROLLER_0_IAM_Rx: ComBitPosition=36, ComBitSize=1, ComHandleId=ITMSpdV_CONNCANFD_SFCANFD_RZCUCA_TC_PTCANFD_10ms_FrP01_SigGWTORZC_CONTROLLER_0_IAM_Rx, ComSignalType=BOOLEAN
        ITMHVILSts_CONNCANFD_SFCANFD_RZC_TC_PTCANFD_10ms_FrP01_SigGWTORZC_CONTROLLER_0_IAM_Rx: ComBitPosition=37, ComBitSize=2, ComHandleId=ITMHVILSts_CONNCANFD_SFCANFD_RZC_TC_PTCANFD_10ms_FrP01_SigGWTORZC_CONTROLLER_0_IAM_Rx, ComSignalType=UINT8
        ITMDmpngCtrlA_CONNCANFD_SFCANFD__TC_PTCANFD_10ms_FrP01_SigGWTORZC_CONTROLLER_0_IAM_Rx: ComBitPosition=39, ComBitSize=1, ComHandleId=ITMDmpngCtrlA_CONNCANFD_SFCANFD__TC_PTCANFD_10ms_FrP01_SigGWTORZC_CONTROLLER_0_IAM_Rx, ComSignalType=BOOLEAN
        ITMSpd_CONNCANFD_SFCANFD_RZCUCAN_TC_PTCANFD_10ms_FrP01_SigGWTORZC_CONTROLLER_0_IAM_Rx: ComBitPosition=48, ComBitSize=16, ComHandleId=ITMSpd_CONNCANFD_SFCANFD_RZCUCAN_TC_PTCANFD_10ms_FrP01_SigGWTORZC_CONTROLLER_0_IAM_Rx, ComSignalType=UINT16
        ITC_10ms_Group01_Reserved2_CONNC_TC_PTCANFD_10ms_FrP01_SigGWTORZC_CONTROLLER_0_IAM_Rx: ComBitPosition=56, ComBitSize=8, ComHandleId=ITC_10ms_Group01_Reserved2_CONNC_TC_PTCANFD_10ms_FrP01_SigGWTORZC_CONTROLLER_0_IAM_Rx, ComSignalType=UINT8
        ITC_10ms_Group01_Reserved3_CONNC_TC_PTCANFD_10ms_FrP01_SigGWTORZC_CONTROLLER_0_IAM_Rx: ComBitPosition=64, ComBitSize=8, ComHandleId=ITC_10ms_Group01_Reserved3_CONNC_TC_PTCANFD_10ms_FrP01_SigGWTORZC_CONTROLLER_0_IAM_Rx, ComSignalType=UINT8
        ITC_10ms_Group01_Reserved4_CONNC_TC_PTCANFD_10ms_FrP01_SigGWTORZC_CONTROLLER_0_IAM_Rx: ComBitPosition=72, ComBitSize=8, ComHandleId=ITC_10ms_Group01_Reserved4_CONNC_TC_PTCANFD_10ms_FrP01_SigGWTORZC_CONTROLLER_0_IAM_Rx, ComSignalType=UINT8
        ITC_10ms_Group01_Reserved5_CONNC_TC_PTCANFD_10ms_FrP01_SigGWTORZC_CONTROLLER_0_IAM_Rx: ComBitPosition=80, ComBitSize=8, ComHandleId=ITC_10ms_Group01_Reserved5_CONNC_TC_PTCANFD_10ms_FrP01_SigGWTORZC_CONTROLLER_0_IAM_Rx, ComSignalType=UINT8
        ITC_10ms_Group01_Reserved6_CONNC_TC_PTCANFD_10ms_FrP01_SigGWTORZC_CONTROLLER_0_IAM_Rx: ComBitPosition=88, ComBitSize=8, ComHandleId=ITC_10ms_Group01_Reserved6_CONNC_TC_PTCANFD_10ms_FrP01_SigGWTORZC_CONTROLLER_0_IAM_Rx, ComSignalType=UINT8
        ITC_10ms_Group01_Reserved7_CONNC_TC_PTCANFD_10ms_FrP01_SigGWTORZC_CONTROLLER_0_IAM_Rx: ComBitPosition=96, ComBitSize=8, ComHandleId=ITC_10ms_Group01_Reserved7_CONNC_TC_PTCANFD_10ms_FrP01_SigGWTORZC_CONTROLLER_0_IAM_Rx, ComSignalType=UINT8
        ITC_10ms_Group01_Reserved8_CONNC_TC_PTCANFD_10ms_FrP01_SigGWTORZC_CONTROLLER_0_IAM_Rx: ComBitPosition=104, ComBitSize=8, ComHandleId=ITC_10ms_Group01_Reserved8_CONNC_TC_PTCANFD_10ms_FrP01_SigGWTORZC_CONTROLLER_0_IAM_Rx, ComSignalType=UINT8
        ITC_10ms_Group01_Reserved10_CONN_TC_PTCANFD_10ms_FrP01_SigGWTORZC_CONTROLLER_0_IAM_Rx: ComBitPosition=112, ComBitSize=5, ComHandleId=ITC_10ms_Group01_Reserved10_CONN_TC_PTCANFD_10ms_FrP01_SigGWTORZC_CONTROLLER_0_IAM_Rx, ComSignalType=UINT8
        ITMSenLossEn_CONNCANFD_SFCANFD_R_TC_PTCANFD_10ms_FrP01_SigGWTORZC_CONTROLLER_0_IAM_Rx: ComBitPosition=117, ComBitSize=1, ComHandleId=ITMSenLossEn_CONNCANFD_SFCANFD_R_TC_PTCANFD_10ms_FrP01_SigGWTORZC_CONTROLLER_0_IAM_Rx, ComSignalType=BOOLEAN
        ITC_10ms_Group01_Reserved9_CONNC_TC_PTCANFD_10ms_FrP01_SigGWTORZC_CONTROLLER_0_IAM_Rx: ComBitPosition=118, ComBitSize=2, ComHandleId=ITC_10ms_Group01_Reserved9_CONNC_TC_PTCANFD_10ms_FrP01_SigGWTORZC_CONTROLLER_0_IAM_Rx, ComSignalType=UINT8
        ITC_10ms_Group01_Reserved11_CONN_TC_PTCANFD_10ms_FrP01_SigGWTORZC_CONTROLLER_0_IAM_Rx: ComBitPosition=120, ComBitSize=8, ComHandleId=ITC_10ms_Group01_Reserved11_CONN_TC_PTCANFD_10ms_FrP01_SigGWTORZC_CONTROLLER_0_IAM_Rx, ComSignalType=UINT8
      RZCU_RZCUCANFD_10ms_FrP22_NoSecOC_CONTROLLER_0_IAM_Rx (ComIPdu):
        ComIPduCancellationSupport = false
        ComIPduDirection = RECEIVE
        ComIPduHandleId = COM_RXPDU_COM_RZCU_RZCUCANFD_10ms_FrP22_NoSecO_CONTROLLER_0_IAM_Rx
        ComIPduSignalProcessing = DEFERRED
        ComIPduType = NORMAL
        ComIPduCallout = RZCU_RZCUCANFD_10ms_FrP22_NoSecOC_CONTROLLER_0_IAM_Rx
        ComPduIdRef = COM_RZCU_RZCUCANFD_10ms_FrP22_NoSecO_CONTROLLER_0_IAM_Rx
        ComIPduSignalGroupRef = IRZCU_10ms_Group22_RZCU_RZCUCANFD_10ms_FrP22_NoSecO_CONTROLLER_0_IAM_Rx
        ComIPduGroupRef = Com_RxPduGroup_CONTROLLER_0_IAM
