AUTOSAR XML (schema 00049)
package /Renesas/EcucDefs_Mcu
  module config Mcu0: definition=Mcu, implementation-config-variant=VARIANT-POST-BUILD-LOADABLE, module-description=Mcu_Impl
    McuGeneralConfiguration0 (McuGeneralConfiguration):
      McuClm0MonitoringClockAccuracy = 9
      McuClm0Operation = true
      McuClm0SamplingClockAccuracy = 9
      McuClm1MonitoringClockAccuracy = 5
      McuClm1Operation = true
      McuClm1SamplingClockAccuracy = 8
      McuClm2MonitoringClockAccuracy = 14
      McuClm2Operation = false
      McuClm2SamplingClockAccuracy = 14
      McuClm3MonitoringClockAccuracy = 14
      McuClm3Operation = false
      McuClm3SamplingClockAccuracy = 14
      McuCopyToSection = false
      McuCriticalSectionProtection = true
      McuCvmHighVoltageDetect = false
      McuCvmLowVoltageDetect = false
      McuDevErrorDetect = true
      McuDeviceName = R7F701649
      McuGetRamStateApi = false
      McuInitClock = true
      McuLoopCount = 5
      McuLowPowerSequencerOperation = true
      McuNoPll = false
      McuPerformResetApi = true
      McuPortGroupStatusBackUp = false
      McuRAMMirror = ENABLE
      McuResetReasonMultipleResets = false
      McuRetentionRamSourceAddress = 65536
      McuSwResetCallApi = false
      McuUseWriteVerifyErrorInterface = true
      McuVersionCheckExternalModules = true
      McuVersionInfoApi = true
      McuWakeUpFactorClearIsr = false
      McuWakeUpFactorsClearCentralised = true
      McuWriteVerify = WV_INIT_RUNTIME
      McuWriteVerifyErrorInterface = Mcu_WVError
    McuModuleConfiguration0 (McuModuleConfiguration):
      McuClockSrcFailureNotification = DISABLED
      McuCyclicRunModeBaseAddress = 4273963008
      McuLviDetectionLevel = DETECTION_LEVEL_0
      McuLviResetMask = RESET_REQUEST
      McuNumberOfMcuModes = 1
      McuRamSectors = 1
      McuResetSetting = 1
      McuRetentionRamAddress = 4273963008
      McuClockSettingConfig0 (McuClockSettingConfig):
        Mcu8MhzRingStopRequestMask = false
        McuClkModeSelect = MCU_CPLLCLK_ID_3
        McuClockSettingId = 0
        McuCpuClockDivider = DIVBY_1_ID_1
        McuCpuMainSysClk = 80000000
        McuOPBT0 = 3123183567
        McuUnitName = CPUCLK
        McuAwoAdca00 (McuAwoAdca0): McuDivClockSel=DIVBY_1_ID_1, McuPeripheralClock=8000000, McuSrcClockSel=FRH_ID_1, McuStopRequestMask=true, McuUnitName=ADCA
        McuAwoFout0 (McuAwoFout): McuFoutDivider=1, McuPeripheralClock=16000000, McuSrcClockSel=FX_ID_1, McuStopRequestMask=true, McuUnitName=FOUT
        McuAwoRtca0 (McuAwoRtca): McuDivClockSel=DIVBY_1_ID_1, McuPeripheralClock=16000000, McuSrcClockSel=FX_ID_2, McuStopRequestMask=true, McuUnitName=RTCA
        McuAwoTauj0 (McuAwoTauj): McuDivClockSel=DIVBY_1_ID_1, McuPeripheralClock=16000000, McuSrcClockSel=FX_ID_2, McuStopRequestMask=true, McuUnitName=TAUJ
        McuAwoWdta0 (McuAwoWdta): McuDivClockSel=DIVBY_128_ID_1, McuPeripheralClock=1875, McuStopRequestMask=true, McuUnitName=WDTA
        McuClockReferencePoint0 (McuClockReferencePoint): McuClockReferencePointFrequency=40000000
        McuIsoCan0 (McuIsoCan): McuPeripheralClock=80000000, McuSrcClockSel=PPLLCLK_DIVBY_1_ID_3, McuStopRequestMask=true, McuUnitName=CAN
        McuIsoCanosc0 (McuIsoCanosc): McuDivClockSel=DIVBY_1_ID_1, McuPeripheralClock=16000000, McuStopRequestMask=true, McuUnitName=CANOSC
        McuIsoCsi0 (McuIsoCsi): McuPeripheralClock=16000000, McuSrcClockSel=FX_ID_3, McuUnitName=CSI
        McuIsoLin0 (McuIsoLin): McuPeripheralClock=16000000, McuSrcClockSel=FX_ID_2, McuStopRequestMask=true, McuUnitName=LIN
        McuIsoLin30 (McuIsoLin3): McuDivClockSel=DIVBY_1_ID_1, McuPeripheralClock=16000000, McuUnitName=LIN3
        McuIsoLrosc0 (McuIsoLrosc): McuPeripheralClock=240000
        McuIsoPeri10 (McuIsoPeri1): McuPeripheralClock=80000000, McuSrcClockSel=PPLLCLK_DIVBY_1_ID_1, McuUnitName=PERI1
        McuIsoPeri20 (McuIsoPeri2): McuPeripheralClock=40000000, McuSrcClockSel=PPLLCLK_DIVBY_2_ID_1, McuUnitName=PERI2
        McuMainOscSetting0 (McuMainOscSetting): McuMainOscAmplificationGain=LOW_ID_2, McuMainOsciFrequency=16000000, McuMainOscStabTimeSetting=131071, McuMainOscStopRequestMask=true
        McuPll0Setting0 (McuPll0Setting):
          McuCpll0Clk = 80000000
          McuCpllDivider = P_VALUE_6
          McuPll0Divider = DIV_BY_6
          McuPll0InputClockSelection = MCU_SELECT_MOSC
          McuPll0MrValue = 2
          McuPll0NrValue = NR_VAL_60
          McuPll0Out = 80000000
          McuPllFreqModCycleSetting = 0
          McuPllFreqModRange = 0
        McuPllSetting0 (McuPllSetting):
          McuCpllClk = 80000000
          McuCpllDivider = P_VALUE_6
          McuPllInputClockSelection = MCU_SELECT_MOSC
          McuPllMrValue = 2
          McuPllNrValue = NR_VAL_60
          McuPpllClk = 80000000
          McuPpllDivider = DIV_BY_6
          McuPpllOut = 80000000
          McuPpllSrcClock = MCU_PPLLOUT_ID_3
      McuDemEventParameterRefs0 (McuDemEventParameterRefs):
        MCU_E_CLOCK_FAILURE = DemEventParameter0
        MCU_E_CVM_SETTING_FAILURE = DemEventParameter3
        MCU_E_INCONCISTENCY_RESF_FAILURE = DemEventParameter4
        MCU_E_LVI_FAILURE = DemEventParameter2
        MCU_E_REG_WRITE_VERIFY = DemEventParameter5
        MCU_E_WRITE_TIMEOUT_FAILURE = DemEventParameter1
      McuLowPowerSequencer0 (McuLowPowerSequencer):
        McuChannelClk = CK0
        McuINTCWENDEnable = true
        McuPrescalerCk{0..2} = PCLK_DIVBY_2_POWOF_15
        McuPrescalerCk3BaudRate = 255
        McuPrescalerCk3Pre = PCLK_DIVBY_2_POWOF_15
        McuPreScaleReq = true
        McuSequencerDpins = 80
        McuTauj0TimerCount = 0
        McuTaujInterruptSelector = INTTAUJ0I0
        McuDigitalInputMode0 (McuDigitalInputMode): McuDigitalExtSensorStableTime=0, McuExternalMultiplexerSupport=MCU_WITHOUT_EXTERN_MULTIPLEXER
        McuDigitalinputSelectionZero0 (McuDigitalinputSelectionZero): McuDigitalInputData=false, McuDigitalInputPins=DPIN0
      3 x McuModeSettingConf, all with McuMainOscOperation=true, McuModeTransitionReq=true, McuWakeUpFactor1=false, McuWakeUpFactor2=false, McuWakeUpFactorIso0=false:
        McuModeSettingConf0: McuMode=0, McuModeType=HALT_MODE, McuWakeUpFactor0=true
          McuWakeUpFactor0Details0 (McuWakeUpFactor0Details): McuWakeUpFactor0Name=INTTAUJ0I0_WUF0_15
        McuModeSettingConf1: McuMode=1, McuModeType=HALT_MODE, McuWakeUpFactor0=true
          McuWakeUpFactor0Details0 (McuWakeUpFactor0Details): McuWakeUpFactor0Name=INTTAUJ0I0_WUF0_15
        McuModeSettingConf2: McuMode=2, McuModeType=RUN_MODE, McuWakeUpFactor0=false
      McuPortGroupConf0 (McuPortGroupConf): McuPortGroupName=PORTGROUP_9
    McuPublishedInformation0 (McuPublishedInformation)
      McuResetReasonConf0 (McuResetReasonConf): McuResetReason=0
      McuRstRsnConfClm00 (McuRstRsnConfClm0): McuResetReason=4
      McuRstRsnConfClm10 (McuRstRsnConfClm1): McuResetReason=5
      McuRstRsnConfClm20 (McuRstRsnConfClm2): McuResetReason=6
      McuRstRsnConfClm30 (McuRstRsnConfClm3): McuResetReason=15
      McuRstRsnConfCvm0 (McuRstRsnConfCvm): McuResetReason=8
      McuRstRsnConfIso0 (McuRstRsnConfIso): McuResetReason=11
      McuRstRsnConfLvi0 (McuRstRsnConfLvi): McuResetReason=7
      McuRstRsnConfMultipleResets0 (McuRstRsnConfMultipleResets): McuResetReason=17
      McuRstRsnConfPOR0 (McuRstRsnConfPOR): McuResetReason=10
      McuRstRsnConfResf110 (McuRstRsnConfResf11): McuResetReason=12
      McuRstRsnConfResf120 (McuRstRsnConfResf12): McuResetReason=13
      McuRstRsnConfResf130 (McuRstRsnConfResf13): McuResetReason=14
      McuRstRsnConfSwRst0 (McuRstRsnConfSwRst): McuResetReason=1
      McuRstRsnConfTer0 (McuRstRsnConfTer): McuResetReason=9
      McuRstRsnConfUndef0 (McuRstRsnConfUndef): McuResetReason=16
      McuRstRsnConfUnknown0 (McuRstRsnConfUnknown): McuResetReason=18
      McuRstRsnConfWdta00 (McuRstRsnConfWdta0): McuResetReason=2
      McuRstRsnConfWdta10 (McuRstRsnConfWdta1): McuResetReason=3
    McuRamInitConfiguration0 (McuRamInitConfiguration): McuRamInitBaseAddress=4273864704, McuRamInitSize=256, McuRamInitValue=255, McuRamTypeSelection=CPU_LOCAL_RAM, McuRamWriteSizeSel=BIT_8
