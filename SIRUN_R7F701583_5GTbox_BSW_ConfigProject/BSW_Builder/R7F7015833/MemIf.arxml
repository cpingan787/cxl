AUTOSAR XML (schema 00048)
package /R7F7015833
  module config MemIf
    MemIfGeneral:
      MemIfGeneralDevErrorDetect = false
      MemIfGeneralNumberOfDevices = 1
      MemIfGeneralVersionInfoApi = false
      MemIfGeneralUseFunciontApi = false
      MemIfGeneralFeeMapSupport = true
      MemIfGeneralEaMapSupport = false
